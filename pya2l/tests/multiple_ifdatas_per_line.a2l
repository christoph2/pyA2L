/begin MEASUREMENT BitSlice "Testsignal: 4 Bit on a byte boundary" UWORD BitSlice.CONVERSION 0 0 0 15 BIT_MASK 0x3C0 BYTE_ORDER MSB_LAST ECU_ADDRESS 0x125438 FORMAT "%.3" SYMBOL_LINK "wordCounter" 0 /end MEASUREMENT
/begin MEASUREMENT BitSlice0 "Testsignal: 5 Bit" UWORD BitSlice.CONVERSION 0 0 0 31 BIT_MASK 0x1F BYTE_ORDER MSB_LAST ECU_ADDRESS 0x125438 FORMAT "%.3" SYMBOL_LINK "wordCounter" 0 /end MEASUREMENT
/begin MEASUREMENT BitSlice1 "Testsignal: 5 Bit " UWORD BitSlice.CONVERSION 0 0 0 31 BIT_MASK 0x3E0 BYTE_ORDER MSB_LAST ECU_ADDRESS 0x125438 FORMAT "%.3" SYMBOL_LINK "wordCounter" 0 /end MEASUREMENT
