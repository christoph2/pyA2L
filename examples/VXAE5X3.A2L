/begin PROJECT DPU-2XX "Visteon Diesel"
/* Keyword REQUIRED; value ignored*/
/begin HEADER " " VERSION "1" PROJECT_NO Global /end HEADER
/begin MODULE ENGINE "International Engine Controller"
/* Keyword REQUIRED; MODULE Name "LongIdentifier" */
/begin MOD_PAR "Engine" /* Keyword RECOMMENDED; MOD_PAR "Comment" */ VERSION "AP1" /* VERSION "Version Identifier" */ ADDR_EPK 0x7FFF0 /* start address of EPROM label;
/* value at addr read and cmp w/ below */ EPK " " /* value EPROM label */ CUSTOMER_NO " " /* CUSTOMER_NO "Customer Number" */ USER "Ford" /* USER "User" */ PHONE_NO "734-302-2059" /* PHONE_NO "Phone number of responsible engineer" */ CPU_TYPE "MPC555" /* CPU_TYPE "CPU" */ ECU "DPU-2XX" /* ECU "Control unit" */ /* MEMORY_SEGMENT */ /* For a correct working of the ETK, the following MEMORY_SEGMENTs have to */ /* be specified in the section 'MOD_PAR' of the ASAP2 file: */ /* Dataxxxx "" DATA FLASH <mem. location> <address> <size> <mirrors(5)> */ /* Codexxxx "" CODE FLASH <mem. location> <address> <size> <mirrors(5)> */ /* ExRAM "ExRAM for DISTAB" */ /* VARIABLES RAM EXTERN <address> <size> <mirrors(5)> */ /* Remark: All data included in a hex file, but not specified by a memory */ /* segment will be ignored inside the application program and lost */ /* when generating hex file export */ /begin MEMORY_SEGMENT RTOS_rprg "" CODE FLASH INTERN 0x0 0x10000 -1 -1 -1 -1 -1 /end MEMORY_SEGMENT
 /begin MEMORY_SEGMENT Strategy "" CODE FLASH INTERN 0x10000 0x30800 -1 -1 -1 -1 -1 /end MEMORY_SEGMENT
 /begin MEMORY_SEGMENT Calibration "" DATA FLASH EXTERN 0x0040800 0x1F800 -1 -1 -1 -1 -1
  /begin IF_DATA ETK ADDRESS_MAPPING /*orig_adr:*/ 0x0040800 /*mapping_adr*/ 0x7FF80800 /*length*/ 0x1F800 /end IF_DATA
 /end MEMORY_SEGMENT
 /begin MEMORY_SEGMENT ExRAM "ExRAM for DISTAB" VARIABLES RAM EXTERN 0x7FF80000 0x800 -1 -1 -1 -1 -1 /end MEMORY_SEGMENT
 /begin MEMORY_SEGMENT RAM "" VARIABLES RAM INTERN 0x003f9800 0x6800 -1 -1 -1 -1 -1 /end MEMORY_SEGMENT
/end MOD_PAR
/begin MOD_COMMON " " BYTE_ORDER MSB_FIRST /end MOD_COMMON
/begin IF_DATA ETK
 /begin TP_BLOB /*version: fixed*/ 0x1000002 /*pba: Project Base Address*/ 0x0 /*reset_cfg: PPC only*/ 0x0
  /begin DISTAB_CFG /*dsptab: type number*/ 0xD /*dat_mod: */ 0x0111 /*rfg: 1=high byte first*/ 0x1 /*trgsegad: TrigSegAddr*/ 0x7FF80400 /*trg_cfg: */ 0x01010100 /*trg_mod: 3 rast*/ TRG_MOD 0x0 0x27 0x0 0x0 0x0 /end DISTAB_CFG
  CODE_CHK /*prg_data:*/ 0x0 /*prg_length:*/ 0x0 /*prg_eram:*/ 0x0 /*prg_length:*/ 0x0 /* Used for programs without code emulation to check compatibility with Project files*/ ETK_CFG 0xFF 0xFF 0xFF 0xFF 0xFF 0xFF 0xFF 0xFF 0xFF 0xFF 0xFF 0xFF 0xFF 0xFF 0xFF 0xFF 0xFF 0xFF 0xFF 0xFF 0xFF 0xFF 0xFF 0xFF /* no config string for ETKP2 */ /* no CRC-Check via display table use RESERVED ...Length_of_Distab13 = (maxnum+2)*4 */ /* RESERVED **start_addr:** 0x7E174 **length:** 0x300 EXTERN -1 -1 -1 -1 -1 */ /* ETK_MAILBOX used for ETK flashing
** **pattern:** 0x55555555
** **page_ecu:** DATA
** **ecu_adr:** 0x600000
** **..length:** 0x8000
** **page_am:** EXRAM
** **am_adr:** 0x620000
** **..length:** 0x8000
*/
  /begin ETK_PRESENCE_CHECK 0x7FF80040 /* This is the start address of the pattern */ ETK_PATTERN 0x5A 0x5A 0xA5 0x5A 0xFA 0x05 /* first 32bits Calvin Signature Value, next 16bits Command Code
= 0xFA05 remap cal space to expernal memory */ /end ETK_PRESENCE_CHECK
 /end TP_BLOB
 /begin SOURCE "PIP" 103 1 QP_BLOB 1 0x38 0x7FF80800 0x7FF80600 0x7FF80440 0 0 0 /end SOURCE
 /begin SOURCE "8ms" 4 1 QP_BLOB 2 0x58 0x7FF808E8 0x7FF80638 0x7FF80442 10 0 0 /end SOURCE
 /begin SOURCE "Background" 5 1 QP_BLOB 3 0x58 0x7FF80A50 0x7FF80690 0x7FF80444 100 0 0 /end SOURCE
/end IF_DATA
/* --- Object for CCP (ASAP V1.21), Version 1.0 31.7.98 --- */
/begin IF_DATA ASAP1B_CCP
 /begin SOURCE "PIP task, synchronous event channel" 103 /* PIP event channel number */ 1 /* PIP event channel number */ /begin QP_BLOB 0 LENGTH 2 CAN_ID_FIXED 0x6F8 RASTER 6 /end QP_BLOB /end SOURCE
 /begin RASTER "PIP task, engine synchronous" "PIP" 6 103 1 /end RASTER
 /begin SOURCE "8ms Task" 3 /* 8ms event channel number */ 8 /* 8ms event channel number */ /begin QP_BLOB 1 LENGTH 4 CAN_ID_FIXED 0x6F8 RASTER 5 /end QP_BLOB /end SOURCE
 /begin RASTER "8ms Task" "8ms" 5 3 8 /end RASTER
 /begin SOURCE "30ms Task" 4 /* 30ms event channel number */ 5 /* 30ms event channel number */ /begin QP_BLOB 3 LENGTH 16 CAN_ID_FIXED 0x6F8 RASTER 3 /end QP_BLOB /end SOURCE
 /begin RASTER "30ms Task" "30ms" 3 4 5 /end RASTER
 /begin SOURCE "100ms Task" 5 /* 100ms event channel number */ 1 /* 100ms event channel number */ /begin QP_BLOB 2 LENGTH 16 CAN_ID_FIXED 0x6F8 RASTER 1 /end QP_BLOB /end SOURCE
 /begin RASTER "100ms Task" "100ms" 1 5 1 /end RASTER
 /begin SEED_KEY /* seed&key dll for CAL privilege */ "" /* seed&key dll for DAQ privilege */ "" /* seed&key dll for PGM privilege */ "" /end SEED_KEY
 /begin TP_BLOB /* CCP version */ 0x201 /* Blob version */ 0x202 /* CAN msg ID - send */ 0x6F9 /* CAN msg ID - recv */ 0x6F8 /* station address */ 0x0 /* byte order */ 1 /* Byte-order: 1 - High-Byte-First (MOT)*/ /* 2 - Low-Byte-First(INTEL) */
  /begin CAN_PARAM /* crystal frequency */ 0x1F4 /* These values for 500K */ /* timing register 0 */ 0x41 /* timing register 1 */ 0x25 /end CAN_PARAM
  DAQ_MODE BURST CONSISTENCY ODT ADDRESS_EXTENSION ODT
  /begin CHECKSUM_PARAM /* algorithm */ 0xC004 /* M_32_BIT_BY_ADD16 */ /* limit */ 0xFFFFFFFF /* -1 max. checksum-length in ECU */ CHECKSUM_CALCULATION ACTIVE_PAGE /end CHECKSUM_PARAM
  /begin DEFINED_PAGES 2 "working page" /* address ext. */ 0x0 /* base address */ 0x50000 /* page length */ 0x20000 RAM RAM_INIT_BY_ECU /end DEFINED_PAGES
  OPTIONAL_CMD 0xC /* SET_S_STATUS */ OPTIONAL_CMD 0xD /* GET_S_STATUS */ OPTIONAL_CMD 0xE /* BUILD_CHKSUM */ /*OPTIONAL_CMD 0x11 SELECT_CAL_PAGE */ OPTIONAL_CMD 0x19 /* MOVE */ OPTIONAL_CMD 0x12 /* GET_SEED */ OPTIONAL_CMD 0x13 /* UNLOCK */ /end TP_BLOB
/end IF_DATA
/begin MEASUREMENT AAT "Ambient air temperature. (DEGREES C)" FLOAT32_IEEE MC_AAT 0 0 0 0 ECU_ADDRESS 0x3FA1D8 /end MEASUREMENT
/begin COMPU_METHOD MC_AAT "AAT conversion" RAT_FUNC "%10.5" "Unitless" COEFFS 0 1 0 0 0 1 /end COMPU_METHOD
/begin MEASUREMENT AAT_F_ORH "AAT Signal out-of_range high fault" UBYTE MC_AAT_F_ORH 0 0 0 0 ECU_ADDRESS 0x3FA1E6 /end MEASUREMENT
/begin COMPU_METHOD MC_AAT_F_ORH "AAT_F_ORH conversion" RAT_FUNC "%3.0" "Unitless" COEFFS 0 1 0 0 0 1 /end COMPU_METHOD
/begin MEASUREMENT AAT_F_ORL "AAT Signal out-of_range low fault" UBYTE MC_AAT_F_ORL 0 0 0 0 ECU_ADDRESS 0x3FA1E5 /end MEASUREMENT
/begin COMPU_METHOD MC_AAT_F_ORL "AAT_F_ORL conversion" RAT_FUNC "%3.0" "Unitless" COEFFS 0 1 0 0 0 1 /end COMPU_METHOD
/begin MEASUREMENT ACCFLG "A/C clutch status; 0 -> disengaged, 1 -> engaged." UBYTE MC_ACCFLG 0 0 0 0 ECU_ADDRESS 0x3F9EB7 /end MEASUREMENT
/begin COMPU_METHOD MC_ACCFLG "ACCFLG conversion" RAT_FUNC "%3.0" "Unitless" COEFFS 0 1 0 0 0 1 /end COMPU_METHOD
/begin MEASUREMENT ACCFLG_LAST "Last pass value of ACCFLG." UBYTE MC_ACCFLG_LAST 0 0 0 0 ECU_ADDRESS 0x3F9EB6 /end MEASUREMENT
/begin COMPU_METHOD MC_ACCFLG_LAST "ACCFLG_LAST conversion" RAT_FUNC "%3.0" "Unitless" COEFFS 0 1 0 0 0 1 /end COMPU_METHOD
/begin CHARACTERISTIC ACCR_NC "Status indicator, set if  the relay is normally closed" VALUE 0x562F0 SD_UBYTE 0 SC_ACCR_NC 0 1 /end CHARACTERISTIC
/begin COMPU_METHOD SC_ACCR_NC "ACCR_NC conversion" RAT_FUNC "%3.0" "flag" COEFFS 0 1 0 0 0 1 /end COMPU_METHOD
/begin MEASUREMENT ACCS "A/C hardware input to module." UBYTE MC_ACCS 0 0 0 0 ECU_ADDRESS 0x3FA9A6 /end MEASUREMENT
/begin COMPU_METHOD MC_ACCS "ACCS conversion" RAT_FUNC "%3.0" "Unitless" COEFFS 0 1 0 0 0 1 /end COMPU_METHOD
/begin CHARACTERISTIC ACCS_HP "Hardware present switch for A/C demand/Cycling hardware input to the module." VALUE 0x562AC SD_UBYTE 0 SC_ACCS_HP 0 1 /end CHARACTERISTIC
/begin COMPU_METHOD SC_ACCS_HP "ACCS_HP conversion" RAT_FUNC "%3.0" "unitless" COEFFS 0 1 0 0 0 1 /end COMPU_METHOD
/begin MEASUREMENT ACCS_SCP "ACCS input data as received on SCP; 1 -> request A/C ON." UBYTE MC_ACCS_SCP 0 0 0 0 ECU_ADDRESS 0x3FADEF /end MEASUREMENT
/begin COMPU_METHOD MC_ACCS_SCP "ACCS_SCP conversion" RAT_FUNC "%3.0" "Unitless" COEFFS 0 1 0 0 0 1 /end COMPU_METHOD
/begin MEASUREMENT ACC_DELTA_SEC "A/C loop timer" FLOAT32_IEEE MC_ACC_DELTA_SEC 0 0 0 0 ECU_ADDRESS 0x3F9EAC /end MEASUREMENT
/begin COMPU_METHOD MC_ACC_DELTA_SEC "ACC_DELTA_SEC conversion" RAT_FUNC "%10.5" "Unitless" COEFFS 0 1 0 0 0 1 /end COMPU_METHOD
/begin MEASUREMENT ACC_KAM_FLG "KAM flag to signify that A/C has been engaged." UBYTE MC_ACC_KAM_FLG 0 0 0 0 ECU_ADDRESS 0x3FAE88 /end MEASUREMENT
/begin COMPU_METHOD MC_ACC_KAM_FLG "ACC_KAM_FLG conversion" RAT_FUNC "%3.0" "Unitless" COEFFS 0 1 0 0 0 1 /end COMPU_METHOD
/begin MEASUREMENT ACC_STATUS "ACC Smart output driver fault status." UBYTE MC_ACC_STATUS 0 0 0 0 ECU_ADDRESS 0x3FAAFC /end MEASUREMENT
/begin COMPU_METHOD MC_ACC_STATUS "ACC_STATUS conversion" RAT_FUNC "%3.0" "Unitless" COEFFS 0 1 0 0 0 1 /end COMPU_METHOD
/begin MEASUREMENT ACD_SCP_HP "Hardware present flag for the A/C demand input received over the SCP Network." UBYTE MC_ACD_SCP_HP 0 0 0 0 ECU_ADDRESS 0x3FAF52 /end MEASUREMENT
/begin COMPU_METHOD MC_ACD_SCP_HP "ACD_SCP_HP conversion" RAT_FUNC "%3.0" "Unitless" COEFFS 0 1 0 0 0 1 /end COMPU_METHOD
/begin CHARACTERISTIC ACECT_CL_DEGC "Minimum ECT to disable A/C clutch" VALUE 0x562A4 SD_FLOAT32_IEEE 0 SC_ACECT_CL_DEGC -150 150 /end CHARACTERISTIC
/begin COMPU_METHOD SC_ACECT_CL_DEGC "ACECT_CL_DEGC conversion" RAT_FUNC "%10.5" "degC" COEFFS 0 1 0 0 0 1 /end COMPU_METHOD
/begin MEASUREMENT ACECT_FLG "High ECT or ECT sensor failed." UBYTE MC_ACECT_FLG 0 0 0 0 ECU_ADDRESS 0x3F9EA2 /end MEASUREMENT
/begin COMPU_METHOD MC_ACECT_FLG "ACECT_FLG conversion" RAT_FUNC "%3.0" "Unitless" COEFFS 0 1 0 0 0 1 /end COMPU_METHOD
/begin CHARACTERISTIC ACECT_SH_DEGC "Maximum ECT for enabling  A/C clutch" VALUE 0x562A0 SD_FLOAT32_IEEE 0 SC_ACECT_SH_DEGC -150 150 /end CHARACTERISTIC
/begin COMPU_METHOD SC_ACECT_SH_DEGC "ACECT_SH_DEGC conversion" RAT_FUNC "%10.5" "degC" COEFFS 0 1 0 0 0 1 /end COMPU_METHOD
/begin MEASUREMENT ACIOTMR "A/C off delay timer, for ISC." FLOAT32_IEEE MC_ACIOTMR 0 0 0 0 ECU_ADDRESS 0x3F9E94 /end MEASUREMENT
/begin COMPU_METHOD MC_ACIOTMR "ACIOTMR conversion" RAT_FUNC "%10.5" "Unitless" COEFFS 0 1 0 0 0 1 /end COMPU_METHOD
/begin MEASUREMENT ACIOTMR_UP "Flag to control the incrementing of the actuated timer aciotmr." UBYTE MC_ACIOTMR_UP 0 0 0 0 ECU_ADDRESS 0x3F9EA1 /end MEASUREMENT
/begin COMPU_METHOD MC_ACIOTMR_UP "ACIOTMR_UP conversion" RAT_FUNC "%3.0" "Unitless" COEFFS 0 1 0 0 0 1 /end COMPU_METHOD
/begin MEASUREMENT ACITMR "A/C clutch idle turn on delay timer." FLOAT32_IEEE MC_ACITMR 0 0 0 0 ECU_ADDRESS 0x3F9E90 /end MEASUREMENT
/begin COMPU_METHOD MC_ACITMR "ACITMR conversion" RAT_FUNC "%10.5" "Unitless" COEFFS 0 1 0 0 0 1 /end COMPU_METHOD
/begin MEASUREMENT ACITMR_UP "Flag to control the incrementing of the actuated timer acitmr." UBYTE MC_ACITMR_UP 0 0 0 0 ECU_ADDRESS 0x3F9EA0 /end MEASUREMENT
/begin COMPU_METHOD MC_ACITMR_UP "ACITMR_UP conversion" RAT_FUNC "%3.0" "Unitless" COEFFS 0 1 0 0 0 1 /end COMPU_METHOD
/begin MEASUREMENT ACLAUNCH_FLG "Hot launch A/C cut-out flag." UBYTE MC_ACLAUNCH_FLG 0 0 0 0 ECU_ADDRESS 0x3F9E9A /end MEASUREMENT
/begin COMPU_METHOD MC_ACLAUNCH_FLG "ACLAUNCH_FLG conversion" RAT_FUNC "%3.0" "Unitless" COEFFS 0 1 0 0 0 1 /end COMPU_METHOD
/begin CHARACTERISTIC ACL_TM_D "Maximum time that A/C launch cutout is allowed to function" VALUE 0x56258 SD_FLOAT32_IEEE 0 SC_ACL_TM_D 0 63.9999 /end CHARACTERISTIC
/begin COMPU_METHOD SC_ACL_TM_D "ACL_TM_D conversion" RAT_FUNC "%10.5" "s" COEFFS 0 1 0 0 0 1 /end COMPU_METHOD
/begin CHARACTERISTIC ACMNDT_PPS "Time delay to keep A/C disabled after leaving high pedal" VALUE 0x5627C SD_FLOAT32_IEEE 0 SC_ACMNDT_PPS 0.5 10 /end CHARACTERISTIC
/begin COMPU_METHOD SC_ACMNDT_PPS "ACMNDT_PPS conversion" RAT_FUNC "%10.5" "s" COEFFS 0 1 0 0 0 1 /end COMPU_METHOD
/begin CHARACTERISTIC ACNHI_CL "RPM to shut off WAC RPM-based cutout." VALUE 0x5629C SD_FLOAT32_IEEE 0 SC_ACNHI_CL 1000 8000 /end CHARACTERISTIC
/begin COMPU_METHOD SC_ACNHI_CL "ACNHI_CL conversion" RAT_FUNC "%10.5" "RPM" COEFFS 0 1 0 0 0 1 /end COMPU_METHOD
/begin MEASUREMENT ACNHI_FLG "A/C engine speed too high." UBYTE MC_ACNHI_FLG 0 0 0 0 ECU_ADDRESS 0x3F9E9F /end MEASUREMENT
/begin COMPU_METHOD MC_ACNHI_FLG "ACNHI_FLG conversion" RAT_FUNC "%3.0" "Unitless" COEFFS 0 1 0 0 0 1 /end COMPU_METHOD
/begin CHARACTERISTIC ACNHI_SH "Max RPM to keep AC clutch enabled." VALUE 0x56298 SD_FLOAT32_IEEE 0 SC_ACNHI_SH 3500 8000 /end CHARACTERISTIC
/begin COMPU_METHOD SC_ACNHI_SH "ACNHI_SH conversion" RAT_FUNC "%10.5" "RPM" COEFFS 0 1 0 0 0 1 /end COMPU_METHOD
/begin CHARACTERISTIC ACNLO_CH "Max RPM to disable A/C clutch." VALUE 0x56294 SD_FLOAT32_IEEE 0 SC_ACNLO_CH 0 1000 /end CHARACTERISTIC
/begin COMPU_METHOD SC_ACNLO_CH "ACNLO_CH conversion" RAT_FUNC "%10.5" "RPM" COEFFS 0 1 0 0 0 1 /end COMPU_METHOD
/begin MEASUREMENT ACNLO_FLG "A/C engine speed too low." UBYTE MC_ACNLO_FLG 0 0 0 0 ECU_ADDRESS 0x3F9E9E /end MEASUREMENT
/begin COMPU_METHOD MC_ACNLO_FLG "ACNLO_FLG conversion" RAT_FUNC "%3.0" "Unitless" COEFFS 0 1 0 0 0 1 /end COMPU_METHOD
/begin CHARACTERISTIC ACNLO_SL "Min RPM for enabing A/C clutch." VALUE 0x56290 SD_FLOAT32_IEEE 0 SC_ACNLO_SL 0 1000 /end CHARACTERISTIC
/begin COMPU_METHOD SC_ACNLO_SL "ACNLO_SL conversion" RAT_FUNC "%10.5" "RPM" COEFFS 0 1 0 0 0 1 /end COMPU_METHOD
/begin MEASUREMENT ACPPSOFF_RQST "A/C high pedal cutout request" UBYTE MC_ACPPSOFF_RQST 0 0 0 0 ECU_ADDRESS 0x3F9E9C /end MEASUREMENT
/begin COMPU_METHOD MC_ACPPSOFF_RQST "ACPPSOFF_RQST conversion" RAT_FUNC "%3.0" "Unitless" COEFFS 0 1 0 0 0 1 /end COMPU_METHOD
/begin MEASUREMENT ACPPSOFF_TMR "A/C high pedal cutout timer" FLOAT32_IEEE MC_ACPPSOFF_TMR 0 0 0 0 ECU_ADDRESS 0x3F9E88 /end MEASUREMENT
/begin COMPU_METHOD MC_ACPPSOFF_TMR "ACPPSOFF_TMR conversion" RAT_FUNC "%10.5" "Unitless" COEFFS 0 1 0 0 0 1 /end COMPU_METHOD
/begin MEASUREMENT ACPPSTMR2 "A/C clutch not at high pedal timer" FLOAT32_IEEE MC_ACPPSTMR2 0 0 0 0 ECU_ADDRESS 0x3F9E8C /end MEASUREMENT
/begin COMPU_METHOD MC_ACPPSTMR2 "ACPPSTMR2 conversion" RAT_FUNC "%10.5" "Unitless" COEFFS 0 1 0 0 0 1 /end COMPU_METHOD
/begin CHARACTERISTIC ACPPS_CL "Maximum PPS to increment acppstmr2" VALUE 0x56284 SD_FLOAT32_IEEE 0 SC_ACPPS_CL 100 1023 /end CHARACTERISTIC
/begin COMPU_METHOD SC_ACPPS_CL "ACPPS_CL conversion" RAT_FUNC "%10.5" "ADct" COEFFS 0 1 0 0 0 1 /end COMPU_METHOD
/begin MEASUREMENT ACPPS_FLG "A/C pedal position flag" UBYTE MC_ACPPS_FLG 0 0 0 0 ECU_ADDRESS 0x3F9E9B /end MEASUREMENT
/begin COMPU_METHOD MC_ACPPS_FLG "ACPPS_FLG conversion" RAT_FUNC "%3.0" "Unitless" COEFFS 0 1 0 0 0 1 /end COMPU_METHOD
/begin CHARACTERISTIC ACPPS_SH "Maximum PPS to enable A/C clutch" VALUE 0x56280 SD_FLOAT32_IEEE 0 SC_ACPPS_SH 500 1023 /end CHARACTERISTIC
/begin COMPU_METHOD SC_ACPPS_SH "ACPPS_SH conversion" RAT_FUNC "%10.5" "ADct" COEFFS 0 1 0 0 0 1 /end COMPU_METHOD
/begin MEASUREMENT ACPRES "A/C head pressure." FLOAT32_IEEE MC_ACPRES 0 0 0 0 ECU_ADDRESS 0x3FAD74 /end MEASUREMENT
/begin COMPU_METHOD MC_ACPRES "ACPRES conversion" RAT_FUNC "%10.5" "Unitless" COEFFS 0 1 0 0 0 1 /end COMPU_METHOD
/begin MEASUREMENT ACPSW "AC medium pressure switch input; 1 -> AC pressure high." UBYTE MC_ACPSW 0 0 0 0 ECU_ADDRESS 0x3FAA9E /end MEASUREMENT
/begin COMPU_METHOD MC_ACPSW "ACPSW conversion" RAT_FUNC "%3.0" "Unitless" COEFFS 0 1 0 0 0 1 /end COMPU_METHOD
/begin CHARACTERISTIC ACPSW_HP "AC Pressure Switch Hardware Present." VALUE 0x57550 SD_UBYTE 0 SC_ACPSW_HP 0 1 /end CHARACTERISTIC
/begin COMPU_METHOD SC_ACPSW_HP "ACPSW_HP conversion" RAT_FUNC "%3.0" "enumerated" COEFFS 0 1 0 0 0 1 /end COMPU_METHOD
/begin MEASUREMENT ACR "A/C output; 1 -> relay energised." UBYTE MC_ACR 0 0 0 0 ECU_ADDRESS 0x3FAF54 /end MEASUREMENT
/begin COMPU_METHOD MC_ACR "ACR conversion" RAT_FUNC "%3.0" "Unitless" COEFFS 0 1 0 0 0 1 /end COMPU_METHOD
/begin MEASUREMENT ACRQST "A/C requested (pre delays); 1 -> request." UBYTE MC_ACRQST 0 0 0 0 ECU_ADDRESS 0x3F9E9D /end MEASUREMENT
/begin COMPU_METHOD MC_ACRQST "ACRQST conversion" RAT_FUNC "%3.0" "Unitless" COEFFS 0 1 0 0 0 1 /end COMPU_METHOD
/begin MEASUREMENT ACRQ_SLG_FLG "A/C de-slug A/C clutch request; 1 -> clutch on." UBYTE MC_ACRQ_SLG_FLG 0 0 0 0 ECU_ADDRESS 0x3F9E7A /end MEASUREMENT
/begin COMPU_METHOD MC_ACRQ_SLG_FLG "ACRQ_SLG_FLG conversion" RAT_FUNC "%3.0" "Unitless" COEFFS 0 1 0 0 0 1 /end COMPU_METHOD
/begin MEASUREMENT ACRQ_SLG_LST "Last pass value of ACRQ_SLG_FLG." UBYTE MC_ACRQ_SLG_LST 0 0 0 0 ECU_ADDRESS 0x3F9E79 /end MEASUREMENT
/begin COMPU_METHOD MC_ACRQ_SLG_LST "ACRQ_SLG_LST conversion" RAT_FUNC "%3.0" "Unitless" COEFFS 0 1 0 0 0 1 /end COMPU_METHOD
/begin CHARACTERISTIC ACR_HP "Hardware present switch to indicate A/C clutch relay is controlled by PCM hardware pin." VALUE 0x562F1 SD_UBYTE 0 SC_ACR_HP 0 1 /end CHARACTERISTIC
/begin COMPU_METHOD SC_ACR_HP "ACR_HP conversion" RAT_FUNC "%3.0" "flag" COEFFS 0 1 0 0 0 1 /end COMPU_METHOD
/begin CHARACTERISTIC ACSTRD "Max seconds to keep AC disabled after start." VALUE 0x5628C SD_FLOAT32_IEEE 0 SC_ACSTRD 0 255 /end CHARACTERISTIC
/begin COMPU_METHOD SC_ACSTRD "ACSTRD conversion" RAT_FUNC "%10.5" "S" COEFFS 0 1 0 0 0 1 /end COMPU_METHOD
/begin MEASUREMENT ACSW "A/C switch input status; 1 -> A/C on, (copy of ACCS or ACCS_SCP)." UBYTE MC_ACSW 0 0 0 0 ECU_ADDRESS 0x3F9EA4 /end MEASUREMENT
/begin COMPU_METHOD MC_ACSW "ACSW conversion" RAT_FUNC "%3.0" "Unitless" COEFFS 0 1 0 0 0 1 /end COMPU_METHOD
/begin MEASUREMENT ACT "Air charge temperature, deg F." FLOAT32_IEEE MC_ACT 0 0 0 0 ECU_ADDRESS 0x3FA148 /end MEASUREMENT
/begin COMPU_METHOD MC_ACT "ACT conversion" RAT_FUNC "%10.5" "Unitless" COEFFS 0 1 0 0 0 1 /end COMPU_METHOD
/begin MEASUREMENT ACT_FIL "Intermittent fault filter for the ACT sensor" UBYTE MC_ACT_FIL 0 0 0 0 ECU_ADDRESS 0x3F9EFF /end MEASUREMENT
/begin COMPU_METHOD MC_ACT_FIL "ACT_FIL conversion" RAT_FUNC "%3.0" "Unitless" COEFFS 0 1 0 0 0 1 /end COMPU_METHOD
/begin MEASUREMENT ACT_FIL_MAX "HIGHEST VALUE THE FAULT FILTER ACT_FIL SEES." UBYTE MC_ACT_FIL_MAX 0 0 0 0 ECU_ADDRESS 0x3FAEDD /end MEASUREMENT
/begin COMPU_METHOD MC_ACT_FIL_MAX "ACT_FIL_MAX conversion" RAT_FUNC "%3.0" "Unitless" COEFFS 0 1 0 0 0 1 /end COMPU_METHOD
/begin MEASUREMENT ACT_INT "Flag set when intermittent is detected on the CAT sensor." UBYTE MC_ACT_INT 0 0 0 0 ECU_ADDRESS 0x3F9EFE /end MEASUREMENT
/begin COMPU_METHOD MC_ACT_INT "ACT_INT conversion" RAT_FUNC "%3.0" "Unitless" COEFFS 0 1 0 0 0 1 /end COMPU_METHOD
/begin CHARACTERISTIC ACT_LVL "Fault level for intermittent ACT snesor." VALUE 0x563A7 SD_UBYTE 0 SC_ACT_LVL 0 255 /end CHARACTERISTIC
/begin COMPU_METHOD SC_ACT_LVL "ACT_LVL conversion" RAT_FUNC "%3.0" "LEVEL" COEFFS 0 1 0 0 0 1 /end COMPU_METHOD
/begin MEASUREMENT AC_CYCLE_FLG "Flag to indicate that the AC is cycling." UBYTE MC_AC_CYCLE_FLG 0 0 0 0 ECU_ADDRESS 0x3F9EB5 /end MEASUREMENT
/begin COMPU_METHOD MC_AC_CYCLE_FLG "AC_CYCLE_FLG conversion" RAT_FUNC "%3.0" "Unitless" COEFFS 0 1 0 0 0 1 /end COMPU_METHOD
/begin MEASUREMENT AC_DESLG_KAM "KAM flag to signify that CASS has been engaged during life cycle." UBYTE MC_AC_DESLG_KAM 0 0 0 0 ECU_ADDRESS 0x3FAE84 /end MEASUREMENT
/begin COMPU_METHOD MC_AC_DESLG_KAM "AC_DESLG_KAM conversion" RAT_FUNC "%3.0" "Unitless" COEFFS 0 1 0 0 0 1 /end COMPU_METHOD
/begin MEASUREMENT AC_DESLG_TMR "Time since engine started to rotate, used in A/C deslugging routine." FLOAT32_IEEE MC_AC_DESLG_TMR 0 0 0 0 ECU_ADDRESS 0x3F9E74 /end MEASUREMENT
/begin COMPU_METHOD MC_AC_DESLG_TMR "AC_DESLG_TMR conversion" RAT_FUNC "%10.5" "Unitless" COEFFS 0 1 0 0 0 1 /end COMPU_METHOD
/begin MEASUREMENT AC_ENG_REVS "RPM integrated during A/C deslugging  for revolution counter." FLOAT32_IEEE MC_AC_ENG_REVS 0 0 0 0 ECU_ADDRESS 0x3F9E70 /end MEASUREMENT
/begin COMPU_METHOD MC_AC_ENG_REVS "AC_ENG_REVS conversion" RAT_FUNC "%10.5" "Unitless" COEFFS 0 1 0 0 0 1 /end COMPU_METHOD
/begin MEASUREMENT AC_EN_TRANS "Flag to delay A/C activation process; 0 -> delay." UBYTE MC_AC_EN_TRANS 0 0 0 0 ECU_ADDRESS 0x3FAF50 /end MEASUREMENT
/begin COMPU_METHOD MC_AC_EN_TRANS "AC_EN_TRANS conversion" RAT_FUNC "%3.0" "Unitless" COEFFS 0 1 0 0 0 1 /end COMPU_METHOD
/begin CHARACTERISTIC AC_LCH_MPH "Vehicle speed above which to enable A/C  launch" VALUE 0x56264 SD_FLOAT32_IEEE 0 SC_AC_LCH_MPH 0 127.998 /end CHARACTERISTIC
/begin COMPU_METHOD SC_AC_LCH_MPH "AC_LCH_MPH conversion" RAT_FUNC "%10.5" "MPH" COEFFS 0 1 0 0 0 1 /end COMPU_METHOD
/begin MEASUREMENT AC_LCH_TMR_D "Time that A/C launch cutout has been active" FLOAT32_IEEE MC_AC_LCH_TMR_D 0 0 0 0 ECU_ADDRESS 0x3F9E84 /end MEASUREMENT
/begin COMPU_METHOD MC_AC_LCH_TMR_D "AC_LCH_TMR_D conversion" RAT_FUNC "%10.5" "Unitless" COEFFS 0 1 0 0 0 1 /end COMPU_METHOD
/begin CHARACTERISTIC AC_MN_FT "Min. time to run low speed EDF after A/C clutch is disengaged." VALUE 0x562EC SD_FLOAT32_IEEE 0 SC_AC_MN_FT 0 62 /end CHARACTERISTIC
/begin COMPU_METHOD SC_AC_MN_FT "AC_MN_FT conversion" RAT_FUNC "%10.5" "s" COEFFS 0 1 0 0 0 1 /end COMPU_METHOD
/begin CHARACTERISTIC AC_NEW_RPM "Max RPM to enable a new A/C compressor to be engaged." VALUE 0x56288 SD_FLOAT32_IEEE 0 SC_AC_NEW_RPM 0 16383 /end CHARACTERISTIC
/begin COMPU_METHOD SC_AC_NEW_RPM "AC_NEW_RPM conversion" RAT_FUNC "%10.5" "RPM" COEFFS 0 1 0 0 0 1 /end COMPU_METHOD
/begin MEASUREMENT AC_PPM_RQST "Request that the ISC adds air to compensate for AC loading." UBYTE MC_AC_PPM_RQST 0 0 0 0 ECU_ADDRESS 0x3F9EB4 /end MEASUREMENT
/begin COMPU_METHOD MC_AC_PPM_RQST "AC_PPM_RQST conversion" RAT_FUNC "%3.0" "Unitless" COEFFS 0 1 0 0 0 1 /end COMPU_METHOD
/begin MEASUREMENT AC_PRERQST "A/C Requested prior to transmission shift override logic, 1 = request" UBYTE MC_AC_PRERQST 0 0 0 0 ECU_ADDRESS 0x3F9E99 /end MEASUREMENT
/begin COMPU_METHOD MC_AC_PRERQST "AC_PRERQST conversion" RAT_FUNC "%3.0" "Unitless" COEFFS 0 1 0 0 0 1 /end COMPU_METHOD
/begin CHARACTERISTIC AC_SLG_BATV "Do not run A/C de-slugging strategy if the VBAT 'EVER' falls below this." VALUE 0x5621C SD_FLOAT32_IEEE 0 SC_AC_SLG_BATV 0 15.9375 /end CHARACTERISTIC
/begin COMPU_METHOD SC_AC_SLG_BATV "AC_SLG_BATV conversion" RAT_FUNC "%10.5" "V" COEFFS 0 1 0 0 0 1 /end COMPU_METHOD
/begin CHARACTERISTIC AC_SLG_LO_DEGC "Normal A/C start if ambient temperature is below this value" VALUE 0x56218 SD_FLOAT32_IEEE 0 SC_AC_SLG_LO_DEGC -110 110 /end CHARACTERISTIC
/begin COMPU_METHOD SC_AC_SLG_LO_DEGC "AC_SLG_LO_DEGC conversion" RAT_FUNC "%10.5" "degC" COEFFS 0 1 0 0 0 1 /end COMPU_METHOD
/begin CHARACTERISTIC AC_SLG_NO "A/C on for this number of engine revolutions to de-slug." VALUE 0x56210 SD_FLOAT32_IEEE 0 SC_AC_SLG_NO 0 1023.98 /end CHARACTERISTIC
/begin COMPU_METHOD SC_AC_SLG_NO "AC_SLG_NO conversion" RAT_FUNC "%10.5" "rev" COEFFS 0 1 0 0 0 1 /end COMPU_METHOD
/begin CHARACTERISTIC AC_SLG_ON_TM "A/C on time during crank to de-slug." VALUE 0x56214 SD_FLOAT32_IEEE 0 SC_AC_SLG_ON_TM 0 63.999 /end CHARACTERISTIC
/begin COMPU_METHOD SC_AC_SLG_ON_TM "AC_SLG_ON_TM conversion" RAT_FUNC "%10.5" "s" COEFFS 0 1 0 0 0 1 /end COMPU_METHOD
/begin CHARACTERISTIC AC_SLG_RPM "A/C on below this engine speed to de-slug." VALUE 0x5620C SD_FLOAT32_IEEE 0 SC_AC_SLG_RPM 0 16383.8 /end CHARACTERISTIC
/begin COMPU_METHOD SC_AC_SLG_RPM "AC_SLG_RPM conversion" RAT_FUNC "%10.5" "RPM" COEFFS 0 1 0 0 0 1 /end COMPU_METHOD
/begin MEASUREMENT AC_SLG_SOAK "CASS copied soak time from ENG_OFF_TMR,  duration in minutes." FLOAT32_IEEE MC_AC_SLG_SOAK 0 0 0 0 ECU_ADDRESS 0x3FAE80 /end MEASUREMENT
/begin COMPU_METHOD MC_AC_SLG_SOAK "AC_SLG_SOAK conversion" RAT_FUNC "%10.5" "Unitless" COEFFS 0 1 0 0 0 1 /end COMPU_METHOD
/begin CHARACTERISTIC AC_SLG_TM "A/C off period below which use normal A/C start." VALUE 0x56208 SD_FLOAT32_IEEE 0 SC_AC_SLG_TM 0 32767.5 /end CHARACTERISTIC
/begin COMPU_METHOD SC_AC_SLG_TM "AC_SLG_TM conversion" RAT_FUNC "%10.5" "min" COEFFS 0 1 0 0 0 1 /end COMPU_METHOD
/begin MEASUREMENT AC_TQ_ENG__A "Air conditioning torque referenced to crank for powertrain torque model." FLOAT32_IEEE MC_AC_TQ_ENG__A 0 0 0 0 ECU_ADDRESS 0x3F9EB0 /end MEASUREMENT
/begin COMPU_METHOD MC_AC_TQ_ENG__A "AC_TQ_ENG__A conversion" RAT_FUNC "%10.5" "Unitless" COEFFS 0 1 0 0 0 1 /end COMPU_METHOD
/begin MEASUREMENT AC_VBAT_FLG "VBAT latch flag applied when VBAT falls below AC_SLG_BATV." UBYTE MC_AC_VBAT_FLG 0 0 0 0 ECU_ADDRESS 0x3F9E78 /end MEASUREMENT
/begin COMPU_METHOD MC_AC_VBAT_FLG "AC_VBAT_FLG conversion" RAT_FUNC "%3.0" "Unitless" COEFFS 0 1 0 0 0 1 /end COMPU_METHOD
/begin MEASUREMENT AD_ROC_PPS "Accelerator pedal position sensor rate of change value." FLOAT32_IEEE MC_AD_ROC_PPS 0 0 0 0 ECU_ADDRESS 0x3FA188 /end MEASUREMENT
/begin COMPU_METHOD MC_AD_ROC_PPS "AD_ROC_PPS conversion" RAT_FUNC "%10.5" "Unitless" COEFFS 0 1 0 0 0 1 /end COMPU_METHOD
/begin MEASUREMENT AFR_DS "Air fuel ratio minimum" FLOAT32_IEEE MC_AFR_DS 0 0 0 0 ECU_ADDRESS 0x3FA3D4 /end MEASUREMENT
/begin COMPU_METHOD MC_AFR_DS "AFR_DS conversion" RAT_FUNC "%10.5" "Unitless" COEFFS 0 1 0 0 0 1 /end COMPU_METHOD
/begin CHARACTERISTIC AFR_MIN "MINIMUM VALUE OF AIR/FUEL RATIO." VALUE 0x3FA33C SD_FLOAT32_IEEE 0 SC_AFR_MIN 0 15.99 /end CHARACTERISTIC
/begin COMPU_METHOD SC_AFR_MIN "AFR_MIN conversion" RAT_FUNC "%10.5" "UNITLESS" COEFFS 0 1 0 0 0 1 /end COMPU_METHOD
/begin MEASUREMENT AFR_MIN_PI "" FLOAT32_IEEE MC_AFR_MIN_PI 0 0 0 0 ECU_ADDRESS 0x3FA350 /end MEASUREMENT
/begin COMPU_METHOD MC_AFR_MIN_PI "AFR_MIN_PI conversion" RAT_FUNC "%10.5" "Unitless" COEFFS 0 1 0 0 0 1 /end COMPU_METHOD
/begin MEASUREMENT AFR_MIN_PI_HI_ALT "" FLOAT32_IEEE MC_AFR_MIN_PI_HI_ALT 0 0 0 0 ECU_ADDRESS 0x3FA390 /end MEASUREMENT
/begin COMPU_METHOD MC_AFR_MIN_PI_HI_ALT "AFR_MIN_PI_HI_ALT conversion" RAT_FUNC "%10.5" "Unitless" COEFFS 0 1 0 0 0 1 /end COMPU_METHOD
/begin MEASUREMENT AFR_MIN_PI_LO_ALT "" FLOAT32_IEEE MC_AFR_MIN_PI_LO_ALT 0 0 0 0 ECU_ADDRESS 0x3FA388 /end MEASUREMENT
/begin COMPU_METHOD MC_AFR_MIN_PI_LO_ALT "AFR_MIN_PI_LO_ALT conversion" RAT_FUNC "%10.5" "Unitless" COEFFS 0 1 0 0 0 1 /end COMPU_METHOD
/begin MEASUREMENT AFR_MIN_PI_MED_ALT "" FLOAT32_IEEE MC_AFR_MIN_PI_MED_ALT 0 0 0 0 ECU_ADDRESS 0x3FA38C /end MEASUREMENT
/begin COMPU_METHOD MC_AFR_MIN_PI_MED_ALT "AFR_MIN_PI_MED_ALT conversion" RAT_FUNC "%10.5" "Unitless" COEFFS 0 1 0 0 0 1 /end COMPU_METHOD
/begin MEASUREMENT AFR_MIN_SS "" FLOAT32_IEEE MC_AFR_MIN_SS 0 0 0 0 ECU_ADDRESS 0x3FA354 /end MEASUREMENT
/begin COMPU_METHOD MC_AFR_MIN_SS "AFR_MIN_SS conversion" RAT_FUNC "%10.5" "Unitless" COEFFS 0 1 0 0 0 1 /end COMPU_METHOD
/begin MEASUREMENT AFR_MIN_SS_HI_ALT "" FLOAT32_IEEE MC_AFR_MIN_SS_HI_ALT 0 0 0 0 ECU_ADDRESS 0x3FA39C /end MEASUREMENT
/begin COMPU_METHOD MC_AFR_MIN_SS_HI_ALT "AFR_MIN_SS_HI_ALT conversion" RAT_FUNC "%10.5" "Unitless" COEFFS 0 1 0 0 0 1 /end COMPU_METHOD
/begin MEASUREMENT AFR_MIN_SS_LO_ALT "" FLOAT32_IEEE MC_AFR_MIN_SS_LO_ALT 0 0 0 0 ECU_ADDRESS 0x3FA394 /end MEASUREMENT
/begin COMPU_METHOD MC_AFR_MIN_SS_LO_ALT "AFR_MIN_SS_LO_ALT conversion" RAT_FUNC "%10.5" "Unitless" COEFFS 0 1 0 0 0 1 /end COMPU_METHOD
/begin MEASUREMENT AFR_MIN_SS_MED_ALT "" FLOAT32_IEEE MC_AFR_MIN_SS_MED_ALT 0 0 0 0 ECU_ADDRESS 0x3FA398 /end MEASUREMENT
/begin COMPU_METHOD MC_AFR_MIN_SS_MED_ALT "AFR_MIN_SS_MED_ALT conversion" RAT_FUNC "%10.5" "Unitless" COEFFS 0 1 0 0 0 1 /end COMPU_METHOD
/begin MEASUREMENT ALTSCP "SCP message register of system fault status" UBYTE MC_ALTSCP 0 0 0 0 ECU_ADDRESS 0x3FADE6 /end MEASUREMENT
/begin COMPU_METHOD MC_ALTSCP "ALTSCP conversion" RAT_FUNC "%3.0" "Unitless" COEFFS 0 1 0 0 0 1 /end COMPU_METHOD
/begin MEASUREMENT APP "Pedal mode flag; -1 -> closed, 0 -> part, 1 -> wide open." SBYTE MC_APP 0 0 0 0 ECU_ADDRESS 0x3FA1BE /end MEASUREMENT
/begin COMPU_METHOD MC_APP "APP conversion" RAT_FUNC "%3.0" "Unitless" COEFFS 0 1 0 0 0 1 /end COMPU_METHOD
/begin MEASUREMENT APP_ENG_A[0] "Array OF PPS Values for PPS sensors before any FMEM action." FLOAT32_IEEE MC_APP_ENG_A 0 0 0 1023 ECU_ADDRESS 0x3F9A30 /end MEASUREMENT
/begin COMPU_METHOD MC_APP_ENG_A "APP_ENG_A conversion" RAT_FUNC "%10.5" "ADct/V" COEFFS 0 1 0 0 0 1 /end COMPU_METHOD
/begin MEASUREMENT APP_ENG_A[1] "Array OF PPS Values for PPS sensors before any FMEM action." FLOAT32_IEEE MC_APP_ENG_A 0 0 0 1023 ECU_ADDRESS 0x3F9A34 /end MEASUREMENT
/begin MEASUREMENT APP_ENG_A[2] "Array OF PPS Values for PPS sensors before any FMEM action." FLOAT32_IEEE MC_APP_ENG_A 0 0 0 1023 ECU_ADDRESS 0x3F9A38 /end MEASUREMENT
/begin MEASUREMENT APP_RAW[0] "Absolute angular position of  acclerator pedal" FLOAT32_IEEE MC_APP_RAW 0 0 0 100 ECU_ADDRESS 0x3F9ABC /end MEASUREMENT
/begin COMPU_METHOD MC_APP_RAW "APP_RAW conversion" RAT_FUNC "%10.5" "deg" COEFFS 0 1 0 0 0 1 /end COMPU_METHOD
/begin MEASUREMENT APP_RAW[1] "Absolute angular position of  acclerator pedal" FLOAT32_IEEE MC_APP_RAW 0 0 0 100 ECU_ADDRESS 0x3F9AC0 /end MEASUREMENT
/begin MEASUREMENT APP_RAW[2] "Absolute angular position of  acclerator pedal" FLOAT32_IEEE MC_APP_RAW 0 0 0 100 ECU_ADDRESS 0x3F9AC4 /end MEASUREMENT
/begin MEASUREMENT APP_STATUS[0] "Status of Accelerator Pedal Position input ( 0 = ok )" UBYTE MC_APP_STATUS 0 0 0 255 ECU_ADDRESS 0x3FA99C /end MEASUREMENT
/begin COMPU_METHOD MC_APP_STATUS "APP_STATUS conversion" RAT_FUNC "%3.0" "unitless" COEFFS 0 1 0 0 0 1 /end COMPU_METHOD
/begin MEASUREMENT APP_STATUS[1] "Status of Accelerator Pedal Position input ( 0 = ok )" UBYTE MC_APP_STATUS 0 0 0 255 ECU_ADDRESS 0x3FA99D /end MEASUREMENT
/begin MEASUREMENT APP_STATUS[2] "Status of Accelerator Pedal Position input ( 0 = ok )" UBYTE MC_APP_STATUS 0 0 0 255 ECU_ADDRESS 0x3FA99E /end MEASUREMENT
/begin MEASUREMENT APP_VOLTS[0] "Accelerator pedal position  input voltage" FLOAT32_IEEE MC_APP_VOLTS 0 0 0 5 ECU_ADDRESS 0x3F9AB0 /end MEASUREMENT
/begin COMPU_METHOD MC_APP_VOLTS "APP_VOLTS conversion" RAT_FUNC "%10.5" "V" COEFFS 0 1 0 0 0 1 /end COMPU_METHOD
/begin MEASUREMENT APP_VOLTS[1] "Accelerator pedal position  input voltage" FLOAT32_IEEE MC_APP_VOLTS 0 0 0 5 ECU_ADDRESS 0x3F9AB4 /end MEASUREMENT
/begin MEASUREMENT APP_VOLTS[2] "Accelerator pedal position  input voltage" FLOAT32_IEEE MC_APP_VOLTS 0 0 0 5 ECU_ADDRESS 0x3F9AB8 /end MEASUREMENT
/begin MEASUREMENT APT "Thottle mode flag; -1 -> closed, 0 -> part, 1 -> wide open." SBYTE MC_APT 0 0 0 0 ECU_ADDRESS 0x3FADE7 /end MEASUREMENT
/begin COMPU_METHOD MC_APT "APT conversion" RAT_FUNC "%3.0" "Unitless" COEFFS 0 1 0 0 0 1 /end COMPU_METHOD
/begin MEASUREMENT ASP_PEDPCNT "Pedal percentage (0-100%) sent to transmission" FLOAT32_IEEE MC_ASP_PEDPCNT 0 0 0 0 ECU_ADDRESS 0x3FA18C /end MEASUREMENT
/begin COMPU_METHOD MC_ASP_PEDPCNT "ASP_PEDPCNT conversion" RAT_FUNC "%10.5" "Unitless" COEFFS 0 1 0 0 0 1 /end COMPU_METHOD
/begin MEASUREMENT ATMR1 "Time since engine start." FLOAT32_IEEE MC_ATMR1 0 0 0 0 ECU_ADDRESS 0x3FABCC /end MEASUREMENT
/begin COMPU_METHOD MC_ATMR1 "ATMR1 conversion" RAT_FUNC "%10.5" "Unitless" COEFFS 0 1 0 0 0 1 /end COMPU_METHOD
/begin MEASUREMENT ATMR1_LST "Last calculated value of ATMR1 from previous calculation." FLOAT32_IEEE MC_ATMR1_LST 0 0 0 0 ECU_ADDRESS 0x3FABD0 /end MEASUREMENT
/begin COMPU_METHOD MC_ATMR1_LST "ATMR1_LST conversion" RAT_FUNC "%10.5" "Unitless" COEFFS 0 1 0 0 0 1 /end COMPU_METHOD
/begin MEASUREMENT ATMR2 "TIME SINCE ENGINE TEMP > TEMPFB" FLOAT32_IEEE MC_ATMR2 0 0 0 0 ECU_ADDRESS 0x3FABC8 /end MEASUREMENT
/begin COMPU_METHOD MC_ATMR2 "ATMR2 conversion" RAT_FUNC "%10.5" "Unitless" COEFFS 0 1 0 0 0 1 /end COMPU_METHOD
/begin MEASUREMENT ATMR3 "TIME IN RUN MODE" FLOAT32_IEEE MC_ATMR3 0 0 0 0 ECU_ADDRESS 0x3FABC4 /end MEASUREMENT
/begin COMPU_METHOD MC_ATMR3 "ATMR3 conversion" RAT_FUNC "%10.5" "Unitless" COEFFS 0 1 0 0 0 1 /end COMPU_METHOD
/begin CHARACTERISTIC AUTO_TRNS_SW "Calibratiion switch to allow selection between auto and manual transmission logic; 0 -> manual, 1 -> auto" VALUE 0x566B0 SD_ULONG 0 SC_AUTO_TRNS_SW 0 1 /end CHARACTERISTIC
/begin COMPU_METHOD SC_AUTO_TRNS_SW "AUTO_TRNS_SW conversion" RAT_FUNC "%10.0" "Unitless" COEFFS 0 1 0 0 0 1 /end COMPU_METHOD
/begin CHARACTERISTIC AXLE_RATIO_F "Fractional portion of Axle Ratio; BCD encoded for SCP. Hi Nibble=Tenths, Lo Nibble=Hundredths multip" VALUE 0x57714 SD_UBYTE 0 SC_AXLE_RATIO_F 0 255 /end CHARACTERISTIC
/begin COMPU_METHOD SC_AXLE_RATIO_F "AXLE_RATIO_F conversion" RAT_FUNC "%3.0" "BCD UNITS" COEFFS 0 1 0 0 0 1 /end COMPU_METHOD
/begin CHARACTERISTIC AXLE_RATIO_I "Integer portion of Axle Ratio; BCD encoded for SCP: Hi Nibble=Tens, Lo Nibble=Ones multiplier." VALUE 0x57715 SD_UBYTE 0 SC_AXLE_RATIO_I 0 255 /end CHARACTERISTIC
/begin COMPU_METHOD SC_AXLE_RATIO_I "AXLE_RATIO_I conversion" RAT_FUNC "%3.0" "BCD UNITS" COEFFS 0 1 0 0 0 1 /end COMPU_METHOD
/begin MEASUREMENT A_RATE_ENA "Flag set when Type A Packets are requested on SCP (~12.5 msec updates)" UBYTE MC_A_RATE_ENA 0 0 0 0 ECU_ADDRESS 0x3FAB17 /end MEASUREMENT
/begin COMPU_METHOD MC_A_RATE_ENA "A_RATE_ENA conversion" RAT_FUNC "%3.0" "Unitless" COEFFS 0 1 0 0 0 1 /end COMPU_METHOD
/begin MEASUREMENT BIFLG "BRAKE ON" UBYTE MC_BIFLG 0 0 0 0 ECU_ADDRESS 0x3FA15C /end MEASUREMENT
/begin COMPU_METHOD MC_BIFLG "BIFLG conversion" RAT_FUNC "%3.0" "Unitless" COEFFS 0 1 0 0 0 1 /end COMPU_METHOD
/begin CHARACTERISTIC BLANKING_RATIO "" VALUE 0x572C4 SD_FLOAT32_IEEE 0 SC_BLANKING_RATIO 0 2 /end CHARACTERISTIC
/begin COMPU_METHOD SC_BLANKING_RATIO "BLANKING_RATIO conversion" RAT_FUNC "%10.5" "unitless" COEFFS 0 1 0 0 0 1 /end COMPU_METHOD
/begin MEASUREMENT BOO_SW "brake on/off switch" UBYTE MC_BOO_SW 0 0 0 0 ECU_ADDRESS 0x3FA9FD /end MEASUREMENT
/begin COMPU_METHOD MC_BOO_SW "BOO_SW conversion" RAT_FUNC "%3.0" "Unitless" COEFFS 0 1 0 0 0 1 /end COMPU_METHOD
/begin MEASUREMENT BP "Barometric Pressure. (Note: Upper byte of BP_WORD.)" FLOAT32_IEEE MC_BP 0 0 0 0 ECU_ADDRESS 0x3FA140 /end MEASUREMENT
/begin COMPU_METHOD MC_BP "BP conversion" RAT_FUNC "%10.5" "Unitless" COEFFS 0 1 0 0 0 1 /end COMPU_METHOD
/begin MEASUREMENT BPS "Brake pressure indicator flag, 1 - pedal is depressed" UBYTE MC_BPS 0 0 0 0 ECU_ADDRESS 0x3FA9FC /end MEASUREMENT
/begin COMPU_METHOD MC_BPS "BPS conversion" RAT_FUNC "%3.0" "Unitless" COEFFS 0 1 0 0 0 1 /end COMPU_METHOD
/begin CHARACTERISTIC BP_AD_TC "Barometric Pressure filter time constant" VALUE 0x5643C SD_FLOAT32_IEEE 0 SC_BP_AD_TC 0 64 /end CHARACTERISTIC
/begin COMPU_METHOD SC_BP_AD_TC "BP_AD_TC conversion" RAT_FUNC "%10.5" "s" COEFFS 0 1 0 0 0 1 /end COMPU_METHOD
/begin CHARACTERISTIC BP_DEF "Default FMEM value for barometric pressure" VALUE 0x56440 SD_FLOAT32_IEEE 0 SC_BP_DEF 0 300 /end CHARACTERISTIC
/begin COMPU_METHOD SC_BP_DEF "BP_DEF conversion" RAT_FUNC "%10.5" "kPa" COEFFS 0 1 0 0 0 1 /end COMPU_METHOD
/begin MEASUREMENT BP_ENG_KPA "raw barometric pressure without any compensation, kPA" FLOAT32_IEEE MC_BP_ENG_KPA 0 0 0 0 ECU_ADDRESS 0x3FA9F0 /end MEASUREMENT
/begin COMPU_METHOD MC_BP_ENG_KPA "BP_ENG_KPA conversion" RAT_FUNC "%10.5" "Unitless" COEFFS 0 1 0 0 0 1 /end COMPU_METHOD
/begin MEASUREMENT BP_ENG_KPA_OFFS "BP Engineering Value with offset" FLOAT32_IEEE MC_BP_ENG_KPA_OFFS 0 0 0 0 ECU_ADDRESS 0x3F9F44 /end MEASUREMENT
/begin COMPU_METHOD MC_BP_ENG_KPA_OFFS "BP_ENG_KPA_OFFS conversion" RAT_FUNC "%10.5" "Unitless" COEFFS 0 1 0 0 0 1 /end COMPU_METHOD
/begin MEASUREMENT BP_FILT_TIME_CONST "BP filter time constant" FLOAT32_IEEE MC_BP_FILT_TIME_CONST 0 0 0 0 ECU_ADDRESS 0x3F9F40 /end MEASUREMENT
/begin COMPU_METHOD MC_BP_FILT_TIME_CONST "BP_FILT_TIME_CONST conversion" RAT_FUNC "%10.5" "Unitless" COEFFS 0 1 0 0 0 1 /end COMPU_METHOD
/begin MEASUREMENT BP_FLT_RECOVERY_FLG "1-> Indicates BP fault recovery is occuring" UBYTE MC_BP_FLT_RECOVERY_FLG 0 0 0 0 ECU_ADDRESS 0x3F9F4C /end MEASUREMENT
/begin COMPU_METHOD MC_BP_FLT_RECOVERY_FLG "BP_FLT_RECOVERY_FLG conversion" RAT_FUNC "%3.0" "Unitless" COEFFS 0 1 0 0 0 1 /end COMPU_METHOD
/begin CHARACTERISTIC BP_F_DEC "BP malf failure/update counter decrement value" VALUE 0x56468 SD_SLONG 0 SC_BP_F_DEC 0 65535 /end CHARACTERISTIC
/begin COMPU_METHOD SC_BP_F_DEC "BP_F_DEC conversion" RAT_FUNC "%10.0" "unitless" COEFFS 0 1 0 0 0 1 /end COMPU_METHOD
/begin CHARACTERISTIC BP_F_INC "BP ORH/ORL failure counter increment value" VALUE 0x5646C SD_SLONG 0 SC_BP_F_INC 0 65535 /end CHARACTERISTIC
/begin COMPU_METHOD SC_BP_F_INC "BP_F_INC conversion" RAT_FUNC "%10.0" "unitless" COEFFS 0 1 0 0 0 1 /end COMPU_METHOD
/begin MEASUREMENT BP_KPA "Barometric Pressure (in KPA)" FLOAT32_IEEE MC_BP_KPA 0 0 0 0 ECU_ADDRESS 0x3F9F48 /end MEASUREMENT
/begin COMPU_METHOD MC_BP_KPA "BP_KPA conversion" RAT_FUNC "%10.5" "Unitless" COEFFS 0 1 0 0 0 1 /end COMPU_METHOD
/begin MEASUREMENT BP_MALF_SET "Indicate BP malf  high or low failure" UBYTE MC_BP_MALF_SET 0 0 0 0 ECU_ADDRESS 0x3F9F4E /end MEASUREMENT
/begin COMPU_METHOD MC_BP_MALF_SET "BP_MALF_SET conversion" RAT_FUNC "%3.0" "Unitless" COEFFS 0 1 0 0 0 1 /end COMPU_METHOD
/begin MEASUREMENT BP_MULT "BP multiplier" FLOAT32_IEEE MC_BP_MULT 0 0 0 0 ECU_ADDRESS 0x3FAD70 /end MEASUREMENT
/begin COMPU_METHOD MC_BP_MULT "BP_MULT conversion" RAT_FUNC "%10.5" "Unitless" COEFFS 0 1 0 0 0 1 /end COMPU_METHOD
/begin MEASUREMENT BP_ORH_CNTR "Barometric Pressure out of range high counter" SLONG MC_BP_ORH_CNTR 0 0 0 0 ECU_ADDRESS 0x3F9F3C /end MEASUREMENT
/begin COMPU_METHOD MC_BP_ORH_CNTR "BP_ORH_CNTR conversion" RAT_FUNC "%10.0" "Unitless" COEFFS 0 1 0 0 0 1 /end COMPU_METHOD
/begin MEASUREMENT BP_ORL_CNTR "Barometric Pressure out of range low counter" SLONG MC_BP_ORL_CNTR 0 0 0 0 ECU_ADDRESS 0x3F9F38 /end MEASUREMENT
/begin COMPU_METHOD MC_BP_ORL_CNTR "BP_ORL_CNTR conversion" RAT_FUNC "%10.0" "Unitless" COEFFS 0 1 0 0 0 1 /end COMPU_METHOD
/begin CHARACTERISTIC BP_REC_INC "BP fault recovery counter increment value" VALUE 0x56438 SD_SLONG 0 SC_BP_REC_INC 0 65535 /end CHARACTERISTIC
/begin COMPU_METHOD SC_BP_REC_INC "BP_REC_INC conversion" RAT_FUNC "%10.0" "unitless" COEFFS 0 1 0 0 0 1 /end COMPU_METHOD
/begin MEASUREMENT BP_STATUS "bp sensor input status;  1 = low voltage error;  2 = high voltage error" UBYTE MC_BP_STATUS 0 0 0 0 ECU_ADDRESS 0x3FA9F4 /end MEASUREMENT
/begin COMPU_METHOD MC_BP_STATUS "BP_STATUS conversion" RAT_FUNC "%3.0" "Unitless" COEFFS 0 1 0 0 0 1 /end COMPU_METHOD
/begin CHARACTERISTIC BP_TCREC_SEL "Switch to select  BP filter time constant during fault recovery and during fault occurance before malf is set" VALUE 0x56444 SD_UBYTE 0 SC_BP_TCREC_SEL 0 1 /end CHARACTERISTIC
/begin COMPU_METHOD SC_BP_TCREC_SEL "BP_TCREC_SEL conversion" RAT_FUNC "%3.0" "unitless" COEFFS 0 1 0 0 0 1 /end COMPU_METHOD
/begin CHARACTERISTIC BP_VMAX "Acceptable maximum voltage limit for bp sensor" VALUE 0x573BC SD_FLOAT32_IEEE 0 SC_BP_VMAX 0 5 /end CHARACTERISTIC
/begin COMPU_METHOD SC_BP_VMAX "BP_VMAX conversion" RAT_FUNC "%10.5" "V" COEFFS 0 1 0 0 0 1 /end COMPU_METHOD
/begin CHARACTERISTIC BP_VMIN "Acceptable minimum voltage limit for bp sensor" VALUE 0x573C0 SD_FLOAT32_IEEE 0 SC_BP_VMIN 0 5 /end CHARACTERISTIC
/begin COMPU_METHOD SC_BP_VMIN "BP_VMIN conversion" RAT_FUNC "%10.5" "V" COEFFS 0 1 0 0 0 1 /end COMPU_METHOD
/begin MEASUREMENT BP_VOLTAGE "Acceptable minimum voltage limit for bp sensor" FLOAT32_IEEE MC_BP_VOLTAGE 0 0 0 0 ECU_ADDRESS 0x3FA9EC /end MEASUREMENT
/begin COMPU_METHOD MC_BP_VOLTAGE "BP_VOLTAGE conversion" RAT_FUNC "%10.5" "Unitless" COEFFS 0 1 0 0 0 1 /end COMPU_METHOD
/begin MEASUREMENT CAL_VER_CMP "Encrypted checksum calculation complete flag, 1 = complete" UBYTE MC_CAL_VER_CMP 0 0 0 0 ECU_ADDRESS 0x3FAC24 /end MEASUREMENT
/begin COMPU_METHOD MC_CAL_VER_CMP "CAL_VER_CMP conversion" RAT_FUNC "%3.0" "Unitless" COEFFS 0 1 0 0 0 1 /end COMPU_METHOD
/begin MEASUREMENT CAN_EOT "Engine oil temperature (DEGREES C) for CAN" FLOAT32_IEEE MC_CAN_EOT 0 0 0 0 ECU_ADDRESS 0x3F9F90 /end MEASUREMENT
/begin COMPU_METHOD MC_CAN_EOT "CAN_EOT conversion" RAT_FUNC "%10.5" "Unitless" COEFFS 0 1 0 0 0 1 /end COMPU_METHOD
/begin MEASUREMENT CAN_ICP "Injection Control Pressure (in MPa) for CAN" FLOAT32_IEEE MC_CAN_ICP 0 0 0 0 ECU_ADDRESS 0x3FA038 /end MEASUREMENT
/begin COMPU_METHOD MC_CAN_ICP "CAN_ICP conversion" RAT_FUNC "%10.5" "Unitless" COEFFS 0 1 0 0 0 1 /end COMPU_METHOD
/begin MEASUREMENT CAT_COUNT "Count of the number of complete catalyst test since KAM reset." UBYTE MC_CAT_COUNT 0 0 0 0 ECU_ADDRESS 0x3FAEEA /end MEASUREMENT
/begin COMPU_METHOD MC_CAT_COUNT "CAT_COUNT conversion" RAT_FUNC "%3.0" "Unitless" COEFFS 0 1 0 0 0 1 /end COMPU_METHOD
/begin MEASUREMENT CAT_FMEM "CAT system FMEM flag.  1 -> don't run CAT system due to FMEM." UBYTE MC_CAT_FMEM 0 0 0 0 ECU_ADDRESS 0x3F9F07 /end MEASUREMENT
/begin COMPU_METHOD MC_CAT_FMEM "CAT_FMEM conversion" RAT_FUNC "%3.0" "Unitless" COEFFS 0 1 0 0 0 1 /end COMPU_METHOD
/begin MEASUREMENT CAT_MON "OBDII monitor flag for catalyst; 1=>all catalyst faults have been monitored since power-up" UBYTE MC_CAT_MON 0 0 0 0 ECU_ADDRESS 0x3FADDD /end MEASUREMENT
/begin COMPU_METHOD MC_CAT_MON "CAT_MON conversion" RAT_FUNC "%3.0" "Unitless" COEFFS 0 1 0 0 0 1 /end COMPU_METHOD
/begin MEASUREMENT CAT_TST_ENA "OBD-II Catalyst Test enable flag. (1 => test enabled)" UBYTE MC_CAT_TST_ENA 0 0 0 0 ECU_ADDRESS 0x3F9EE7 /end MEASUREMENT
/begin COMPU_METHOD MC_CAT_TST_ENA "CAT_TST_ENA conversion" RAT_FUNC "%3.0" "Unitless" COEFFS 0 1 0 0 0 1 /end COMPU_METHOD
/begin MEASUREMENT CAT_TST_RDY "CAT test ready flag; 1 ->  all  local  conditions have been met; ready to run CAT test." UBYTE MC_CAT_TST_RDY 0 0 0 0 ECU_ADDRESS 0x3FADD2 /end MEASUREMENT
/begin COMPU_METHOD MC_CAT_TST_RDY "CAT_TST_RDY conversion" RAT_FUNC "%3.0" "Unitless" COEFFS 0 1 0 0 0 1 /end COMPU_METHOD
/begin MEASUREMENT CCMDIAGX_MLFUPD_EN "Diagnostic enable flag" UBYTE MC_CCMDIAGX_MLFUPD_EN 0 0 0 0 ECU_ADDRESS 0x3F9F28 /end MEASUREMENT
/begin COMPU_METHOD MC_CCMDIAGX_MLFUPD_EN "CCMDIAGX_MLFUPD_EN conversion" RAT_FUNC "%3.0" "Unitless" COEFFS 0 1 0 0 0 1 /end COMPU_METHOD
/begin MEASUREMENT CCMDIAGX_RESET_EN "Diagnostic  enable flag based on system reset flags" UBYTE MC_CCMDIAGX_RESET_EN 0 0 0 0 ECU_ADDRESS 0x3F9F29 /end MEASUREMENT
/begin COMPU_METHOD MC_CCMDIAGX_RESET_EN "CCMDIAGX_RESET_EN conversion" RAT_FUNC "%3.0" "Unitless" COEFFS 0 1 0 0 0 1 /end COMPU_METHOD
/begin MEASUREMENT CCM_ENA_FLG "CCM_* test is enabled; 1-> CCM_TST_ENA = 1 or CCM_EO_ENA 1, or CCM_ER_ENA = 1." UBYTE MC_CCM_ENA_FLG 0 0 0 0 ECU_ADDRESS 0x3F9ED8 /end MEASUREMENT
/begin COMPU_METHOD MC_CCM_ENA_FLG "CCM_ENA_FLG conversion" RAT_FUNC "%3.0" "Unitless" COEFFS 0 1 0 0 0 1 /end COMPU_METHOD
/begin CHARACTERISTIC CCM_EO_DONE "Value of EO_STATUS when CCM on demand engine off test is complete" VALUE 0x57853 SD_UBYTE 0 SC_CCM_EO_DONE 0 100 /end CHARACTERISTIC
/begin COMPU_METHOD SC_CCM_EO_DONE "CCM_EO_DONE conversion" RAT_FUNC "%3.0" "unitless" COEFFS 0 1 0 0 0 1 /end COMPU_METHOD
/begin MEASUREMENT CCM_EO_ENA "Engine off on demand test for CCM enabled." UBYTE MC_CCM_EO_ENA 0 0 0 0 ECU_ADDRESS 0x3FAB78 /end MEASUREMENT
/begin COMPU_METHOD MC_CCM_EO_ENA "CCM_EO_ENA conversion" RAT_FUNC "%3.0" "Unitless" COEFFS 0 1 0 0 0 1 /end COMPU_METHOD
/begin CHARACTERISTIC CCM_EO_WAIT "Value of EO_STATUS when waiting for engine off CCM test to complete" VALUE 0x57854 SD_UBYTE 0 SC_CCM_EO_WAIT 0 100 /end CHARACTERISTIC
/begin COMPU_METHOD SC_CCM_EO_WAIT "CCM_EO_WAIT conversion" RAT_FUNC "%3.0" "unitless" COEFFS 0 1 0 0 0 1 /end COMPU_METHOD
/begin MEASUREMENT CCM_ER_ENA "Engine running on demand test for CCM enabled." UBYTE MC_CCM_ER_ENA 0 0 0 0 ECU_ADDRESS 0x3FAB99 /end MEASUREMENT
/begin COMPU_METHOD MC_CCM_ER_ENA "CCM_ER_ENA conversion" RAT_FUNC "%3.0" "Unitless" COEFFS 0 1 0 0 0 1 /end COMPU_METHOD
/begin MEASUREMENT CCM_FMEM "CCM system FMEM flag.  1 -> don't run CCM due to FMEM." UBYTE MC_CCM_FMEM 0 0 0 0 ECU_ADDRESS 0x3F9F06 /end MEASUREMENT
/begin COMPU_METHOD MC_CCM_FMEM "CCM_FMEM conversion" RAT_FUNC "%3.0" "Unitless" COEFFS 0 1 0 0 0 1 /end COMPU_METHOD
/begin CHARACTERISTIC CCM_IVPWR_MAX "Maximum system voltage threshold above which diagnostics tests are disabled" VALUE 0x56428 SD_FLOAT32_IEEE 0 SC_CCM_IVPWR_MAX 0 30 /end CHARACTERISTIC
/begin COMPU_METHOD SC_CCM_IVPWR_MAX "CCM_IVPWR_MAX conversion" RAT_FUNC "%10.5" "V" COEFFS 0 1 0 0 0 1 /end COMPU_METHOD
/begin CHARACTERISTIC CCM_IVPWR_MIN "Minimum system voltage threshold below which diagnostics are disabled" VALUE 0x56424 SD_FLOAT32_IEEE 0 SC_CCM_IVPWR_MIN 0 30 /end CHARACTERISTIC
/begin COMPU_METHOD SC_CCM_IVPWR_MIN "CCM_IVPWR_MIN conversion" RAT_FUNC "%10.5" "V" COEFFS 0 1 0 0 0 1 /end COMPU_METHOD
/begin MEASUREMENT CCM_MON "OBDII monitor flag for comp components. 1=>all CCM faults have been monitored since power-up" UBYTE MC_CCM_MON 0 0 0 0 ECU_ADDRESS 0x3FADDC /end MEASUREMENT
/begin COMPU_METHOD MC_CCM_MON "CCM_MON conversion" RAT_FUNC "%3.0" "Unitless" COEFFS 0 1 0 0 0 1 /end COMPU_METHOD
/begin CHARACTERISTIC CCM_PUTM "Diagnostic enable time" VALUE 0x5642C SD_FLOAT32_IEEE 0 SC_CCM_PUTM 0 63.999 /end CHARACTERISTIC
/begin COMPU_METHOD SC_CCM_PUTM "CCM_PUTM conversion" RAT_FUNC "%10.5" "s" COEFFS 0 1 0 0 0 1 /end COMPU_METHOD
/begin MEASUREMENT CCM_TST_ENA "OBD-II Comprehensive Component Test enable flag; 1 -> test enabled." UBYTE MC_CCM_TST_ENA 0 0 0 0 ECU_ADDRESS 0x3F9EE6 /end MEASUREMENT
/begin COMPU_METHOD MC_CCM_TST_ENA "CCM_TST_ENA conversion" RAT_FUNC "%3.0" "Unitless" COEFFS 0 1 0 0 0 1 /end COMPU_METHOD
/begin MEASUREMENT CFMFLG "ECT failure mode (FMEM) flag." UBYTE MC_CFMFLG 0 0 0 0 ECU_ADDRESS 0x3F9FE6 /end MEASUREMENT
/begin COMPU_METHOD MC_CFMFLG "CFMFLG conversion" RAT_FUNC "%3.0" "Unitless" COEFFS 0 1 0 0 0 1 /end COMPU_METHOD
/begin MEASUREMENT CHKD_FLAGS "bit0=cat_chkd;bit2=purg_chkd;bit3=sair_chkd;bit5;ego_chkd;bit6=egr_chkd" UBYTE MC_CHKD_FLAGS 0 0 0 0 ECU_ADDRESS 0x3FAEE4 /end MEASUREMENT
/begin COMPU_METHOD MC_CHKD_FLAGS "CHKD_FLAGS conversion" RAT_FUNC "%3.0" "Unitless" COEFFS 0 1 0 0 0 1 /end COMPU_METHOD
/begin MEASUREMENT CODES_CHECKD "Flag indicating the warm-up counters for OBD-II codes have been checked." UBYTE MC_CODES_CHECKD 0 0 0 0 ECU_ADDRESS 0x3F9EBC /end MEASUREMENT
/begin COMPU_METHOD MC_CODES_CHECKD "CODES_CHECKD conversion" RAT_FUNC "%3.0" "Unitless" COEFFS 0 1 0 0 0 1 /end COMPU_METHOD
/begin MEASUREMENT CODES_COUNT "Count of total number of fault codes and pending codes (MIL and NO_MIL) stored by the EEC." UBYTE MC_CODES_COUNT 0 0 0 0 ECU_ADDRESS 0x3FAEBC /end MEASUREMENT
/begin COMPU_METHOD MC_CODES_COUNT "CODES_COUNT conversion" RAT_FUNC "%3.0" "Unitless" COEFFS 0 1 0 0 0 1 /end COMPU_METHOD
/begin MEASUREMENT COD_ANT_SCAN "Flag indicating that an incorrect PATS incode has been entered." UBYTE MC_COD_ANT_SCAN 0 0 0 0 ECU_ADDRESS 0x3FB040 /end MEASUREMENT
/begin COMPU_METHOD MC_COD_ANT_SCAN "COD_ANT_SCAN conversion" RAT_FUNC "%3.0" "Unitless" COEFFS 0 1 0 0 0 1 /end COMPU_METHOD
/begin MEASUREMENT COLDIDLEMLT "Output from FNCOLIDLMLT" FLOAT32_IEEE MC_COLDIDLEMLT 0 0 0 0 ECU_ADDRESS 0x3FAF78 /end MEASUREMENT
/begin COMPU_METHOD MC_COLDIDLEMLT "COLDIDLEMLT conversion" RAT_FUNC "%10.5" "Unitless" COEFFS 0 1 0 0 0 1 /end COMPU_METHOD
/begin MEASUREMENT COLDIDLETMR "Cold idle timer" FLOAT32_IEEE MC_COLDIDLETMR 0 0 0 0 ECU_ADDRESS 0x3FA27C /end MEASUREMENT
/begin COMPU_METHOD MC_COLDIDLETMR "COLDIDLETMR conversion" RAT_FUNC "%10.5" "Unitless" COEFFS 0 1 0 0 0 1 /end COMPU_METHOD
/begin MEASUREMENT COOL_FLG "Overtemp flag; 1 -> overtemp condition." UBYTE MC_COOL_FLG 0 0 0 0 ECU_ADDRESS 0x3FA15D /end MEASUREMENT
/begin COMPU_METHOD MC_COOL_FLG "COOL_FLG conversion" RAT_FUNC "%3.0" "Unitless" COEFFS 0 1 0 0 0 1 /end COMPU_METHOD
/begin MEASUREMENT COOL_MIL_ON "MIL status flag for fail safe cooling." UBYTE MC_COOL_MIL_ON 0 0 0 0 ECU_ADDRESS 0x3FAEBA /end MEASUREMENT
/begin COMPU_METHOD MC_COOL_MIL_ON "COOL_MIL_ON conversion" RAT_FUNC "%3.0" "Unitless" COEFFS 0 1 0 0 0 1 /end COMPU_METHOD
/begin CHARACTERISTIC COOL_MIL_SW "Fail safe cooling MIL enable switch." VALUE 0x56347 SD_UBYTE 0 SC_COOL_MIL_SW 0 1 /end CHARACTERISTIC
/begin COMPU_METHOD SC_COOL_MIL_SW "COOL_MIL_SW conversion" RAT_FUNC "%3.0" "SWITCH" COEFFS 0 1 0 0 0 1 /end COMPU_METHOD
/begin MEASUREMENT CRANK_ANGLE "Cylinder Position expressed as degrees of crank." FLOAT32_IEEE MC_CRANK_ANGLE 0 0 0 0 ECU_ADDRESS 0x3FA974 /end MEASUREMENT
/begin COMPU_METHOD MC_CRANK_ANGLE "CRANK_ANGLE conversion" RAT_FUNC "%10.5" "Unitless" COEFFS 0 1 0 0 0 1 /end COMPU_METHOD
/begin MEASUREMENT CRANK_FLG "engine in crank" UBYTE MC_CRANK_FLG 0 0 0 0 ECU_ADDRESS 0x3FA3DC /end MEASUREMENT
/begin COMPU_METHOD MC_CRANK_FLG "CRANK_FLG conversion" RAT_FUNC "%3.0" "Unitless" COEFFS 0 1 0 0 0 1 /end COMPU_METHOD
/begin MEASUREMENT CRANK_TMR "FMEM - Time since crank mode entered" FLOAT32_IEEE MC_CRANK_TMR 0 0 0 0 ECU_ADDRESS 0x3FA3E8 /end MEASUREMENT
/begin COMPU_METHOD MC_CRANK_TMR "CRANK_TMR conversion" RAT_FUNC "%10.5" "Unitless" COEFFS 0 1 0 0 0 1 /end COMPU_METHOD
/begin MEASUREMENT CRKFLG "Crank Flag; 1 -> In Crank Mode, 0 -> Not in Crank Mode." UBYTE MC_CRKFLG 0 0 0 0 ECU_ADDRESS 0x3FA15B /end MEASUREMENT
/begin COMPU_METHOD MC_CRKFLG "CRKFLG conversion" RAT_FUNC "%3.0" "Unitless" COEFFS 0 1 0 0 0 1 /end COMPU_METHOD
/begin MEASUREMENT CRNK_TMR "Time since last crankshaft interrupt (PIP)" ULONG MC_CRNK_TMR 0 0 0 0 ECU_ADDRESS 0x3FA3EC /end MEASUREMENT
/begin COMPU_METHOD MC_CRNK_TMR "CRNK_TMR conversion" RAT_FUNC "%10.0" "Unitless" COEFFS 0 1 0 0 0 1 /end COMPU_METHOD
/begin MEASUREMENT CTTMR "AT CLOSED THROTTLE TIMER" FLOAT32_IEEE MC_CTTMR 0 0 0 0 ECU_ADDRESS 0x3FABB8 /end MEASUREMENT
/begin COMPU_METHOD MC_CTTMR "CTTMR conversion" RAT_FUNC "%10.5" "Unitless" COEFFS 0 1 0 0 0 1 /end COMPU_METHOD
/begin MEASUREMENT DEMAND_ABORT "Flag indicating that an on demand test is in the progress of a abort" UBYTE MC_DEMAND_ABORT 0 0 0 0 ECU_ADDRESS 0x3FAB98 /end MEASUREMENT
/begin COMPU_METHOD MC_DEMAND_ABORT "DEMAND_ABORT conversion" RAT_FUNC "%3.0" "Unitless" COEFFS 0 1 0 0 0 1 /end COMPU_METHOD
/begin MEASUREMENT DEMAND_MODE "Flag set when an On-Demand self test mode is active." UBYTE MC_DEMAND_MODE 0 0 0 0 ECU_ADDRESS 0x3F9EDE /end MEASUREMENT
/begin COMPU_METHOD MC_DEMAND_MODE "DEMAND_MODE conversion" RAT_FUNC "%3.0" "Unitless" COEFFS 0 1 0 0 0 1 /end COMPU_METHOD
/begin MEASUREMENT DEMAND_TIMER "Utility timer for sequenced on demand tests." FLOAT32_IEEE MC_DEMAND_TIMER 0 0 0 0 ECU_ADDRESS 0x3FAB74 /end MEASUREMENT
/begin COMPU_METHOD MC_DEMAND_TIMER "DEMAND_TIMER conversion" RAT_FUNC "%10.5" "Unitless" COEFFS 0 1 0 0 0 1 /end COMPU_METHOD
/begin CHARACTERISTIC DENSITY "Standard diesel fuel density (mg/mm**3)" VALUE 0x56A08 SD_FLOAT32_IEEE 0 SC_DENSITY 0.8 0.9 /end CHARACTERISTIC
/begin COMPU_METHOD SC_DENSITY "DENSITY conversion" RAT_FUNC "%10.5" "unitless" COEFFS 0 1 0 0 0 1 /end COMPU_METHOD
/begin MEASUREMENT DENSITY_MULT "Fuel density adjustment" FLOAT32_IEEE MC_DENSITY_MULT 0 0 0 0 ECU_ADDRESS 0x3FA324 /end MEASUREMENT
/begin COMPU_METHOD MC_DENSITY_MULT "DENSITY_MULT conversion" RAT_FUNC "%10.5" "Unitless" COEFFS 0 1 0 0 0 1 /end COMPU_METHOD
/begin MEASUREMENT DIAGX_RESET "1 = The OBD diagnostic system reset is requested." UBYTE MC_DIAGX_RESET 0 0 0 0 ECU_ADDRESS 0x3F9EB8 /end MEASUREMENT
/begin COMPU_METHOD MC_DIAGX_RESET "DIAGX_RESET conversion" RAT_FUNC "%3.0" "Unitless" COEFFS 0 1 0 0 0 1 /end COMPU_METHOD
/begin MEASUREMENT DIAG_TST_STP "Navistar Diesel KOEO step pointer." UBYTE MC_DIAG_TST_STP 0 0 0 0 ECU_ADDRESS 0x3FA7F1 /end MEASUREMENT
/begin COMPU_METHOD MC_DIAG_TST_STP "DIAG_TST_STP conversion" RAT_FUNC "%3.0" "Unitless" COEFFS 0 1 0 0 0 1 /end COMPU_METHOD
/begin CHARACTERISTIC DISPL_LITERS "Engine displacement in liters. Calibrate as 10*Displacement (example: 3.8L == 38 decimal) for SCP>" VALUE 0x5771A SD_UBYTE 0 SC_DISPL_LITERS 0 255 /end CHARACTERISTIC
/begin COMPU_METHOD SC_DISPL_LITERS "DISPL_LITERS conversion" RAT_FUNC "%3.0" "LITERS" COEFFS 0 1 0 0 0 1 /end COMPU_METHOD
/begin MEASUREMENT DITDES "Desired engine timing degrees (Crank Deg/BTDC)" FLOAT32_IEEE MC_DITDES 0 0 0 0 ECU_ADDRESS 0x3FA430 /end MEASUREMENT
/begin COMPU_METHOD MC_DITDES "DITDES conversion" RAT_FUNC "%10.5" "Unitless" COEFFS 0 1 0 0 0 1 /end COMPU_METHOD
/begin CHARACTERISTIC DITDES_LMN "Direct Injection Timing Desired Minimum" VALUE 0x56B40 SD_FLOAT32_IEEE 0 SC_DITDES_LMN -15 5 /end CHARACTERISTIC
/begin COMPU_METHOD SC_DITDES_LMN "DITDES_LMN conversion" RAT_FUNC "%10.5" "deg" COEFFS 0 1 0 0 0 1 /end COMPU_METHOD
/begin CHARACTERISTIC DITDES_LMX "Direct Injection Timing Desired Maximum" VALUE 0x56B3C SD_FLOAT32_IEEE 0 SC_DITDES_LMX 0 135 /end CHARACTERISTIC
/begin COMPU_METHOD SC_DITDES_LMX "DITDES_LMX conversion" RAT_FUNC "%10.5" "deg" COEFFS 0 1 0 0 0 1 /end COMPU_METHOD
/begin CHARACTERISTIC DITOFST "Calibratable Direct Injection Timing Desired Offset" VALUE 0x56B34 SD_FLOAT32_IEEE 0 SC_DITOFST -20 63.9 /end CHARACTERISTIC
/begin COMPU_METHOD SC_DITOFST "DITOFST conversion" RAT_FUNC "%10.5" "deg" COEFFS 0 1 0 0 0 1 /end COMPU_METHOD
/begin MEASUREMENT DIT_HI_ALT "DIT for high altitude (Crank Deg/BTDC)" FLOAT32_IEEE MC_DIT_HI_ALT 0 0 0 0 ECU_ADDRESS 0x3FA478 /end MEASUREMENT
/begin COMPU_METHOD MC_DIT_HI_ALT "DIT_HI_ALT conversion" RAT_FUNC "%10.5" "Unitless" COEFFS 0 1 0 0 0 1 /end COMPU_METHOD
/begin MEASUREMENT DIT_HI_ALT_P "DIT for high altitude (Crank Deg/BTDC)" FLOAT32_IEEE MC_DIT_HI_ALT_P 0 0 0 0 ECU_ADDRESS 0x3FA45C /end MEASUREMENT
/begin COMPU_METHOD MC_DIT_HI_ALT_P "DIT_HI_ALT_P conversion" RAT_FUNC "%10.5" "Unitless" COEFFS 0 1 0 0 0 1 /end COMPU_METHOD
/begin MEASUREMENT DIT_HI_COLD_ADV "" FLOAT32_IEEE MC_DIT_HI_COLD_ADV 0 0 0 0 ECU_ADDRESS 0x3FA490 /end MEASUREMENT
/begin COMPU_METHOD MC_DIT_HI_COLD_ADV "DIT_HI_COLD_ADV conversion" RAT_FUNC "%10.5" "Unitless" COEFFS 0 1 0 0 0 1 /end COMPU_METHOD
/begin MEASUREMENT DIT_HI_COLD_ADV_P "" FLOAT32_IEEE MC_DIT_HI_COLD_ADV_P 0 0 0 0 ECU_ADDRESS 0x3FA484 /end MEASUREMENT
/begin COMPU_METHOD MC_DIT_HI_COLD_ADV_P "DIT_HI_COLD_ADV_P conversion" RAT_FUNC "%10.5" "Unitless" COEFFS 0 1 0 0 0 1 /end COMPU_METHOD
/begin MEASUREMENT DIT_LO_ALT "DIT for low altitude (Crank Deg/BTDC)" FLOAT32_IEEE MC_DIT_LO_ALT 0 0 0 0 ECU_ADDRESS 0x3FA480 /end MEASUREMENT
/begin COMPU_METHOD MC_DIT_LO_ALT "DIT_LO_ALT conversion" RAT_FUNC "%10.5" "Unitless" COEFFS 0 1 0 0 0 1 /end COMPU_METHOD
/begin MEASUREMENT DIT_LO_ALT_P "DIT for low altitude (Crank Deg/BTDC)" FLOAT32_IEEE MC_DIT_LO_ALT_P 0 0 0 0 ECU_ADDRESS 0x3FA464 /end MEASUREMENT
/begin COMPU_METHOD MC_DIT_LO_ALT_P "DIT_LO_ALT_P conversion" RAT_FUNC "%10.5" "Unitless" COEFFS 0 1 0 0 0 1 /end COMPU_METHOD
/begin MEASUREMENT DIT_LO_COLD_ADV "" FLOAT32_IEEE MC_DIT_LO_COLD_ADV 0 0 0 0 ECU_ADDRESS 0x3FA498 /end MEASUREMENT
/begin COMPU_METHOD MC_DIT_LO_COLD_ADV "DIT_LO_COLD_ADV conversion" RAT_FUNC "%10.5" "Unitless" COEFFS 0 1 0 0 0 1 /end COMPU_METHOD
/begin MEASUREMENT DIT_LO_COLD_ADV_P "" FLOAT32_IEEE MC_DIT_LO_COLD_ADV_P 0 0 0 0 ECU_ADDRESS 0x3FA48C /end MEASUREMENT
/begin COMPU_METHOD MC_DIT_LO_COLD_ADV_P "DIT_LO_COLD_ADV_P conversion" RAT_FUNC "%10.5" "Unitless" COEFFS 0 1 0 0 0 1 /end COMPU_METHOD
/begin MEASUREMENT DIT_MED_ALT "" FLOAT32_IEEE MC_DIT_MED_ALT 0 0 0 0 ECU_ADDRESS 0x3FA47C /end MEASUREMENT
/begin COMPU_METHOD MC_DIT_MED_ALT "DIT_MED_ALT conversion" RAT_FUNC "%10.5" "Unitless" COEFFS 0 1 0 0 0 1 /end COMPU_METHOD
/begin MEASUREMENT DIT_MED_ALT_P "" FLOAT32_IEEE MC_DIT_MED_ALT_P 0 0 0 0 ECU_ADDRESS 0x3FA460 /end MEASUREMENT
/begin COMPU_METHOD MC_DIT_MED_ALT_P "DIT_MED_ALT_P conversion" RAT_FUNC "%10.5" "Unitless" COEFFS 0 1 0 0 0 1 /end COMPU_METHOD
/begin MEASUREMENT DIT_MED_COLD_ADV "" FLOAT32_IEEE MC_DIT_MED_COLD_ADV 0 0 0 0 ECU_ADDRESS 0x3FA494 /end MEASUREMENT
/begin COMPU_METHOD MC_DIT_MED_COLD_ADV "DIT_MED_COLD_ADV conversion" RAT_FUNC "%10.5" "Unitless" COEFFS 0 1 0 0 0 1 /end COMPU_METHOD
/begin MEASUREMENT DIT_MED_COLD_ADV_P "" FLOAT32_IEEE MC_DIT_MED_COLD_ADV_P 0 0 0 0 ECU_ADDRESS 0x3FA488 /end MEASUREMENT
/begin COMPU_METHOD MC_DIT_MED_COLD_ADV_P "DIT_MED_COLD_ADV_P conversion" RAT_FUNC "%10.5" "Unitless" COEFFS 0 1 0 0 0 1 /end COMPU_METHOD
/begin MEASUREMENT DIT_N_MAT_HI "" FLOAT32_IEEE MC_DIT_N_MAT_HI 0 0 0 0 ECU_ADDRESS 0x3FA414 /end MEASUREMENT
/begin COMPU_METHOD MC_DIT_N_MAT_HI "DIT_N_MAT_HI conversion" RAT_FUNC "%10.5" "Unitless" COEFFS 0 1 0 0 0 1 /end COMPU_METHOD
/begin MEASUREMENT DIT_N_MAT_HI_P "" FLOAT32_IEEE MC_DIT_N_MAT_HI_P 0 0 0 0 ECU_ADDRESS 0x3FA410 /end MEASUREMENT
/begin COMPU_METHOD MC_DIT_N_MAT_HI_P "DIT_N_MAT_HI_P conversion" RAT_FUNC "%10.5" "Unitless" COEFFS 0 1 0 0 0 1 /end COMPU_METHOD
/begin MEASUREMENT DIT_N_MAT_LO "" FLOAT32_IEEE MC_DIT_N_MAT_LO 0 0 0 0 ECU_ADDRESS 0x3FA424 /end MEASUREMENT
/begin COMPU_METHOD MC_DIT_N_MAT_LO "DIT_N_MAT_LO conversion" RAT_FUNC "%10.5" "Unitless" COEFFS 0 1 0 0 0 1 /end COMPU_METHOD
/begin MEASUREMENT DIT_N_MAT_LO_P "" FLOAT32_IEEE MC_DIT_N_MAT_LO_P 0 0 0 0 ECU_ADDRESS 0x3FA420 /end MEASUREMENT
/begin COMPU_METHOD MC_DIT_N_MAT_LO_P "DIT_N_MAT_LO_P conversion" RAT_FUNC "%10.5" "Unitless" COEFFS 0 1 0 0 0 1 /end COMPU_METHOD
/begin MEASUREMENT DIT_N_MAT_MED "" FLOAT32_IEEE MC_DIT_N_MAT_MED 0 0 0 0 ECU_ADDRESS 0x3FA41C /end MEASUREMENT
/begin COMPU_METHOD MC_DIT_N_MAT_MED "DIT_N_MAT_MED conversion" RAT_FUNC "%10.5" "Unitless" COEFFS 0 1 0 0 0 1 /end COMPU_METHOD
/begin MEASUREMENT DIT_N_MAT_MED_P "" FLOAT32_IEEE MC_DIT_N_MAT_MED_P 0 0 0 0 ECU_ADDRESS 0x3FA418 /end MEASUREMENT
/begin COMPU_METHOD MC_DIT_N_MAT_MED_P "DIT_N_MAT_MED_P conversion" RAT_FUNC "%10.5" "Unitless" COEFFS 0 1 0 0 0 1 /end COMPU_METHOD
/begin MEASUREMENT DLOAD_ADR "Address at which the next download message will store its bytes." ULONG MC_DLOAD_ADR 0 0 0 0 ECU_ADDRESS 0x3FAB28 /end MEASUREMENT
/begin COMPU_METHOD MC_DLOAD_ADR "DLOAD_ADR conversion" RAT_FUNC "%10.0" "Unitless" COEFFS 0 1 0 0 0 1 /end COMPU_METHOD
/begin MEASUREMENT DLOAD_CNT "Number of bytes yet to be downloaded from off board tool." UWORD MC_DLOAD_CNT 0 0 0 0 ECU_ADDRESS 0x3FAB2C /end MEASUREMENT
/begin COMPU_METHOD MC_DLOAD_CNT "DLOAD_CNT conversion" RAT_FUNC "%5.0" "Unitless" COEFFS 0 1 0 0 0 1 /end COMPU_METHOD
/begin MEASUREMENT DLOAD_EXEC_KEY "Command Key byte to enable execution of a program downloaded from ODU" UWORD MC_DLOAD_EXEC_KEY 0 0 0 0 ECU_ADDRESS 0x3FAB36 /end MEASUREMENT
/begin COMPU_METHOD MC_DLOAD_EXEC_KEY "DLOAD_EXEC_KEY conversion" RAT_FUNC "%5.0" "Unitless" COEFFS 0 1 0 0 0 1 /end COMPU_METHOD
/begin MEASUREMENT DNDT_RAW "Engine acceleration from engine position input driver (RPM/S)." FLOAT32_IEEE MC_DNDT_RAW 0 0 0 0 ECU_ADDRESS 0x3FA978 /end MEASUREMENT
/begin COMPU_METHOD MC_DNDT_RAW "DNDT_RAW conversion" RAT_FUNC "%10.5" "Unitless" COEFFS 0 1 0 0 0 1 /end COMPU_METHOD
/begin CHARACTERISTIC DNDT_THRESHOLD "" VALUE 0x572C0 SD_FLOAT32_IEEE 0 SC_DNDT_THRESHOLD 0 20000 /end CHARACTERISTIC
/begin COMPU_METHOD SC_DNDT_THRESHOLD "DNDT_THRESHOLD conversion" RAT_FUNC "%10.5" "RPM" COEFFS 0 1 0 0 0 1 /end COMPU_METHOD
/begin MEASUREMENT DN_FF_TMRCTL "Governor 'FF' term for D/N timer flag (1=count)" UBYTE MC_DN_FF_TMRCTL 0 0 0 0 ECU_ADDRESS 0x3FA2EC /end MEASUREMENT
/begin COMPU_METHOD MC_DN_FF_TMRCTL "DN_FF_TMRCTL conversion" RAT_FUNC "%3.0" "Unitless" COEFFS 0 1 0 0 0 1 /end COMPU_METHOD
/begin MEASUREMENT DOT_NE "Engine speed derivative over time, rpm/sec." FLOAT32_IEEE MC_DOT_NE 0 0 0 0 ECU_ADDRESS 0x3FA13C /end MEASUREMENT
/begin COMPU_METHOD MC_DOT_NE "DOT_NE conversion" RAT_FUNC "%10.5" "Unitless" COEFFS 0 1 0 0 0 1 /end COMPU_METHOD
/begin MEASUREMENT DP_ANTI_FOUL_MULT "" FLOAT32_IEEE MC_DP_ANTI_FOUL_MULT 0 0 0 0 ECU_ADDRESS 0x3FA780 /end MEASUREMENT
/begin COMPU_METHOD MC_DP_ANTI_FOUL_MULT "DP_ANTI_FOUL_MULT conversion" RAT_FUNC "%10.5" "Unitless" COEFFS 0 1 0 0 0 1 /end COMPU_METHOD
/begin MEASUREMENT DP_DP "" FLOAT32_IEEE MC_DP_DP 0 0 0 0 ECU_ADDRESS 0x3FA77C /end MEASUREMENT
/begin COMPU_METHOD MC_DP_DP "DP_DP conversion" RAT_FUNC "%10.5" "Unitless" COEFFS 0 1 0 0 0 1 /end COMPU_METHOD
/begin MEASUREMENT DP_EGRP_DES "" FLOAT32_IEEE MC_DP_EGRP_DES 0 0 0 0 ECU_ADDRESS 0x3FA724 /end MEASUREMENT
/begin COMPU_METHOD MC_DP_EGRP_DES "DP_EGRP_DES conversion" RAT_FUNC "%10.5" "Unitless" COEFFS 0 1 0 0 0 1 /end COMPU_METHOD
/begin MEASUREMENT DP_EGRP_ERR "" FLOAT32_IEEE MC_DP_EGRP_ERR 0 0 0 0 ECU_ADDRESS 0x3FA720 /end MEASUREMENT
/begin COMPU_METHOD MC_DP_EGRP_ERR "DP_EGRP_ERR conversion" RAT_FUNC "%10.5" "Unitless" COEFFS 0 1 0 0 0 1 /end COMPU_METHOD
/begin MEASUREMENT DP_EGRP_ERR_DER "" FLOAT32_IEEE MC_DP_EGRP_ERR_DER 0 0 0 0 ECU_ADDRESS 0x3FA71C /end MEASUREMENT
/begin COMPU_METHOD MC_DP_EGRP_ERR_DER "DP_EGRP_ERR_DER conversion" RAT_FUNC "%10.5" "Unitless" COEFFS 0 1 0 0 0 1 /end COMPU_METHOD
/begin MEASUREMENT DP_EGRP_ERR_DER_DIFF "" FLOAT32_IEEE MC_DP_EGRP_ERR_DER_DIFF 0 0 0 0 ECU_ADDRESS 0x3FA718 /end MEASUREMENT
/begin COMPU_METHOD MC_DP_EGRP_ERR_DER_DIFF "DP_EGRP_ERR_DER_DIFF conversion" RAT_FUNC "%10.5" "Unitless" COEFFS 0 1 0 0 0 1 /end COMPU_METHOD
/begin MEASUREMENT DP_EGRP_ERR_FILT "" FLOAT32_IEEE MC_DP_EGRP_ERR_FILT 0 0 0 0 ECU_ADDRESS 0x3FA714 /end MEASUREMENT
/begin COMPU_METHOD MC_DP_EGRP_ERR_FILT "DP_EGRP_ERR_FILT conversion" RAT_FUNC "%10.5" "Unitless" COEFFS 0 1 0 0 0 1 /end COMPU_METHOD
/begin MEASUREMENT DP_EGRVP_DES "" FLOAT32_IEEE MC_DP_EGRVP_DES 0 0 0 0 ECU_ADDRESS 0x3FA710 /end MEASUREMENT
/begin COMPU_METHOD MC_DP_EGRVP_DES "DP_EGRVP_DES conversion" RAT_FUNC "%10.5" "Unitless" COEFFS 0 1 0 0 0 1 /end COMPU_METHOD
/begin CHARACTERISTIC DP_EGR_COND_CAL "" VALUE 0x57020 SD_FLOAT32_IEEE 0 SC_DP_EGR_COND_CAL 0 1 /end CHARACTERISTIC
/begin COMPU_METHOD SC_DP_EGR_COND_CAL "DP_EGR_COND_CAL conversion" RAT_FUNC "%10.5" "unitless" COEFFS 0 1 0 0 0 1 /end COMPU_METHOD
/begin CHARACTERISTIC DP_EGR_COND_SEL "" VALUE 0x570B4 SD_UBYTE 0 SC_DP_EGR_COND_SEL 0 1 /end CHARACTERISTIC
/begin COMPU_METHOD SC_DP_EGR_COND_SEL "DP_EGR_COND_SEL conversion" RAT_FUNC "%3.0" "unitless" COEFFS 0 1 0 0 0 1 /end COMPU_METHOD
/begin MEASUREMENT DP_EGR_DTY "" FLOAT32_IEEE MC_DP_EGR_DTY 0 0 0 0 ECU_ADDRESS 0x3FA774 /end MEASUREMENT
/begin COMPU_METHOD MC_DP_EGR_DTY "DP_EGR_DTY conversion" RAT_FUNC "%10.5" "Unitless" COEFFS 0 1 0 0 0 1 /end COMPU_METHOD
/begin CHARACTERISTIC DP_EGR_DTY_CAL "" VALUE 0x57014 SD_FLOAT32_IEEE 0 SC_DP_EGR_DTY_CAL 0 1 /end CHARACTERISTIC
/begin COMPU_METHOD SC_DP_EGR_DTY_CAL "DP_EGR_DTY_CAL conversion" RAT_FUNC "%10.5" "unitless" COEFFS 0 1 0 0 0 1 /end COMPU_METHOD
/begin CHARACTERISTIC DP_EGR_DTY_LMN "" VALUE 0x57010 SD_FLOAT32_IEEE 0 SC_DP_EGR_DTY_LMN -1 1 /end CHARACTERISTIC
/begin COMPU_METHOD SC_DP_EGR_DTY_LMN "DP_EGR_DTY_LMN conversion" RAT_FUNC "%10.5" "unitless" COEFFS 0 1 0 0 0 1 /end COMPU_METHOD
/begin CHARACTERISTIC DP_EGR_DTY_LMX "" VALUE 0x5700C SD_FLOAT32_IEEE 0 SC_DP_EGR_DTY_LMX 0 2 /end CHARACTERISTIC
/begin COMPU_METHOD SC_DP_EGR_DTY_LMX "DP_EGR_DTY_LMX conversion" RAT_FUNC "%10.5" "unitless" COEFFS 0 1 0 0 0 1 /end COMPU_METHOD
/begin MEASUREMENT DP_EGR_DUTY "" FLOAT32_IEEE MC_DP_EGR_DUTY 0 0 0 0 ECU_ADDRESS 0x3FA770 /end MEASUREMENT
/begin COMPU_METHOD MC_DP_EGR_DUTY "DP_EGR_DUTY conversion" RAT_FUNC "%10.5" "Unitless" COEFFS 0 1 0 0 0 1 /end COMPU_METHOD
/begin CHARACTERISTIC DP_EGR_D_DTY_LMN "" VALUE 0x5701C SD_FLOAT32_IEEE 0 SC_DP_EGR_D_DTY_LMN -1 2 /end CHARACTERISTIC
/begin COMPU_METHOD SC_DP_EGR_D_DTY_LMN "DP_EGR_D_DTY_LMN conversion" RAT_FUNC "%10.5" "unitless" COEFFS 0 1 0 0 0 1 /end COMPU_METHOD
/begin CHARACTERISTIC DP_EGR_D_DTY_LMX "" VALUE 0x57018 SD_FLOAT32_IEEE 0 SC_DP_EGR_D_DTY_LMX 0 2 /end CHARACTERISTIC
/begin COMPU_METHOD SC_DP_EGR_D_DTY_LMX "DP_EGR_D_DTY_LMX conversion" RAT_FUNC "%10.5" "unitless" COEFFS 0 1 0 0 0 1 /end COMPU_METHOD
/begin MEASUREMENT DP_EGR_D_DUTY "" FLOAT32_IEEE MC_DP_EGR_D_DUTY 0 0 0 0 ECU_ADDRESS 0x3FA778 /end MEASUREMENT
/begin COMPU_METHOD MC_DP_EGR_D_DUTY "DP_EGR_D_DUTY conversion" RAT_FUNC "%10.5" "Unitless" COEFFS 0 1 0 0 0 1 /end COMPU_METHOD
/begin MEASUREMENT DP_EGR_FF "" FLOAT32_IEEE MC_DP_EGR_FF 0 0 0 0 ECU_ADDRESS 0x3FA76C /end MEASUREMENT
/begin COMPU_METHOD MC_DP_EGR_FF "DP_EGR_FF conversion" RAT_FUNC "%10.5" "Unitless" COEFFS 0 1 0 0 0 1 /end COMPU_METHOD
/begin MEASUREMENT DP_EGR_I "" FLOAT32_IEEE MC_DP_EGR_I 0 0 0 0 ECU_ADDRESS 0x3FA768 /end MEASUREMENT
/begin COMPU_METHOD MC_DP_EGR_I "DP_EGR_I conversion" RAT_FUNC "%10.5" "Unitless" COEFFS 0 1 0 0 0 1 /end COMPU_METHOD
/begin MEASUREMENT DP_EGR_I_DUTY "" FLOAT32_IEEE MC_DP_EGR_I_DUTY 0 0 0 0 ECU_ADDRESS 0x3FA764 /end MEASUREMENT
/begin COMPU_METHOD MC_DP_EGR_I_DUTY "DP_EGR_I_DUTY conversion" RAT_FUNC "%10.5" "Unitless" COEFFS 0 1 0 0 0 1 /end COMPU_METHOD
/begin MEASUREMENT DP_EGR_I_ERR "" FLOAT32_IEEE MC_DP_EGR_I_ERR 0 0 0 0 ECU_ADDRESS 0x3FA760 /end MEASUREMENT
/begin COMPU_METHOD MC_DP_EGR_I_ERR "DP_EGR_I_ERR conversion" RAT_FUNC "%10.5" "Unitless" COEFFS 0 1 0 0 0 1 /end COMPU_METHOD
/begin CHARACTERISTIC DP_EGR_I_LMN "" VALUE 0x57008 SD_FLOAT32_IEEE 0 SC_DP_EGR_I_LMN -1 1 /end CHARACTERISTIC
/begin COMPU_METHOD SC_DP_EGR_I_LMN "DP_EGR_I_LMN conversion" RAT_FUNC "%10.5" "unitless" COEFFS 0 1 0 0 0 1 /end COMPU_METHOD
/begin CHARACTERISTIC DP_EGR_I_LMX "" VALUE 0x57004 SD_FLOAT32_IEEE 0 SC_DP_EGR_I_LMX 0 1 /end CHARACTERISTIC
/begin COMPU_METHOD SC_DP_EGR_I_LMX "DP_EGR_I_LMX conversion" RAT_FUNC "%10.5" "unitless" COEFFS 0 1 0 0 0 1 /end COMPU_METHOD
/begin CHARACTERISTIC DP_EGR_LI_ACTV "" VALUE 0x570B3 SD_UBYTE 0 SC_DP_EGR_LI_ACTV 0 1 /end CHARACTERISTIC
/begin COMPU_METHOD SC_DP_EGR_LI_ACTV "DP_EGR_LI_ACTV conversion" RAT_FUNC "%3.0" "unitless" COEFFS 0 1 0 0 0 1 /end COMPU_METHOD
/begin CHARACTERISTIC DP_EGR_LI_ACTV_TM "" VALUE 0x57000 SD_FLOAT32_IEEE 0 SC_DP_EGR_LI_ACTV_TM 0 5 /end CHARACTERISTIC
/begin COMPU_METHOD SC_DP_EGR_LI_ACTV_TM "DP_EGR_LI_ACTV_TM conversion" RAT_FUNC "%10.5" "unitless" COEFFS 0 1 0 0 0 1 /end COMPU_METHOD
/begin MEASUREMENT DP_EGR_LI_ACTV_TMR "" FLOAT32_IEEE MC_DP_EGR_LI_ACTV_TMR 0 0 0 0 ECU_ADDRESS 0x3FA75C /end MEASUREMENT
/begin COMPU_METHOD MC_DP_EGR_LI_ACTV_TMR "DP_EGR_LI_ACTV_TMR conversion" RAT_FUNC "%10.5" "Unitless" COEFFS 0 1 0 0 0 1 /end COMPU_METHOD
/begin MEASUREMENT DP_EGR_LI_DUTY "" FLOAT32_IEEE MC_DP_EGR_LI_DUTY 0 0 0 0 ECU_ADDRESS 0x3FA758 /end MEASUREMENT
/begin COMPU_METHOD MC_DP_EGR_LI_DUTY "DP_EGR_LI_DUTY conversion" RAT_FUNC "%10.5" "Unitless" COEFFS 0 1 0 0 0 1 /end COMPU_METHOD
/begin CHARACTERISTIC DP_EGR_LI_ERR_BAND "" VALUE 0x56FFC SD_FLOAT32_IEEE 0 SC_DP_EGR_LI_ERR_BAND -1 1 /end CHARACTERISTIC
/begin COMPU_METHOD SC_DP_EGR_LI_ERR_BAND "DP_EGR_LI_ERR_BAND conversion" RAT_FUNC "%10.5" "unitless" COEFFS 0 1 0 0 0 1 /end COMPU_METHOD
/begin MEASUREMENT DP_EGR_MAF_SENSOR_FAULT "" UBYTE MC_DP_EGR_MAF_SENSOR_FAULT 0 0 0 0 ECU_ADDRESS 0x3FA7EB /end MEASUREMENT
/begin COMPU_METHOD MC_DP_EGR_MAF_SENSOR_FAULT "DP_EGR_MAF_SENSOR_FAULT conversion" RAT_FUNC "%3.0" "Unitless" COEFFS 0 1 0 0 0 1 /end COMPU_METHOD
/begin MEASUREMENT DP_EGR_MAP_EBP_SENSOR_FAULT "" UBYTE MC_DP_EGR_MAP_EBP_SENSOR_FAULT 0 0 0 0 ECU_ADDRESS 0x3FA7EA /end MEASUREMENT
/begin COMPU_METHOD MC_DP_EGR_MAP_EBP_SENSOR_FAULT "DP_EGR_MAP_EBP_SENSOR_FAULT conversion" RAT_FUNC "%3.0" "Unitless" COEFFS 0 1 0 0 0 1 /end COMPU_METHOD
/begin CHARACTERISTIC DP_EGR_MAX_MF_INC "" VALUE 0x56FF8 SD_FLOAT32_IEEE 0 SC_DP_EGR_MAX_MF_INC 0 20 /end CHARACTERISTIC
/begin COMPU_METHOD SC_DP_EGR_MAX_MF_INC "DP_EGR_MAX_MF_INC conversion" RAT_FUNC "%10.5" "unitless" COEFFS 0 1 0 0 0 1 /end COMPU_METHOD
/begin CHARACTERISTIC DP_EGR_MAX_MF_TM "" VALUE 0x56FF4 SD_FLOAT32_IEEE 0 SC_DP_EGR_MAX_MF_TM 0 10 /end CHARACTERISTIC
/begin COMPU_METHOD SC_DP_EGR_MAX_MF_TM "DP_EGR_MAX_MF_TM conversion" RAT_FUNC "%10.5" "unitless" COEFFS 0 1 0 0 0 1 /end COMPU_METHOD
/begin MEASUREMENT DP_EGR_MAX_MF_TMR "" FLOAT32_IEEE MC_DP_EGR_MAX_MF_TMR 0 0 0 0 ECU_ADDRESS 0x3FA754 /end MEASUREMENT
/begin COMPU_METHOD MC_DP_EGR_MAX_MF_TMR "DP_EGR_MAX_MF_TMR conversion" RAT_FUNC "%10.5" "Unitless" COEFFS 0 1 0 0 0 1 /end COMPU_METHOD
/begin MEASUREMENT DP_EGR_MFLOW_DES "" FLOAT32_IEEE MC_DP_EGR_MFLOW_DES 0 0 0 0 ECU_ADDRESS 0x3FA74C /end MEASUREMENT
/begin COMPU_METHOD MC_DP_EGR_MFLOW_DES "DP_EGR_MFLOW_DES conversion" RAT_FUNC "%10.5" "Unitless" COEFFS 0 1 0 0 0 1 /end COMPU_METHOD
/begin MEASUREMENT DP_EGR_MFLW "" FLOAT32_IEEE MC_DP_EGR_MFLW 0 0 0 0 ECU_ADDRESS 0x3FA748 /end MEASUREMENT
/begin COMPU_METHOD MC_DP_EGR_MFLW "DP_EGR_MFLW conversion" RAT_FUNC "%10.5" "Unitless" COEFFS 0 1 0 0 0 1 /end COMPU_METHOD
/begin CHARACTERISTIC DP_EGR_MFLW_CAL "" VALUE 0x56FF0 SD_FLOAT32_IEEE 0 SC_DP_EGR_MFLW_CAL 0 10000 /end CHARACTERISTIC
/begin COMPU_METHOD SC_DP_EGR_MFLW_CAL "DP_EGR_MFLW_CAL conversion" RAT_FUNC "%10.5" "unitless" COEFFS 0 1 0 0 0 1 /end COMPU_METHOD
/begin MEASUREMENT DP_EGR_MF_TRNS_FILT "" FLOAT32_IEEE MC_DP_EGR_MF_TRNS_FILT 0 0 0 0 ECU_ADDRESS 0x3FA750 /end MEASUREMENT
/begin COMPU_METHOD MC_DP_EGR_MF_TRNS_FILT "DP_EGR_MF_TRNS_FILT conversion" RAT_FUNC "%10.5" "Unitless" COEFFS 0 1 0 0 0 1 /end COMPU_METHOD
/begin MEASUREMENT DP_EGR_PCT "" FLOAT32_IEEE MC_DP_EGR_PCT 0 0 0 0 ECU_ADDRESS 0x3FA740 /end MEASUREMENT
/begin COMPU_METHOD MC_DP_EGR_PCT "DP_EGR_PCT conversion" RAT_FUNC "%10.5" "Unitless" COEFFS 0 1 0 0 0 1 /end COMPU_METHOD
/begin CHARACTERISTIC DP_EGR_PCT_CAL "" VALUE 0x56FEC SD_FLOAT32_IEEE 0 SC_DP_EGR_PCT_CAL 0 1 /end CHARACTERISTIC
/begin COMPU_METHOD SC_DP_EGR_PCT_CAL "DP_EGR_PCT_CAL conversion" RAT_FUNC "%10.5" "unitless" COEFFS 0 1 0 0 0 1 /end COMPU_METHOD
/begin MEASUREMENT DP_EGR_PCT_DES "" FLOAT32_IEEE MC_DP_EGR_PCT_DES 0 0 0 0 ECU_ADDRESS 0x3FA73C /end MEASUREMENT
/begin COMPU_METHOD MC_DP_EGR_PCT_DES "DP_EGR_PCT_DES conversion" RAT_FUNC "%10.5" "Unitless" COEFFS 0 1 0 0 0 1 /end COMPU_METHOD
/begin MEASUREMENT DP_EGR_PCT_DES_HI "" FLOAT32_IEEE MC_DP_EGR_PCT_DES_HI 0 0 0 0 ECU_ADDRESS 0x3FA738 /end MEASUREMENT
/begin COMPU_METHOD MC_DP_EGR_PCT_DES_HI "DP_EGR_PCT_DES_HI conversion" RAT_FUNC "%10.5" "Unitless" COEFFS 0 1 0 0 0 1 /end COMPU_METHOD
/begin MEASUREMENT DP_EGR_PCT_DES_LO "" FLOAT32_IEEE MC_DP_EGR_PCT_DES_LO 0 0 0 0 ECU_ADDRESS 0x3FA734 /end MEASUREMENT
/begin COMPU_METHOD MC_DP_EGR_PCT_DES_LO "DP_EGR_PCT_DES_LO conversion" RAT_FUNC "%10.5" "Unitless" COEFFS 0 1 0 0 0 1 /end COMPU_METHOD
/begin MEASUREMENT DP_EGR_PCT_DES_MED "" FLOAT32_IEEE MC_DP_EGR_PCT_DES_MED 0 0 0 0 ECU_ADDRESS 0x3FA730 /end MEASUREMENT
/begin COMPU_METHOD MC_DP_EGR_PCT_DES_MED "DP_EGR_PCT_DES_MED conversion" RAT_FUNC "%10.5" "Unitless" COEFFS 0 1 0 0 0 1 /end COMPU_METHOD
/begin MEASUREMENT DP_EGR_PCT_LMX "" FLOAT32_IEEE MC_DP_EGR_PCT_LMX 0 0 0 0 ECU_ADDRESS 0x3FA72C /end MEASUREMENT
/begin COMPU_METHOD MC_DP_EGR_PCT_LMX "DP_EGR_PCT_LMX conversion" RAT_FUNC "%10.5" "Unitless" COEFFS 0 1 0 0 0 1 /end COMPU_METHOD
/begin MEASUREMENT DP_EGR_PCT_TBL "" FLOAT32_IEEE MC_DP_EGR_PCT_TBL 0 0 0 0 ECU_ADDRESS 0x3FA728 /end MEASUREMENT
/begin COMPU_METHOD MC_DP_EGR_PCT_TBL "DP_EGR_PCT_TBL conversion" RAT_FUNC "%10.5" "Unitless" COEFFS 0 1 0 0 0 1 /end COMPU_METHOD
/begin CHARACTERISTIC DP_EGR_PID_KD "" VALUE 0x56FE8 SD_FLOAT32_IEEE 0 SC_DP_EGR_PID_KD 0 1 /end CHARACTERISTIC
/begin COMPU_METHOD SC_DP_EGR_PID_KD "DP_EGR_PID_KD conversion" RAT_FUNC "%10.5" "unitless" COEFFS 0 1 0 0 0 1 /end COMPU_METHOD
/begin CHARACTERISTIC DP_EGR_PID_KI "" VALUE 0x56FE4 SD_FLOAT32_IEEE 0 SC_DP_EGR_PID_KI 0 1 /end CHARACTERISTIC
/begin COMPU_METHOD SC_DP_EGR_PID_KI "DP_EGR_PID_KI conversion" RAT_FUNC "%10.5" "unitless" COEFFS 0 1 0 0 0 1 /end COMPU_METHOD
/begin CHARACTERISTIC DP_EGR_PID_KP "" VALUE 0x56FE0 SD_FLOAT32_IEEE 0 SC_DP_EGR_PID_KP 0 1 /end CHARACTERISTIC
/begin COMPU_METHOD SC_DP_EGR_PID_KP "DP_EGR_PID_KP conversion" RAT_FUNC "%10.5" "unitless" COEFFS 0 1 0 0 0 1 /end COMPU_METHOD
/begin MEASUREMENT DP_EGR_P_DUTY "" FLOAT32_IEEE MC_DP_EGR_P_DUTY 0 0 0 0 ECU_ADDRESS 0x3FA744 /end MEASUREMENT
/begin COMPU_METHOD MC_DP_EGR_P_DUTY "DP_EGR_P_DUTY conversion" RAT_FUNC "%10.5" "Unitless" COEFFS 0 1 0 0 0 1 /end COMPU_METHOD
/begin CHARACTERISTIC DP_EGR_SEL "" VALUE 0x570B2 SD_UBYTE 0 SC_DP_EGR_SEL 0 4 /end CHARACTERISTIC
/begin COMPU_METHOD SC_DP_EGR_SEL "DP_EGR_SEL conversion" RAT_FUNC "%3.0" "unitless" COEFFS 0 1 0 0 0 1 /end COMPU_METHOD
/begin CHARACTERISTIC DP_EGR_VP_CAL "" VALUE 0x56FDC SD_FLOAT32_IEEE 0 SC_DP_EGR_VP_CAL 0 1 /end CHARACTERISTIC
/begin COMPU_METHOD SC_DP_EGR_VP_CAL "DP_EGR_VP_CAL conversion" RAT_FUNC "%10.5" "unitless" COEFFS 0 1 0 0 0 1 /end COMPU_METHOD
/begin CHARACTERISTIC DP_FLT_COF_A "" VALUE 0x56FD8 SD_FLOAT32_IEEE 0 SC_DP_FLT_COF_A -2 2 /end CHARACTERISTIC
/begin COMPU_METHOD SC_DP_FLT_COF_A "DP_FLT_COF_A conversion" RAT_FUNC "%10.5" "unitless" COEFFS 0 1 0 0 0 1 /end COMPU_METHOD
/begin CHARACTERISTIC DP_FLT_COF_B "" VALUE 0x56FD4 SD_FLOAT32_IEEE 0 SC_DP_FLT_COF_B -2 2 /end CHARACTERISTIC
/begin COMPU_METHOD SC_DP_FLT_COF_B "DP_FLT_COF_B conversion" RAT_FUNC "%10.5" "unitless" COEFFS 0 1 0 0 0 1 /end COMPU_METHOD
/begin CHARACTERISTIC DP_FLT_COF_C "" VALUE 0x56FD0 SD_FLOAT32_IEEE 0 SC_DP_FLT_COF_C -2 2 /end CHARACTERISTIC
/begin COMPU_METHOD SC_DP_FLT_COF_C "DP_FLT_COF_C conversion" RAT_FUNC "%10.5" "unitless" COEFFS 0 1 0 0 0 1 /end COMPU_METHOD
/begin CHARACTERISTIC DP_FLT_COF_D "" VALUE 0x56FCC SD_FLOAT32_IEEE 0 SC_DP_FLT_COF_D -2 2 /end CHARACTERISTIC
/begin COMPU_METHOD SC_DP_FLT_COF_D "DP_FLT_COF_D conversion" RAT_FUNC "%10.5" "unitless" COEFFS 0 1 0 0 0 1 /end COMPU_METHOD
/begin CHARACTERISTIC DP_FLT_COF_E "" VALUE 0x56FC8 SD_FLOAT32_IEEE 0 SC_DP_FLT_COF_E -2 2 /end CHARACTERISTIC
/begin COMPU_METHOD SC_DP_FLT_COF_E "DP_FLT_COF_E conversion" RAT_FUNC "%10.5" "unitless" COEFFS 0 1 0 0 0 1 /end COMPU_METHOD
/begin CHARACTERISTIC DP_FLT_COF_F "" VALUE 0x56FC4 SD_FLOAT32_IEEE 0 SC_DP_FLT_COF_F -2 2 /end CHARACTERISTIC
/begin COMPU_METHOD SC_DP_FLT_COF_F "DP_FLT_COF_F conversion" RAT_FUNC "%10.5" "unitless" COEFFS 0 1 0 0 0 1 /end COMPU_METHOD
/begin MEASUREMENT DP_MAF_TRNS_MULT "" FLOAT32_IEEE MC_DP_MAF_TRNS_MULT 0 0 0 0 ECU_ADDRESS 0x3FA70C /end MEASUREMENT
/begin COMPU_METHOD MC_DP_MAF_TRNS_MULT "DP_MAF_TRNS_MULT conversion" RAT_FUNC "%10.5" "Unitless" COEFFS 0 1 0 0 0 1 /end COMPU_METHOD
/begin MEASUREMENT DP_MFDES_DIFF "" FLOAT32_IEEE MC_DP_MFDES_DIFF 0 0 0 0 ECU_ADDRESS 0x3FA708 /end MEASUREMENT
/begin COMPU_METHOD MC_DP_MFDES_DIFF "DP_MFDES_DIFF conversion" RAT_FUNC "%10.5" "Unitless" COEFFS 0 1 0 0 0 1 /end COMPU_METHOD
/begin CHARACTERISTIC DP_MF_TRNS_KF "" VALUE 0x56FC0 SD_FLOAT32_IEEE 0 SC_DP_MF_TRNS_KF 0 10 /end CHARACTERISTIC
/begin COMPU_METHOD SC_DP_MF_TRNS_KF "DP_MF_TRNS_KF conversion" RAT_FUNC "%10.5" "unitless" COEFFS 0 1 0 0 0 1 /end COMPU_METHOD
/begin MEASUREMENT DP_MF_TRNS_MULT "" FLOAT32_IEEE MC_DP_MF_TRNS_MULT 0 0 0 0 ECU_ADDRESS 0x3FA704 /end MEASUREMENT
/begin COMPU_METHOD MC_DP_MF_TRNS_MULT "DP_MF_TRNS_MULT conversion" RAT_FUNC "%10.5" "Unitless" COEFFS 0 1 0 0 0 1 /end COMPU_METHOD
/begin MEASUREMENT DP_PLUS "" FLOAT32_IEEE MC_DP_PLUS 0 0 0 0 ECU_ADDRESS 0x3FA700 /end MEASUREMENT
/begin COMPU_METHOD MC_DP_PLUS "DP_PLUS conversion" RAT_FUNC "%10.5" "Unitless" COEFFS 0 1 0 0 0 1 /end COMPU_METHOD
/begin MEASUREMENT DP_TOT_MASS_FLOW "" FLOAT32_IEEE MC_DP_TOT_MASS_FLOW 0 0 0 0 ECU_ADDRESS 0x3FA6FC /end MEASUREMENT
/begin COMPU_METHOD MC_DP_TOT_MASS_FLOW "DP_TOT_MASS_FLOW conversion" RAT_FUNC "%10.5" "Unitless" COEFFS 0 1 0 0 0 1 /end COMPU_METHOD
/begin MEASUREMENT DP_VOL_EFF_TBL "" FLOAT32_IEEE MC_DP_VOL_EFF_TBL 0 0 0 0 ECU_ADDRESS 0x3FA6F8 /end MEASUREMENT
/begin COMPU_METHOD MC_DP_VOL_EFF_TBL "DP_VOL_EFF_TBL conversion" RAT_FUNC "%10.5" "Unitless" COEFFS 0 1 0 0 0 1 /end COMPU_METHOD
/begin MEASUREMENT DRIVE_COUNT "Count of number of OBD-II drive cycles completed." UWORD MC_DRIVE_COUNT 0 0 0 0 ECU_ADDRESS 0x3FAE8C /end MEASUREMENT
/begin COMPU_METHOD MC_DRIVE_COUNT "DRIVE_COUNT conversion" RAT_FUNC "%5.0" "Unitless" COEFFS 0 1 0 0 0 1 /end COMPU_METHOD
/begin MEASUREMENT DRIVE_CYCLE "Flag indicating if out of crank this powerup" UBYTE MC_DRIVE_CYCLE 0 0 0 0 ECU_ADDRESS 0x3FAE8E /end MEASUREMENT
/begin COMPU_METHOD MC_DRIVE_CYCLE "DRIVE_CYCLE conversion" RAT_FUNC "%3.0" "Unitless" COEFFS 0 1 0 0 0 1 /end COMPU_METHOD
/begin CHARACTERISTIC DSFP_PU_TM "EEC stabilization time before testing fuel pump" VALUE 0x56840 SD_FLOAT32_IEEE 0 SC_DSFP_PU_TM 0 64 /end CHARACTERISTIC
/begin COMPU_METHOD SC_DSFP_PU_TM "DSFP_PU_TM conversion" RAT_FUNC "%10.5" "s" COEFFS 0 1 0 0 0 1 /end COMPU_METHOD
/begin MEASUREMENT EBP "Exhaust Back Pressure absolute pressure(in KPA)" FLOAT32_IEEE MC_EBP 0 0 0 0 ECU_ADDRESS 0x3FA20C /end MEASUREMENT
/begin COMPU_METHOD MC_EBP "EBP conversion" RAT_FUNC "%10.5" "Unitless" COEFFS 0 1 0 0 0 1 /end COMPU_METHOD
/begin MEASUREMENT EBPG "Exhaust Back Pressure Gage pressure (in KPA)" FLOAT32_IEEE MC_EBPG 0 0 0 0 ECU_ADDRESS 0x3FA208 /end MEASUREMENT
/begin COMPU_METHOD MC_EBPG "EBPG conversion" RAT_FUNC "%10.5" "Unitless" COEFFS 0 1 0 0 0 1 /end COMPU_METHOD
/begin CHARACTERISTIC EBP_AD_TC "Exhaust Back Pressure filter time constant" VALUE 0x567C8 SD_FLOAT32_IEEE 0 SC_EBP_AD_TC 0 64 /end CHARACTERISTIC
/begin COMPU_METHOD SC_EBP_AD_TC "EBP_AD_TC conversion" RAT_FUNC "%10.5" "s" COEFFS 0 1 0 0 0 1 /end COMPU_METHOD
/begin MEASUREMENT EBP_CNTS "Exhaust back pressure sensor A/D counts" SLONG MC_EBP_CNTS 0 0 0 0 ECU_ADDRESS 0x3FAA8C /end MEASUREMENT
/begin COMPU_METHOD MC_EBP_CNTS "EBP_CNTS conversion" RAT_FUNC "%10.0" "Unitless" COEFFS 0 1 0 0 0 1 /end COMPU_METHOD
/begin CHARACTERISTIC EBP_DEF "Default FMEM value for exhaust back pressure" VALUE 0x567D8 SD_FLOAT32_IEEE 0 SC_EBP_DEF 100 400 /end CHARACTERISTIC
/begin COMPU_METHOD SC_EBP_DEF "EBP_DEF conversion" RAT_FUNC "%10.5" "kPa" COEFFS 0 1 0 0 0 1 /end COMPU_METHOD
/begin MEASUREMENT EBP_ENG_KPA "Raw exhaust back pressure without any compensation, kPA" FLOAT32_IEEE MC_EBP_ENG_KPA 0 0 0 0 ECU_ADDRESS 0x3FAA88 /end MEASUREMENT
/begin COMPU_METHOD MC_EBP_ENG_KPA "EBP_ENG_KPA conversion" RAT_FUNC "%10.5" "Unitless" COEFFS 0 1 0 0 0 1 /end COMPU_METHOD
/begin MEASUREMENT EBP_FILT_TIME_CONST "EBP filter time constant" FLOAT32_IEEE MC_EBP_FILT_TIME_CONST 0 0 0 0 ECU_ADDRESS 0x3FA204 /end MEASUREMENT
/begin COMPU_METHOD MC_EBP_FILT_TIME_CONST "EBP_FILT_TIME_CONST conversion" RAT_FUNC "%10.5" "Unitless" COEFFS 0 1 0 0 0 1 /end COMPU_METHOD
/begin MEASUREMENT EBP_FLT_RECOVERY_CNTR " EBP fault recovery counter" SLONG MC_EBP_FLT_RECOVERY_CNTR 0 0 0 0 ECU_ADDRESS 0x3FA1FC /end MEASUREMENT
/begin COMPU_METHOD MC_EBP_FLT_RECOVERY_CNTR "EBP_FLT_RECOVERY_CNTR conversion" RAT_FUNC "%10.0" "Unitless" COEFFS 0 1 0 0 0 1 /end COMPU_METHOD
/begin MEASUREMENT EBP_FLT_RECOVERY_FLG "EBP filt recovery flag" UBYTE MC_EBP_FLT_RECOVERY_FLG 0 0 0 0 ECU_ADDRESS 0x3FA210 /end MEASUREMENT
/begin COMPU_METHOD MC_EBP_FLT_RECOVERY_FLG "EBP_FLT_RECOVERY_FLG conversion" RAT_FUNC "%3.0" "Unitless" COEFFS 0 1 0 0 0 1 /end COMPU_METHOD
/begin CHARACTERISTIC EBP_F_DEC "EBP ORH/ORL failure counter decrement value" VALUE 0x567D0 SD_SLONG 0 SC_EBP_F_DEC 0 65535 /end CHARACTERISTIC
/begin COMPU_METHOD SC_EBP_F_DEC "EBP_F_DEC conversion" RAT_FUNC "%10.0" "unitless" COEFFS 0 1 0 0 0 1 /end COMPU_METHOD
/begin CHARACTERISTIC EBP_F_INC "EBP ORH/ORL failure counter increment value" VALUE 0x567D4 SD_SLONG 0 SC_EBP_F_INC 0 65535 /end CHARACTERISTIC
/begin COMPU_METHOD SC_EBP_F_INC "EBP_F_INC conversion" RAT_FUNC "%10.0" "unitless" COEFFS 0 1 0 0 0 1 /end COMPU_METHOD
/begin MEASUREMENT EBP_F_ORH "EBP Signal out-of_range high fault" UBYTE MC_EBP_F_ORH 0 0 0 0 ECU_ADDRESS 0x3FA216 /end MEASUREMENT
/begin COMPU_METHOD MC_EBP_F_ORH "EBP_F_ORH conversion" RAT_FUNC "%3.0" "Unitless" COEFFS 0 1 0 0 0 1 /end COMPU_METHOD
/begin MEASUREMENT EBP_F_ORL "EBP Signal out of range low fault" UBYTE MC_EBP_F_ORL 0 0 0 0 ECU_ADDRESS 0x3FA215 /end MEASUREMENT
/begin COMPU_METHOD MC_EBP_F_ORL "EBP_F_ORL conversion" RAT_FUNC "%3.0" "Unitless" COEFFS 0 1 0 0 0 1 /end COMPU_METHOD
/begin MEASUREMENT EBP_MALF_SET "Indicate  ebp malf high or low failure" UBYTE MC_EBP_MALF_SET 0 0 0 0 ECU_ADDRESS 0x3FA212 /end MEASUREMENT
/begin COMPU_METHOD MC_EBP_MALF_SET "EBP_MALF_SET conversion" RAT_FUNC "%3.0" "Unitless" COEFFS 0 1 0 0 0 1 /end COMPU_METHOD
/begin MEASUREMENT EBP_ORH_CNTR "Exhaust Back Pressure out of range high counter" SLONG MC_EBP_ORH_CNTR 0 0 0 0 ECU_ADDRESS 0x3FA1F8 /end MEASUREMENT
/begin COMPU_METHOD MC_EBP_ORH_CNTR "EBP_ORH_CNTR conversion" RAT_FUNC "%10.0" "Unitless" COEFFS 0 1 0 0 0 1 /end COMPU_METHOD
/begin MEASUREMENT EBP_ORL_CNTR "Exhaust Back Pressure out of range low counter" SLONG MC_EBP_ORL_CNTR 0 0 0 0 ECU_ADDRESS 0x3FA1F4 /end MEASUREMENT
/begin COMPU_METHOD MC_EBP_ORL_CNTR "EBP_ORL_CNTR conversion" RAT_FUNC "%10.0" "Unitless" COEFFS 0 1 0 0 0 1 /end COMPU_METHOD
/begin MEASUREMENT EBP_RAW_KPA "Exaust Back Pressure raw value" FLOAT32_IEEE MC_EBP_RAW_KPA 0 0 0 0 ECU_ADDRESS 0x3FA200 /end MEASUREMENT
/begin COMPU_METHOD MC_EBP_RAW_KPA "EBP_RAW_KPA conversion" RAT_FUNC "%10.5" "Unitless" COEFFS 0 1 0 0 0 1 /end COMPU_METHOD
/begin CHARACTERISTIC EBP_REC_INC "EBP  Fault recovery counter increment value" VALUE 0x567CC SD_SLONG 0 SC_EBP_REC_INC 0 32767 /end CHARACTERISTIC
/begin COMPU_METHOD SC_EBP_REC_INC "EBP_REC_INC conversion" RAT_FUNC "%10.0" "unitless" COEFFS 0 1 0 0 0 1 /end COMPU_METHOD
/begin MEASUREMENT EBP_STATUS "Status of Exhaust Back Pressure sensor,  0 = no error" UBYTE MC_EBP_STATUS 0 0 0 0 ECU_ADDRESS 0x3FAA90 /end MEASUREMENT
/begin COMPU_METHOD MC_EBP_STATUS "EBP_STATUS conversion" RAT_FUNC "%3.0" "Unitless" COEFFS 0 1 0 0 0 1 /end COMPU_METHOD
/begin CHARACTERISTIC EBP_TCREC_SEL "Switch to select EBP filter constant" VALUE 0x567DC SD_UBYTE 0 SC_EBP_TCREC_SEL 0 1 /end CHARACTERISTIC
/begin COMPU_METHOD SC_EBP_TCREC_SEL "EBP_TCREC_SEL conversion" RAT_FUNC "%3.0" "unitless" COEFFS 0 1 0 0 0 1 /end COMPU_METHOD
/begin CHARACTERISTIC EBP_VMAX "Exhaust Back Pressure out of range high limit" VALUE 0x5753C SD_FLOAT32_IEEE 0 SC_EBP_VMAX 0 5 /end CHARACTERISTIC
/begin COMPU_METHOD SC_EBP_VMAX "EBP_VMAX conversion" RAT_FUNC "%10.5" "V" COEFFS 0 1 0 0 0 1 /end COMPU_METHOD
/begin CHARACTERISTIC EBP_VMIN "Exhaust Back Pressure out of range low limit" VALUE 0x57540 SD_FLOAT32_IEEE 0 SC_EBP_VMIN 0 5 /end CHARACTERISTIC
/begin COMPU_METHOD SC_EBP_VMIN "EBP_VMIN conversion" RAT_FUNC "%10.5" "V" COEFFS 0 1 0 0 0 1 /end COMPU_METHOD
/begin MEASUREMENT EBP_VOLTAGE "Exhaust Back Pressure sensor voltage" FLOAT32_IEEE MC_EBP_VOLTAGE 0 0 0 0 ECU_ADDRESS 0x3FAA84 /end MEASUREMENT
/begin COMPU_METHOD MC_EBP_VOLTAGE "EBP_VOLTAGE conversion" RAT_FUNC "%10.5" "Unitless" COEFFS 0 1 0 0 0 1 /end COMPU_METHOD
/begin MEASUREMENT ECT "Engine coolant temperature, deg F." FLOAT32_IEEE MC_ECT 0 0 0 0 ECU_ADDRESS 0x3FA138 /end MEASUREMENT
/begin COMPU_METHOD MC_ECT "ECT conversion" RAT_FUNC "%10.5" "Unitless" COEFFS 0 1 0 0 0 1 /end COMPU_METHOD
/begin CHARACTERISTIC ECT_AD_TC "Engine coolant temperature filter time constant" VALUE 0x5650C SD_FLOAT32_IEEE 0 SC_ECT_AD_TC 0 64 /end CHARACTERISTIC
/begin COMPU_METHOD SC_ECT_AD_TC "ECT_AD_TC conversion" RAT_FUNC "%10.5" "s" COEFFS 0 1 0 0 0 1 /end COMPU_METHOD
/begin MEASUREMENT ECT_C "Engine coolant temperature. (DEGREES C)" FLOAT32_IEEE MC_ECT_C 0 0 0 0 ECU_ADDRESS 0x3F9FD4 /end MEASUREMENT
/begin COMPU_METHOD MC_ECT_C "ECT_C conversion" RAT_FUNC "%10.5" "Unitless" COEFFS 0 1 0 0 0 1 /end COMPU_METHOD
/begin MEASUREMENT ECT_CNTS "Engine Coolant Temperature, input from A/D." SLONG MC_ECT_CNTS 0 0 0 0 ECU_ADDRESS 0x3FA9C0 /end MEASUREMENT
/begin COMPU_METHOD MC_ECT_CNTS "ECT_CNTS conversion" RAT_FUNC "%10.0" "Unitless" COEFFS 0 1 0 0 0 1 /end COMPU_METHOD
/begin MEASUREMENT ECT_COLD_CNT "Threshold monitor cold counter" SLONG MC_ECT_COLD_CNT 0 0 0 0 ECU_ADDRESS 0x3F9FB4 /end MEASUREMENT
/begin COMPU_METHOD MC_ECT_COLD_CNT "ECT_COLD_CNT conversion" RAT_FUNC "%10.0" "Unitless" COEFFS 0 1 0 0 0 1 /end COMPU_METHOD
/begin CHARACTERISTIC ECT_COLD_CNT_LM "" VALUE 0x564EC SD_SLONG 0 SC_ECT_COLD_CNT_LM 0 65535 /end CHARACTERISTIC
/begin COMPU_METHOD SC_ECT_COLD_CNT_LM "ECT_COLD_CNT_LM conversion" RAT_FUNC "%10.0" "unitless" COEFFS 0 1 0 0 0 1 /end COMPU_METHOD
/begin CHARACTERISTIC ECT_COLD_LMN "" VALUE 0x564E8 SD_FLOAT32_IEEE 0 SC_ECT_COLD_LMN -4096 4095.87 /end CHARACTERISTIC
/begin COMPU_METHOD SC_ECT_COLD_LMN "ECT_COLD_LMN conversion" RAT_FUNC "%10.5" "degC" COEFFS 0 1 0 0 0 1 /end COMPU_METHOD
/begin CHARACTERISTIC ECT_COLD_MFDES "" VALUE 0x564F4 SD_FLOAT32_IEEE 0 SC_ECT_COLD_MFDES -2048 2.04794 /end CHARACTERISTIC
/begin COMPU_METHOD SC_ECT_COLD_MFDES "ECT_COLD_MFDES conversion" RAT_FUNC "%10.5" "unitless" COEFFS 0 1 0 0 0 1 /end COMPU_METHOD
/begin CHARACTERISTIC ECT_COLD_N "ect cold engine speed calibration" VALUE 0x564F8 SD_FLOAT32_IEEE 0 SC_ECT_COLD_N 0 16387.3 /end CHARACTERISTIC
/begin COMPU_METHOD SC_ECT_COLD_N "ECT_COLD_N conversion" RAT_FUNC "%10.5" "RPM" COEFFS 0 1 0 0 0 1 /end COMPU_METHOD
/begin MEASUREMENT ECT_C_THLD "ect threshold flag" UBYTE MC_ECT_C_THLD 0 0 0 0 ECU_ADDRESS 0x3F9FDC /end MEASUREMENT
/begin COMPU_METHOD MC_ECT_C_THLD "ECT_C_THLD conversion" RAT_FUNC "%3.0" "Unitless" COEFFS 0 1 0 0 0 1 /end COMPU_METHOD
/begin CHARACTERISTIC ECT_DEF "Default FMEM value for engine coolant temp" VALUE 0x56510 SD_FLOAT32_IEEE 0 SC_ECT_DEF -20 150 /end CHARACTERISTIC
/begin COMPU_METHOD SC_ECT_DEF "ECT_DEF conversion" RAT_FUNC "%10.5" "degC" COEFFS 0 1 0 0 0 1 /end COMPU_METHOD
/begin MEASUREMENT ECT_ENG "Engine Coolant Temperature without any FMEM modifications." FLOAT32_IEEE MC_ECT_ENG 0 0 0 0 ECU_ADDRESS 0x3FACA0 /end MEASUREMENT
/begin COMPU_METHOD MC_ECT_ENG "ECT_ENG conversion" RAT_FUNC "%10.5" "Unitless" COEFFS 0 1 0 0 0 1 /end COMPU_METHOD
/begin MEASUREMENT ECT_ENG_C "Engine Coolant Temperature without any FMEM modifications, degrees C" FLOAT32_IEEE MC_ECT_ENG_C 0 0 0 0 ECU_ADDRESS 0x3FA9C4 /end MEASUREMENT
/begin COMPU_METHOD MC_ECT_ENG_C "ECT_ENG_C conversion" RAT_FUNC "%10.5" "Unitless" COEFFS 0 1 0 0 0 1 /end COMPU_METHOD
/begin MEASUREMENT ECT_FIL "Intermittent fault filter for the ECT semsor." UBYTE MC_ECT_FIL 0 0 0 0 ECU_ADDRESS 0x3F9EFD /end MEASUREMENT
/begin COMPU_METHOD MC_ECT_FIL "ECT_FIL conversion" RAT_FUNC "%3.0" "Unitless" COEFFS 0 1 0 0 0 1 /end COMPU_METHOD
/begin MEASUREMENT ECT_FILT_TIME_CONST "ect filter time const" FLOAT32_IEEE MC_ECT_FILT_TIME_CONST 0 0 0 0 ECU_ADDRESS 0x3F9FD0 /end MEASUREMENT
/begin COMPU_METHOD MC_ECT_FILT_TIME_CONST "ECT_FILT_TIME_CONST conversion" RAT_FUNC "%10.5" "Unitless" COEFFS 0 1 0 0 0 1 /end COMPU_METHOD
/begin MEASUREMENT ECT_FIL_MAX "HIGHEST VALUE THE FAULT FILTER ECT_FIL ACHIEVES." UBYTE MC_ECT_FIL_MAX 0 0 0 0 ECU_ADDRESS 0x3FAEDC /end MEASUREMENT
/begin COMPU_METHOD MC_ECT_FIL_MAX "ECT_FIL_MAX conversion" RAT_FUNC "%3.0" "Unitless" COEFFS 0 1 0 0 0 1 /end COMPU_METHOD
/begin MEASUREMENT ECT_FLT_RECOVERY_CNTR "ect fault recovery counter" SLONG MC_ECT_FLT_RECOVERY_CNTR 0 0 0 0 ECU_ADDRESS 0x3F9FBC /end MEASUREMENT
/begin COMPU_METHOD MC_ECT_FLT_RECOVERY_CNTR "ECT_FLT_RECOVERY_CNTR conversion" RAT_FUNC "%10.0" "Unitless" COEFFS 0 1 0 0 0 1 /end COMPU_METHOD
/begin MEASUREMENT ECT_FLT_RECOVERY_FLG "ect fault recovery flag" UBYTE MC_ECT_FLT_RECOVERY_FLG 0 0 0 0 ECU_ADDRESS 0x3F9FDD /end MEASUREMENT
/begin COMPU_METHOD MC_ECT_FLT_RECOVERY_FLG "ECT_FLT_RECOVERY_FLG conversion" RAT_FUNC "%3.0" "Unitless" COEFFS 0 1 0 0 0 1 /end COMPU_METHOD
/begin CHARACTERISTIC ECT_F_DEC "ECT ORH/ORL failure counter decrement value" VALUE 0x56540 SD_SLONG 0 SC_ECT_F_DEC 0 65535 /end CHARACTERISTIC
/begin COMPU_METHOD SC_ECT_F_DEC "ECT_F_DEC conversion" RAT_FUNC "%10.0" "unitless" COEFFS 0 1 0 0 0 1 /end COMPU_METHOD
/begin MEASUREMENT ECT_F_HOT_THLD "threshold monitor hot flag" UBYTE MC_ECT_F_HOT_THLD 0 0 0 0 ECU_ADDRESS 0x3F9FD8 /end MEASUREMENT
/begin COMPU_METHOD MC_ECT_F_HOT_THLD "ECT_F_HOT_THLD conversion" RAT_FUNC "%3.0" "Unitless" COEFFS 0 1 0 0 0 1 /end COMPU_METHOD
/begin CHARACTERISTIC ECT_F_INC "ECT ORH/ORL failure counter increment value" VALUE 0x56544 SD_SLONG 0 SC_ECT_F_INC 0 65535 /end CHARACTERISTIC
/begin COMPU_METHOD SC_ECT_F_INC "ECT_F_INC conversion" RAT_FUNC "%10.0" "unitless" COEFFS 0 1 0 0 0 1 /end COMPU_METHOD
/begin MEASUREMENT ECT_F_ORH "Engine Coolant Temperature out of range high fail" UBYTE MC_ECT_F_ORH 0 0 0 0 ECU_ADDRESS 0x3F9FE3 /end MEASUREMENT
/begin COMPU_METHOD MC_ECT_F_ORH "ECT_F_ORH conversion" RAT_FUNC "%3.0" "Unitless" COEFFS 0 1 0 0 0 1 /end COMPU_METHOD
/begin MEASUREMENT ECT_F_ORL "Engine Coolant Temperature out of range low fail" UBYTE MC_ECT_F_ORL 0 0 0 0 ECU_ADDRESS 0x3F9FE2 /end MEASUREMENT
/begin COMPU_METHOD MC_ECT_F_ORL "ECT_F_ORL conversion" RAT_FUNC "%3.0" "Unitless" COEFFS 0 1 0 0 0 1 /end COMPU_METHOD
/begin CHARACTERISTIC ECT_HI_VOLTS "Maximum acceptable voltage for ECT sensor" VALUE 0x57380 SD_FLOAT32_IEEE 0 SC_ECT_HI_VOLTS 0 5 /end CHARACTERISTIC
/begin COMPU_METHOD SC_ECT_HI_VOLTS "ECT_HI_VOLTS conversion" RAT_FUNC "%10.5" "V" COEFFS 0 1 0 0 0 1 /end COMPU_METHOD
/begin MEASUREMENT ECT_HOT_CNT "Threshold monitor hot counter" SLONG MC_ECT_HOT_CNT 0 0 0 0 ECU_ADDRESS 0x3F9FB8 /end MEASUREMENT
/begin COMPU_METHOD MC_ECT_HOT_CNT "ECT_HOT_CNT conversion" RAT_FUNC "%10.0" "Unitless" COEFFS 0 1 0 0 0 1 /end COMPU_METHOD
/begin CHARACTERISTIC ECT_HOT_CNT_LM "" VALUE 0x564E4 SD_SLONG 0 SC_ECT_HOT_CNT_LM 0 65535 /end CHARACTERISTIC
/begin COMPU_METHOD SC_ECT_HOT_CNT_LM "ECT_HOT_CNT_LM conversion" RAT_FUNC "%10.0" "unitless" COEFFS 0 1 0 0 0 1 /end COMPU_METHOD
/begin CHARACTERISTIC ECT_HOT_LMN "" VALUE 0x564E0 SD_FLOAT32_IEEE 0 SC_ECT_HOT_LMN -4096 4095.87 /end CHARACTERISTIC
/begin COMPU_METHOD SC_ECT_HOT_LMN "ECT_HOT_LMN conversion" RAT_FUNC "%10.5" "degC" COEFFS 0 1 0 0 0 1 /end COMPU_METHOD
/begin CHARACTERISTIC ECT_HOT_MFDES "Hot mfdes calibration." VALUE 0x564FC SD_FLOAT32_IEEE 0 SC_ECT_HOT_MFDES -2048 2047.94 /end CHARACTERISTIC
/begin COMPU_METHOD SC_ECT_HOT_MFDES "ECT_HOT_MFDES conversion" RAT_FUNC "%10.5" "unitless" COEFFS 0 1 0 0 0 1 /end COMPU_METHOD
/begin CHARACTERISTIC ECT_HOT_N "Hot engine speed calibration" VALUE 0x56500 SD_FLOAT32_IEEE 0 SC_ECT_HOT_N 0 16387.5 /end CHARACTERISTIC
/begin COMPU_METHOD SC_ECT_HOT_N "ECT_HOT_N conversion" RAT_FUNC "%10.5" "RPM" COEFFS 0 1 0 0 0 1 /end COMPU_METHOD
/begin MEASUREMENT ECT_INT "Flag set when intermittent is detected on ECT sensor." UBYTE MC_ECT_INT 0 0 0 0 ECU_ADDRESS 0x3F9EFC /end MEASUREMENT
/begin COMPU_METHOD MC_ECT_INT "ECT_INT conversion" RAT_FUNC "%3.0" "Unitless" COEFFS 0 1 0 0 0 1 /end COMPU_METHOD
/begin CHARACTERISTIC ECT_LO_VOLTS "Minimum acceptable voltage for ECT sensor" VALUE 0x5737C SD_FLOAT32_IEEE 0 SC_ECT_LO_VOLTS 0 5 /end CHARACTERISTIC
/begin COMPU_METHOD SC_ECT_LO_VOLTS "ECT_LO_VOLTS conversion" RAT_FUNC "%10.5" "V" COEFFS 0 1 0 0 0 1 /end COMPU_METHOD
/begin CHARACTERISTIC ECT_LVL "Fault level for intermittent ECT sensor." VALUE 0x563A6 SD_UBYTE 0 SC_ECT_LVL 0 255 /end CHARACTERISTIC
/begin COMPU_METHOD SC_ECT_LVL "ECT_LVL conversion" RAT_FUNC "%3.0" "LEVEL" COEFFS 0 1 0 0 0 1 /end COMPU_METHOD
/begin MEASUREMENT ECT_MALF_SET "Indicate ect malf high or low failure." UBYTE MC_ECT_MALF_SET 0 0 0 0 ECU_ADDRESS 0x3F9FDF /end MEASUREMENT
/begin COMPU_METHOD MC_ECT_MALF_SET "ECT_MALF_SET conversion" RAT_FUNC "%3.0" "Unitless" COEFFS 0 1 0 0 0 1 /end COMPU_METHOD
/begin MEASUREMENT ECT_ORH_CNTR "Engine Coolant Temp out of range high counter" SLONG MC_ECT_ORH_CNTR 0 0 0 0 ECU_ADDRESS 0x3F9FCC /end MEASUREMENT
/begin COMPU_METHOD MC_ECT_ORH_CNTR "ECT_ORH_CNTR conversion" RAT_FUNC "%10.0" "Unitless" COEFFS 0 1 0 0 0 1 /end COMPU_METHOD
/begin MEASUREMENT ECT_ORL_CNTR "Engine Coolant Temp out of range low counter" SLONG MC_ECT_ORL_CNTR 0 0 0 0 ECU_ADDRESS 0x3F9FC8 /end MEASUREMENT
/begin COMPU_METHOD MC_ECT_ORL_CNTR "ECT_ORL_CNTR conversion" RAT_FUNC "%10.0" "Unitless" COEFFS 0 1 0 0 0 1 /end COMPU_METHOD
/begin MEASUREMENT ECT_P_HOT_THLD "threshold monitor hot flag" UBYTE MC_ECT_P_HOT_THLD 0 0 0 0 ECU_ADDRESS 0x3F9FDA /end MEASUREMENT
/begin COMPU_METHOD MC_ECT_P_HOT_THLD "ECT_P_HOT_THLD conversion" RAT_FUNC "%3.0" "Unitless" COEFFS 0 1 0 0 0 1 /end COMPU_METHOD
/begin CHARACTERISTIC ECT_REC_INC "" VALUE 0x56508 SD_SLONG 0 SC_ECT_REC_INC 0 65334 /end CHARACTERISTIC
/begin COMPU_METHOD SC_ECT_REC_INC "ECT_REC_INC conversion" RAT_FUNC "%10.0" "unitless" COEFFS 0 1 0 0 0 1 /end COMPU_METHOD
/begin CHARACTERISTIC ECT_SNS_HP "ECT hardware present switch; 0 -> no ECT, 1 -> ECT sensor present." VALUE 0x3FADBF SD_UBYTE 0 SC_ECT_SNS_HP 0 1 /end CHARACTERISTIC
/begin COMPU_METHOD SC_ECT_SNS_HP "ECT_SNS_HP conversion" RAT_FUNC "%3.0" "UNITLESS" COEFFS 0 1 0 0 0 1 /end COMPU_METHOD
/begin MEASUREMENT ECT_STATUS "Status of Engine Coolant Temperature high level driver ( 0 = ok )" UBYTE MC_ECT_STATUS 0 0 0 0 ECU_ADDRESS 0x3FA9C8 /end MEASUREMENT
/begin COMPU_METHOD MC_ECT_STATUS "ECT_STATUS conversion" RAT_FUNC "%3.0" "Unitless" COEFFS 0 1 0 0 0 1 /end COMPU_METHOD
/begin CHARACTERISTIC ECT_TCREC_SEL "" VALUE 0x56514 SD_UBYTE 0 SC_ECT_TCREC_SEL 0 1 /end CHARACTERISTIC
/begin COMPU_METHOD SC_ECT_TCREC_SEL "ECT_TCREC_SEL conversion" RAT_FUNC "%3.0" "unitless" COEFFS 0 1 0 0 0 1 /end COMPU_METHOD
/begin MEASUREMENT ECT_THLD_TMR "threshold monitor timer counter" FLOAT32_IEEE MC_ECT_THLD_TMR 0 0 0 0 ECU_ADDRESS 0x3F9FAC /end MEASUREMENT
/begin COMPU_METHOD MC_ECT_THLD_TMR "ECT_THLD_TMR conversion" RAT_FUNC "%10.5" "Unitless" COEFFS 0 1 0 0 0 1 /end COMPU_METHOD
/begin CHARACTERISTIC ECT_THLD_TST_TM "" VALUE 0x564F0 SD_FLOAT32_IEEE 0 SC_ECT_THLD_TST_TM 0 50000 /end CHARACTERISTIC
/begin COMPU_METHOD SC_ECT_THLD_TST_TM "ECT_THLD_TST_TM conversion" RAT_FUNC "%10.5" "unitless" COEFFS 0 1 0 0 0 1 /end COMPU_METHOD
/begin MEASUREMENT ECT_UPDOWN_CNTR "threshold monitor updown counter" SLONG MC_ECT_UPDOWN_CNTR 0 0 0 0 ECU_ADDRESS 0x3F9FB0 /end MEASUREMENT
/begin COMPU_METHOD MC_ECT_UPDOWN_CNTR "ECT_UPDOWN_CNTR conversion" RAT_FUNC "%10.0" "Unitless" COEFFS 0 1 0 0 0 1 /end COMPU_METHOD
/begin CHARACTERISTIC ECT_WARM "Temperature above which the engine is considered warm for the purposes of OBDII similar conditions." VALUE 0x56394 SD_UBYTE 0 SC_ECT_WARM 0 254 /end CHARACTERISTIC
/begin COMPU_METHOD SC_ECT_WARM "ECT_WARM conversion" RAT_FUNC "%3.0" "DEGREES" COEFFS 0 1 0 0 0 1 /end COMPU_METHOD
/begin CHARACTERISTIC ECU_EO_DONE "VAlue of EO_STATUS when ECU test is complete (engine off on demand test sequence)" VALUE 0x57855 SD_UBYTE 0 SC_ECU_EO_DONE 0 100 /end CHARACTERISTIC
/begin COMPU_METHOD SC_ECU_EO_DONE "ECU_EO_DONE conversion" RAT_FUNC "%3.0" "unitless" COEFFS 0 1 0 0 0 1 /end COMPU_METHOD
/begin CHARACTERISTIC ECU_EO_INIT "Value of EO_STATUS to signal for ECU test (Instruction, KAM, RAM, ROM)" VALUE 0x57856 SD_UBYTE 0 SC_ECU_EO_INIT 0 100 /end CHARACTERISTIC
/begin COMPU_METHOD SC_ECU_EO_INIT "ECU_EO_INIT conversion" RAT_FUNC "%3.0" "unitless" COEFFS 0 1 0 0 0 1 /end COMPU_METHOD
/begin MEASUREMENT EDF_DELTA_SEC "EDF loop timer" FLOAT32_IEEE MC_EDF_DELTA_SEC 0 0 0 0 ECU_ADDRESS 0x3FA928 /end MEASUREMENT
/begin COMPU_METHOD MC_EDF_DELTA_SEC "EDF_DELTA_SEC conversion" RAT_FUNC "%10.5" "Unitless" COEFFS 0 1 0 0 0 1 /end COMPU_METHOD
/begin MEASUREMENT EGC_MFL_MULT "EGC overboost smoke limiter multiplier" FLOAT32_IEEE MC_EGC_MFL_MULT 0 0 0 0 ECU_ADDRESS 0x3FA328 /end MEASUREMENT
/begin COMPU_METHOD MC_EGC_MFL_MULT "EGC_MFL_MULT conversion" RAT_FUNC "%10.5" "Unitless" COEFFS 0 1 0 0 0 1 /end COMPU_METHOD
/begin MEASUREMENT EGO_COUNT "Count of the number of complete ego tests since KAM reset." UBYTE MC_EGO_COUNT 0 0 0 0 ECU_ADDRESS 0x3FAEE6 /end MEASUREMENT
/begin COMPU_METHOD MC_EGO_COUNT "EGO_COUNT conversion" RAT_FUNC "%3.0" "Unitless" COEFFS 0 1 0 0 0 1 /end COMPU_METHOD
/begin CHARACTERISTIC EGO_DEL_TM "Time delay between succesive runs of the EGO monitor." VALUE 0x5637F SD_UBYTE 0 SC_EGO_DEL_TM 0 127 /end CHARACTERISTIC
/begin COMPU_METHOD SC_EGO_DEL_TM "EGO_DEL_TM conversion" RAT_FUNC "%3.0" "s" COEFFS 0 1 0 0 0 1 /end COMPU_METHOD
/begin MEASUREMENT EGO_DEL_TMR "Time since abort of the EGO monitor." FLOAT32_IEEE MC_EGO_DEL_TMR 0 0 0 0 ECU_ADDRESS 0x3F9F14 /end MEASUREMENT
/begin COMPU_METHOD MC_EGO_DEL_TMR "EGO_DEL_TMR conversion" RAT_FUNC "%10.5" "Unitless" COEFFS 0 1 0 0 0 1 /end COMPU_METHOD
/begin CHARACTERISTIC EGO_ER_DONE "Value for state pointer when engine running EGO test is complete" VALUE 0x57830 SD_UBYTE 0 SC_EGO_ER_DONE 0 100 /end CHARACTERISTIC
/begin COMPU_METHOD SC_EGO_ER_DONE "EGO_ER_DONE conversion" RAT_FUNC "%3.0" "unitless" COEFFS 0 1 0 0 0 1 /end COMPU_METHOD
/begin CHARACTERISTIC EGO_ER_INIT "Value for state of ER_STATUS to indicate engine running EGO test is to be run" VALUE 0x57831 SD_UBYTE 0 SC_EGO_ER_INIT 0 100 /end CHARACTERISTIC
/begin COMPU_METHOD SC_EGO_ER_INIT "EGO_ER_INIT conversion" RAT_FUNC "%3.0" "unitless" COEFFS 0 1 0 0 0 1 /end COMPU_METHOD
/begin MEASUREMENT EGO_FMEM "EGO system FMEM flag.  1 -> don't run EGO monitor due to FMEM." UBYTE MC_EGO_FMEM 0 0 0 0 ECU_ADDRESS 0x3F9F03 /end MEASUREMENT
/begin COMPU_METHOD MC_EGO_FMEM "EGO_FMEM conversion" RAT_FUNC "%3.0" "Unitless" COEFFS 0 1 0 0 0 1 /end COMPU_METHOD
/begin MEASUREMENT EGO_MON "OBDII monitor flag for EGO system; 1=> all fuel faults been monitored since power-up" UBYTE MC_EGO_MON 0 0 0 0 ECU_ADDRESS 0x3FADD8 /end MEASUREMENT
/begin COMPU_METHOD MC_EGO_MON "EGO_MON conversion" RAT_FUNC "%3.0" "Unitless" COEFFS 0 1 0 0 0 1 /end COMPU_METHOD
/begin MEASUREMENT EGO_TST_ENA "OBD-II EGO Test enable flag. (1 => test enabled)" UBYTE MC_EGO_TST_ENA 0 0 0 0 ECU_ADDRESS 0x3F9EE2 /end MEASUREMENT
/begin COMPU_METHOD MC_EGO_TST_ENA "EGO_TST_ENA conversion" RAT_FUNC "%3.0" "Unitless" COEFFS 0 1 0 0 0 1 /end COMPU_METHOD
/begin MEASUREMENT EGO_TST_RDY "EGO test ready flag; 1 ->  all  local  conditions have been met; ready to run EGO test." UBYTE MC_EGO_TST_RDY 0 0 0 0 ECU_ADDRESS 0x3FADD0 /end MEASUREMENT
/begin COMPU_METHOD MC_EGO_TST_RDY "EGO_TST_RDY conversion" RAT_FUNC "%3.0" "Unitless" COEFFS 0 1 0 0 0 1 /end COMPU_METHOD
/begin CHARACTERISTIC EGRC_AFR_KF "EGR Close time constant  for  AFR  based transient compensator" VALUE 0x57074 SD_FLOAT32_IEEE 0 SC_EGRC_AFR_KF 0 5 /end CHARACTERISTIC
/begin COMPU_METHOD SC_EGRC_AFR_KF "EGRC_AFR_KF conversion" RAT_FUNC "%10.5" "s" COEFFS 0 1 0 0 0 1 /end COMPU_METHOD
/begin CHARACTERISTIC EGRC_AFR_PPS_KF "EGR close time constant for pps by AFR based transient compensation" VALUE 0x57028 SD_FLOAT32_IEEE 0 SC_EGRC_AFR_PPS_KF 0 5 /end CHARACTERISTIC
/begin COMPU_METHOD SC_EGRC_AFR_PPS_KF "EGRC_AFR_PPS_KF conversion" RAT_FUNC "%10.5" "s" COEFFS 0 1 0 0 0 1 /end COMPU_METHOD
/begin CHARACTERISTIC EGRF_ERR_LMN "Minimum limit check for egr_flw_err" VALUE 0x57070 SD_FLOAT32_IEEE 0 SC_EGRF_ERR_LMN -10000 0 /end CHARACTERISTIC
/begin COMPU_METHOD SC_EGRF_ERR_LMN "EGRF_ERR_LMN conversion" RAT_FUNC "%10.5" "unitless" COEFFS 0 1 0 0 0 1 /end COMPU_METHOD
/begin CHARACTERISTIC EGRF_ERR_LMX "Maximum limit check for egr_flw_err" VALUE 0x5706C SD_FLOAT32_IEEE 0 SC_EGRF_ERR_LMX 0 10000 /end CHARACTERISTIC
/begin COMPU_METHOD SC_EGRF_ERR_LMX "EGRF_ERR_LMX conversion" RAT_FUNC "%10.5" "unitless" COEFFS 0 1 0 0 0 1 /end COMPU_METHOD
/begin CHARACTERISTIC EGRF_ERR_OBD "Steady state flow error threshold, OBD" VALUE 0x57068 SD_FLOAT32_IEEE 0 SC_EGRF_ERR_OBD 0 100 /end CHARACTERISTIC
/begin COMPU_METHOD SC_EGRF_ERR_OBD "EGRF_ERR_OBD conversion" RAT_FUNC "%10.5" "g/s" COEFFS 0 1 0 0 0 1 /end COMPU_METHOD
/begin CHARACTERISTIC EGRF_ERR_SS "Steady state flow error threshold, failure management" VALUE 0x57064 SD_FLOAT32_IEEE 0 SC_EGRF_ERR_SS 0 500 /end CHARACTERISTIC
/begin COMPU_METHOD SC_EGRF_ERR_SS "EGRF_ERR_SS conversion" RAT_FUNC "%10.5" "g/s" COEFFS 0 1 0 0 0 1 /end COMPU_METHOD
/begin MEASUREMENT EGRF_F_OBD "EGR  flow steady state error flag for OBD" UBYTE MC_EGRF_F_OBD 0 0 0 0 ECU_ADDRESS 0x3FA7EF /end MEASUREMENT
/begin COMPU_METHOD MC_EGRF_F_OBD "EGRF_F_OBD conversion" RAT_FUNC "%3.0" "Unitless" COEFFS 0 1 0 0 0 1 /end COMPU_METHOD
/begin MEASUREMENT EGRF_F_SS "EGR flow steady state error flag" UBYTE MC_EGRF_F_SS 0 0 0 0 ECU_ADDRESS 0x3FA7EE /end MEASUREMENT
/begin COMPU_METHOD MC_EGRF_F_SS "EGRF_F_SS conversion" RAT_FUNC "%3.0" "Unitless" COEFFS 0 1 0 0 0 1 /end COMPU_METHOD
/begin CHARACTERISTIC EGRF_OBD_DT "Steady state flow error detection time, OBD" VALUE 0x57060 SD_FLOAT32_IEEE 0 SC_EGRF_OBD_DT 0 600 /end CHARACTERISTIC
/begin COMPU_METHOD SC_EGRF_OBD_DT "EGRF_OBD_DT conversion" RAT_FUNC "%10.5" "s" COEFFS 0 1 0 0 0 1 /end COMPU_METHOD
/begin MEASUREMENT EGRF_OBD_DTR "Detection timer for OBDII MAF rate failure diagnostics" FLOAT32_IEEE MC_EGRF_OBD_DTR 0 0 0 0 ECU_ADDRESS 0x3FA7A0 /end MEASUREMENT
/begin COMPU_METHOD MC_EGRF_OBD_DTR "EGRF_OBD_DTR conversion" RAT_FUNC "%10.5" "Unitless" COEFFS 0 1 0 0 0 1 /end COMPU_METHOD
/begin CHARACTERISTIC EGRF_OBD_RT "Steady state flow error recovery time, OBD" VALUE 0x5705C SD_FLOAT32_IEEE 0 SC_EGRF_OBD_RT 0 600 /end CHARACTERISTIC
/begin COMPU_METHOD SC_EGRF_OBD_RT "EGRF_OBD_RT conversion" RAT_FUNC "%10.5" "s" COEFFS 0 1 0 0 0 1 /end COMPU_METHOD
/begin MEASUREMENT EGRF_OBD_RTR "Recovery timer for OBDII MAF rate failure diagnostics" FLOAT32_IEEE MC_EGRF_OBD_RTR 0 0 0 0 ECU_ADDRESS 0x3FA79C /end MEASUREMENT
/begin COMPU_METHOD MC_EGRF_OBD_RTR "EGRF_OBD_RTR conversion" RAT_FUNC "%10.5" "Unitless" COEFFS 0 1 0 0 0 1 /end COMPU_METHOD
/begin CHARACTERISTIC EGRF_SS_DT "Steady state flow error detection time, failure management" VALUE 0x57058 SD_FLOAT32_IEEE 0 SC_EGRF_SS_DT 0 600 /end CHARACTERISTIC
/begin COMPU_METHOD SC_EGRF_SS_DT "EGRF_SS_DT conversion" RAT_FUNC "%10.5" "s" COEFFS 0 1 0 0 0 1 /end COMPU_METHOD
/begin MEASUREMENT EGRF_SS_DTR "Detection timer for steady state MAF rate failure diagnostics" FLOAT32_IEEE MC_EGRF_SS_DTR 0 0 0 0 ECU_ADDRESS 0x3FA798 /end MEASUREMENT
/begin COMPU_METHOD MC_EGRF_SS_DTR "EGRF_SS_DTR conversion" RAT_FUNC "%10.5" "Unitless" COEFFS 0 1 0 0 0 1 /end COMPU_METHOD
/begin CHARACTERISTIC EGRF_SS_RT "Steady state flow error recovery time, failure management" VALUE 0x57054 SD_FLOAT32_IEEE 0 SC_EGRF_SS_RT 0 600 /end CHARACTERISTIC
/begin COMPU_METHOD SC_EGRF_SS_RT "EGRF_SS_RT conversion" RAT_FUNC "%10.5" "s" COEFFS 0 1 0 0 0 1 /end COMPU_METHOD
/begin MEASUREMENT EGRF_SS_RTR "Recovery timer for steady state MAF rate failure diagnostics" FLOAT32_IEEE MC_EGRF_SS_RTR 0 0 0 0 ECU_ADDRESS 0x3FA794 /end MEASUREMENT
/begin COMPU_METHOD MC_EGRF_SS_RTR "EGRF_SS_RTR conversion" RAT_FUNC "%10.5" "Unitless" COEFFS 0 1 0 0 0 1 /end COMPU_METHOD
/begin CHARACTERISTIC EGRO_AFR_KF "EGR Open time constant for AFR based transient compensator" VALUE 0x57050 SD_FLOAT32_IEEE 0 SC_EGRO_AFR_KF 0 5 /end CHARACTERISTIC
/begin COMPU_METHOD SC_EGRO_AFR_KF "EGRO_AFR_KF conversion" RAT_FUNC "%10.5" "s" COEFFS 0 1 0 0 0 1 /end COMPU_METHOD
/begin CHARACTERISTIC EGRO_AFR_PPS_KF "EGR open time constantfor pps  by AFR based transient compensation" VALUE 0x57024 SD_FLOAT32_IEEE 0 SC_EGRO_AFR_PPS_KF 0 5 /end CHARACTERISTIC
/begin COMPU_METHOD SC_EGRO_AFR_PPS_KF "EGRO_AFR_PPS_KF conversion" RAT_FUNC "%10.5" "s" COEFFS 0 1 0 0 0 1 /end COMPU_METHOD
/begin MEASUREMENT EGRP "EGR Valve position" FLOAT32_IEEE MC_EGRP 0 0 0 0 ECU_ADDRESS 0x3FA000 /end MEASUREMENT
/begin COMPU_METHOD MC_EGRP "EGRP conversion" RAT_FUNC "%10.5" "Unitless" COEFFS 0 1 0 0 0 1 /end COMPU_METHOD
/begin CHARACTERISTIC EGRP_AD_TC "EGR Position filter time constant" VALUE 0x56548 SD_FLOAT32_IEEE 0 SC_EGRP_AD_TC 0 64 /end CHARACTERISTIC
/begin COMPU_METHOD SC_EGRP_AD_TC "EGRP_AD_TC conversion" RAT_FUNC "%10.5" "s" COEFFS 0 1 0 0 0 1 /end COMPU_METHOD
/begin CHARACTERISTIC EGRP_CAL "Calibration mode valve position desired input" VALUE 0x5704C SD_FLOAT32_IEEE 0 SC_EGRP_CAL 0 1 /end CHARACTERISTIC
/begin COMPU_METHOD SC_EGRP_CAL "EGRP_CAL conversion" RAT_FUNC "%10.5" "%" COEFFS 0 1 0 0 0 1 /end COMPU_METHOD
/begin CHARACTERISTIC EGRP_DEF "EGR Valve position default value" VALUE 0x56554 SD_FLOAT32_IEEE 0 SC_EGRP_DEF 0 1 /end CHARACTERISTIC
/begin COMPU_METHOD SC_EGRP_DEF "EGRP_DEF conversion" RAT_FUNC "%10.5" "%" COEFFS 0 1 0 0 0 1 /end COMPU_METHOD
/begin MEASUREMENT EGRP_DES "MAF rate based PI loop Desired valve position" FLOAT32_IEEE MC_EGRP_DES 0 0 0 0 ECU_ADDRESS 0x3FA790 /end MEASUREMENT
/begin COMPU_METHOD MC_EGRP_DES "EGRP_DES conversion" RAT_FUNC "%10.5" "Unitless" COEFFS 0 1 0 0 0 1 /end COMPU_METHOD
/begin MEASUREMENT EGRP_ENG "EGR Valve position engineer unit." FLOAT32_IEEE MC_EGRP_ENG 0 0 0 0 ECU_ADDRESS 0x3FAA4C /end MEASUREMENT
/begin COMPU_METHOD MC_EGRP_ENG "EGRP_ENG conversion" RAT_FUNC "%10.5" "Unitless" COEFFS 0 1 0 0 0 1 /end COMPU_METHOD
/begin MEASUREMENT EGRP_ERR "EGR position error" FLOAT32_IEEE MC_EGRP_ERR 0 0 0 0 ECU_ADDRESS 0x3FA78C /end MEASUREMENT
/begin COMPU_METHOD MC_EGRP_ERR "EGRP_ERR conversion" RAT_FUNC "%10.5" "Unitless" COEFFS 0 1 0 0 0 1 /end COMPU_METHOD
/begin CHARACTERISTIC EGRP_ERR_LMN "Minimum limit check for egrp_err" VALUE 0x57048 SD_FLOAT32_IEEE 0 SC_EGRP_ERR_LMN -10 10 /end CHARACTERISTIC
/begin COMPU_METHOD SC_EGRP_ERR_LMN "EGRP_ERR_LMN conversion" RAT_FUNC "%10.5" "unitless" COEFFS 0 1 0 0 0 1 /end COMPU_METHOD
/begin CHARACTERISTIC EGRP_ERR_LMX "Maximum limit check for egrp_err" VALUE 0x57044 SD_FLOAT32_IEEE 0 SC_EGRP_ERR_LMX 0 10 /end CHARACTERISTIC
/begin COMPU_METHOD SC_EGRP_ERR_LMX "EGRP_ERR_LMX conversion" RAT_FUNC "%10.5" "unitless" COEFFS 0 1 0 0 0 1 /end COMPU_METHOD
/begin CHARACTERISTIC EGRP_ERR_OBD "Position error based steady state detection threshold for OBD" VALUE 0x57040 SD_FLOAT32_IEEE 0 SC_EGRP_ERR_OBD 0 1 /end CHARACTERISTIC
/begin COMPU_METHOD SC_EGRP_ERR_OBD "EGRP_ERR_OBD conversion" RAT_FUNC "%10.5" "%" COEFFS 0 1 0 0 0 1 /end COMPU_METHOD
/begin CHARACTERISTIC EGRP_ERR_SS "Position error based steady state detection" VALUE 0x5703C SD_FLOAT32_IEEE 0 SC_EGRP_ERR_SS 0 1 /end CHARACTERISTIC
/begin COMPU_METHOD SC_EGRP_ERR_SS "EGRP_ERR_SS conversion" RAT_FUNC "%10.5" "%" COEFFS 0 1 0 0 0 1 /end COMPU_METHOD
/begin MEASUREMENT EGRP_FILT_TIME_CONST "EGRP filter time constant" FLOAT32_IEEE MC_EGRP_FILT_TIME_CONST 0 0 0 0 ECU_ADDRESS 0x3F9FE8 /end MEASUREMENT
/begin COMPU_METHOD MC_EGRP_FILT_TIME_CONST "EGRP_FILT_TIME_CONST conversion" RAT_FUNC "%10.5" "Unitless" COEFFS 0 1 0 0 0 1 /end COMPU_METHOD
/begin MEASUREMENT EGRP_FLT_RECOVERY_CNTR "EGRP fault recovery counter" SLONG MC_EGRP_FLT_RECOVERY_CNTR 0 0 0 0 ECU_ADDRESS 0x3F9FEC /end MEASUREMENT
/begin COMPU_METHOD MC_EGRP_FLT_RECOVERY_CNTR "EGRP_FLT_RECOVERY_CNTR conversion" RAT_FUNC "%10.0" "Unitless" COEFFS 0 1 0 0 0 1 /end COMPU_METHOD
/begin MEASUREMENT EGRP_FLT_RECOVERY_FLG "1-> Indicates EGRP fault recovery is occuring" UBYTE MC_EGRP_FLT_RECOVERY_FLG 0 0 0 0 ECU_ADDRESS 0x3FA004 /end MEASUREMENT
/begin COMPU_METHOD MC_EGRP_FLT_RECOVERY_FLG "EGRP_FLT_RECOVERY_FLG conversion" RAT_FUNC "%3.0" "Unitless" COEFFS 0 1 0 0 0 1 /end COMPU_METHOD
/begin CHARACTERISTIC EGRP_F_DEC "EGRP malf failure/update counter decrement value" VALUE 0x56564 SD_SLONG 0 SC_EGRP_F_DEC 0 65535 /end CHARACTERISTIC
/begin COMPU_METHOD SC_EGRP_F_DEC "EGRP_F_DEC conversion" RAT_FUNC "%10.0" "unitless" COEFFS 0 1 0 0 0 1 /end COMPU_METHOD
/begin CHARACTERISTIC EGRP_F_INC "EGRP ORH/ORL failure counter increment value" VALUE 0x56568 SD_SLONG 0 SC_EGRP_F_INC 0 65535 /end CHARACTERISTIC
/begin COMPU_METHOD SC_EGRP_F_INC "EGRP_F_INC conversion" RAT_FUNC "%10.0" "unitless" COEFFS 0 1 0 0 0 1 /end COMPU_METHOD
/begin MEASUREMENT EGRP_F_ORH "EGRP out of range high fault" UBYTE MC_EGRP_F_ORH 0 0 0 0 ECU_ADDRESS 0x3FA00A /end MEASUREMENT
/begin COMPU_METHOD MC_EGRP_F_ORH "EGRP_F_ORH conversion" RAT_FUNC "%3.0" "Unitless" COEFFS 0 1 0 0 0 1 /end COMPU_METHOD
/begin MEASUREMENT EGRP_F_ORL "EGRP out  of range low fault" UBYTE MC_EGRP_F_ORL 0 0 0 0 ECU_ADDRESS 0x3FA009 /end MEASUREMENT
/begin COMPU_METHOD MC_EGRP_F_ORL "EGRP_F_ORL conversion" RAT_FUNC "%3.0" "Unitless" COEFFS 0 1 0 0 0 1 /end COMPU_METHOD
/begin MEASUREMENT EGRP_F_SS "EGR valve position Steady state error flag" UBYTE MC_EGRP_F_SS 0 0 0 0 ECU_ADDRESS 0x3FA7ED /end MEASUREMENT
/begin COMPU_METHOD MC_EGRP_F_SS "EGRP_F_SS conversion" RAT_FUNC "%3.0" "Unitless" COEFFS 0 1 0 0 0 1 /end COMPU_METHOD
/begin CHARACTERISTIC EGRP_HI_ER "Egr out-of-range high in counts" VALUE 0x57488 SD_FLOAT32_IEEE 0 SC_EGRP_HI_ER 0 1023 /end CHARACTERISTIC
/begin COMPU_METHOD SC_EGRP_HI_ER "EGRP_HI_ER conversion" RAT_FUNC "%10.5" "ADct" COEFFS 0 1 0 0 0 1 /end COMPU_METHOD
/begin CHARACTERISTIC EGRP_KI "EGRP integral gain term" VALUE 0x57038 SD_FLOAT32_IEEE 0 SC_EGRP_KI 0 30 /end CHARACTERISTIC
/begin COMPU_METHOD SC_EGRP_KI "EGRP_KI conversion" RAT_FUNC "%10.5" "unitless" COEFFS 0 1 0 0 0 1 /end COMPU_METHOD
/begin CHARACTERISTIC EGRP_KP "proportional gain term" VALUE 0x57034 SD_FLOAT32_IEEE 0 SC_EGRP_KP 0 30 /end CHARACTERISTIC
/begin COMPU_METHOD SC_EGRP_KP "EGRP_KP conversion" RAT_FUNC "%10.5" "unitless" COEFFS 0 1 0 0 0 1 /end COMPU_METHOD
/begin CHARACTERISTIC EGRP_LO_ER "EGRP out-of-range low in counts" VALUE 0x57484 SD_FLOAT32_IEEE 0 SC_EGRP_LO_ER 0 1023 /end CHARACTERISTIC
/begin COMPU_METHOD SC_EGRP_LO_ER "EGRP_LO_ER conversion" RAT_FUNC "%10.5" "ADct" COEFFS 0 1 0 0 0 1 /end COMPU_METHOD
/begin MEASUREMENT EGRP_MALF_SET "Indicate EGRP malf  high or low failure" UBYTE MC_EGRP_MALF_SET 0 0 0 0 ECU_ADDRESS 0x3FA006 /end MEASUREMENT
/begin COMPU_METHOD MC_EGRP_MALF_SET "EGRP_MALF_SET conversion" RAT_FUNC "%3.0" "Unitless" COEFFS 0 1 0 0 0 1 /end COMPU_METHOD
/begin MEASUREMENT EGRP_ORH_CNTR "EGRP out of range high counter" SLONG MC_EGRP_ORH_CNTR 0 0 0 0 ECU_ADDRESS 0x3F9FFC /end MEASUREMENT
/begin COMPU_METHOD MC_EGRP_ORH_CNTR "EGRP_ORH_CNTR conversion" RAT_FUNC "%10.0" "Unitless" COEFFS 0 1 0 0 0 1 /end COMPU_METHOD
/begin MEASUREMENT EGRP_ORL_CNTR "EGRP out of range low counter" SLONG MC_EGRP_ORL_CNTR 0 0 0 0 ECU_ADDRESS 0x3F9FF8 /end MEASUREMENT
/begin COMPU_METHOD MC_EGRP_ORL_CNTR "EGRP_ORL_CNTR conversion" RAT_FUNC "%10.0" "Unitless" COEFFS 0 1 0 0 0 1 /end COMPU_METHOD
/begin MEASUREMENT EGRP_RAW "Raw A/D value for EGR valve position" FLOAT32_IEEE MC_EGRP_RAW 0 0 0 0 ECU_ADDRESS 0x3FAA48 /end MEASUREMENT
/begin COMPU_METHOD MC_EGRP_RAW "EGRP_RAW conversion" RAT_FUNC "%10.5" "Unitless" COEFFS 0 1 0 0 0 1 /end COMPU_METHOD
/begin CHARACTERISTIC EGRP_REC_INC "EGRP fault recovery counter increment value" VALUE 0x56550 SD_SLONG 0 SC_EGRP_REC_INC 0 65535 /end CHARACTERISTIC
/begin COMPU_METHOD SC_EGRP_REC_INC "EGRP_REC_INC conversion" RAT_FUNC "%10.0" "unitless" COEFFS 0 1 0 0 0 1 /end COMPU_METHOD
/begin CHARACTERISTIC EGRP_SS_DT "Detection time threshold for detection, failure diagnostics" VALUE 0x57030 SD_FLOAT32_IEEE 0 SC_EGRP_SS_DT 0 600 /end CHARACTERISTIC
/begin COMPU_METHOD SC_EGRP_SS_DT "EGRP_SS_DT conversion" RAT_FUNC "%10.5" "s" COEFFS 0 1 0 0 0 1 /end COMPU_METHOD
/begin MEASUREMENT EGRP_SS_DTR "" FLOAT32_IEEE MC_EGRP_SS_DTR 0 0 0 0 ECU_ADDRESS 0x3FA788 /end MEASUREMENT
/begin COMPU_METHOD MC_EGRP_SS_DTR "EGRP_SS_DTR conversion" RAT_FUNC "%10.5" "Unitless" COEFFS 0 1 0 0 0 1 /end COMPU_METHOD
/begin CHARACTERISTIC EGRP_SS_RT "Recovery time threshold for detection, failure diagnostics" VALUE 0x5702C SD_FLOAT32_IEEE 0 SC_EGRP_SS_RT 0 600 /end CHARACTERISTIC
/begin COMPU_METHOD SC_EGRP_SS_RT "EGRP_SS_RT conversion" RAT_FUNC "%10.5" "s" COEFFS 0 1 0 0 0 1 /end COMPU_METHOD
/begin MEASUREMENT EGRP_SS_RTR "" FLOAT32_IEEE MC_EGRP_SS_RTR 0 0 0 0 ECU_ADDRESS 0x3FA784 /end MEASUREMENT
/begin COMPU_METHOD MC_EGRP_SS_RTR "EGRP_SS_RTR conversion" RAT_FUNC "%10.5" "Unitless" COEFFS 0 1 0 0 0 1 /end COMPU_METHOD
/begin MEASUREMENT EGRP_STATUS "EGR Valve position status" UBYTE MC_EGRP_STATUS 0 0 0 0 ECU_ADDRESS 0x3FAA50 /end MEASUREMENT
/begin COMPU_METHOD MC_EGRP_STATUS "EGRP_STATUS conversion" RAT_FUNC "%3.0" "Unitless" COEFFS 0 1 0 0 0 1 /end COMPU_METHOD
/begin CHARACTERISTIC EGRP_TCREC_SEL "Switch to select EGRP filter time constant during fault recovery and during fault occurance before malf is set" VALUE 0x56558 SD_UBYTE 0 SC_EGRP_TCREC_SEL 0 1 /end CHARACTERISTIC
/begin COMPU_METHOD SC_EGRP_TCREC_SEL "EGRP_TCREC_SEL conversion" RAT_FUNC "%3.0" "unitless" COEFFS 0 1 0 0 0 1 /end COMPU_METHOD
/begin MEASUREMENT EGR_AFR_KF "First Order Filter time constant (sec)" FLOAT32_IEEE MC_EGR_AFR_KF 0 0 0 0 ECU_ADDRESS 0x3FA7E0 /end MEASUREMENT
/begin COMPU_METHOD MC_EGR_AFR_KF "EGR_AFR_KF conversion" RAT_FUNC "%10.5" "Unitless" COEFFS 0 1 0 0 0 1 /end COMPU_METHOD
/begin MEASUREMENT EGR_AFR_MLT "Multiplier that modifies MAF setpoint for transient management" FLOAT32_IEEE MC_EGR_AFR_MLT 0 0 0 0 ECU_ADDRESS 0x3FA7DC /end MEASUREMENT
/begin COMPU_METHOD MC_EGR_AFR_MLT "EGR_AFR_MLT conversion" RAT_FUNC "%10.5" "Unitless" COEFFS 0 1 0 0 0 1 /end COMPU_METHOD
/begin MEASUREMENT EGR_AFR_PPS_KF "First  order filter constant" FLOAT32_IEEE MC_EGR_AFR_PPS_KF 0 0 0 0 ECU_ADDRESS 0x3FA7D8 /end MEASUREMENT
/begin COMPU_METHOD MC_EGR_AFR_PPS_KF "EGR_AFR_PPS_KF conversion" RAT_FUNC "%10.5" "Unitless" COEFFS 0 1 0 0 0 1 /end COMPU_METHOD
/begin MEASUREMENT EGR_COND_MULT "" FLOAT32_IEEE MC_EGR_COND_MULT 0 0 0 0 ECU_ADDRESS 0x3FA6F4 /end MEASUREMENT
/begin COMPU_METHOD MC_EGR_COND_MULT "EGR_COND_MULT conversion" RAT_FUNC "%10.5" "Unitless" COEFFS 0 1 0 0 0 1 /end COMPU_METHOD
/begin MEASUREMENT EGR_COUNT "Count of the number of complete egr tests since KAM reset." UBYTE MC_EGR_COUNT 0 0 0 0 ECU_ADDRESS 0x3FAEE7 /end MEASUREMENT
/begin COMPU_METHOD MC_EGR_COUNT "EGR_COUNT conversion" RAT_FUNC "%3.0" "Unitless" COEFFS 0 1 0 0 0 1 /end COMPU_METHOD
/begin MEASUREMENT EGR_DTY "EGR Valve duty cycle" FLOAT32_IEEE MC_EGR_DTY 0 0 0 0 ECU_ADDRESS 0x3FA6F0 /end MEASUREMENT
/begin COMPU_METHOD MC_EGR_DTY "EGR_DTY conversion" RAT_FUNC "%10.5" "Unitless" COEFFS 0 1 0 0 0 1 /end COMPU_METHOD
/begin CHARACTERISTIC EGR_DTY_CAL "EGR duty cycle calibration value" VALUE 0x570AC SD_FLOAT32_IEEE 0 SC_EGR_DTY_CAL 0 1 /end CHARACTERISTIC
/begin COMPU_METHOD SC_EGR_DTY_CAL "EGR_DTY_CAL conversion" RAT_FUNC "%10.5" "unitless" COEFFS 0 1 0 0 0 1 /end COMPU_METHOD
/begin CHARACTERISTIC EGR_DTY_DEF "default value of egr_dty for egr_f setting" VALUE 0x570A8 SD_FLOAT32_IEEE 0 SC_EGR_DTY_DEF 0 1 /end CHARACTERISTIC
/begin COMPU_METHOD SC_EGR_DTY_DEF "EGR_DTY_DEF conversion" RAT_FUNC "%10.5" "unitless" COEFFS 0 1 0 0 0 1 /end COMPU_METHOD
/begin CHARACTERISTIC EGR_DTY_LMN "egr duty cycle low limit" VALUE 0x570A4 SD_FLOAT32_IEEE 0 SC_EGR_DTY_LMN -2 1.99 /end CHARACTERISTIC
/begin COMPU_METHOD SC_EGR_DTY_LMN "EGR_DTY_LMN conversion" RAT_FUNC "%10.5" "unitless" COEFFS 0 1 0 0 0 1 /end COMPU_METHOD
/begin CHARACTERISTIC EGR_DTY_LMX "egr  duty cycle high limit" VALUE 0x570A0 SD_FLOAT32_IEEE 0 SC_EGR_DTY_LMX 0 3.9 /end CHARACTERISTIC
/begin COMPU_METHOD SC_EGR_DTY_LMX "EGR_DTY_LMX conversion" RAT_FUNC "%10.5" "unitless" COEFFS 0 1 0 0 0 1 /end COMPU_METHOD
/begin MEASUREMENT EGR_DUTY "" FLOAT32_IEEE MC_EGR_DUTY 0 0 0 0 ECU_ADDRESS 0x3FA7D4 /end MEASUREMENT
/begin COMPU_METHOD MC_EGR_DUTY "EGR_DUTY conversion" RAT_FUNC "%10.5" "Unitless" COEFFS 0 1 0 0 0 1 /end COMPU_METHOD
/begin CHARACTERISTIC EGR_EOT_EN "Cold Engine oil temperature above which to enable EGR" VALUE 0x5709C SD_FLOAT32_IEEE 0 SC_EGR_EOT_EN 0 100 /end CHARACTERISTIC
/begin COMPU_METHOD SC_EGR_EOT_EN "EGR_EOT_EN conversion" RAT_FUNC "%10.5" "degC" COEFFS 0 1 0 0 0 1 /end COMPU_METHOD
/begin CHARACTERISTIC EGR_ER_DONE "Value for state of ER_STATUS to indicate engine running EGR test is complete" VALUE 0x57833 SD_UBYTE 0 SC_EGR_ER_DONE 0 100 /end CHARACTERISTIC
/begin COMPU_METHOD SC_EGR_ER_DONE "EGR_ER_DONE conversion" RAT_FUNC "%3.0" "unitless" COEFFS 0 1 0 0 0 1 /end COMPU_METHOD
/begin CHARACTERISTIC EGR_ER_INIT "Value for state of ER_STATUS to request engine running egr test." VALUE 0x57834 SD_UBYTE 0 SC_EGR_ER_INIT 0 100 /end CHARACTERISTIC
/begin COMPU_METHOD SC_EGR_ER_INIT "EGR_ER_INIT conversion" RAT_FUNC "%3.0" "unitless" COEFFS 0 1 0 0 0 1 /end COMPU_METHOD
/begin MEASUREMENT EGR_FMEM "EGR system FMEM flag.  1 -> don't run EGR monitor due to FMEM." UBYTE MC_EGR_FMEM 0 0 0 0 ECU_ADDRESS 0x3F9F02 /end MEASUREMENT
/begin COMPU_METHOD MC_EGR_FMEM "EGR_FMEM conversion" RAT_FUNC "%3.0" "Unitless" COEFFS 0 1 0 0 0 1 /end COMPU_METHOD
/begin MEASUREMENT EGR_I_DTY "EGR integral term duty cycle" FLOAT32_IEEE MC_EGR_I_DTY 0 0 0 0 ECU_ADDRESS 0x3FA7D0 /end MEASUREMENT
/begin COMPU_METHOD MC_EGR_I_DTY "EGR_I_DTY conversion" RAT_FUNC "%10.5" "Unitless" COEFFS 0 1 0 0 0 1 /end COMPU_METHOD
/begin MEASUREMENT EGR_I_VPD "Integral part of EGR duty cycle" FLOAT32_IEEE MC_EGR_I_VPD 0 0 0 0 ECU_ADDRESS 0x3FA7CC /end MEASUREMENT
/begin COMPU_METHOD MC_EGR_I_VPD "EGR_I_VPD conversion" RAT_FUNC "%10.5" "Unitless" COEFFS 0 1 0 0 0 1 /end COMPU_METHOD
/begin CHARACTERISTIC EGR_KOER_HI "MAF Desired high setpoint for EGR Control KOER Diagnostics" VALUE 0x57098 SD_FLOAT32_IEEE 0 SC_EGR_KOER_HI 0 100 /end CHARACTERISTIC
/begin COMPU_METHOD SC_EGR_KOER_HI "EGR_KOER_HI conversion" RAT_FUNC "%10.5" "g/s" COEFFS 0 1 0 0 0 1 /end COMPU_METHOD
/begin CHARACTERISTIC EGR_KOER_LO "MAF Desired low setpoint for EGR Control KOER Diagnostics" VALUE 0x57094 SD_FLOAT32_IEEE 0 SC_EGR_KOER_LO 0 100 /end CHARACTERISTIC
/begin COMPU_METHOD SC_EGR_KOER_LO "EGR_KOER_LO conversion" RAT_FUNC "%10.5" "g/s" COEFFS 0 1 0 0 0 1 /end COMPU_METHOD
/begin CHARACTERISTIC EGR_KOER_OFF "MAF Desired off setpoint  for EGR Control  KOER Diagnostics" VALUE 0x57090 SD_FLOAT32_IEEE 0 SC_EGR_KOER_OFF 0 100 /end CHARACTERISTIC
/begin COMPU_METHOD SC_EGR_KOER_OFF "EGR_KOER_OFF conversion" RAT_FUNC "%10.5" "g/s" COEFFS 0 1 0 0 0 1 /end COMPU_METHOD
/begin CHARACTERISTIC EGR_MAF_CAL "Calibration mode manual MAF setpoint input" VALUE 0x5708C SD_FLOAT32_IEEE 0 SC_EGR_MAF_CAL 0 100 /end CHARACTERISTIC
/begin COMPU_METHOD SC_EGR_MAF_CAL "EGR_MAF_CAL conversion" RAT_FUNC "%10.5" "g/s" COEFFS 0 1 0 0 0 1 /end COMPU_METHOD
/begin MEASUREMENT EGR_MAF_DES "Desired MAF setpoint after saturation block" FLOAT32_IEEE MC_EGR_MAF_DES 0 0 0 0 ECU_ADDRESS 0x3FA7C0 /end MEASUREMENT
/begin COMPU_METHOD MC_EGR_MAF_DES "EGR_MAF_DES conversion" RAT_FUNC "%10.5" "Unitless" COEFFS 0 1 0 0 0 1 /end COMPU_METHOD
/begin MEASUREMENT EGR_MAF_ERR "MAF error calculated by actual MAF sensor - setpoint" FLOAT32_IEEE MC_EGR_MAF_ERR 0 0 0 0 ECU_ADDRESS 0x3FA7BC /end MEASUREMENT
/begin COMPU_METHOD MC_EGR_MAF_ERR "EGR_MAF_ERR conversion" RAT_FUNC "%10.5" "Unitless" COEFFS 0 1 0 0 0 1 /end COMPU_METHOD
/begin CHARACTERISTIC EGR_MAF_LMN "Minimum limit for MAF desired" VALUE 0x57088 SD_FLOAT32_IEEE 0 SC_EGR_MAF_LMN 0 100 /end CHARACTERISTIC
/begin COMPU_METHOD SC_EGR_MAF_LMN "EGR_MAF_LMN conversion" RAT_FUNC "%10.5" "g/s" COEFFS 0 1 0 0 0 1 /end COMPU_METHOD
/begin CHARACTERISTIC EGR_MAF_LMX "Maximum limit for MAF desired" VALUE 0x57084 SD_FLOAT32_IEEE 0 SC_EGR_MAF_LMX 0 2000 /end CHARACTERISTIC
/begin COMPU_METHOD SC_EGR_MAF_LMX "EGR_MAF_LMX conversion" RAT_FUNC "%10.5" "g/s" COEFFS 0 1 0 0 0 1 /end COMPU_METHOD
/begin MEASUREMENT EGR_MAF_SP "MAF desired setpoint from table FNtbd10?" FLOAT32_IEEE MC_EGR_MAF_SP 0 0 0 0 ECU_ADDRESS 0x3FA7B8 /end MEASUREMENT
/begin COMPU_METHOD MC_EGR_MAF_SP "EGR_MAF_SP conversion" RAT_FUNC "%10.5" "Unitless" COEFFS 0 1 0 0 0 1 /end COMPU_METHOD
/begin MEASUREMENT EGR_MON "OBDII monitor flag for EGR system; 1=> all EGR faults been monitored since power-up" UBYTE MC_EGR_MON 0 0 0 0 ECU_ADDRESS 0x3FADD7 /end MEASUREMENT
/begin COMPU_METHOD MC_EGR_MON "EGR_MON conversion" RAT_FUNC "%3.0" "Unitless" COEFFS 0 1 0 0 0 1 /end COMPU_METHOD
/begin CHARACTERISTIC EGR_MSTR_3WAY_SEL "" VALUE 0x570B6 SD_UBYTE 0 SC_EGR_MSTR_3WAY_SEL 0 2 /end CHARACTERISTIC
/begin COMPU_METHOD SC_EGR_MSTR_3WAY_SEL "EGR_MSTR_3WAY_SEL conversion" RAT_FUNC "%3.0" "unitless" COEFFS 0 1 0 0 0 1 /end COMPU_METHOD
/begin CHARACTERISTIC EGR_MSTR_SEL "" VALUE 0x570B5 SD_UBYTE 0 SC_EGR_MSTR_SEL 0 1 /end CHARACTERISTIC
/begin COMPU_METHOD SC_EGR_MSTR_SEL "EGR_MSTR_SEL conversion" RAT_FUNC "%3.0" "unitless" COEFFS 0 1 0 0 0 1 /end COMPU_METHOD
/begin CHARACTERISTIC EGR_PERIOD_OUT "" VALUE 0x576F0 SD_FLOAT32_IEEE 0 SC_EGR_PERIOD_OUT 100 2e+06 /end CHARACTERISTIC
/begin COMPU_METHOD SC_EGR_PERIOD_OUT "EGR_PERIOD_OUT conversion" RAT_FUNC "%10.5" "us" COEFFS 0 1 0 0 0 1 /end COMPU_METHOD
/begin MEASUREMENT EGR_PPS_DIF "Difference of actual PPS minus filtered PPS" FLOAT32_IEEE MC_EGR_PPS_DIF 0 0 0 0 ECU_ADDRESS 0x3FA7AC /end MEASUREMENT
/begin COMPU_METHOD MC_EGR_PPS_DIF "EGR_PPS_DIF conversion" RAT_FUNC "%10.5" "Unitless" COEFFS 0 1 0 0 0 1 /end COMPU_METHOD
/begin MEASUREMENT EGR_PPS_FOF "Output of First Order Filter of PPS signal" FLOAT32_IEEE MC_EGR_PPS_FOF 0 0 0 0 ECU_ADDRESS 0x3FA7A8 /end MEASUREMENT
/begin COMPU_METHOD MC_EGR_PPS_FOF "EGR_PPS_FOF conversion" RAT_FUNC "%10.5" "Unitless" COEFFS 0 1 0 0 0 1 /end COMPU_METHOD
/begin CHARACTERISTIC EGR_PPS_KF "EGR time constant for PPS based transient compensator" VALUE 0x57080 SD_FLOAT32_IEEE 0 SC_EGR_PPS_KF 0 1 /end CHARACTERISTIC
/begin COMPU_METHOD SC_EGR_PPS_KF "EGR_PPS_KF conversion" RAT_FUNC "%10.5" "s" COEFFS 0 1 0 0 0 1 /end COMPU_METHOD
/begin MEASUREMENT EGR_PPS_MLT "MAF  setpoint   based on PPS Trasient multiplier" FLOAT32_IEEE MC_EGR_PPS_MLT 0 0 0 0 ECU_ADDRESS 0x3FA7A4 /end MEASUREMENT
/begin COMPU_METHOD MC_EGR_PPS_MLT "EGR_PPS_MLT conversion" RAT_FUNC "%10.5" "Unitless" COEFFS 0 1 0 0 0 1 /end COMPU_METHOD
/begin MEASUREMENT EGR_P_DTY "EGR proportional term duty cycle" FLOAT32_IEEE MC_EGR_P_DTY 0 0 0 0 ECU_ADDRESS 0x3FA7B4 /end MEASUREMENT
/begin COMPU_METHOD MC_EGR_P_DTY "EGR_P_DTY conversion" RAT_FUNC "%10.5" "Unitless" COEFFS 0 1 0 0 0 1 /end COMPU_METHOD
/begin MEASUREMENT EGR_P_VPD "Proportional part of EGR duty cycle" FLOAT32_IEEE MC_EGR_P_VPD 0 0 0 0 ECU_ADDRESS 0x3FA7B0 /end MEASUREMENT
/begin COMPU_METHOD MC_EGR_P_VPD "EGR_P_VPD conversion" RAT_FUNC "%10.5" "Unitless" COEFFS 0 1 0 0 0 1 /end COMPU_METHOD
/begin CHARACTERISTIC EGR_SEL "EGR mode selection" VALUE 0x570B7 SD_UBYTE 0 SC_EGR_SEL 0 3 /end CHARACTERISTIC
/begin COMPU_METHOD SC_EGR_SEL "EGR_SEL conversion" RAT_FUNC "%3.0" "unitless" COEFFS 0 1 0 0 0 1 /end COMPU_METHOD
/begin MEASUREMENT EGR_SENSOR_FAULT "" UBYTE MC_EGR_SENSOR_FAULT 0 0 0 0 ECU_ADDRESS 0x3FA7EC /end MEASUREMENT
/begin COMPU_METHOD MC_EGR_SENSOR_FAULT "EGR_SENSOR_FAULT conversion" RAT_FUNC "%3.0" "Unitless" COEFFS 0 1 0 0 0 1 /end COMPU_METHOD
/begin MEASUREMENT EGR_TST_ENA "OBD-II EGR Test enable flag. (1 => test enabled)" UBYTE MC_EGR_TST_ENA 0 0 0 0 ECU_ADDRESS 0x3F9EE1 /end MEASUREMENT
/begin COMPU_METHOD MC_EGR_TST_ENA "EGR_TST_ENA conversion" RAT_FUNC "%3.0" "Unitless" COEFFS 0 1 0 0 0 1 /end COMPU_METHOD
/begin MEASUREMENT EGR_TST_RDY "EGR test ready flag; 1 ->  all  local  conditions have been met; ready to run EGR test." UBYTE MC_EGR_TST_RDY 0 0 0 0 ECU_ADDRESS 0x3FADD1 /end MEASUREMENT
/begin COMPU_METHOD MC_EGR_TST_RDY "EGR_TST_RDY conversion" RAT_FUNC "%3.0" "Unitless" COEFFS 0 1 0 0 0 1 /end COMPU_METHOD
/begin MEASUREMENT EGR_V6_KI "" FLOAT32_IEEE MC_EGR_V6_KI 0 0 0 0 ECU_ADDRESS 0x3FA7C8 /end MEASUREMENT
/begin COMPU_METHOD MC_EGR_V6_KI "EGR_V6_KI conversion" RAT_FUNC "%10.5" "Unitless" COEFFS 0 1 0 0 0 1 /end COMPU_METHOD
/begin MEASUREMENT EGR_V6_KP "" FLOAT32_IEEE MC_EGR_V6_KP 0 0 0 0 ECU_ADDRESS 0x3FA7C4 /end MEASUREMENT
/begin COMPU_METHOD MC_EGR_V6_KP "EGR_V6_KP conversion" RAT_FUNC "%10.5" "Unitless" COEFFS 0 1 0 0 0 1 /end COMPU_METHOD
/begin CHARACTERISTIC EGR_VPD_LMN "Minimum egr_flw_err for enable egr_i_vpd" VALUE 0x5707C SD_FLOAT32_IEEE 0 SC_EGR_VPD_LMN -1 1 /end CHARACTERISTIC
/begin COMPU_METHOD SC_EGR_VPD_LMN "EGR_VPD_LMN conversion" RAT_FUNC "%10.5" "unitless" COEFFS 0 1 0 0 0 1 /end COMPU_METHOD
/begin CHARACTERISTIC EGR_VPD_LMX "Max egr_flw_err for enable egr_i_vpd" VALUE 0x57078 SD_FLOAT32_IEEE 0 SC_EGR_VPD_LMX 0 1 /end CHARACTERISTIC
/begin COMPU_METHOD SC_EGR_VPD_LMX "EGR_VPD_LMX conversion" RAT_FUNC "%10.5" "unitless" COEFFS 0 1 0 0 0 1 /end COMPU_METHOD
/begin MEASUREMENT ENC_CHKSUM "Four byte Encrypted Checksum for Mode 9" ULONG MC_ENC_CHKSUM 0 0 0 0 ECU_ADDRESS 0x3FAC20 /end MEASUREMENT
/begin COMPU_METHOD MC_ENC_CHKSUM "ENC_CHKSUM conversion" RAT_FUNC "%10.0" "Unitless" COEFFS 0 1 0 0 0 1 /end COMPU_METHOD
/begin MEASUREMENT ENGINE_SPEED "Engine speed (RPM)." FLOAT32_IEEE MC_ENGINE_SPEED 0 0 0 0 ECU_ADDRESS 0x3FA134 /end MEASUREMENT
/begin COMPU_METHOD MC_ENGINE_SPEED "ENGINE_SPEED conversion" RAT_FUNC "%10.5" "Unitless" COEFFS 0 1 0 0 0 1 /end COMPU_METHOD
/begin CHARACTERISTIC ENG_CONFIG_1 "Calibration of Engine Cylinders and Valves for SCP. CAl as (NUMCYL * 8) + (Number of Valves per cyl)" VALUE 0x57719 SD_UBYTE 0 SC_ENG_CONFIG_1 0 255 /end CHARACTERISTIC
/begin COMPU_METHOD SC_ENG_CONFIG_1 "ENG_CONFIG_1 conversion" RAT_FUNC "%3.0" "UNITLESS" COEFFS 0 1 0 0 0 1 /end COMPU_METHOD
/begin CHARACTERISTIC ENG_CONFIG_2 "Calibration of Air induction and Fuel Type/Delivery for SCP.  Cal as (Ref SCP_MSG_CONTROL module)." VALUE 0x57718 SD_UBYTE 0 SC_ENG_CONFIG_2 0 255 /end CHARACTERISTIC
/begin COMPU_METHOD SC_ENG_CONFIG_2 "ENG_CONFIG_2 conversion" RAT_FUNC "%3.0" "UNITLESS" COEFFS 0 1 0 0 0 1 /end COMPU_METHOD
/begin MEASUREMENT ENG_OFF_HRES "High Res engine off time.  From H/W timer." FLOAT32_IEEE MC_ENG_OFF_HRES 0 0 0 0 ECU_ADDRESS 0x3FAC00 /end MEASUREMENT
/begin COMPU_METHOD MC_ENG_OFF_HRES "ENG_OFF_HRES conversion" RAT_FUNC "%10.5" "Unitless" COEFFS 0 1 0 0 0 1 /end COMPU_METHOD
/begin CHARACTERISTIC ENG_OFF_OVRD "Flag  override of engine off timer calculation" VALUE 0x57944 SD_UBYTE 0 SC_ENG_OFF_OVRD 0 1 /end CHARACTERISTIC
/begin COMPU_METHOD SC_ENG_OFF_OVRD "ENG_OFF_OVRD conversion" RAT_FUNC "%3.0" "unitless" COEFFS 0 1 0 0 0 1 /end COMPU_METHOD
/begin MEASUREMENT ENG_OFF_TMR "Elapsed time of the most recent EEC module key-off powered-down period." FLOAT32_IEEE MC_ENG_OFF_TMR 0 0 0 0 ECU_ADDRESS 0x3FAC04 /end MEASUREMENT
/begin COMPU_METHOD MC_ENG_OFF_TMR "ENG_OFF_TMR conversion" RAT_FUNC "%10.5" "Unitless" COEFFS 0 1 0 0 0 1 /end COMPU_METHOD
/begin CHARACTERISTIC ENG_OFF_VAL "" VALUE 0x57940 SD_FLOAT32_IEEE 0 SC_ENG_OFF_VAL 0 40320 /end CHARACTERISTIC
/begin COMPU_METHOD SC_ENG_OFF_VAL "ENG_OFF_VAL conversion" RAT_FUNC "%10.5" "min" COEFFS 0 1 0 0 0 1 /end COMPU_METHOD
/begin MEASUREMENT ENG_STALLED "Flag set to one when the engine has stalled (TSLPIP > TSTALL, 800 msec)." UBYTE MC_ENG_STALLED 0 0 0 0 ECU_ADDRESS 0x3FA3DE /end MEASUREMENT
/begin COMPU_METHOD MC_ENG_STALLED "ENG_STALLED conversion" RAT_FUNC "%3.0" "Unitless" COEFFS 0 1 0 0 0 1 /end COMPU_METHOD
/begin CHARACTERISTIC EOT_AD_TC "Engine oil temperature filter time constant" VALUE 0x56498 SD_FLOAT32_IEEE 0 SC_EOT_AD_TC 0 64 /end CHARACTERISTIC
/begin COMPU_METHOD SC_EOT_AD_TC "EOT_AD_TC conversion" RAT_FUNC "%10.5" "s" COEFFS 0 1 0 0 0 1 /end COMPU_METHOD
/begin MEASUREMENT EOT_C "Engine oil temperature. (DEGREES C)" FLOAT32_IEEE MC_EOT_C 0 0 0 0 ECU_ADDRESS 0x3F9F94 /end MEASUREMENT
/begin COMPU_METHOD MC_EOT_C "EOT_C conversion" RAT_FUNC "%10.5" "Unitless" COEFFS 0 1 0 0 0 1 /end COMPU_METHOD
/begin MEASUREMENT EOT_CNTS "Engine Oil Temperature A/D input." SLONG MC_EOT_CNTS 0 0 0 0 ECU_ADDRESS 0x3FA9D4 /end MEASUREMENT
/begin COMPU_METHOD MC_EOT_CNTS "EOT_CNTS conversion" RAT_FUNC "%10.0" "Unitless" COEFFS 0 1 0 0 0 1 /end COMPU_METHOD
/begin MEASUREMENT EOT_COLD_CNT "threshold monitor cold counter" SLONG MC_EOT_COLD_CNT 0 0 0 0 ECU_ADDRESS 0x3F9F70 /end MEASUREMENT
/begin COMPU_METHOD MC_EOT_COLD_CNT "EOT_COLD_CNT conversion" RAT_FUNC "%10.0" "Unitless" COEFFS 0 1 0 0 0 1 /end COMPU_METHOD
/begin CHARACTERISTIC EOT_COLD_CNT_LM "threshold mnitor cold count limit" VALUE 0x5647C SD_SLONG 0 SC_EOT_COLD_CNT_LM 0 65535 /end CHARACTERISTIC
/begin COMPU_METHOD SC_EOT_COLD_CNT_LM "EOT_COLD_CNT_LM conversion" RAT_FUNC "%10.0" "unitless" COEFFS 0 1 0 0 0 1 /end COMPU_METHOD
/begin CHARACTERISTIC EOT_COLD_DEF "Default value for Engine Oil Temperature" VALUE 0x564D4 SD_FLOAT32_IEEE 0 SC_EOT_COLD_DEF -40 50 /end CHARACTERISTIC
/begin COMPU_METHOD SC_EOT_COLD_DEF "EOT_COLD_DEF conversion" RAT_FUNC "%10.5" "degC" COEFFS 0 1 0 0 0 1 /end COMPU_METHOD
/begin CHARACTERISTIC EOT_COLD_LMN "threshold monitor cold temperature limit" VALUE 0x56478 SD_FLOAT32_IEEE 0 SC_EOT_COLD_LMN -8192 8191 /end CHARACTERISTIC
/begin COMPU_METHOD SC_EOT_COLD_LMN "EOT_COLD_LMN conversion" RAT_FUNC "%10.5" "degC" COEFFS 0 1 0 0 0 1 /end COMPU_METHOD
/begin CHARACTERISTIC EOT_COLD_MFDES "cold desired mass fuel threshold value" VALUE 0x56480 SD_FLOAT32_IEEE 0 SC_EOT_COLD_MFDES -2048 2047.94 /end CHARACTERISTIC
/begin COMPU_METHOD SC_EOT_COLD_MFDES "EOT_COLD_MFDES conversion" RAT_FUNC "%10.5" "g/s" COEFFS 0 1 0 0 0 1 /end COMPU_METHOD
/begin CHARACTERISTIC EOT_COLD_N "cold engine speed threshold value" VALUE 0x56484 SD_FLOAT32_IEEE 0 SC_EOT_COLD_N 0 16383.8 /end CHARACTERISTIC
/begin COMPU_METHOD SC_EOT_COLD_N "EOT_COLD_N conversion" RAT_FUNC "%10.5" "RPM" COEFFS 0 1 0 0 0 1 /end COMPU_METHOD
/begin MEASUREMENT EOT_C_THLD "eot threshold flag" UBYTE MC_EOT_C_THLD 0 0 0 0 ECU_ADDRESS 0x3F9F9C /end MEASUREMENT
/begin COMPU_METHOD MC_EOT_C_THLD "EOT_C_THLD conversion" RAT_FUNC "%3.0" "Unitless" COEFFS 0 1 0 0 0 1 /end COMPU_METHOD
/begin MEASUREMENT EOT_ENG_C "Engine Oil Temperature without FMEM substitutions, degree C" FLOAT32_IEEE MC_EOT_ENG_C 0 0 0 0 ECU_ADDRESS 0x3FA9CC /end MEASUREMENT
/begin COMPU_METHOD MC_EOT_ENG_C "EOT_ENG_C conversion" RAT_FUNC "%10.5" "Unitless" COEFFS 0 1 0 0 0 1 /end COMPU_METHOD
/begin MEASUREMENT EOT_FILT_TIME_CONST "eot filter time constant" FLOAT32_IEEE MC_EOT_FILT_TIME_CONST 0 0 0 0 ECU_ADDRESS 0x3F9F8C /end MEASUREMENT
/begin COMPU_METHOD MC_EOT_FILT_TIME_CONST "EOT_FILT_TIME_CONST conversion" RAT_FUNC "%10.5" "Unitless" COEFFS 0 1 0 0 0 1 /end COMPU_METHOD
/begin MEASUREMENT EOT_FLT_RECOVERY_CNTR "eot fault recovery counter" SLONG MC_EOT_FLT_RECOVERY_CNTR 0 0 0 0 ECU_ADDRESS 0x3F9F78 /end MEASUREMENT
/begin COMPU_METHOD MC_EOT_FLT_RECOVERY_CNTR "EOT_FLT_RECOVERY_CNTR conversion" RAT_FUNC "%10.0" "Unitless" COEFFS 0 1 0 0 0 1 /end COMPU_METHOD
/begin MEASUREMENT EOT_FLT_RECOVERY_FLG "eot fault recovery flag" UBYTE MC_EOT_FLT_RECOVERY_FLG 0 0 0 0 ECU_ADDRESS 0x3F9F9D /end MEASUREMENT
/begin COMPU_METHOD MC_EOT_FLT_RECOVERY_FLG "EOT_FLT_RECOVERY_FLG conversion" RAT_FUNC "%3.0" "Unitless" COEFFS 0 1 0 0 0 1 /end COMPU_METHOD
/begin MEASUREMENT EOT_FMFLG "Engine oil temperature failure mode flag, set to one if EOT_HP is zero." UBYTE MC_EOT_FMFLG 0 0 0 0 ECU_ADDRESS 0x3F9FA6 /end MEASUREMENT
/begin COMPU_METHOD MC_EOT_FMFLG "EOT_FMFLG conversion" RAT_FUNC "%3.0" "Unitless" COEFFS 0 1 0 0 0 1 /end COMPU_METHOD
/begin CHARACTERISTIC EOT_F_DEC "EOT ORH/ORL failure counter decrement value" VALUE 0x564D8 SD_SLONG 0 SC_EOT_F_DEC 0 65535 /end CHARACTERISTIC
/begin COMPU_METHOD SC_EOT_F_DEC "EOT_F_DEC conversion" RAT_FUNC "%10.0" "unitless" COEFFS 0 1 0 0 0 1 /end COMPU_METHOD
/begin CHARACTERISTIC EOT_F_INC "EOT ORH/ORL failure counter increment value" VALUE 0x564DC SD_SLONG 0 SC_EOT_F_INC 0 65535 /end CHARACTERISTIC
/begin COMPU_METHOD SC_EOT_F_INC "EOT_F_INC conversion" RAT_FUNC "%10.0" "unitless" COEFFS 0 1 0 0 0 1 /end COMPU_METHOD
/begin MEASUREMENT EOT_F_ORH "Engine Oil Temperature out of range high fail" UBYTE MC_EOT_F_ORH 0 0 0 0 ECU_ADDRESS 0x3F9FA3 /end MEASUREMENT
/begin COMPU_METHOD MC_EOT_F_ORH "EOT_F_ORH conversion" RAT_FUNC "%3.0" "Unitless" COEFFS 0 1 0 0 0 1 /end COMPU_METHOD
/begin MEASUREMENT EOT_F_ORL "Engine Oil Temperature out of range low fail" UBYTE MC_EOT_F_ORL 0 0 0 0 ECU_ADDRESS 0x3F9FA2 /end MEASUREMENT
/begin COMPU_METHOD MC_EOT_F_ORL "EOT_F_ORL conversion" RAT_FUNC "%3.0" "Unitless" COEFFS 0 1 0 0 0 1 /end COMPU_METHOD
/begin CHARACTERISTIC EOT_HI_VOLTS "Maximum acceptable voltage for EOT sensor" VALUE 0x573A0 SD_FLOAT32_IEEE 0 SC_EOT_HI_VOLTS 0 5 /end CHARACTERISTIC
/begin COMPU_METHOD SC_EOT_HI_VOLTS "EOT_HI_VOLTS conversion" RAT_FUNC "%10.5" "V" COEFFS 0 1 0 0 0 1 /end COMPU_METHOD
/begin MEASUREMENT EOT_HOT_CNT "threshold monitor hot counter" SLONG MC_EOT_HOT_CNT 0 0 0 0 ECU_ADDRESS 0x3F9F74 /end MEASUREMENT
/begin COMPU_METHOD MC_EOT_HOT_CNT "EOT_HOT_CNT conversion" RAT_FUNC "%10.0" "Unitless" COEFFS 0 1 0 0 0 1 /end COMPU_METHOD
/begin CHARACTERISTIC EOT_HOT_CNT_LM "threshold monitor hot count limit" VALUE 0x56474 SD_SLONG 0 SC_EOT_HOT_CNT_LM 0 65535 /end CHARACTERISTIC
/begin COMPU_METHOD SC_EOT_HOT_CNT_LM "EOT_HOT_CNT_LM conversion" RAT_FUNC "%10.0" "unitless" COEFFS 0 1 0 0 0 1 /end COMPU_METHOD
/begin CHARACTERISTIC EOT_HOT_LMN "threshold monitr hot count limit" VALUE 0x56470 SD_FLOAT32_IEEE 0 SC_EOT_HOT_LMN -8192 8191 /end CHARACTERISTIC
/begin COMPU_METHOD SC_EOT_HOT_LMN "EOT_HOT_LMN conversion" RAT_FUNC "%10.5" "degC" COEFFS 0 1 0 0 0 1 /end COMPU_METHOD
/begin CHARACTERISTIC EOT_HOT_MFDES "hot, desired massfuel  threshold value" VALUE 0x56488 SD_FLOAT32_IEEE 0 SC_EOT_HOT_MFDES -2048 2047.94 /end CHARACTERISTIC
/begin COMPU_METHOD SC_EOT_HOT_MFDES "EOT_HOT_MFDES conversion" RAT_FUNC "%10.5" "g/s" COEFFS 0 1 0 0 0 1 /end COMPU_METHOD
/begin CHARACTERISTIC EOT_HOT_N "hot engine speed threshold value" VALUE 0x5648C SD_FLOAT32_IEEE 0 SC_EOT_HOT_N 0 16383.8 /end CHARACTERISTIC
/begin COMPU_METHOD SC_EOT_HOT_N "EOT_HOT_N conversion" RAT_FUNC "%10.5" "RPM" COEFFS 0 1 0 0 0 1 /end COMPU_METHOD
/begin CHARACTERISTIC EOT_KICK_MAX "Maximum EOT allowed for cold idle kicker" VALUE 0x56858 SD_FLOAT32_IEEE 0 SC_EOT_KICK_MAX -40 150 /end CHARACTERISTIC
/begin COMPU_METHOD SC_EOT_KICK_MAX "EOT_KICK_MAX conversion" RAT_FUNC "%10.5" "degC" COEFFS 0 1 0 0 0 1 /end COMPU_METHOD
/begin CHARACTERISTIC EOT_LO_VOLTS "Minimum acceptable voltage for EOT sensor" VALUE 0x5739C SD_FLOAT32_IEEE 0 SC_EOT_LO_VOLTS 0 5 /end CHARACTERISTIC
/begin COMPU_METHOD SC_EOT_LO_VOLTS "EOT_LO_VOLTS conversion" RAT_FUNC "%10.5" "V" COEFFS 0 1 0 0 0 1 /end COMPU_METHOD
/begin MEASUREMENT EOT_MALF_SET "indicate eot malf high or low failure" UBYTE MC_EOT_MALF_SET 0 0 0 0 ECU_ADDRESS 0x3F9F9F /end MEASUREMENT
/begin COMPU_METHOD MC_EOT_MALF_SET "EOT_MALF_SET conversion" RAT_FUNC "%3.0" "Unitless" COEFFS 0 1 0 0 0 1 /end COMPU_METHOD
/begin MEASUREMENT EOT_ORH_CNTR "Engine Oil Temp out of range high counter" SLONG MC_EOT_ORH_CNTR 0 0 0 0 ECU_ADDRESS 0x3F9F88 /end MEASUREMENT
/begin COMPU_METHOD MC_EOT_ORH_CNTR "EOT_ORH_CNTR conversion" RAT_FUNC "%10.0" "Unitless" COEFFS 0 1 0 0 0 1 /end COMPU_METHOD
/begin MEASUREMENT EOT_ORL_CNTR "Engine Oil Temp out of range low counter" SLONG MC_EOT_ORL_CNTR 0 0 0 0 ECU_ADDRESS 0x3F9F84 /end MEASUREMENT
/begin COMPU_METHOD MC_EOT_ORL_CNTR "EOT_ORL_CNTR conversion" RAT_FUNC "%10.0" "Unitless" COEFFS 0 1 0 0 0 1 /end COMPU_METHOD
/begin CHARACTERISTIC EOT_REC_INC "EOT recovery counter increment value" VALUE 0x56494 SD_SLONG 0 SC_EOT_REC_INC 0 65535 /end CHARACTERISTIC
/begin COMPU_METHOD SC_EOT_REC_INC "EOT_REC_INC conversion" RAT_FUNC "%10.0" "unitless" COEFFS 0 1 0 0 0 1 /end COMPU_METHOD
/begin MEASUREMENT EOT_STATUS "Status of Engine Oil Temperature sensor,  0 = no error" UBYTE MC_EOT_STATUS 0 0 0 0 ECU_ADDRESS 0x3FA9D8 /end MEASUREMENT
/begin COMPU_METHOD MC_EOT_STATUS "EOT_STATUS conversion" RAT_FUNC "%3.0" "Unitless" COEFFS 0 1 0 0 0 1 /end COMPU_METHOD
/begin CHARACTERISTIC EOT_TCREC_SEL "switch to select EOT filter constant" VALUE 0x564A0 SD_UBYTE 0 SC_EOT_TCREC_SEL 0 1 /end CHARACTERISTIC
/begin COMPU_METHOD SC_EOT_TCREC_SEL "EOT_TCREC_SEL conversion" RAT_FUNC "%3.0" "unitless" COEFFS 0 1 0 0 0 1 /end COMPU_METHOD
/begin MEASUREMENT EOT_THLD_TMR "threshold monitor timer counter" FLOAT32_IEEE MC_EOT_THLD_TMR 0 0 0 0 ECU_ADDRESS 0x3F9F68 /end MEASUREMENT
/begin COMPU_METHOD MC_EOT_THLD_TMR "EOT_THLD_TMR conversion" RAT_FUNC "%10.5" "Unitless" COEFFS 0 1 0 0 0 1 /end COMPU_METHOD
/begin MEASUREMENT EOT_THLD_TST_TM "threshold monitor counter limit" FLOAT32_IEEE MC_EOT_THLD_TST_TM 0 0 0 0 ECU_ADDRESS 0x3F9F64 /end MEASUREMENT
/begin COMPU_METHOD MC_EOT_THLD_TST_TM "EOT_THLD_TST_TM conversion" RAT_FUNC "%10.5" "Unitless" COEFFS 0 1 0 0 0 1 /end COMPU_METHOD
/begin MEASUREMENT EOT_UPDOWN_CNTR "eot updown counter" SLONG MC_EOT_UPDOWN_CNTR 0 0 0 0 ECU_ADDRESS 0x3F9F6C /end MEASUREMENT
/begin COMPU_METHOD MC_EOT_UPDOWN_CNTR "EOT_UPDOWN_CNTR conversion" RAT_FUNC "%10.0" "Unitless" COEFFS 0 1 0 0 0 1 /end COMPU_METHOD
/begin MEASUREMENT EOT_VLTS "Engine Oil Temperature sensor voltage" FLOAT32_IEEE MC_EOT_VLTS 0 0 0 0 ECU_ADDRESS 0x3FA9D0 /end MEASUREMENT
/begin COMPU_METHOD MC_EOT_VLTS "EOT_VLTS conversion" RAT_FUNC "%10.5" "Unitless" COEFFS 0 1 0 0 0 1 /end COMPU_METHOD
/begin CHARACTERISTIC EOT_WARM_DEF "Default FMEM value for warm engine oil temp" VALUE 0x5649C SD_FLOAT32_IEEE 0 SC_EOT_WARM_DEF 60 150 /end CHARACTERISTIC
/begin COMPU_METHOD SC_EOT_WARM_DEF "EOT_WARM_DEF conversion" RAT_FUNC "%10.5" "degC" COEFFS 0 1 0 0 0 1 /end COMPU_METHOD
/begin MEASUREMENT EO_ACTIVE "Flag set when engine off on demand test is active" UBYTE MC_EO_ACTIVE 0 0 0 0 ECU_ADDRESS 0x3FAB9E /end MEASUREMENT
/begin COMPU_METHOD MC_EO_ACTIVE "EO_ACTIVE conversion" RAT_FUNC "%3.0" "Unitless" COEFFS 0 1 0 0 0 1 /end COMPU_METHOD
/begin CHARACTERISTIC EO_CCM_DLY "Delay time for CCM and OSM off state during engine off on demand test" VALUE 0x5784C SD_FLOAT32_IEEE 0 SC_EO_CCM_DLY 0 31 /end CHARACTERISTIC
/begin COMPU_METHOD SC_EO_CCM_DLY "EO_CCM_DLY conversion" RAT_FUNC "%10.5" "s" COEFFS 0 1 0 0 0 1 /end COMPU_METHOD
/begin CHARACTERISTIC EO_DONE "Value of EO_STATUS when engine off on demand t est is complete" VALUE 0x57850 SD_UBYTE 0 SC_EO_DONE 0 100 /end CHARACTERISTIC
/begin COMPU_METHOD SC_EO_DONE "EO_DONE conversion" RAT_FUNC "%3.0" "unitless" COEFFS 0 1 0 0 0 1 /end COMPU_METHOD
/begin CHARACTERISTIC EO_INACTIVE "Value of ER_STATUS when engine off pn demand test is complete" VALUE 0x57857 SD_UBYTE 0 SC_EO_INACTIVE 0 100 /end CHARACTERISTIC
/begin COMPU_METHOD SC_EO_INACTIVE "EO_INACTIVE conversion" RAT_FUNC "%3.0" "unitless" COEFFS 0 1 0 0 0 1 /end COMPU_METHOD
/begin MEASUREMENT EO_MON "Flag indicating the engine off on-demand test is complete." UBYTE MC_EO_MON 0 0 0 0 ECU_ADDRESS 0x3FAB9D /end MEASUREMENT
/begin COMPU_METHOD MC_EO_MON "EO_MON conversion" RAT_FUNC "%3.0" "Unitless" COEFFS 0 1 0 0 0 1 /end COMPU_METHOD
/begin CHARACTERISTIC EO_OSM_DLY "Delay time for OSM on state during engine off on demand test" VALUE 0x57848 SD_FLOAT32_IEEE 0 SC_EO_OSM_DLY 0 31 /end CHARACTERISTIC
/begin COMPU_METHOD SC_EO_OSM_DLY "EO_OSM_DLY conversion" RAT_FUNC "%10.5" "s" COEFFS 0 1 0 0 0 1 /end COMPU_METHOD
/begin MEASUREMENT EO_STATUS "State pointer that indicates current state of engine off on demand test sequence" UBYTE MC_EO_STATUS 0 0 0 0 ECU_ADDRESS 0x3FAB9F /end MEASUREMENT
/begin COMPU_METHOD MC_EO_STATUS "EO_STATUS conversion" RAT_FUNC "%3.0" "Unitless" COEFFS 0 1 0 0 0 1 /end COMPU_METHOD
/begin MEASUREMENT EO_TST_ENA "Flag to activate engine off on demand test" UBYTE MC_EO_TST_ENA 0 0 0 0 ECU_ADDRESS 0x3F9EEF /end MEASUREMENT
/begin COMPU_METHOD MC_EO_TST_ENA "EO_TST_ENA conversion" RAT_FUNC "%3.0" "Unitless" COEFFS 0 1 0 0 0 1 /end COMPU_METHOD
/begin MEASUREMENT EO_TST_RDY "Flag that signals OBD-II executive that the engine off test is able to run" UBYTE MC_EO_TST_RDY 0 0 0 0 ECU_ADDRESS 0x3FAB9C /end MEASUREMENT
/begin COMPU_METHOD MC_EO_TST_RDY "EO_TST_RDY conversion" RAT_FUNC "%3.0" "Unitless" COEFFS 0 1 0 0 0 1 /end COMPU_METHOD
/begin MEASUREMENT EPOS_STATUS "Status of Cylinder Position high level driver ( 0 = ok )" UBYTE MC_EPOS_STATUS 0 0 0 0 ECU_ADDRESS 0x3FA999 /end MEASUREMENT
/begin COMPU_METHOD MC_EPOS_STATUS "EPOS_STATUS conversion" RAT_FUNC "%3.0" "Unitless" COEFFS 0 1 0 0 0 1 /end COMPU_METHOD
/begin MEASUREMENT ER_ACTIVE "flag set when engine running on demand test is active" UBYTE MC_ER_ACTIVE 0 0 0 0 ECU_ADDRESS 0x3FAB96 /end MEASUREMENT
/begin COMPU_METHOD MC_ER_ACTIVE "ER_ACTIVE conversion" RAT_FUNC "%3.0" "Unitless" COEFFS 0 1 0 0 0 1 /end COMPU_METHOD
/begin CHARACTERISTIC ER_CLEANUP "Value of ER_STATUS when ""cleanup"" portion of engine running test is in progress" VALUE 0x5782A SD_UBYTE 0 SC_ER_CLEANUP 0 100 /end CHARACTERISTIC
/begin COMPU_METHOD SC_ER_CLEANUP "ER_CLEANUP conversion" RAT_FUNC "%3.0" "unitless" COEFFS 0 1 0 0 0 1 /end COMPU_METHOD
/begin MEASUREMENT ER_CONDTS "Conditions necessary to run KOER test, 1 = conditions not met" UBYTE MC_ER_CONDTS 0 0 0 0 ECU_ADDRESS 0x3FAB95 /end MEASUREMENT
/begin COMPU_METHOD MC_ER_CONDTS "ER_CONDTS conversion" RAT_FUNC "%3.0" "Unitless" COEFFS 0 1 0 0 0 1 /end COMPU_METHOD
/begin CHARACTERISTIC ER_DONE "Value of ER_STATUS when engine running test is complete" VALUE 0x57829 SD_UBYTE 0 SC_ER_DONE 0 100 /end CHARACTERISTIC
/begin COMPU_METHOD SC_ER_DONE "ER_DONE conversion" RAT_FUNC "%3.0" "unitless" COEFFS 0 1 0 0 0 1 /end COMPU_METHOD
/begin MEASUREMENT ER_FUL_REQ "Flag to signal fuel system to set lambse to KOER_LQM_DSD" UBYTE MC_ER_FUL_REQ 0 0 0 0 ECU_ADDRESS 0x3FAB94 /end MEASUREMENT
/begin COMPU_METHOD MC_ER_FUL_REQ "ER_FUL_REQ conversion" RAT_FUNC "%3.0" "Unitless" COEFFS 0 1 0 0 0 1 /end COMPU_METHOD
/begin CHARACTERISTIC ER_HI_RPM "Base value for RPM requested during engine running on demand test" VALUE 0x57808 SD_FLOAT32_IEEE 0 SC_ER_HI_RPM 0 2040 /end CHARACTERISTIC
/begin COMPU_METHOD SC_ER_HI_RPM "ER_HI_RPM conversion" RAT_FUNC "%10.5" "RPM" COEFFS 0 1 0 0 0 1 /end COMPU_METHOD
/begin CHARACTERISTIC ER_INACTIVE "VAlue for state ER_STATUS when engine runnint test is not active." VALUE 0x57839 SD_UBYTE 0 SC_ER_INACTIVE 0 100 /end CHARACTERISTIC
/begin COMPU_METHOD SC_ER_INACTIVE "ER_INACTIVE conversion" RAT_FUNC "%3.0" "unitless" COEFFS 0 1 0 0 0 1 /end COMPU_METHOD
/begin CHARACTERISTIC ER_INIT "Value for state of ER_STATUS when engine running test first inits." VALUE 0x57838 SD_UBYTE 0 SC_ER_INIT 0 100 /end CHARACTERISTIC
/begin COMPU_METHOD SC_ER_INIT "ER_INIT conversion" RAT_FUNC "%3.0" "unitless" COEFFS 0 1 0 0 0 1 /end COMPU_METHOD
/begin MEASUREMENT ER_ISC_HLD "Flag to signal Idle Speed Control to hold ISC solenoid at current duty cycle." UBYTE MC_ER_ISC_HLD 0 0 0 0 ECU_ADDRESS 0x3FAB93 /end MEASUREMENT
/begin COMPU_METHOD MC_ER_ISC_HLD "ER_ISC_HLD conversion" RAT_FUNC "%3.0" "Unitless" COEFFS 0 1 0 0 0 1 /end COMPU_METHOD
/begin MEASUREMENT ER_ISC_REQ "Flag to request ER_RPM from ISC system" UBYTE MC_ER_ISC_REQ 0 0 0 0 ECU_ADDRESS 0x3FAB92 /end MEASUREMENT
/begin COMPU_METHOD MC_ER_ISC_REQ "ER_ISC_REQ conversion" RAT_FUNC "%3.0" "Unitless" COEFFS 0 1 0 0 0 1 /end COMPU_METHOD
/begin CHARACTERISTIC ER_LAM_BAS "Base value for LAMBSE requested during engine running on demand test" VALUE 0x57820 SD_FLOAT32_IEEE 0 SC_ER_LAM_BAS 0 1.9 /end CHARACTERISTIC
/begin COMPU_METHOD SC_ER_LAM_BAS "ER_LAM_BAS conversion" RAT_FUNC "%10.5" "LAMBDA" COEFFS 0 1 0 0 0 1 /end COMPU_METHOD
/begin MEASUREMENT ER_LAM_DSD[0] "LAMBSE value requesetd by engine running on demand self test." FLOAT32_IEEE MC_ER_LAM_DSD 0 0 0 1.9 ECU_ADDRESS 0x3FAB7C /end MEASUREMENT
/begin COMPU_METHOD MC_ER_LAM_DSD "ER_LAM_DSD conversion" RAT_FUNC "%10.5" "LAMBDA" COEFFS 0 1 0 0 0 1 /end COMPU_METHOD
/begin MEASUREMENT ER_LAM_DSD[1] "LAMBSE value requesetd by engine running on demand self test." FLOAT32_IEEE MC_ER_LAM_DSD 0 0 0 1.9 ECU_ADDRESS 0x3FAB80 /end MEASUREMENT
/begin MEASUREMENT ER_MON "Flag indicating the engine running on demand test is complete." UBYTE MC_ER_MON 0 0 0 0 ECU_ADDRESS 0x3FAB91 /end MEASUREMENT
/begin COMPU_METHOD MC_ER_MON "ER_MON conversion" RAT_FUNC "%3.0" "Unitless" COEFFS 0 1 0 0 0 1 /end COMPU_METHOD
/begin MEASUREMENT ER_RPM "Register that contains RPM value requested during engine running self test" FLOAT32_IEEE MC_ER_RPM 0 0 0 0 ECU_ADDRESS 0x3FAB88 /end MEASUREMENT
/begin COMPU_METHOD MC_ER_RPM "ER_RPM conversion" RAT_FUNC "%10.5" "Unitless" COEFFS 0 1 0 0 0 1 /end COMPU_METHOD
/begin MEASUREMENT ER_SPARK "Required value of SAF during on demand self test." FLOAT32_IEEE MC_ER_SPARK 0 0 0 0 ECU_ADDRESS 0x3FAB84 /end MEASUREMENT
/begin COMPU_METHOD MC_ER_SPARK "ER_SPARK conversion" RAT_FUNC "%10.5" "Unitless" COEFFS 0 1 0 0 0 1 /end COMPU_METHOD
/begin CHARACTERISTIC ER_SPARK_BAS "BAse value for Spark advance during engine running on demand tes" VALUE 0x57804 SD_FLOAT32_IEEE 0 SC_ER_SPARK_BAS 0 60 /end CHARACTERISTIC
/begin COMPU_METHOD SC_ER_SPARK_BAS "ER_SPARK_BAS conversion" RAT_FUNC "%10.5" "DEGREES" COEFFS 0 1 0 0 0 1 /end COMPU_METHOD
/begin MEASUREMENT ER_SPK_REQ "Flag to request ER_SPARK from spark strategy during engine running on demand test" UBYTE MC_ER_SPK_REQ 0 0 0 0 ECU_ADDRESS 0x3FAB90 /end MEASUREMENT
/begin COMPU_METHOD MC_ER_SPK_REQ "ER_SPK_REQ conversion" RAT_FUNC "%3.0" "Unitless" COEFFS 0 1 0 0 0 1 /end COMPU_METHOD
/begin MEASUREMENT ER_STATUS "State pointer that indicated current state of engine running on demand test" UBYTE MC_ER_STATUS 0 0 0 0 ECU_ADDRESS 0x3FAB97 /end MEASUREMENT
/begin COMPU_METHOD MC_ER_STATUS "ER_STATUS conversion" RAT_FUNC "%3.0" "Unitless" COEFFS 0 1 0 0 0 1 /end COMPU_METHOD
/begin MEASUREMENT ER_TST_ENA "Flag to signal engine running on demand test to run" UBYTE MC_ER_TST_ENA 0 0 0 0 ECU_ADDRESS 0x3F9EF0 /end MEASUREMENT
/begin COMPU_METHOD MC_ER_TST_ENA "ER_TST_ENA conversion" RAT_FUNC "%3.0" "Unitless" COEFFS 0 1 0 0 0 1 /end COMPU_METHOD
/begin MEASUREMENT ER_TST_RDY "Flag to signal OBD-II executive that the engine running on demand test is able to run" UBYTE MC_ER_TST_RDY 0 0 0 0 ECU_ADDRESS 0x3FAB8F /end MEASUREMENT
/begin COMPU_METHOD MC_ER_TST_RDY "ER_TST_RDY conversion" RAT_FUNC "%3.0" "Unitless" COEFFS 0 1 0 0 0 1 /end COMPU_METHOD
/begin MEASUREMENT ETC_PDL_FL1 "Closed  pedal mode flag." UBYTE MC_ETC_PDL_FL1 0 0 0 0 ECU_ADDRESS 0x3FA1BD /end MEASUREMENT
/begin COMPU_METHOD MC_ETC_PDL_FL1 "ETC_PDL_FL1 conversion" RAT_FUNC "%3.0" "Unitless" COEFFS 0 1 0 0 0 1 /end COMPU_METHOD
/begin MEASUREMENT ETC_PDL_FL2 "WOP  / pedal mode flag." UBYTE MC_ETC_PDL_FL2 0 0 0 0 ECU_ADDRESS 0x3FA1BC /end MEASUREMENT
/begin COMPU_METHOD MC_ETC_PDL_FL2 "ETC_PDL_FL2 conversion" RAT_FUNC "%3.0" "Unitless" COEFFS 0 1 0 0 0 1 /end COMPU_METHOD
/begin MEASUREMENT ETC_TP_REL "Closed in throttle bore TP_REL." FLOAT32_IEEE MC_ETC_TP_REL 0 0 0 0 ECU_ADDRESS 0x3FA130 /end MEASUREMENT
/begin COMPU_METHOD MC_ETC_TP_REL "ETC_TP_REL conversion" RAT_FUNC "%10.5" "Unitless" COEFFS 0 1 0 0 0 1 /end COMPU_METHOD
/begin CHARACTERISTIC ETKP2_SHADOW0_CAL_EN "" VALUE 0x57B55 SD_UBYTE 0 SC_ETKP2_SHADOW0_CAL_EN 0 1 /end CHARACTERISTIC
/begin COMPU_METHOD SC_ETKP2_SHADOW0_CAL_EN "ETKP2_SHADOW0_CAL_EN conversion" RAT_FUNC "%3.0" "unitless" COEFFS 0 1 0 0 0 1 /end COMPU_METHOD
/begin CHARACTERISTIC ETKP2_SHADOW1_CAL_EN "" VALUE 0x57B54 SD_UBYTE 0 SC_ETKP2_SHADOW1_CAL_EN 0 1 /end CHARACTERISTIC
/begin COMPU_METHOD SC_ETKP2_SHADOW1_CAL_EN "ETKP2_SHADOW1_CAL_EN conversion" RAT_FUNC "%3.0" "unitless" COEFFS 0 1 0 0 0 1 /end COMPU_METHOD
/begin CHARACTERISTIC ETKP2_SHADOW2_CAL_EN "" VALUE 0x57B53 SD_UBYTE 0 SC_ETKP2_SHADOW2_CAL_EN 0 1 /end CHARACTERISTIC
/begin COMPU_METHOD SC_ETKP2_SHADOW2_CAL_EN "ETKP2_SHADOW2_CAL_EN conversion" RAT_FUNC "%3.0" "unitless" COEFFS 0 1 0 0 0 1 /end COMPU_METHOD
/begin CHARACTERISTIC FCPPS "TIME CONSTANT FOR PEDAL FILTERING" VALUE 0x56768 SD_FLOAT32_IEEE 0 SC_FCPPS 0 5000 /end CHARACTERISTIC
/begin COMPU_METHOD SC_FCPPS "FCPPS conversion" RAT_FUNC "%10.5" "unitless" COEFFS 0 1 0 0 0 1 /end COMPU_METHOD
/begin MEASUREMENT FFG_ACT "OBDII system FMEM flag for ACT; 1 -> ACT is currently unreliable." UBYTE MC_FFG_ACT 0 0 0 0 ECU_ADDRESS 0x3FA15A /end MEASUREMENT
/begin COMPU_METHOD MC_FFG_ACT "FFG_ACT conversion" RAT_FUNC "%3.0" "Unitless" COEFFS 0 1 0 0 0 1 /end COMPU_METHOD
/begin MEASUREMENT FFG_CID "OBDII system FMEM flag for CID - 1 -> CID is not currently reliable." UBYTE MC_FFG_CID 0 0 0 0 ECU_ADDRESS 0x3FADC2 /end MEASUREMENT
/begin COMPU_METHOD MC_FFG_CID "FFG_CID conversion" RAT_FUNC "%3.0" "Unitless" COEFFS 0 1 0 0 0 1 /end COMPU_METHOD
/begin MEASUREMENT FFG_ECT "OBDII system FMEM flag for ECT; 1 -> ECT is currently unreliable." UBYTE MC_FFG_ECT 0 0 0 0 ECU_ADDRESS 0x3FA159 /end MEASUREMENT
/begin COMPU_METHOD MC_FFG_ECT "FFG_ECT conversion" RAT_FUNC "%3.0" "Unitless" COEFFS 0 1 0 0 0 1 /end COMPU_METHOD
/begin MEASUREMENT FFG_EGO[0][0] "" UBYTE MC_FFG_EGO 0 0 0 1 ECU_ADDRESS 0x3FADC8 /end MEASUREMENT
/begin COMPU_METHOD MC_FFG_EGO "FFG_EGO conversion" RAT_FUNC "%3.0" "Unitless" COEFFS 0 1 0 0 0 1 /end COMPU_METHOD
/begin MEASUREMENT FFG_EGO[0][1] "" UBYTE MC_FFG_EGO 0 0 0 1 ECU_ADDRESS 0x3FADC9 /end MEASUREMENT
/begin MEASUREMENT FFG_EGO[1][0] "" UBYTE MC_FFG_EGO 0 0 0 1 ECU_ADDRESS 0x3FADCA /end MEASUREMENT
/begin MEASUREMENT FFG_EGO[1][1] "" UBYTE MC_FFG_EGO 0 0 0 1 ECU_ADDRESS 0x3FADCB /end MEASUREMENT
/begin MEASUREMENT FFG_EGR "OBDII system FMEM flag for the EGR system - 1 -> EGR system not currently operationg reliably." UBYTE MC_FFG_EGR 0 0 0 0 ECU_ADDRESS 0x3FADC5 /end MEASUREMENT
/begin COMPU_METHOD MC_FFG_EGR "FFG_EGR conversion" RAT_FUNC "%3.0" "Unitless" COEFFS 0 1 0 0 0 1 /end COMPU_METHOD
/begin CHARACTERISTIC FFG_EGR_SW "Bybass egr fmem." VALUE 0x563A9 SD_UBYTE 0 SC_FFG_EGR_SW 0 1 /end CHARACTERISTIC
/begin COMPU_METHOD SC_FFG_EGR_SW "FFG_EGR_SW conversion" RAT_FUNC "%3.0" "unitless" COEFFS 0 1 0 0 0 1 /end COMPU_METHOD
/begin MEASUREMENT FFG_FRP "OBDII system FMEM flag for FRP" UBYTE MC_FFG_FRP 0 0 0 0 ECU_ADDRESS 0x3FADC0 /end MEASUREMENT
/begin COMPU_METHOD MC_FFG_FRP "FFG_FRP conversion" RAT_FUNC "%3.0" "Unitless" COEFFS 0 1 0 0 0 1 /end COMPU_METHOD
/begin MEASUREMENT FFG_LAMBSE1 "OBDII system FMEM flag for LAMBSE1 - 1 -> LAMBSE1 is not currently reliable." UBYTE MC_FFG_LAMBSE1 0 0 0 0 ECU_ADDRESS 0x3FADC4 /end MEASUREMENT
/begin COMPU_METHOD MC_FFG_LAMBSE1 "FFG_LAMBSE1 conversion" RAT_FUNC "%3.0" "Unitless" COEFFS 0 1 0 0 0 1 /end COMPU_METHOD
/begin MEASUREMENT FFG_LAMBSE2 "OBDII system FMEM flag for LAMBSE2 - 1 -> LAMBSE2 is not currently reliable." UBYTE MC_FFG_LAMBSE2 0 0 0 0 ECU_ADDRESS 0x3FADC3 /end MEASUREMENT
/begin COMPU_METHOD MC_FFG_LAMBSE2 "FFG_LAMBSE2 conversion" RAT_FUNC "%3.0" "Unitless" COEFFS 0 1 0 0 0 1 /end COMPU_METHOD
/begin MEASUREMENT FFG_MAF "OBD-II system FMEM flag for MAF" UBYTE MC_FFG_MAF 0 0 0 0 ECU_ADDRESS 0x3FADCA /end MEASUREMENT
/begin COMPU_METHOD MC_FFG_MAF "FFG_MAF conversion" RAT_FUNC "%3.0" "Unitless" COEFFS 0 1 0 0 0 1 /end COMPU_METHOD
/begin MEASUREMENT FFG_MAP "OBD-II system FMEM flag for MAP" UBYTE MC_FFG_MAP 0 0 0 0 ECU_ADDRESS 0x3FADCB /end MEASUREMENT
/begin COMPU_METHOD MC_FFG_MAP "FFG_MAP conversion" RAT_FUNC "%3.0" "Unitless" COEFFS 0 1 0 0 0 1 /end COMPU_METHOD
/begin CHARACTERISTIC FFG_MAP_SW "map sensor indicator: 0 = no map sensor; 1 = map sensor present." VALUE 0x563A8 SD_UBYTE 0 SC_FFG_MAP_SW 0 1 /end CHARACTERISTIC
/begin COMPU_METHOD SC_FFG_MAP_SW "FFG_MAP_SW conversion" RAT_FUNC "%3.0" "unitless" COEFFS 0 1 0 0 0 1 /end COMPU_METHOD
/begin MEASUREMENT FFG_MISFIRE "OBDII system FMEM flag for engine misfire - 1 -> currently misfiring." UBYTE MC_FFG_MISFIRE 0 0 0 0 ECU_ADDRESS 0x3FADC1 /end MEASUREMENT
/begin COMPU_METHOD MC_FFG_MISFIRE "FFG_MISFIRE conversion" RAT_FUNC "%3.0" "Unitless" COEFFS 0 1 0 0 0 1 /end COMPU_METHOD
/begin MEASUREMENT FFG_PIP "OBDII system FMEM flag for PIP - 1 -> PIP not currently reliable." UBYTE MC_FFG_PIP 0 0 0 0 ECU_ADDRESS 0x3FADC9 /end MEASUREMENT
/begin COMPU_METHOD MC_FFG_PIP "FFG_PIP conversion" RAT_FUNC "%3.0" "Unitless" COEFFS 0 1 0 0 0 1 /end COMPU_METHOD
/begin MEASUREMENT FFG_PURG "OBDII system FMEM flag for the purge system - 1 -> purge system is not under control reliably." UBYTE MC_FFG_PURG 0 0 0 0 ECU_ADDRESS 0x3FADC7 /end MEASUREMENT
/begin COMPU_METHOD MC_FFG_PURG "FFG_PURG conversion" RAT_FUNC "%3.0" "Unitless" COEFFS 0 1 0 0 0 1 /end COMPU_METHOD
/begin MEASUREMENT FFG_SAIR "OBDII system FMEM flag for the sair system - 1 -> sair sytem is not currently under control reliably" UBYTE MC_FFG_SAIR 0 0 0 0 ECU_ADDRESS 0x3FADC6 /end MEASUREMENT
/begin COMPU_METHOD MC_FFG_SAIR "FFG_SAIR conversion" RAT_FUNC "%3.0" "Unitless" COEFFS 0 1 0 0 0 1 /end COMPU_METHOD
/begin MEASUREMENT FFG_TP "OBDII system FMEM flag for TP - 1 -> TP is not currently reliable." UBYTE MC_FFG_TP 0 0 0 0 ECU_ADDRESS 0x3FADCD /end MEASUREMENT
/begin COMPU_METHOD MC_FFG_TP "FFG_TP conversion" RAT_FUNC "%3.0" "Unitless" COEFFS 0 1 0 0 0 1 /end COMPU_METHOD
/begin MEASUREMENT FFG_VS "OBDII system FMEM flag for VS - 1 -> VS is currently unreliable." UBYTE MC_FFG_VS 0 0 0 0 ECU_ADDRESS 0x3FADCC /end MEASUREMENT
/begin COMPU_METHOD MC_FFG_VS "FFG_VS conversion" RAT_FUNC "%3.0" "Unitless" COEFFS 0 1 0 0 0 1 /end COMPU_METHOD
/begin MEASUREMENT FF_CODE "Code number of fault for which freeze frame conditions are stored. freeze frame is loaded." UWORD MC_FF_CODE 0 0 0 0 ECU_ADDRESS 0x3FAEAE /end MEASUREMENT
/begin COMPU_METHOD MC_FF_CODE "FF_CODE conversion" RAT_FUNC "%5.0" "Unitless" COEFFS 0 1 0 0 0 1 /end COMPU_METHOD
/begin MEASUREMENT FF_ECT "Engine coolant temperature when fault occured." SWORD MC_FF_ECT 0 0 0 0 ECU_ADDRESS 0x3FAEAC /end MEASUREMENT
/begin COMPU_METHOD MC_FF_ECT "FF_ECT conversion" RAT_FUNC "%5.0" "Unitless" COEFFS 0 1 0 0 0 1 /end COMPU_METHOD
/begin MEASUREMENT FF_FUEL_MIS "Freeze frame FUEL or MISFIRE data stored flag. 1 -> freeze frame was stored due to FUEL or MISFIRE." UBYTE MC_FF_FUEL_MIS 0 0 0 0 ECU_ADDRESS 0x3FAEB2 /end MEASUREMENT
/begin COMPU_METHOD MC_FF_FUEL_MIS "FF_FUEL_MIS conversion" RAT_FUNC "%3.0" "Unitless" COEFFS 0 1 0 0 0 1 /end COMPU_METHOD
/begin MEASUREMENT FF_KAMREF[0] "Value of KAMRF1 (adaptive correction) at the time the freeze frame was stored." FLOAT32_IEEE MC_FF_KAMREF 0 0 0 255.996 ECU_ADDRESS 0x3FAE90 /end MEASUREMENT
/begin COMPU_METHOD MC_FF_KAMREF "FF_KAMREF conversion" RAT_FUNC "%10.5" "UNITLESS" COEFFS 0 1 0 0 0 1 /end COMPU_METHOD
/begin MEASUREMENT FF_KAMREF[1] "Value of KAMRF1 (adaptive correction) at the time the freeze frame was stored." FLOAT32_IEEE MC_FF_KAMREF 0 0 0 255.996 ECU_ADDRESS 0x3FAE94 /end MEASUREMENT
/begin MEASUREMENT FF_LAMBSE[0] "An array containing the values of LAMBSE (short term fuel trim) at the time the freeze frame was stored." FLOAT32_IEEE MC_FF_LAMBSE 0 0 0 1.9999 ECU_ADDRESS 0x3FAE98 /end MEASUREMENT
/begin COMPU_METHOD MC_FF_LAMBSE "FF_LAMBSE conversion" RAT_FUNC "%10.5" "UNITLESS" COEFFS 0 1 0 0 0 1 /end COMPU_METHOD
/begin MEASUREMENT FF_LAMBSE[1] "An array containing the values of LAMBSE (short term fuel trim) at the time the freeze frame was stored." FLOAT32_IEEE MC_FF_LAMBSE 0 0 0 1.9999 ECU_ADDRESS 0x3FAE9C /end MEASUREMENT
/begin MEASUREMENT FF_OL_DM "Value of OL_DESIRED at time freeze frame was stored." UBYTE MC_FF_OL_DM 0 0 0 0 ECU_ADDRESS 0x3FAEB5 /end MEASUREMENT
/begin COMPU_METHOD MC_FF_OL_DM "FF_OL_DM conversion" RAT_FUNC "%3.0" "Unitless" COEFFS 0 1 0 0 0 1 /end COMPU_METHOD
/begin MEASUREMENT FF_OL_FAULT "Flag, when set representing closed loop with EGO fault at time the freeze frame was stored." UBYTE MC_FF_OL_FAULT 0 0 0 0 ECU_ADDRESS 0x3FAEB3 /end MEASUREMENT
/begin COMPU_METHOD MC_FF_OL_FAULT "FF_OL_FAULT conversion" RAT_FUNC "%3.0" "Unitless" COEFFS 0 1 0 0 0 1 /end COMPU_METHOD
/begin MEASUREMENT FF_OL_FDBACK "Flag, when set representing closed loop fuel control when freeze frame was stored." UBYTE MC_FF_OL_FDBACK 0 0 0 0 ECU_ADDRESS 0x3FAEB6 /end MEASUREMENT
/begin COMPU_METHOD MC_FF_OL_FDBACK "FF_OL_FDBACK conversion" RAT_FUNC "%3.0" "Unitless" COEFFS 0 1 0 0 0 1 /end COMPU_METHOD
/begin MEASUREMENT FF_OL_FMEM "Value of OL_FMEM at time freeze frame was stored." UBYTE MC_FF_OL_FMEM 0 0 0 0 ECU_ADDRESS 0x3FAEB4 /end MEASUREMENT
/begin COMPU_METHOD MC_FF_OL_FMEM "FF_OL_FMEM conversion" RAT_FUNC "%3.0" "Unitless" COEFFS 0 1 0 0 0 1 /end COMPU_METHOD
/begin MEASUREMENT FF_OL_HOLD "Value of OL_HOLD when freeze frame was stored." UBYTE MC_FF_OL_HOLD 0 0 0 0 ECU_ADDRESS 0x3FAEB7 /end MEASUREMENT
/begin COMPU_METHOD MC_FF_OL_HOLD "FF_OL_HOLD conversion" RAT_FUNC "%3.0" "Unitless" COEFFS 0 1 0 0 0 1 /end COMPU_METHOD
/begin MEASUREMENT FF_RPM "Value of engine speed at the time the freeze frame was stored." FLOAT32_IEEE MC_FF_RPM 0 0 0 0 ECU_ADDRESS 0x3FAEA8 /end MEASUREMENT
/begin COMPU_METHOD MC_FF_RPM "FF_RPM conversion" RAT_FUNC "%10.5" "Unitless" COEFFS 0 1 0 0 0 1 /end COMPU_METHOD
/begin MEASUREMENT FILT_BP_KPA "Previous cycle BP" FLOAT32_IEEE MC_FILT_BP_KPA 0 0 0 0 ECU_ADDRESS 0x3FAEF4 /end MEASUREMENT
/begin COMPU_METHOD MC_FILT_BP_KPA "FILT_BP_KPA conversion" RAT_FUNC "%10.5" "Unitless" COEFFS 0 1 0 0 0 1 /end COMPU_METHOD
/begin CHARACTERISTIC FILT_EBP "previouse cycle filtered ebp value" VALUE 0x3FAF1C SD_FLOAT32_IEEE 0 SC_FILT_EBP -4096 4095.87 /end CHARACTERISTIC
/begin COMPU_METHOD SC_FILT_EBP "FILT_EBP conversion" RAT_FUNC "%10.5" "degC" COEFFS 0 1 0 0 0 1 /end COMPU_METHOD
/begin MEASUREMENT FILT_ECT_C "previous cycle eot value" FLOAT32_IEEE MC_FILT_ECT_C 0 0 0 0 ECU_ADDRESS 0x3FAEFC /end MEASUREMENT
/begin COMPU_METHOD MC_FILT_ECT_C "FILT_ECT_C conversion" RAT_FUNC "%10.5" "Unitless" COEFFS 0 1 0 0 0 1 /end COMPU_METHOD
/begin MEASUREMENT FILT_EGRP "Previous cycle EGRP" FLOAT32_IEEE MC_FILT_EGRP 0 0 0 0 ECU_ADDRESS 0x3FAF00 /end MEASUREMENT
/begin COMPU_METHOD MC_FILT_EGRP "FILT_EGRP conversion" RAT_FUNC "%10.5" "Unitless" COEFFS 0 1 0 0 0 1 /end COMPU_METHOD
/begin MEASUREMENT FILT_EOT_C "previous cycle eot value" FLOAT32_IEEE MC_FILT_EOT_C 0 0 0 0 ECU_ADDRESS 0x3FAEF8 /end MEASUREMENT
/begin COMPU_METHOD MC_FILT_EOT_C "FILT_EOT_C conversion" RAT_FUNC "%10.5" "Unitless" COEFFS 0 1 0 0 0 1 /end COMPU_METHOD
/begin MEASUREMENT FILT_IAT "Previous cycle intake air temperature" FLOAT32_IEEE MC_FILT_IAT 0 0 0 0 ECU_ADDRESS 0x3FAF18 /end MEASUREMENT
/begin COMPU_METHOD MC_FILT_IAT "FILT_IAT conversion" RAT_FUNC "%10.5" "Unitless" COEFFS 0 1 0 0 0 1 /end COMPU_METHOD
/begin MEASUREMENT FILT_ICP_MPA "previous cycle icp value" FLOAT32_IEEE MC_FILT_ICP_MPA 0 0 0 0 ECU_ADDRESS 0x3FAF04 /end MEASUREMENT
/begin COMPU_METHOD MC_FILT_ICP_MPA "FILT_ICP_MPA conversion" RAT_FUNC "%10.5" "Unitless" COEFFS 0 1 0 0 0 1 /end COMPU_METHOD
/begin MEASUREMENT FILT_ITHP "Previous cycle intake throttle position" FLOAT32_IEEE MC_FILT_ITHP 0 0 0 0 ECU_ADDRESS 0x3FAF20 /end MEASUREMENT
/begin COMPU_METHOD MC_FILT_ITHP "FILT_ITHP conversion" RAT_FUNC "%10.5" "Unitless" COEFFS 0 1 0 0 0 1 /end COMPU_METHOD
/begin MEASUREMENT FILT_IVPWR "Previous cycle System voltage" FLOAT32_IEEE MC_FILT_IVPWR 0 0 0 0 ECU_ADDRESS 0x3FAF24 /end MEASUREMENT
/begin COMPU_METHOD MC_FILT_IVPWR "FILT_IVPWR conversion" RAT_FUNC "%10.5" "Unitless" COEFFS 0 1 0 0 0 1 /end COMPU_METHOD
/begin MEASUREMENT FILT_MAF_GMS "Previous cycle MAF in gms" FLOAT32_IEEE MC_FILT_MAF_GMS 0 0 0 0 ECU_ADDRESS 0x3FAF0C /end MEASUREMENT
/begin COMPU_METHOD MC_FILT_MAF_GMS "FILT_MAF_GMS conversion" RAT_FUNC "%10.5" "Unitless" COEFFS 0 1 0 0 0 1 /end COMPU_METHOD
/begin MEASUREMENT FILT_MAP_KPA "Previous cycle filtered MAP value" FLOAT32_IEEE MC_FILT_MAP_KPA 0 0 0 0 ECU_ADDRESS 0x3FAF10 /end MEASUREMENT
/begin COMPU_METHOD MC_FILT_MAP_KPA "FILT_MAP_KPA conversion" RAT_FUNC "%10.5" "Unitless" COEFFS 0 1 0 0 0 1 /end COMPU_METHOD
/begin MEASUREMENT FILT_MAT "Previous cycle filtered MAT value" FLOAT32_IEEE MC_FILT_MAT 0 0 0 0 ECU_ADDRESS 0x3FAF14 /end MEASUREMENT
/begin COMPU_METHOD MC_FILT_MAT "FILT_MAT conversion" RAT_FUNC "%10.5" "Unitless" COEFFS 0 1 0 0 0 1 /end COMPU_METHOD
/begin MEASUREMENT FIRST_PIP "INDICATES THAT FIRST PIP HAS BEEN RECEIVED" UBYTE MC_FIRST_PIP 0 0 0 0 ECU_ADDRESS 0x3FADF0 /end MEASUREMENT
/begin COMPU_METHOD MC_FIRST_PIP "FIRST_PIP conversion" RAT_FUNC "%3.0" "Unitless" COEFFS 0 1 0 0 0 1 /end COMPU_METHOD
/begin CHARACTERISTIC FK_MFREF "Filter constant for MFREF term filtering Neutral/Drive transitions" VALUE 0x569A4 SD_FLOAT32_IEEE 0 SC_FK_MFREF 0 0.999985 /end CHARACTERISTIC
/begin COMPU_METHOD SC_FK_MFREF "FK_MFREF conversion" RAT_FUNC "%10.5" "unitless" COEFFS 0 1 0 0 0 1 /end COMPU_METHOD
/begin CHARACTERISTIC FK_MPH_FILT "FILTER CONSTANT for MPH_FILT term in ROLAV" VALUE 0x56570 SD_FLOAT32_IEEE 0 SC_FK_MPH_FILT 0 0.999985 /end CHARACTERISTIC
/begin COMPU_METHOD SC_FK_MPH_FILT "FK_MPH_FILT conversion" RAT_FUNC "%10.5" "unitless" COEFFS 0 1 0 0 0 1 /end COMPU_METHOD
/begin CHARACTERISTIC FK_RDSP "FILTER CONSTANT for RDSP_FILT term in ROLAV" VALUE 0x5656C SD_FLOAT32_IEEE 0 SC_FK_RDSP 0 0.999985 /end CHARACTERISTIC
/begin COMPU_METHOD SC_FK_RDSP "FK_RDSP conversion" RAT_FUNC "%10.5" "unitless" COEFFS 0 1 0 0 0 1 /end COMPU_METHOD
/begin CHARACTERISTIC FLF_TST_SW "Mapped byte of sys_FLF_SW flag bits in the order(0..7): {cat,ccm,purg,sair,fuel,ego,egr,mis}." VALUE 0x56382 SD_UBYTE 0 SC_FLF_TST_SW 0 255 /end CHARACTERISTIC
/begin COMPU_METHOD SC_FLF_TST_SW "FLF_TST_SW conversion" RAT_FUNC "%3.0" "MAPPED_BYTE" COEFFS 0 1 0 0 0 1 /end COMPU_METHOD
/begin MEASUREMENT FLG_4X4L "4X4 LOW FLAG" UBYTE MC_FLG_4X4L 0 0 0 0 ECU_ADDRESS 0x3FA158 /end MEASUREMENT
/begin COMPU_METHOD MC_FLG_4X4L "FLG_4X4L conversion" RAT_FUNC "%3.0" "Unitless" COEFFS 0 1 0 0 0 1 /end COMPU_METHOD
/begin MEASUREMENT FLG_AC_HLD "Indicates that A/C and/or fans should not change state." UBYTE MC_FLG_AC_HLD 0 0 0 0 ECU_ADDRESS 0x3F9E98 /end MEASUREMENT
/begin COMPU_METHOD MC_FLG_AC_HLD "FLG_AC_HLD conversion" RAT_FUNC "%3.0" "Unitless" COEFFS 0 1 0 0 0 1 /end COMPU_METHOD
/begin MEASUREMENT FLG_CONT_MON "Flag set when continuous monitors are enabled in the OBD-II system." UBYTE MC_FLG_CONT_MON 0 0 0 0 ECU_ADDRESS 0x3F9EDF /end MEASUREMENT
/begin COMPU_METHOD MC_FLG_CONT_MON "FLG_CONT_MON conversion" RAT_FUNC "%3.0" "Unitless" COEFFS 0 1 0 0 0 1 /end COMPU_METHOD
/begin MEASUREMENT FLG_ENG_IN "ENGAGEMENT IN PROGRESS FLAG" UBYTE MC_FLG_ENG_IN 0 0 0 0 ECU_ADDRESS 0x3FA14D /end MEASUREMENT
/begin COMPU_METHOD MC_FLG_ENG_IN "FLG_ENG_IN conversion" RAT_FUNC "%3.0" "Unitless" COEFFS 0 1 0 0 0 1 /end COMPU_METHOD
/begin MEASUREMENT FLG_SFT_IN "Shift in progress flag." UBYTE MC_FLG_SFT_IN 0 0 0 0 ECU_ADDRESS 0x3FA14C /end MEASUREMENT
/begin COMPU_METHOD MC_FLG_SFT_IN "FLG_SFT_IN conversion" RAT_FUNC "%3.0" "Unitless" COEFFS 0 1 0 0 0 1 /end COMPU_METHOD
/begin MEASUREMENT FLI_ENG "Fuel level in engineering units, % fill" FLOAT32_IEEE MC_FLI_ENG 0 0 0 0 ECU_ADDRESS 0x3FAA1C /end MEASUREMENT
/begin COMPU_METHOD MC_FLI_ENG "FLI_ENG conversion" RAT_FUNC "%10.5" "Unitless" COEFFS 0 1 0 0 0 1 /end COMPU_METHOD
/begin MEASUREMENT FLI_ENG2 "Fuel level in engineering units from second sending unit, % fill" FLOAT32_IEEE MC_FLI_ENG2 0 0 0 0 ECU_ADDRESS 0x3FAA18 /end MEASUREMENT
/begin COMPU_METHOD MC_FLI_ENG2 "FLI_ENG2 conversion" RAT_FUNC "%10.5" "Unitless" COEFFS 0 1 0 0 0 1 /end COMPU_METHOD
/begin MEASUREMENT FLI_STATUS "Status of Fuel Level Input from the high level input driver; 0=ok, 1=under voltage, 2=over voltage" UBYTE MC_FLI_STATUS 0 0 0 0 ECU_ADDRESS 0x3FAA33 /end MEASUREMENT
/begin COMPU_METHOD MC_FLI_STATUS "FLI_STATUS conversion" RAT_FUNC "%3.0" "Unitless" COEFFS 0 1 0 0 0 1 /end COMPU_METHOD
/begin CHARACTERISTIC FN011DS "Engine speed normalization function" CURVE 0x4939C FD_FLOAT32_IEEE 0 FCY_FN011DS 0 10 /begin AXIS_DESCR STD_AXIS N FCX_FN011DS 13 0 5000 /end AXIS_DESCR /end CHARACTERISTIC
/begin COMPU_METHOD FCX_FN011DS "FN011DS X-axis conversion" RAT_FUNC "%10.5" "RPM" COEFFS 0 1 0 0 0 1 /end COMPU_METHOD
/begin COMPU_METHOD FCY_FN011DS "FN011DS Y-axis conversion" RAT_FUNC "%10.5" "unitless" COEFFS 0 1 0 0 0 1 /end COMPU_METHOD
/begin CHARACTERISTIC FN011P "Engine speed normalization function" CURVE 0x49404 FD_FLOAT32_IEEE 0 FCY_FN011P 0 10 /begin AXIS_DESCR STD_AXIS N FCX_FN011P 13 0 5000 /end AXIS_DESCR /end CHARACTERISTIC
/begin COMPU_METHOD FCX_FN011P "FN011P X-axis conversion" RAT_FUNC "%10.5" "RPM" COEFFS 0 1 0 0 0 1 /end COMPU_METHOD
/begin COMPU_METHOD FCY_FN011P "FN011P Y-axis conversion" RAT_FUNC "%10.5" "unitless" COEFFS 0 1 0 0 0 1 /end COMPU_METHOD
/begin CHARACTERISTIC FN012DS "" CURVE 0x43F6C FD_FLOAT32_IEEE 0 FCY_FN012DS 0 10 /begin AXIS_DESCR STD_AXIS N FCX_FN012DS 10 0 5000 /end AXIS_DESCR /end CHARACTERISTIC
/begin COMPU_METHOD FCX_FN012DS "FN012DS X-axis conversion" RAT_FUNC "%10.5" "RPM" COEFFS 0 1 0 0 0 1 /end COMPU_METHOD
/begin COMPU_METHOD FCY_FN012DS "FN012DS Y-axis conversion" RAT_FUNC "%10.5" "unitless" COEFFS 0 1 0 0 0 1 /end COMPU_METHOD
/begin CHARACTERISTIC FN012P "" CURVE 0x43FBC FD_FLOAT32_IEEE 0 FCY_FN012P 0 10 /begin AXIS_DESCR STD_AXIS N FCX_FN012P 10 0 5000 /end AXIS_DESCR /end CHARACTERISTIC
/begin COMPU_METHOD FCX_FN012P "FN012P X-axis conversion" RAT_FUNC "%10.5" "RPM" COEFFS 0 1 0 0 0 1 /end COMPU_METHOD
/begin COMPU_METHOD FCY_FN012P "FN012P Y-axis conversion" RAT_FUNC "%10.5" "unitless" COEFFS 0 1 0 0 0 1 /end COMPU_METHOD
/begin CHARACTERISTIC FN013DS "Normalized mass fuel desired (mg/stroke)" CURVE 0x46444 FD_FLOAT32_IEEE 0 FCY_FN013DS 0 10 /begin AXIS_DESCR STD_AXIS MFDES FCX_FN013DS 11 0 120 /end AXIS_DESCR /end CHARACTERISTIC
/begin COMPU_METHOD FCX_FN013DS "FN013DS X-axis conversion" RAT_FUNC "%10.5" "unitless" COEFFS 0 1 0 0 0 1 /end COMPU_METHOD
/begin COMPU_METHOD FCY_FN013DS "FN013DS Y-axis conversion" RAT_FUNC "%10.5" "unitless" COEFFS 0 1 0 0 0 1 /end COMPU_METHOD
/begin CHARACTERISTIC FN013P "Normalized mass fuel desired (mg/stroke)" CURVE 0x4630C FD_FLOAT32_IEEE 0 FCY_FN013P 0 10 /begin AXIS_DESCR STD_AXIS MFDES FCX_FN013P 11 0 120 /end AXIS_DESCR /end CHARACTERISTIC
/begin COMPU_METHOD FCX_FN013P "FN013P X-axis conversion" RAT_FUNC "%10.5" "unitless" COEFFS 0 1 0 0 0 1 /end COMPU_METHOD
/begin COMPU_METHOD FCY_FN013P "FN013P Y-axis conversion" RAT_FUNC "%10.5" "unitless" COEFFS 0 1 0 0 0 1 /end COMPU_METHOD
/begin CHARACTERISTIC FN014DS "Engine speed normalization for torque limited fuel table" CURVE 0x43C3C FD_FLOAT32_IEEE 0 FCY_FN014DS 0 13 /begin AXIS_DESCR STD_AXIS N FCX_FN014DS 14 0 5000 /end AXIS_DESCR /end CHARACTERISTIC
/begin COMPU_METHOD FCX_FN014DS "FN014DS X-axis conversion" RAT_FUNC "%10.5" "RPM" COEFFS 0 1 0 0 0 1 /end COMPU_METHOD
/begin COMPU_METHOD FCY_FN014DS "FN014DS Y-axis conversion" RAT_FUNC "%10.5" "unitless" COEFFS 0 1 0 0 0 1 /end COMPU_METHOD
/begin CHARACTERISTIC FN014P "Engine speed normalization for torque limited fuel table" CURVE 0x43D1C FD_FLOAT32_IEEE 0 FCY_FN014P 0 13 /begin AXIS_DESCR STD_AXIS N FCX_FN014P 14 0 5000 /end AXIS_DESCR /end CHARACTERISTIC
/begin COMPU_METHOD FCX_FN014P "FN014P X-axis conversion" RAT_FUNC "%10.5" "RPM" COEFFS 0 1 0 0 0 1 /end COMPU_METHOD
/begin COMPU_METHOD FCY_FN014P "FN014P Y-axis conversion" RAT_FUNC "%10.5" "unitless" COEFFS 0 1 0 0 0 1 /end COMPU_METHOD
/begin CHARACTERISTIC FN015DS_ECT_C "" CURVE 0x43CAC FD_FLOAT32_IEEE 0 FCY_FN015DS_ECT_C 0 1000 /begin AXIS_DESCR STD_AXIS ECT_C FCX_FN015DS_ECT_C 7 -40 1000 /end AXIS_DESCR /end CHARACTERISTIC
/begin COMPU_METHOD FCX_FN015DS_ECT_C "FN015DS_ECT_C X-axis conversion" RAT_FUNC "%10.5" "degC" COEFFS 0 1 0 0 0 1 /end COMPU_METHOD
/begin COMPU_METHOD FCY_FN015DS_ECT_C "FN015DS_ECT_C Y-axis conversion" RAT_FUNC "%10.5" "unitless" COEFFS 0 1 0 0 0 1 /end COMPU_METHOD
/begin CHARACTERISTIC FN015DS_EOT_C "" CURVE 0x43CE4 FD_FLOAT32_IEEE 0 FCY_FN015DS_EOT_C 0 7 /begin AXIS_DESCR STD_AXIS EOT_C FCX_FN015DS_EOT_C 7 -200 1000 /end AXIS_DESCR /end CHARACTERISTIC
/begin COMPU_METHOD FCX_FN015DS_EOT_C "FN015DS_EOT_C X-axis conversion" RAT_FUNC "%10.5" "degC" COEFFS 0 1 0 0 0 1 /end COMPU_METHOD
/begin COMPU_METHOD FCY_FN015DS_EOT_C "FN015DS_EOT_C Y-axis conversion" RAT_FUNC "%10.5" "unitless" COEFFS 0 1 0 0 0 1 /end COMPU_METHOD
/begin CHARACTERISTIC FN015P_ECT_C "" CURVE 0x43D8C FD_FLOAT32_IEEE 0 FCY_FN015P_ECT_C 0 7 /begin AXIS_DESCR STD_AXIS ECT_C FCX_FN015P_ECT_C 7 -200 1000 /end AXIS_DESCR /end CHARACTERISTIC
/begin COMPU_METHOD FCX_FN015P_ECT_C "FN015P_ECT_C X-axis conversion" RAT_FUNC "%10.5" "degC" COEFFS 0 1 0 0 0 1 /end COMPU_METHOD
/begin COMPU_METHOD FCY_FN015P_ECT_C "FN015P_ECT_C Y-axis conversion" RAT_FUNC "%10.5" "unitless" COEFFS 0 1 0 0 0 1 /end COMPU_METHOD
/begin CHARACTERISTIC FN015P_EOT_C "" CURVE 0x43DC4 FD_FLOAT32_IEEE 0 FCY_FN015P_EOT_C 0 7 /begin AXIS_DESCR STD_AXIS EOT_C FCX_FN015P_EOT_C 7 -200 1000 /end AXIS_DESCR /end CHARACTERISTIC
/begin COMPU_METHOD FCX_FN015P_EOT_C "FN015P_EOT_C X-axis conversion" RAT_FUNC "%10.5" "degC" COEFFS 0 1 0 0 0 1 /end COMPU_METHOD
/begin COMPU_METHOD FCY_FN015P_EOT_C "FN015P_EOT_C Y-axis conversion" RAT_FUNC "%10.5" "unitless" COEFFS 0 1 0 0 0 1 /end COMPU_METHOD
/begin CHARACTERISTIC FN019DS "Normalized engine speed (RPM)" CURVE 0x4649C FD_FLOAT32_IEEE 0 FCY_FN019DS 0 10 /begin AXIS_DESCR STD_AXIS N FCX_FN019DS 12 0 5000 /end AXIS_DESCR /end CHARACTERISTIC
/begin COMPU_METHOD FCX_FN019DS "FN019DS X-axis conversion" RAT_FUNC "%10.5" "unitless" COEFFS 0 1 0 0 0 1 /end COMPU_METHOD
/begin COMPU_METHOD FCY_FN019DS "FN019DS Y-axis conversion" RAT_FUNC "%10.5" "unitless" COEFFS 0 1 0 0 0 1 /end COMPU_METHOD
/begin CHARACTERISTIC FN019P "Normalized engine speed" CURVE 0x46364 FD_FLOAT32_IEEE 0 FCY_FN019P 0 10 /begin AXIS_DESCR STD_AXIS N FCX_FN019P 12 0 5000 /end AXIS_DESCR /end CHARACTERISTIC
/begin COMPU_METHOD FCX_FN019P "FN019P X-axis conversion" RAT_FUNC "%10.5" "unitless" COEFFS 0 1 0 0 0 1 /end COMPU_METHOD
/begin COMPU_METHOD FCY_FN019P "FN019P Y-axis conversion" RAT_FUNC "%10.5" "unitless" COEFFS 0 1 0 0 0 1 /end COMPU_METHOD
/begin CHARACTERISTIC FN021DS "Engine Speed (n) normalization function" CURVE 0x42A8C FD_FLOAT32_IEEE 0 FCY_FN021DS 0 13 /begin AXIS_DESCR STD_AXIS N FCX_FN021DS 14 0 5000 /end AXIS_DESCR /end CHARACTERISTIC
/begin COMPU_METHOD FCX_FN021DS "FN021DS X-axis conversion" RAT_FUNC "%10.5" "RPM" COEFFS 0 1 0 0 0 1 /end COMPU_METHOD
/begin COMPU_METHOD FCY_FN021DS "FN021DS Y-axis conversion" RAT_FUNC "%10.5" "unitless" COEFFS 0 1 0 0 0 1 /end COMPU_METHOD
/begin CHARACTERISTIC FN021P "Engine Speed (n) normalization function" CURVE 0x42B6C FD_FLOAT32_IEEE 0 FCY_FN021P 0 13 /begin AXIS_DESCR STD_AXIS N FCX_FN021P 14 0 5000 /end AXIS_DESCR /end CHARACTERISTIC
/begin COMPU_METHOD FCX_FN021P "FN021P X-axis conversion" RAT_FUNC "%10.5" "RPM" COEFFS 0 1 0 0 0 1 /end COMPU_METHOD
/begin COMPU_METHOD FCY_FN021P "FN021P Y-axis conversion" RAT_FUNC "%10.5" "unitless" COEFFS 0 1 0 0 0 1 /end COMPU_METHOD
/begin CHARACTERISTIC FN022DS "EOT normalization function for GPC" CURVE 0x4DE44 FD_FLOAT32_IEEE 0 FCY_FN022DS 0 10 /begin AXIS_DESCR STD_AXIS EOT_C FCX_FN022DS 12 -40 150 /end AXIS_DESCR /end CHARACTERISTIC
/begin COMPU_METHOD FCX_FN022DS "FN022DS X-axis conversion" RAT_FUNC "%10.5" "degC" COEFFS 0 1 0 0 0 1 /end COMPU_METHOD
/begin COMPU_METHOD FCY_FN022DS "FN022DS Y-axis conversion" RAT_FUNC "%10.5" "unitless" COEFFS 0 1 0 0 0 1 /end COMPU_METHOD
/begin CHARACTERISTIC FN023DS "IVPWR normalization function for GPC" CURVE 0x4DEA4 FD_FLOAT32_IEEE 0 FCY_FN023DS 0 5 /begin AXIS_DESCR STD_AXIS IVPWR FCX_FN023DS 8 6 25.2 /end AXIS_DESCR /end CHARACTERISTIC
/begin COMPU_METHOD FCX_FN023DS "FN023DS X-axis conversion" RAT_FUNC "%10.5" "V" COEFFS 0 1 0 0 0 1 /end COMPU_METHOD
/begin COMPU_METHOD FCY_FN023DS "FN023DS Y-axis conversion" RAT_FUNC "%10.5" "unitless" COEFFS 0 1 0 0 0 1 /end COMPU_METHOD
/begin CHARACTERISTIC FN027DS "Oil viscosity normalization" CURVE 0x4946C FD_FLOAT32_IEEE 0 FCY_FN027DS 0 16 /begin AXIS_DESCR STD_AXIS EOT_C FCX_FN027DS 17 -8192 8191.75 /end AXIS_DESCR /end CHARACTERISTIC
/begin COMPU_METHOD FCX_FN027DS "FN027DS X-axis conversion" RAT_FUNC "%10.5" "degC" COEFFS 0 1 0 0 0 1 /end COMPU_METHOD
/begin COMPU_METHOD FCY_FN027DS "FN027DS Y-axis conversion" RAT_FUNC "%10.5" "unitless" COEFFS 0 1 0 0 0 1 /end COMPU_METHOD
/begin CHARACTERISTIC FN030DS "" CURVE 0x4400C FD_FLOAT32_IEEE 0 FCY_FN030DS 0 12 /begin AXIS_DESCR STD_AXIS NO_INPUT_QUANTITY FCX_FN030DS 8 0 1000 /end AXIS_DESCR /end CHARACTERISTIC
/begin COMPU_METHOD FCX_FN030DS "FN030DS X-axis conversion" RAT_FUNC "%10.5" "unitless" COEFFS 0 1 0 0 0 1 /end COMPU_METHOD
/begin COMPU_METHOD FCY_FN030DS "FN030DS Y-axis conversion" RAT_FUNC "%10.5" "unitless" COEFFS 0 1 0 0 0 1 /end COMPU_METHOD
/begin CHARACTERISTIC FN030P "" CURVE 0x4404C FD_FLOAT32_IEEE 0 FCY_FN030P 0 11 /begin AXIS_DESCR STD_AXIS NO_INPUT_QUANTITY FCX_FN030P 8 0 1000 /end AXIS_DESCR /end CHARACTERISTIC
/begin COMPU_METHOD FCX_FN030P "FN030P X-axis conversion" RAT_FUNC "%10.5" "unitless" COEFFS 0 1 0 0 0 1 /end COMPU_METHOD
/begin COMPU_METHOD FCY_FN030P "FN030P Y-axis conversion" RAT_FUNC "%10.5" "unitless" COEFFS 0 1 0 0 0 1 /end COMPU_METHOD
/begin CHARACTERISTIC FN031DS "Normalize mass fuel quantity for ICPDES table lookup" CURVE 0x494F4 FD_FLOAT32_IEEE 0 FCY_FN031DS 0 9 /begin AXIS_DESCR STD_AXIS MFDES FCX_FN031DS 12 0 255.996 /end AXIS_DESCR /end CHARACTERISTIC
/begin COMPU_METHOD FCX_FN031DS "FN031DS X-axis conversion" RAT_FUNC "%10.5" "unitless" COEFFS 0 1 0 0 0 1 /end COMPU_METHOD
/begin COMPU_METHOD FCY_FN031DS "FN031DS Y-axis conversion" RAT_FUNC "%10.5" "unitless" COEFFS 0 1 0 0 0 1 /end COMPU_METHOD
/begin CHARACTERISTIC FN031P "Normalize mass fuel quantity for ICPDES table lookup" CURVE 0x49554 FD_FLOAT32_IEEE 0 FCY_FN031P 0 9 /begin AXIS_DESCR STD_AXIS MFDES FCX_FN031P 12 0 255.996 /end AXIS_DESCR /end CHARACTERISTIC
/begin COMPU_METHOD FCX_FN031P "FN031P X-axis conversion" RAT_FUNC "%10.5" "unitless" COEFFS 0 1 0 0 0 1 /end COMPU_METHOD
/begin COMPU_METHOD FCY_FN031P "FN031P Y-axis conversion" RAT_FUNC "%10.5" "unitless" COEFFS 0 1 0 0 0 1 /end COMPU_METHOD
/begin CHARACTERISTIC FN032DS "Normalized Engine Oil Temperature (EOT degrees C)" CURVE 0x4653C FD_FLOAT32_IEEE 0 FCY_FN032DS 0 7 /begin AXIS_DESCR STD_AXIS EOT_C FCX_FN032DS 8 -40 150 /end AXIS_DESCR /end CHARACTERISTIC
/begin COMPU_METHOD FCX_FN032DS "FN032DS X-axis conversion" RAT_FUNC "%10.5" "unitless" COEFFS 0 1 0 0 0 1 /end COMPU_METHOD
/begin COMPU_METHOD FCY_FN032DS "FN032DS Y-axis conversion" RAT_FUNC "%10.5" "unitless" COEFFS 0 1 0 0 0 1 /end COMPU_METHOD
/begin CHARACTERISTIC FN032P "Normalized Engine Oil Temperature (EOT degrees C)" CURVE 0x46404 FD_FLOAT32_IEEE 0 FCY_FN032P 0 6 /begin AXIS_DESCR STD_AXIS EOT_C FCX_FN032P 8 -40 150 /end AXIS_DESCR /end CHARACTERISTIC
/begin COMPU_METHOD FCX_FN032P "FN032P X-axis conversion" RAT_FUNC "%10.5" "unitless" COEFFS 0 1 0 0 0 1 /end COMPU_METHOD
/begin COMPU_METHOD FCY_FN032P "FN032P Y-axis conversion" RAT_FUNC "%10.5" "unitless" COEFFS 0 1 0 0 0 1 /end COMPU_METHOD
/begin CHARACTERISTIC FN033DS "" CURVE 0x464FC FD_FLOAT32_IEEE 0 FCY_FN033DS 0 6 /begin AXIS_DESCR STD_AXIS N FCX_FN033DS 8 0 5000 /end AXIS_DESCR /end CHARACTERISTIC
/begin COMPU_METHOD FCX_FN033DS "FN033DS X-axis conversion" RAT_FUNC "%10.5" "unitless" COEFFS 0 1 0 0 0 1 /end COMPU_METHOD
/begin COMPU_METHOD FCY_FN033DS "FN033DS Y-axis conversion" RAT_FUNC "%10.5" "unitless" COEFFS 0 1 0 0 0 1 /end COMPU_METHOD
/begin CHARACTERISTIC FN033P "Normalized engine speed" CURVE 0x463C4 FD_FLOAT32_IEEE 0 FCY_FN033P 0 6 /begin AXIS_DESCR STD_AXIS N FCX_FN033P 8 0 5000 /end AXIS_DESCR /end CHARACTERISTIC
/begin COMPU_METHOD FCX_FN033P "FN033P X-axis conversion" RAT_FUNC "%10.5" "unitless" COEFFS 0 1 0 0 0 1 /end COMPU_METHOD
/begin COMPU_METHOD FCY_FN033P "FN033P Y-axis conversion" RAT_FUNC "%10.5" "unitless" COEFFS 0 1 0 0 0 1 /end COMPU_METHOD
/begin CHARACTERISTIC FN035DS "Drive-By-Wire Pedal normalization function" CURVE 0x42AFC FD_FLOAT32_IEEE 0 FCY_FN035DS 0 13 /begin AXIS_DESCR STD_AXIS PPS FCX_FN035DS 14 0 1023 /end AXIS_DESCR /end CHARACTERISTIC
/begin COMPU_METHOD FCX_FN035DS "FN035DS X-axis conversion" RAT_FUNC "%10.5" "ADct" COEFFS 0 1 0 0 0 1 /end COMPU_METHOD
/begin COMPU_METHOD FCY_FN035DS "FN035DS Y-axis conversion" RAT_FUNC "%10.5" "unitless" COEFFS 0 1 0 0 0 1 /end COMPU_METHOD
/begin CHARACTERISTIC FN035P "Drive-By-Wire Pedal normalization function" CURVE 0x42BDC FD_FLOAT32_IEEE 0 FCY_FN035P 0 13 /begin AXIS_DESCR STD_AXIS PPS FCX_FN035P 14 0 1023 /end AXIS_DESCR /end CHARACTERISTIC
/begin COMPU_METHOD FCX_FN035P "FN035P X-axis conversion" RAT_FUNC "%10.5" "ADct" COEFFS 0 1 0 0 0 1 /end COMPU_METHOD
/begin COMPU_METHOD FCY_FN035P "FN035P Y-axis conversion" RAT_FUNC "%10.5" "unitless" COEFFS 0 1 0 0 0 1 /end COMPU_METHOD
/begin CHARACTERISTIC FN038DS "MFDES normalization function" CURVE 0x4350C FD_FLOAT32_IEEE 0 FCY_FN038DS 0 9 /begin AXIS_DESCR STD_AXIS MFDES FCX_FN038DS 10 0 255.996 /end AXIS_DESCR /end CHARACTERISTIC
/begin COMPU_METHOD FCX_FN038DS "FN038DS X-axis conversion" RAT_FUNC "%10.5" "unitless" COEFFS 0 1 0 0 0 1 /end COMPU_METHOD
/begin COMPU_METHOD FCY_FN038DS "FN038DS Y-axis conversion" RAT_FUNC "%10.5" "unitless" COEFFS 0 1 0 0 0 1 /end COMPU_METHOD
/begin RECORD_LAYOUT SD_UBYTE FNC_VALUES 1 UBYTE ROW_DIR DIRECT /end RECORD_LAYOUT
/begin RECORD_LAYOUT SD_ULONG FNC_VALUES 1 ULONG ROW_DIR DIRECT /end RECORD_LAYOUT
/begin RECORD_LAYOUT SD_SLONG FNC_VALUES 1 SLONG ROW_DIR DIRECT /end RECORD_LAYOUT
/begin RECORD_LAYOUT SD_FLOAT32_IEEE FNC_VALUES 1 FLOAT32_IEEE ROW_DIR DIRECT /end RECORD_LAYOUT
/begin RECORD_LAYOUT FD_FLOAT32_IEEE AXIS_PTS_X 1 FLOAT32_IEEE INDEX_INCR DIRECT FNC_VALUES 2 FLOAT32_IEEE ALTERNATE_WITH_X DIRECT /end RECORD_LAYOUT
/* asap2_trailer.a2l */ /* This file must be appended to the .a2l file created by the sym2asap2 */ /* tool. The tool does not currently add these keywords to mark the end */ /* of the file. If the sym2asap2 tool is modified in the future to add */ /* these keywords, this file will no longer be necessary. */
/end MODULE
/end PROJECT
