ASAP2_VERSION 1 21
/begin PROJECT Brs_6Zylinder "310B6"
/begin HEADER "" VERSION "_310B621d" PROJECT_NO Brs_6Zylinder /end HEADER
/begin MODULE DIM ""
/begin MOD_COMMON "" BYTE_ORDER MSB_LAST S_REC_LAYOUT DAMOS /end MOD_COMMON
/begin AXIS_PTS SAN12ESUW "SST-Verteilung für den begrenzten Einspritzzähler anztib_w" 0x11BE8 anztib_w SstAUwSstUw 65535 dez 12 0 65535 DEPOSIT ABSOLUTE /end AXIS_PTS
/begin AXIS_PTS STS12ESUB "SST-Verteilung für Motorstarttemperatur" 0x100DE tmst SstAUbSstUb 191.25 temp_ub_q0p75_o48 12 -48 143.25 DEPOSIT ABSOLUTE /end AXIS_PTS
/begin AXIS_PTS STA06ESUB "SST-Verteilung für die Ansauglufttemperatur" 0x1006B tans SstAUbSstUb 191.25 temp_ub_q0p75_o48 6 -48 143.25 DEPOSIT ABSOLUTE /end AXIS_PTS
/begin AXIS_PTS SNM16KRUB "Stützstellenverteilung Drehzahl, 16 Sst." 0x10050 nmot SstAUbSstUb 10200 nmot_ub_q40 16 0 10200 DEPOSIT ABSOLUTE /end AXIS_PTS
/begin CHARACTERISTIC CDTVFZ "Codewort Tester: Fahrzeug-Geschwindigkeit" VALUE 0x11F3C KwUw 65535 dez 0 65535 FORMAT "%8.2" /end CHARACTERISTIC
/begin CHARACTERISTIC CLAVFZ "Fehlerklasse: Geschwindigkeitssignal" VALUE 0x1013C KwUb 255 dez 0 255 FORMAT "%5.1" /end CHARACTERISTIC
/begin CHARACTERISTIC TSFVFZ "Fehlersummenzeit: Fahrzeug-Geschwindigkeit" VALUE 0x101C6 KwUb 255 dez 0 255 FORMAT "%5.1" /end CHARACTERISTIC
/begin CHARACTERISTIC CDKVFZ "Codewort Kunde:	Fahrzeug-Geschwindigkeit" VALUE 0x11EE0 KwUw 65535 dez 0 65535 FORMAT "%8.2" /end CHARACTERISTIC
/begin CHARACTERISTIC FFTVFZ "Freeze Frame Tabelle: Geschwindigkeitssignal" VAL_BLK 0x10196 KwbUb 255 dez 0 255 FORMAT "%5.1" NUMBER 2 /end CHARACTERISTIC
/begin CHARACTERISTIC BITTIME "" VALUE 0x11C34 KwUw 65535 dez 0 65535 FORMAT "%8.2" /end CHARACTERISTIC
/begin CHARACTERISTIC CDTAAA "Dummy: Tabellenanfang" VALUE 0x11EE4 KwUw 65535 dez 0 65535 FORMAT "%8.2" /end CHARACTERISTIC
/begin CHARACTERISTIC CLAAAA "Dummy: Tabellenanfang" VALUE 0x10110 KwUb 255 dez 0 255 FORMAT "%5.1" /end CHARACTERISTIC
/begin CHARACTERISTIC TSFAAA "Dummy: Tabellenanfang" VALUE 0x1019A KwUb 255 dez 0 255 FORMAT "%5.1" /end CHARACTERISTIC
/begin CHARACTERISTIC CDKAAA "Dummy: Tabellenanfang" VALUE 0x11E88 KwUw 65535 dez 0 65535 FORMAT "%8.2" /end CHARACTERISTIC
/begin CHARACTERISTIC FFTAAA "Dummy: Tabellenanfang" VAL_BLK 0x1013E KwbUb 255 dez 0 255 FORMAT "%5.1" NUMBER 2 /end CHARACTERISTIC
/begin CHARACTERISTIC CDTZZZ "Dummy: Tabellenende" VALUE 0x11F3E KwUw 65535 dez 0 65535 FORMAT "%8.2" /end CHARACTERISTIC
/begin CHARACTERISTIC CLAZZZ "Dummy: Tabellenende" VALUE 0x1013D KwUb 255 dez 0 255 FORMAT "%5.1" /end CHARACTERISTIC
/begin CHARACTERISTIC TSFZZZ "Dummy: Tabellenende" VALUE 0x101C7 KwUb 255 dez 0 255 FORMAT "%5.1" /end CHARACTERISTIC
/begin CHARACTERISTIC CDKZZZ "Dummy: Tabellenendeng" VALUE 0x11EE2 KwUw 65535 dez 0 65535 FORMAT "%8.2" /end CHARACTERISTIC
/begin CHARACTERISTIC FFTZZZ "Dummy: Tabellenende" VAL_BLK 0x10198 KwbUb 255 dez 0 255 FORMAT "%5.1" NUMBER 2 /end CHARACTERISTIC
/begin CHARACTERISTIC TMWUCST "max. Motortemperatur im Start für Erfüllung 'warm up cycle'" VALUE 0x101CA KwUb 191.25 temp_ub_q0p75_o48 -48 143.25 FORMAT "%5.1" /end CHARACTERISTIC
/begin CHARACTERISTIC DTMWUC "Delta Motortemperaturschwelle für Erfüllung 'warm up cycle'" VALUE 0x101C8 KwUb 191.25 temp_ub_b191p25 0 191.25 FORMAT "%5.1" /end CHARACTERISTIC
/begin CHARACTERISTIC TMWUC "Motortemperaturschwelle für Erfüllung 'warm up cycle'" VALUE 0x101C9 KwUb 191.25 temp_ub_q0p75_o48 -48 143.25 FORMAT "%5.1" /end CHARACTERISTIC
/begin CHARACTERISTIC PHNOKA "Anfangswert für Zähler Phasensignal nicht ok" VALUE 0x10200 KwUb 255 dez 0 255 FORMAT "%5.1" /end CHARACTERISTIC
/begin CHARACTERISTIC CDTPH "Codewort Tester: Phasensensor" VALUE 0x11F2C KwUw 65535 dez 0 65535 FORMAT "%8.2" /end CHARACTERISTIC
/begin CHARACTERISTIC CLAPH "Fehlerklasse: Phasengeber" VALUE 0x10134 KwUb 255 dez 0 255 FORMAT "%5.1" /end CHARACTERISTIC
/begin CHARACTERISTIC TSFPH "Fehlersummenzeit: Phasensensor" VALUE 0x101BE KwUb 255 dez 0 255 FORMAT "%5.1" /end CHARACTERISTIC
/begin CHARACTERISTIC CDKPH "Codewort Kunde: Phasensensor" VALUE 0x11ED0 KwUw 65535 dez 0 65535 FORMAT "%8.2" /end CHARACTERISTIC
/begin CHARACTERISTIC FFTPH "Freeze Frame Tabelle: Phasensensor" VAL_BLK 0x10186 KwbUb 255 dez 0 255 FORMAT "%5.1" NUMBER 2 /end CHARACTERISTIC
/begin CHARACTERISTIC TDFHS "Entprellzeit für Heizerendstufe" VALUE 0x1023C KwUb 2.55 t10msxs_ub_b2p55 0 2.55 FORMAT "%5.3" /end CHARACTERISTIC
/begin CHARACTERISTIC TVLSUBM "maximal zul. Verzögerungszeit für Betriebsbereitschaft stetige Lambdasonde LSU" VALUE 0x12018 KwUw 3276.75 t50msxs_uw_b3276p75 0 3276.75 FORMAT "%8.3" /end CHARACTERISTIC
/begin CHARACTERISTIC TVLSUST "Verzögerungszeit für Endstufendiagnose Heizung LSU" VALUE 0x1023B KwUb 25.5 t100msxs_ub_b25p5 0 25.5 FORMAT "%5.2" /end CHARACTERISTIC
/begin CHARACTERISTIC UHEMN "Schwellwert für bestromte Heizerendstufe" VALUE 0x1023D KwUb 4.98047 spg_ub_q0p019 0 4.98047 FORMAT "%5.3" /end CHARACTERISTIC
/begin CHARACTERISTIC UHEMX "Schwellwert für stromlose Heizerendstufe" VALUE 0x1023E KwUb 4.98047 spg_ub_q0p019 0 4.98047 FORMAT "%5.3" /end CHARACTERISTIC
/begin CHARACTERISTIC CDTHSV "Codewort Tester: Lambdasonden-Heizung vor Katalysator" VALUE 0x11F08 KwUw 65535 dez 0 65535 FORMAT "%8.2" /end CHARACTERISTIC
/begin CHARACTERISTIC CLAHSV "Fehlerklasse: Heizung Lambdasonde vor Kat" VALUE 0x10122 KwUb 255 dez 0 255 FORMAT "%5.1" /end CHARACTERISTIC
/begin CHARACTERISTIC TSFHSV "Fehlersummenzeit: Lambdasonden-Heizung vor Katalysator" VALUE 0x101AC KwUb 255 dez 0 255 FORMAT "%5.1" /end CHARACTERISTIC
/begin CHARACTERISTIC CDKHSV "Codewort Kunde: Lambdasonden-Heizung vor Katalysator" VALUE 0x11EAC KwUw 65535 dez 0 65535 FORMAT "%8.2" /end CHARACTERISTIC
/begin CHARACTERISTIC FFTHSV "Tabelle Umweltbedingungen Heizung Lambdasonde vor Kat" VAL_BLK 0x10162 KwbUb 255 dez 0 255 FORMAT "%5.1" NUMBER 2 /end CHARACTERISTIC
/begin CHARACTERISTIC CDTHSV2 "Codewort Tester: Lambdasonden-Heizung vor Kat., Bank 2" VALUE 0x11F0A KwUw 65535 dez 0 65535 FORMAT "%8.2" /end CHARACTERISTIC
/begin CHARACTERISTIC CLAHSV2 "Fehlerklasse: Heizung Lambdasonde 2 vor Kat" VALUE 0x10123 KwUb 255 dez 0 255 FORMAT "%5.1" /end CHARACTERISTIC
/begin CHARACTERISTIC TSFHSV2 "Fehlersummenzeit: Lambdasonden-Heizung vor Katalysator, Bank 2" VALUE 0x101AD KwUb 255 dez 0 255 FORMAT "%5.1" /end CHARACTERISTIC
/begin CHARACTERISTIC CDKHSV2 "Codewort Kunde:	Lambdasonden-Heizung vor Katalysator, Bank 2" VALUE 0x11EAE KwUw 65535 dez 0 65535 FORMAT "%8.2" /end CHARACTERISTIC
/begin CHARACTERISTIC FFTHSV2 "Tabelle Umweltbedingungen Heizung Lambdasonde vor Kat Bank2" VAL_BLK 0x10164 KwbUb 255 dez 0 255 FORMAT "%5.1" NUMBER 2 /end CHARACTERISTIC
/begin CHARACTERISTIC DRLMX "Schwelle für Laständerung" VALUE 0x1023F KwUb 191.25 rel_ub_q0p75 0 191.25 FORMAT "%5.1" /end CHARACTERISTIC
/begin CHARACTERISTIC LAMMN "Untere Plausibilitätsschwelle für Lambda" VALUE 0x1201A KwUw 15.9998 fak_uw_b16 0 15.9998 FORMAT "%8.5" /end CHARACTERISTIC
/begin CHARACTERISTIC LAMMX "Obere Plausibilitätsschwelle für Lambda" VALUE 0x1201C KwUw 15.9998 fak_uw_b16 0 15.9998 FORMAT "%8.5" /end CHARACTERISTIC
/begin CHARACTERISTIC LSUNAMN "untere Schwelle für LSU nicht aktiv" VALUE 0x1201E KwUw 15.9998 fak_uw_b16 0 15.9998 FORMAT "%8.5" /end CHARACTERISTIC
/begin CHARACTERISTIC LSUNAMX "obere Schwelle für LSU nicht aktiv" VALUE 0x12020 KwUw 15.9998 fak_uw_b16 0 15.9998 FORMAT "%8.5" /end CHARACTERISTIC
/begin CHARACTERISTIC SDLAMX "Schwelle delta Lambda max pro Rechentakt" VALUE 0x12028 KwUw 15.9998 fak_uw_b16 0 15.9998 FORMAT "%8.5" /end CHARACTERISTIC
/begin CHARACTERISTIC SULSUMX "Schwellwert für Plausibilitätsfehler CJ110" VALUE 0x12022 KwUw 319.995 spg_uw_q0p00488 0 319.995 FORMAT "%8.4" /end CHARACTERISTIC
/begin CHARACTERISTIC TALAMX "Abgastemperatur-Schwellwert für Prüfung Heizerkopplung" VALUE 0x10240 KwUb 1275 temp_ub_q5_o50 -50 1225 FORMAT "%5.0" /end CHARACTERISTIC
/begin CHARACTERISTIC TALSUMX "Abgastemperatur-Schwellwert für hohe Sondenspannung" VALUE 0x10241 KwUb 1275 temp_ub_q5_o50 -50 1225 FORMAT "%5.0" /end CHARACTERISTIC
/begin CHARACTERISTIC TVCJLSU "Verzögerungszeit für Fehler CJ110" VALUE 0x10242 KwUb 25.5 t100msxs_ub_b25p5 0 25.5 FORMAT "%5.2" /end CHARACTERISTIC
/begin CHARACTERISTIC TVHKLSU "Verzögerungszeit für Diagnose Heizerkopplung" VALUE 0x12024 KwUw 30 t10msxs_uw_b655p35 0 30 FORMAT "%8.5" /end CHARACTERISTIC
/begin CHARACTERISTIC TVHKLSUV "Zeit für Diagnose Heizerkopplung" VALUE 0x10243 KwUb 2.55 t10msxs_ub_b2p55 0 2.55 FORMAT "%5.3" /end CHARACTERISTIC
/begin CHARACTERISTIC TVLSUHK "Verzögerungszeit nach Start für Diagnose Heizerkopplung" VALUE 0x12026 KwUw 655.35 t10msxs_uw_b655p35 0 655.35 FORMAT "%8.4" /end CHARACTERISTIC
/begin CHARACTERISTIC TVNOLSU "Verzögerungszeit für LSU OK" VALUE 0x10244 KwUb 25.5 t100msxs_ub_b25p5 0 25.5 FORMAT "%5.2" /end CHARACTERISTIC
/begin CHARACTERISTIC ZEHK "Fehlerzähler für Heizerkopplung auf das Lambdasignal" VALUE 0x1024E KwUb 255 dez 0 255 FORMAT "%5.1" /end CHARACTERISTIC
/begin CHARACTERISTIC TVPLMSA "Verzögerungszeit für Erkennung Unplausibilität LSU" CURVE 0x10245 KlAUbSstUbWUb 25.5 t100msxs_ub_b25p5 0 25.5 FORMAT "%5.2" /begin AXIS_DESCR STD_AXIS ml m_ub_b1020 4 0 1020 DEPOSIT ABSOLUTE /end AXIS_DESCR /end CHARACTERISTIC
/begin CHARACTERISTIC CDTLSV "Codewort Tester: Lambda-Sonde vor Kat" VALUE 0x11F20 KwUw 65535 dez 0 65535 FORMAT "%8.2" /end CHARACTERISTIC
/begin CHARACTERISTIC CLALSV "Fehlerklasse: Lambdasonde vor Kat" VALUE 0x1012E KwUb 255 dez 0 255 FORMAT "%5.1" /end CHARACTERISTIC
/begin CHARACTERISTIC TSFLSV "Fehlersummenzeit: Lambda-Sonde vor Kat" VALUE 0x101B8 KwUb 255 dez 0 255 FORMAT "%5.1" /end CHARACTERISTIC
/begin CHARACTERISTIC CDKLSV "Codewort Kunde:	Lambda-Sonde vor Kat" VALUE 0x11EC4 KwUw 65535 dez 0 65535 FORMAT "%8.2" /end CHARACTERISTIC
/begin CHARACTERISTIC FFTLSV "Tabelle Umweltbedingungen: Lambdasonde vor Kat" VAL_BLK 0x1017A KwbUb 255 dez 0 255 FORMAT "%5.1" NUMBER 2 /end CHARACTERISTIC
/begin CHARACTERISTIC CDTLSV2 "Codewort Tester: Lambda-Sonde 2 vor Kat" VALUE 0x11F22 KwUw 65535 dez 0 65535 FORMAT "%8.2" /end CHARACTERISTIC
/begin CHARACTERISTIC CLALSV2 "Fehlerklasse: Lambdasonde 2 vor Kat" VALUE 0x1012F KwUb 255 dez 0 255 FORMAT "%5.1" /end CHARACTERISTIC
/begin CHARACTERISTIC TSFLSV2 "Fehlersummenzeit: Lambda-Sonde 2 vor Kat" VALUE 0x101B9 KwUb 255 dez 0 255 FORMAT "%5.1" /end CHARACTERISTIC
/begin CHARACTERISTIC CDKLSV2 "Codewort Kunde:	Lambda-Sonde 2 vor Kat" VALUE 0x11EC6 KwUw 65535 dez 0 65535 FORMAT "%8.2" /end CHARACTERISTIC
/begin CHARACTERISTIC FFTLSV2 "Tabelle Umweltbedingungen: Lambdasonde vor Kat Bank2" VAL_BLK 0x1017C KwbUb 255 dez 0 255 FORMAT "%5.1" NUMBER 2 /end CHARACTERISTIC
/begin CHARACTERISTIC CDTUB "Codewort Tester: UB" VALUE 0x11F3A KwUw 65535 dez 0 65535 FORMAT "%8.2" /end CHARACTERISTIC
/begin CHARACTERISTIC CLAUB "Fehlerklasse: Batteriespannung UB (Bordnetz)" VALUE 0x1013B KwUb 255 dez 0 255 FORMAT "%5.1" /end CHARACTERISTIC
/begin CHARACTERISTIC TSFUB "Fehlersummenzeit: Batteriespannung UB (Bordnetz)" VALUE 0x101C5 KwUb 255 dez 0 255 FORMAT "%5.1" /end CHARACTERISTIC
/begin CHARACTERISTIC CDKUB "Codewort Kunde:	UB" VALUE 0x11EDE KwUw 65535 dez 0 65535 FORMAT "%8.2" /end CHARACTERISTIC
/begin CHARACTERISTIC FFTUB "Freeze Frame Tabelle: Batteriespannung UB (Bordnetz)" VAL_BLK 0x10194 KwbUb 255 dez 0 255 FORMAT "%5.1" NUMBER 2 /end CHARACTERISTIC
/begin CHARACTERISTIC CDTEV1 "Codewort Tester: EV von Zyl. 1" VALUE 0x11EFA KwUw 65535 dez 0 65535 FORMAT "%8.2" /end CHARACTERISTIC
/begin CHARACTERISTIC CLAEV1 "Fehlerklasse: EV Endtsufe 1" VALUE 0x1011B KwUb 255 dez 0 255 FORMAT "%5.1" /end CHARACTERISTIC
/begin CHARACTERISTIC TSFEV1 "Fehlersummenzeit: EV von Zyl. 1" VALUE 0x101A5 KwUb 255 dez 0 255 FORMAT "%5.1" /end CHARACTERISTIC
/begin CHARACTERISTIC CDKEV1 "Codewort Kunde: EV von Zyl. 1" VALUE 0x11E9E KwUw 65535 dez 0 65535 FORMAT "%8.2" /end CHARACTERISTIC
/begin CHARACTERISTIC FFTEV1 "Freeze Frame Tabelle: EV Endstufe 1" VAL_BLK 0x10154 KwbUb 255 dez 0 255 FORMAT "%5.1" NUMBER 2 /end CHARACTERISTIC
/begin CHARACTERISTIC CDTEV2 "Codewort Tester: EV von Zyl. 2" VALUE 0x11EFC KwUw 65535 dez 0 65535 FORMAT "%8.2" /end CHARACTERISTIC
/begin CHARACTERISTIC CLAEV2 "Fehlerklasse: EV Endstufe 2" VALUE 0x1011C KwUb 255 dez 0 255 FORMAT "%5.1" /end CHARACTERISTIC
/begin CHARACTERISTIC TSFEV2 "Fehlersummenzeit: EV von Zyl. 2" VALUE 0x101A6 KwUb 255 dez 0 255 FORMAT "%5.1" /end CHARACTERISTIC
/begin CHARACTERISTIC CDKEV2 "Codewort Kunde: EV von Zyl. 2" VALUE 0x11EA0 KwUw 65535 dez 0 65535 FORMAT "%8.2" /end CHARACTERISTIC
/begin CHARACTERISTIC FFTEV2 "Freeze Frame Tabelle: EV Endstufe 2" VAL_BLK 0x10156 KwbUb 255 dez 0 255 FORMAT "%5.1" NUMBER 2 /end CHARACTERISTIC
/begin CHARACTERISTIC CDTEV3 "Codewort Tester: EV von Zyl. 3" VALUE 0x11EFE KwUw 65535 dez 0 65535 FORMAT "%8.2" /end CHARACTERISTIC
/begin CHARACTERISTIC CLAEV3 "Fehlerklasse: EV Endstufe 3" VALUE 0x1011D KwUb 255 dez 0 255 FORMAT "%5.1" /end CHARACTERISTIC
/begin CHARACTERISTIC TSFEV3 "Fehlersummenzeit: EV von Zyl. 3" VALUE 0x101A7 KwUb 255 dez 0 255 FORMAT "%5.1" /end CHARACTERISTIC
/begin CHARACTERISTIC CDKEV3 "Codewort Kunde: EV von Zyl. 3" VALUE 0x11EA2 KwUw 65535 dez 0 65535 FORMAT "%8.2" /end CHARACTERISTIC
/begin CHARACTERISTIC FFTEV3 "Freeze Frame Tabelle: EV Endstufe 3" VAL_BLK 0x10158 KwbUb 255 dez 0 255 FORMAT "%5.1" NUMBER 2 /end CHARACTERISTIC
/begin CHARACTERISTIC CDTEV4 "Codewort Tester: EV von Zyl. 4" VALUE 0x11F00 KwUw 65535 dez 0 65535 FORMAT "%8.2" /end CHARACTERISTIC
/begin CHARACTERISTIC CLAEV4 "Fehlerklasse: EV Endstufe 4" VALUE 0x1011E KwUb 255 dez 0 255 FORMAT "%5.1" /end CHARACTERISTIC
/begin CHARACTERISTIC TSFEV4 "Fehlersummenzeit: EV von Zyl. 4" VALUE 0x101A8 KwUb 255 dez 0 255 FORMAT "%5.1" /end CHARACTERISTIC
/begin CHARACTERISTIC CDKEV4 "Codewort Kunde: EV von Zyl. 4" VALUE 0x11EA4 KwUw 65535 dez 0 65535 FORMAT "%8.2" /end CHARACTERISTIC
/begin CHARACTERISTIC FFTEV4 "Freeze Frame Tabelle: EV Endstufe 4" VAL_BLK 0x1015A KwbUb 255 dez 0 255 FORMAT "%5.1" NUMBER 2 /end CHARACTERISTIC
/begin CHARACTERISTIC CDTEV5 "Codewort Tester: EV von Zyl. 5" VALUE 0x11F02 KwUw 65535 dez 0 65535 FORMAT "%8.2" /end CHARACTERISTIC
/begin CHARACTERISTIC CLAEV5 "Fehlerklasse: EV Endstufe 5" VALUE 0x1011F KwUb 255 dez 0 255 FORMAT "%5.1" /end CHARACTERISTIC
/begin CHARACTERISTIC TSFEV5 "Fehlersummenzeit: EV von Zyl. 5" VALUE 0x101A9 KwUb 255 dez 0 255 FORMAT "%5.1" /end CHARACTERISTIC
/begin CHARACTERISTIC CDKEV5 "Codewort Kunde: EV von Zyl. 5" VALUE 0x11EA6 KwUw 65535 dez 0 65535 FORMAT "%8.2" /end CHARACTERISTIC
/begin CHARACTERISTIC FFTEV5 "Freeze Frame Tabelle: EV Endstufe 5" VAL_BLK 0x1015C KwbUb 255 dez 0 255 FORMAT "%5.1" NUMBER 2 /end CHARACTERISTIC
/begin CHARACTERISTIC CDTEV6 "Codewort Tester: EV von Zyl. 6" VALUE 0x11F04 KwUw 65535 dez 0 65535 FORMAT "%8.2" /end CHARACTERISTIC
/begin CHARACTERISTIC CLAEV6 "Fehlerklasse: EV Endstufe 6" VALUE 0x10120 KwUb 255 dez 0 255 FORMAT "%5.1" /end CHARACTERISTIC
/begin CHARACTERISTIC TSFEV6 "Fehlersummenzeit: EV von Zyl. 6" VALUE 0x101AA KwUb 255 dez 0 255 FORMAT "%5.1" /end CHARACTERISTIC
/begin CHARACTERISTIC CDKEV6 "Codewort Kunde: EV von Zyl. 6" VALUE 0x11EA8 KwUw 65535 dez 0 65535 FORMAT "%8.2" /end CHARACTERISTIC
/begin CHARACTERISTIC FFTEV6 "Freeze frame Tabelle: EV Endstufe 6" VAL_BLK 0x1015E KwbUb 255 dez 0 255 FORMAT "%5.1" NUMBER 2 /end CHARACTERISTIC
/begin CHARACTERISTIC CDTMILE "Codewort Tester: MIL-Endstufe" VALUE 0x11F24 KwUw 65535 dez 0 65535 FORMAT "%8.2" /end CHARACTERISTIC
/begin CHARACTERISTIC CLAMILE "Fehlerklasse: MIL-Endstufe" VALUE 0x10130 KwUb 255 dez 0 255 FORMAT "%5.1" /end CHARACTERISTIC
/begin CHARACTERISTIC TSFMILE "Fehlersummenzeit: MIL-Endstufe" VALUE 0x101BA KwUb 255 dez 0 255 FORMAT "%5.1" /end CHARACTERISTIC
/begin CHARACTERISTIC CDKMILE "Codewort Kunde: MIL-Endstufe" VALUE 0x11EC8 KwUw 65535 dez 0 65535 FORMAT "%8.2" /end CHARACTERISTIC
/begin CHARACTERISTIC FFTMILE "Freeze Frame Tabelle: MIL-Endstufe" VAL_BLK 0x1017E KwbUb 255 dez 0 255 FORMAT "%5.1" NUMBER 2 /end CHARACTERISTIC
/begin CHARACTERISTIC CDTKPE "Codewort Tester: EKP-Relais Endstufe" VALUE 0x11F0C KwUw 65535 dez 0 65535 FORMAT "%8.2" /end CHARACTERISTIC
/begin CHARACTERISTIC CLAKPE "Fehlerklasse: EKP-Relais Endstufe" VALUE 0x10124 KwUb 255 dez 0 255 FORMAT "%5.1" /end CHARACTERISTIC
/begin CHARACTERISTIC TSFKPE "Fehlersummenzeit: EKP-Relais Endstufe" VALUE 0x101AE KwUb 255 dez 0 255 FORMAT "%5.1" /end CHARACTERISTIC
/begin CHARACTERISTIC CDKKPE "Codewort Kunde: EKP-Relais Endstufe" VALUE 0x11EB0 KwUw 65535 dez 0 65535 FORMAT "%8.2" /end CHARACTERISTIC
/begin CHARACTERISTIC FFTKPE "Freeze Frame Tabelle: EKP-Relais Endstufe" VAL_BLK 0x10166 KwbUb 255 dez 0 255 FORMAT "%5.1" NUMBER 2 /end CHARACTERISTIC
/begin CHARACTERISTIC CDTOLLAE "Codewort Tester: Endstufe Ölwarnlampe" VALUE 0x11F2A KwUw 65535 dez 0 65535 FORMAT "%8.2" /end CHARACTERISTIC
/begin CHARACTERISTIC CLAOLLAE "Fehlerklasse: Endstufe Ölwarnlampe" VALUE 0x10133 KwUb 255 dez 0 255 FORMAT "%5.1" /end CHARACTERISTIC
/begin CHARACTERISTIC TSFOLLAE "Fehlersummenzeit: Endstufe Ölwarnlampe" VALUE 0x101BD KwUb 255 dez 0 255 FORMAT "%5.1" /end CHARACTERISTIC
/begin CHARACTERISTIC CDKOLLAE "Codewort Kunde: Endstufe Ölwarnlampe" VALUE 0x11ECE KwUw 65535 dez 0 65535 FORMAT "%8.2" /end CHARACTERISTIC
/begin CHARACTERISTIC FFTOLLAE "Freeze Frame Tabelle: Endstufe Ölwarnlampe" VAL_BLK 0x10184 KwbUb 255 dez 0 255 FORMAT "%5.1" NUMBER 2 /end CHARACTERISTIC
/begin CHARACTERISTIC CDTSHLAE "Codewort Tester: Endstufe Schaltlampe" VALUE 0x11F2E KwUw 65535 dez 0 65535 FORMAT "%8.2" /end CHARACTERISTIC
/begin CHARACTERISTIC CLASHLAE "Fehlerklasse: Endstufe Schaltlampe" VALUE 0x10135 KwUb 255 dez 0 255 FORMAT "%5.1" /end CHARACTERISTIC
/begin CHARACTERISTIC TSFSHLAE "Fehlersummenzeit: Endstufe Schaltlampe" VALUE 0x101BF KwUb 255 dez 0 255 FORMAT "%5.1" /end CHARACTERISTIC
/begin CHARACTERISTIC CDKSHLAE "Codewort Kunde: Endstufe Schaltlampe" VALUE 0x11ED2 KwUw 65535 dez 0 65535 FORMAT "%8.2" /end CHARACTERISTIC
/begin CHARACTERISTIC FFTSHLAE "Freeze Frame Tabelle: Endstufe Schaltlampe" VAL_BLK 0x10188 KwbUb 255 dez 0 255 FORMAT "%5.1" NUMBER 2 /end CHARACTERISTIC
/begin CHARACTERISTIC CDTMILSE "Codewort Tester: Endstufe kundenspezifische Fehlerlampe" VALUE 0x11F26 KwUw 65535 dez 0 65535 FORMAT "%8.2" /end CHARACTERISTIC
/begin CHARACTERISTIC CLAMILSE "Fehlerklasse: Endstufe kundenspezifische Fehlerlampe" VALUE 0x10131 KwUb 255 dez 0 255 FORMAT "%5.1" /end CHARACTERISTIC
/begin CHARACTERISTIC TSFMILSE "Fehlersummenzeit: Endstufe kundenspezifische Fehlerlampe" VALUE 0x101BB KwUb 255 dez 0 255 FORMAT "%5.1" /end CHARACTERISTIC
/begin CHARACTERISTIC CDKMILSE "Codewort Kunde: Endstufe kundenspezifische Fehlerlampe" VALUE 0x11ECA KwUw 65535 dez 0 65535 FORMAT "%8.2" /end CHARACTERISTIC
/begin CHARACTERISTIC FFTMILSE "Freeze Frame Tabelle: Endstufe kundenspezifische Fehlerlampe" VAL_BLK 0x10180 KwbUb 255 dez 0 255 FORMAT "%5.1" NUMBER 2 /end CHARACTERISTIC
/begin CHARACTERISTIC CDTDSU "Codewort Tester: Drucksensor Umgebung" VALUE 0x11EF6 KwUw 65535 dez 0 65535 FORMAT "%8.2" /end CHARACTERISTIC
/begin CHARACTERISTIC CLADSU "Fehlerklasse: Umgebungsdrucksensor" VALUE 0x10119 KwUb 255 dez 0 255 FORMAT "%5.1" /end CHARACTERISTIC
/begin CHARACTERISTIC TSFDSU "Fehlersummenzeit: Drucksensor Umgebung" VALUE 0x101A3 KwUb 255 dez 0 255 FORMAT "%5.1" /end CHARACTERISTIC
/begin CHARACTERISTIC CDKDSU "Codewort Kunde: Drucksensor Umgebung" VALUE 0x11E9A KwUw 65535 dez 0 65535 FORMAT "%8.2" /end CHARACTERISTIC
/begin CHARACTERISTIC FFTDSU "Freeze Frame Tabelle: Umgebungsdrucksensor" VAL_BLK 0x10150 KwbUb 255 dez 0 255 FORMAT "%5.1" NUMBER 2 /end CHARACTERISTIC
/begin CHARACTERISTIC CDTDSL "Codewort Tester: Drucksensor Ladedruck" VALUE 0x11EF0 KwUw 65535 dez 0 65535 FORMAT "%8.2" /end CHARACTERISTIC
/begin CHARACTERISTIC CLADSL "Fehlerklasse: Druchsensor Ladedruck" VALUE 0x10116 KwUb 255 dez 0 255 FORMAT "%5.1" /end CHARACTERISTIC
/begin CHARACTERISTIC TSFDSL "Fehlersummenzeit: Drucksensor Ladedruck" VALUE 0x101A0 KwUb 255 dez 0 255 FORMAT "%5.1" /end CHARACTERISTIC
/begin CHARACTERISTIC CDKDSL "Codewort Kunde: Drucksensor Ladedruck" VALUE 0x11E94 KwUw 65535 dez 0 65535 FORMAT "%8.2" /end CHARACTERISTIC
/begin CHARACTERISTIC FFTDSL "Freeze Frame Tabelle: Drucksensor Ladedruck" VAL_BLK 0x1014A KwbUb 255 dez 0 255 FORMAT "%5.1" NUMBER 2 /end CHARACTERISTIC
/begin CHARACTERISTIC CDTDSVLU "Codewort Tester: Drucksensorsignalvergleich (DS-L DS-U)" VALUE 0x11EF8 KwUw 65535 dez 0 65535 FORMAT "%8.2" /end CHARACTERISTIC
/begin CHARACTERISTIC CLADSVLU "Fehlerklasse: Drucksensorsignalvergleich (DS-L DS-U)" VALUE 0x1011A KwUb 255 dez 0 255 FORMAT "%5.1" /end CHARACTERISTIC
/begin CHARACTERISTIC TSFDSVLU "Fehlersummenzeit: Drucksensorsignalvergleich (DS-L DS-U)" VALUE 0x101A4 KwUb 255 dez 0 255 FORMAT "%5.1" /end CHARACTERISTIC
/begin CHARACTERISTIC CDKDSVLU "Codewort Kunde: Drucksensorsignalvergleich (DS-L DS-U)" VALUE 0x11E9C KwUw 65535 dez 0 65535 FORMAT "%8.2" /end CHARACTERISTIC
/begin CHARACTERISTIC FFTDSVLU "Freeze Frame Tabelle: Drucksensorsignalvergleich (DS-L DS-U)" VAL_BLK 0x10152 KwbUb 255 dez 0 255 FORMAT "%5.1" NUMBER 2 /end CHARACTERISTIC
/begin CHARACTERISTIC ANZTIBMX "Begrenzung ti-Einspritzzähler \"anztib_w\"" VALUE 0x127A4 KwUw 50176 dez 0 50176 FORMAT "%8.2" /end CHARACTERISTIC
/begin CHARACTERISTIC ZDGZA1 "Zündungszahl Abregelung Bereich 1" VALUE 0x105A4 KwUb 255 dez 0 255 FORMAT "%5.1" /end CHARACTERISTIC
/begin CHARACTERISTIC ZDGZA2 "Zündungszahl Abregelung Bereich 2" VALUE 0x105A5 KwUb 255 dez 0 255 FORMAT "%5.1" /end CHARACTERISTIC
/begin CHARACTERISTIC FNSMXTM "maximale Nachstartanhebung" CURVE 0x1051F KlAUbSstUbWUb 7.96875 fak_ub_b8 0 7.96875 FORMAT "%5.3"
 /begin AXIS_DESCR STD_AXIS tmst temp_ub_q0p75_o48 4 -48 143.25 DEPOSIT ABSOLUTE /end AXIS_DESCR
/end CHARACTERISTIC
/begin CHARACTERISTIC FNSSM "Nachstartanhebung" CURVE 0x10528 GklWUb 3.98438 fak_ub_b4 0 3.98438 FORMAT "%5.3"
 /begin AXIS_DESCR COM_AXIS tmst temp_ub_q0p75_o48 12 -48 143.25 AXIS_PTS_REF STS12ESUB /end AXIS_DESCR
/end CHARACTERISTIC
/begin CHARACTERISTIC SZANSSM "Absteuerungsfaktorumschaltschwelle für Nachstartfaktor" CURVE 0x10558 GklWUb 0.996094 fak_ub_b1 0 0.996094 FORMAT "%5.3"
 /begin AXIS_DESCR COM_AXIS tmst temp_ub_q0p75_o48 12 -48 143.25 AXIS_PTS_REF STS12ESUB /end AXIS_DESCR
/end CHARACTERISTIC
/begin CHARACTERISTIC FZANSSM1 "Faktor für zündsynchrone Abregelung des Nachstartfaktors oberhalb Schwelle" CURVE 0x10540 GklWUb 0.249023 fak_ub_b0p25 0 0.249023 FORMAT "%5.3"
 /begin AXIS_DESCR COM_AXIS tmst temp_ub_q0p75_o48 12 -48 143.25 AXIS_PTS_REF STS12ESUB /end AXIS_DESCR
/end CHARACTERISTIC
/begin CHARACTERISTIC FZANSSM2 "Faktor für zündsynchrone Abregelung des Nachstartfaktors unterhalb Schwelle" CURVE 0x1054C GklWUb 0.249023 fak_ub_b0p25 0 0.249023 FORMAT "%5.3"
 /begin AXIS_DESCR COM_AXIS tmst temp_ub_q0p75_o48 12 -48 143.25 AXIS_PTS_REF STS12ESUB /end AXIS_DESCR
/end CHARACTERISTIC
/begin CHARACTERISTIC FNSA "Nachstartanhebung" CURVE 0x10519 GklWUb 1.99219 fak_ub_b2 0 1.99219 FORMAT "%5.3"
 /begin AXIS_DESCR COM_AXIS tans temp_ub_q0p75_o48 6 -48 143.25 AXIS_PTS_REF STA06ESUB /end AXIS_DESCR
/end CHARACTERISTIC
/begin CHARACTERISTIC FZANSSA1 "Faktor für zündsynchrone Abregelung des Nachstartfaktors bei Heißstart Bereich 1" CURVE 0x10534 GklWUb 0.249023 fak_ub_b0p25 0 0.249023 FORMAT "%5.3"
 /begin AXIS_DESCR COM_AXIS tans temp_ub_q0p75_o48 6 -48 143.25 AXIS_PTS_REF STA06ESUB /end AXIS_DESCR
/end CHARACTERISTIC
/begin CHARACTERISTIC FZANSSA2 "Faktor für zündsynchrone Abregelung des Nachstartfaktors bei Heißstart Bereich 2" CURVE 0x1053A GklWUb 0.249023 fak_ub_b0p25 0 0.249023 FORMAT "%5.3"
 /begin AXIS_DESCR COM_AXIS tans temp_ub_q0p75_o48 6 -48 143.25 AXIS_PTS_REF STA06ESUB /end AXIS_DESCR
/end CHARACTERISTIC
/begin CHARACTERISTIC KFNSWRL "Wichtung Nachstartanhebung" MAP 0x10564 KfAxUbAyUbSstxUbSstyUbWUb 1.99219 fak_ub_b2 0 1.99219 FORMAT "%5.3"
 /begin AXIS_DESCR STD_AXIS tmst temp_ub_q0p75_o48 8 -48 143.25 DEPOSIT ABSOLUTE /end AXIS_DESCR
 /begin AXIS_DESCR STD_AXIS rl rel_ub_q0p75 6 0 191.25 DEPOSIT ABSOLUTE /end AXIS_DESCR
/end CHARACTERISTIC
/begin CHARACTERISTIC KFLANS "Kennfeld Lambda-Motor-Beschreibung im Nachstart" MAP 0x127A6 GkfWUw 15.8999 fak_uw_b16 0.0998535 15.9998 FORMAT "%8.5"
 /begin AXIS_DESCR COM_AXIS tmst temp_ub_q0p75_o48 12 -48 143.25 AXIS_PTS_REF STS12ESUB /end AXIS_DESCR
 /begin AXIS_DESCR COM_AXIS anztib_w dez 12 0 65535 AXIS_PTS_REF SAN12ESUW /end AXIS_DESCR
/end CHARACTERISTIC
/begin CHARACTERISTIC TMH "Motortemperatur - Schwelle heiß" VALUE 0x10665 KwUb 191.25 temp_ub_q0p75_o48 -48 143.25 FORMAT "%5.1" /end CHARACTERISTIC
/begin CHARACTERISTIC TMHSG "Motortemperatur Heißstartgrenze" VALUE 0x10666 KwUb 191.25 temp_ub_q0p75_o48 -48 143.25 FORMAT "%5.1" /end CHARACTERISTIC
/begin CHARACTERISTIC IMLHS "Luftmassenintegral Heißstart" VALUE 0x105D5 KwUb 23.2107 m_ub_b23p3 0 23.2107 FORMAT "%5.2" /end CHARACTERISTIC
/begin CHARACTERISTIC FKSTT "Faktor Kaltstart" CURVE 0x105BC KlAUbSstUbWUb 63.75 fak_ub_b64 0 63.75 FORMAT "%5.2"
 /begin AXIS_DESCR STD_AXIS tmst temp_ub_q0p75_o48 12 -48 143.25 DEPOSIT ABSOLUTE /end AXIS_DESCR
/end CHARACTERISTIC
/begin CHARACTERISTIC FHSTT "Faktor Heißstart" CURVE 0x105A6 KlAUbSstUbWUb 63.75 fak_ub_b64 0 63.75 FORMAT "%5.2"
 /begin AXIS_DESCR STD_AXIS tans temp_ub_q0p75_o48 6 -48 143.25 DEPOSIT ABSOLUTE /end AXIS_DESCR
/end CHARACTERISTIC
/begin CHARACTERISTIC TANDT "Schwelle Temperaturdifferenz Ansaugluft für Heißstart" CURVE 0x10654 KlAUbSstUbWUb 191.25 temp_ub_b191p25 0 191.25 FORMAT "%5.1"
 /begin AXIS_DESCR STD_AXIS tansab temp_ub_q0p75_o48 8 -48 143.25 DEPOSIT ABSOLUTE /end AXIS_DESCR
/end CHARACTERISTIC
/begin CHARACTERISTIC TWSTT "Schwelle Abstellzeit für Wiederholstart" CURVE 0x10667 KlAUbSstUbWUb 255 t1sxs_ub_b255 0 255 FORMAT "%5.1"
 /begin AXIS_DESCR STD_AXIS tmotab temp_ub_q0p75_o48 12 -48 143.25 DEPOSIT ABSOLUTE /end AXIS_DESCR
/end CHARACTERISTIC
/begin CHARACTERISTIC FKFVHO "Wichtungsfaktor für fst_w" CURVE 0x105B3 KlAUbSstUbWUb 1.99219 fak_ub_b2 0 1.99219 FORMAT "%5.3" /begin AXIS_DESCR STD_AXIS fho fak_ub_b4 4 0 3.98438 DEPOSIT ABSOLUTE /end AXIS_DESCR /end CHARACTERISTIC
/begin CHARACTERISTIC KFWHSTT "Wichtungskennfeld Heißstart" MAP 0x105D6 KfAxUbAyUbSstxUbSstyUbWUb 1.99219 fak_ub_b2 0 1.99219 FORMAT "%5.3"
 /begin AXIS_DESCR STD_AXIS tans temp_ub_q0p75_o48 6 -48 143.25 DEPOSIT ABSOLUTE /end AXIS_DESCR
 /begin AXIS_DESCR STD_AXIS anzti dez 6 0 255 DEPOSIT ABSOLUTE /end AXIS_DESCR
/end CHARACTERISTIC
/begin CHARACTERISTIC KFWKSTT "Wichtungskennfeld Kaltstart" MAP 0x10622 KfAxUbAyUbSstxUbSstyUbWUb 1.99219 fak_ub_b2 0 1.99219 FORMAT "%5.3"
 /begin AXIS_DESCR STD_AXIS tmst temp_ub_q0p75_o48 6 -48 143.25 DEPOSIT ABSOLUTE /end AXIS_DESCR
 /begin AXIS_DESCR STD_AXIS anzti dez 6 0 255 DEPOSIT ABSOLUTE /end AXIS_DESCR
/end CHARACTERISTIC
/begin CHARACTERISTIC KFWKSTN "Wichtungskennfeld Kaltstart" MAP 0x10608 KfAxUbAyUbSstxUbSstyUbWUb 0.996094 fak_ub_b1 0 0.996094 FORMAT "%5.3"
 /begin AXIS_DESCR STD_AXIS tmst temp_ub_q0p75_o48 4 -48 143.25 DEPOSIT ABSOLUTE /end AXIS_DESCR
 /begin AXIS_DESCR STD_AXIS nmot nmot_ub_q40 4 0 10200 DEPOSIT ABSOLUTE /end AXIS_DESCR
/end CHARACTERISTIC
/begin CHARACTERISTIC CDTTA "Codewort Tester: TANS" VALUE 0x11F30 KwUw 65535 dez 0 65535 FORMAT "%8.2" /end CHARACTERISTIC
/begin CHARACTERISTIC CLATA "Fehlerklasse: Ansauglufttemperatur TANS (/Ladeluft-)" VALUE 0x10136 KwUb 255 dez 0 255 FORMAT "%5.1" /end CHARACTERISTIC
/begin CHARACTERISTIC TSFTA "Fehlersummenzeit: Ansauglufttemperatur TANS" VALUE 0x101C0 KwUb 255 dez 0 255 FORMAT "%5.1" /end CHARACTERISTIC
/begin CHARACTERISTIC CDKTA "Codewort Kunde:	TANS" VALUE 0x11ED4 KwUw 65535 dez 0 65535 FORMAT "%8.2" /end CHARACTERISTIC
/begin CHARACTERISTIC FFTTA "Freeze Frame Tabelle: Ansauglufttemperatur TANS (/Ladeluft-)" VAL_BLK 0x1018A KwbUb 255 dez 0 255 FORMAT "%5.1" NUMBER 2 /end CHARACTERISTIC
/begin CHARACTERISTIC CDTTM "Codewort Tester: TMOT" VALUE 0x11F34 KwUw 65535 dez 0 65535 FORMAT "%8.2" /end CHARACTERISTIC
/begin CHARACTERISTIC CLATM "Fehlerklasse: Motortemperatur TMOT" VALUE 0x10138 KwUb 255 dez 0 255 FORMAT "%5.1" /end CHARACTERISTIC
/begin CHARACTERISTIC TSFTM "Fehlersummenzeit: Motortemperatur TMOT" VALUE 0x101C2 KwUb 255 dez 0 255 FORMAT "%5.1" /end CHARACTERISTIC
/begin CHARACTERISTIC CDKTM "Codewort Kunde: TMOT" VALUE 0x11ED8 KwUw 65535 dez 0 65535 FORMAT "%8.2" /end CHARACTERISTIC
/begin CHARACTERISTIC FFTTM "Freeze Frame Tabelle: Motortemperatur TMOT" VAL_BLK 0x1018E KwbUb 255 dez 0 255 FORMAT "%5.1" NUMBER 2 /end CHARACTERISTIC
/begin CHARACTERISTIC CDKRNT "Codewort: KR-Diagnose Integratorsteigung" VALUE 0x10CEF KwUb 255 dez 0 255 FORMAT "%5.1" /end CHARACTERISTIC
/begin CHARACTERISTIC CDKROF "Codewort: KR-Diagnose Resetwert" VALUE 0x10CF0 KwUb 255 dez 0 255 FORMAT "%5.1" /end CHARACTERISTIC
/begin CHARACTERISTIC DKRISNT "Grenzwert der Integratorsteigung für Nulltest" VALUE 0x12CA0 KwUw 6103.43 spgg_sw_b3052 0 6103.43 FORMAT "%8.3" /end CHARACTERISTIC
/begin CHARACTERISTIC DKROKU "Untere Drehzahlschwelle für Ermittlung Offsetkompensationswert" VALUE 0x10CF1 KwUb 10200 nmot_ub_q40 0 10200 FORMAT "%5.0" /end CHARACTERISTIC
/begin CHARACTERISTIC KRFHT "Fehlerhäufigkeit Testimpuls" VALUE 0x10CF2 KwUb 254 dez 1 255 FORMAT "%5.1" /end CHARACTERISTIC
/begin CHARACTERISTIC UDKRGOFS "Spannungsschwelle für DIA/KR Grundoffset Verstärker" VALUE 0x10CF3 KwUb 5 spg_ub_b5 0 5 FORMAT "%5.3" /end CHARACTERISTIC
/begin CHARACTERISTIC CDTKRNT "Codewort Tester: Klopfregelung Nulltest" VALUE 0x11F0E KwUw 65535 dez 0 65535 FORMAT "%8.2" /end CHARACTERISTIC
/begin CHARACTERISTIC CLAKRNT "Fehlerklasse: Klopfregelung Nulltest" VALUE 0x10125 KwUb 255 dez 0 255 FORMAT "%5.1" /end CHARACTERISTIC
/begin CHARACTERISTIC TSFKRNT "Fehlersummenzeit: Klopfregelung Nulltest" VALUE 0x101AF KwUb 255 dez 0 255 FORMAT "%5.1" /end CHARACTERISTIC
/begin CHARACTERISTIC CDKKRNT "Codewort Kunde:	Klopfregelung Nulltest" VALUE 0x11EB2 KwUw 65535 dez 0 65535 FORMAT "%8.2" /end CHARACTERISTIC
/begin CHARACTERISTIC FFTKRNT "Freeze frame Tabelle: Klopfregelung Nulltest" VAL_BLK 0x10168 KwbUb 255 dez 0 255 FORMAT "%5.1" NUMBER 2 /end CHARACTERISTIC
/begin CHARACTERISTIC CDTKROF "Codewort Tester: Klopfregelung Offset" VALUE 0x11F10 KwUw 65535 dez 0 65535 FORMAT "%8.2" /end CHARACTERISTIC
/begin CHARACTERISTIC CLAKROF "Fehlerklasse: Klopfreglung Offset" VALUE 0x10126 KwUb 255 dez 0 255 FORMAT "%5.1" /end CHARACTERISTIC
/begin CHARACTERISTIC TSFKROF "Fehlersummenzeit: Klopfregelung Offset" VALUE 0x101B0 KwUb 255 dez 0 255 FORMAT "%5.1" /end CHARACTERISTIC
/begin CHARACTERISTIC CDKKROF "Codewort Kunde:	Klopfregelung Offset" VALUE 0x11EB4 KwUw 65535 dez 0 65535 FORMAT "%8.2" /end CHARACTERISTIC
/begin CHARACTERISTIC FFTKROF "Freeze Frame Tabelle: Klopfregelung Offset" VAL_BLK 0x1016A KwbUb 255 dez 0 255 FORMAT "%5.1" NUMBER 2 /end CHARACTERISTIC
/begin CHARACTERISTIC KRFHKS "Fehlerhäufigkeit Klopfsensoren" VALUE 0x10CF8 KwUb 255 dez 0 255 FORMAT "%5.1" /end CHARACTERISTIC
/begin CHARACTERISTIC CDKS1 "Codewort: Klopfsensordiagnose Sensor1" VALUE 0x10CF4 KwUb 255 dez 0 255 FORMAT "%5.1" /end CHARACTERISTIC
/begin CHARACTERISTIC CDKS2 "Codewort: Klopfsensordiagnose Sensor 2" VALUE 0x10CF5 KwUb 255 dez 0 255 FORMAT "%5.1" /end CHARACTERISTIC
/begin CHARACTERISTIC CDKS3 "Codewort: Klopfsensordiagnose Sensor 3" VALUE 0x10CF6 KwUb 255 dez 0 255 FORMAT "%5.1" /end CHARACTERISTIC
/begin CHARACTERISTIC CDKS4 "Codewort: Klopfsensordiagnose Sensor 4" VALUE 0x10CF7 KwUb 255 dez 0 255 FORMAT "%5.1" /end CHARACTERISTIC
/begin CHARACTERISTIC NDKS "Drehzahlschwelle für Dia KS" VALUE 0x10CF9 KwUb 10200 nmot_ub_q40 0 10200 FORMAT "%5.0" /end CHARACTERISTIC
/begin CHARACTERISTIC UDKSNO "Obere Referenzspannungsschwelle DIA KS" CURVE 0x12CA2 GklWUw 319.981 spg_uw_b1280 0 319.981 FORMAT "%8.4"
 /begin AXIS_DESCR COM_AXIS nmot nmot_ub_q40 16 0 10200 AXIS_PTS_REF SNM16KRUB /end AXIS_DESCR
/end CHARACTERISTIC
/begin CHARACTERISTIC UDKSNU "untere Referenzspannungsschwelle DIA KS" CURVE 0x12CC2 GklWUw 319.981 spg_uw_b1280 0 319.981 FORMAT "%8.4"
 /begin AXIS_DESCR COM_AXIS nmot nmot_ub_q40 16 0 10200 AXIS_PTS_REF SNM16KRUB /end AXIS_DESCR
/end CHARACTERISTIC
/begin CHARACTERISTIC CDTKS1 "Codewort Tester: Klopfsensor 1" VALUE 0x11F14 KwUw 65535 dez 0 65535 FORMAT "%8.2" /end CHARACTERISTIC
/begin CHARACTERISTIC CLAKS1 "Fehlerklasse: Klopfsensor 1" VALUE 0x10128 KwUb 255 dez 0 255 FORMAT "%5.1" /end CHARACTERISTIC
/begin CHARACTERISTIC TSFKS1 "Fehlersummenzeit: Klopfsensor 1" VALUE 0x101B2 KwUb 255 dez 0 255 FORMAT "%5.1" /end CHARACTERISTIC
/begin CHARACTERISTIC CDKKS1 "Codewort Kunde:	Klopfsensor 1" VALUE 0x11EB8 KwUw 65535 dez 0 65535 FORMAT "%8.2" /end CHARACTERISTIC
/begin CHARACTERISTIC FFTKS1 "Freeze Frame Tabelle: Klopfsensor 1" VAL_BLK 0x1016E KwbUb 255 dez 0 255 FORMAT "%5.1" NUMBER 2 /end CHARACTERISTIC
/begin CHARACTERISTIC CDTKS2 "Codewort Tester: Klopfsensor 2" VALUE 0x11F16 KwUw 65535 dez 0 65535 FORMAT "%8.2" /end CHARACTERISTIC
/begin CHARACTERISTIC CLAKS2 "Fehlerklasse: Klopfsensor 2" VALUE 0x10129 KwUb 255 dez 0 255 FORMAT "%5.1" /end CHARACTERISTIC
/begin CHARACTERISTIC TSFKS2 "Fehlersummenzeit: Klopfsensor 2" VALUE 0x101B3 KwUb 255 dez 0 255 FORMAT "%5.1" /end CHARACTERISTIC
/begin CHARACTERISTIC CDKKS2 "Codewort Kunde:	Klopfsensor 2" VALUE 0x11EBA KwUw 65535 dez 0 65535 FORMAT "%8.2" /end CHARACTERISTIC
/begin CHARACTERISTIC FFTKS2 "Freeze Frame Tabelle: Klopfsensor 2" VAL_BLK 0x10170 KwbUb 255 dez 0 255 FORMAT "%5.1" NUMBER 2 /end CHARACTERISTIC
/begin CHARACTERISTIC CDTKS3 "Codewort Tester: Klopfsensor 3" VALUE 0x11F18 KwUw 65535 dez 0 65535 FORMAT "%8.2" /end CHARACTERISTIC
/begin CHARACTERISTIC CLAKS3 "Fehlerklasse: Klopfsensor 3" VALUE 0x1012A KwUb 255 dez 0 255 FORMAT "%5.1" /end CHARACTERISTIC
/begin CHARACTERISTIC TSFKS3 "Fehlersummenzeit: Klopfsensor 3" VALUE 0x101B4 KwUb 255 dez 0 255 FORMAT "%5.1" /end CHARACTERISTIC
/begin CHARACTERISTIC CDKKS3 "Codewort Kunde:	Klopfsensor 3" VALUE 0x11EBC KwUw 65535 dez 0 65535 FORMAT "%8.2" /end CHARACTERISTIC
/begin CHARACTERISTIC FFTKS3 "Freeze Frame Tabelle: Klopfsensor 3" VAL_BLK 0x10172 KwbUb 255 dez 0 255 FORMAT "%5.1" NUMBER 2 /end CHARACTERISTIC
/begin CHARACTERISTIC CDTKS4 "Codewort Tester: Klopfsensor 4" VALUE 0x11F1A KwUw 65535 dez 0 65535 FORMAT "%8.2" /end CHARACTERISTIC
/begin CHARACTERISTIC CLAKS4 "Fehlerklasse: Klopfsensor 4" VALUE 0x1012B KwUb 255 dez 0 255 FORMAT "%5.1" /end CHARACTERISTIC
/begin CHARACTERISTIC TSFKS4 "Fehlersummenzeit: Klopfsensor 4" VALUE 0x101B5 KwUb 255 dez 0 255 FORMAT "%5.1" /end CHARACTERISTIC
/begin CHARACTERISTIC CDKKS4 "Codewort Kunde:	Klopfsensor 4" VALUE 0x11EBE KwUw 65535 dez 0 65535 FORMAT "%8.2" /end CHARACTERISTIC
/begin CHARACTERISTIC FFTKS4 "Freeze Frame Tabelle: Klopfsensor 4" VAL_BLK 0x10174 KwbUb 255 dez 0 255 FORMAT "%5.1" NUMBER 2 /end CHARACTERISTIC
/begin CHARACTERISTIC CDKRTP "Codewort: KR-Diagnose Testimpuls" VALUE 0x10CFA KwUb 255 dez 0 255 FORMAT "%5.1" /end CHARACTERISTIC
/begin CHARACTERISTIC UDKRTP "Integratorspannungsschwelle für Dia KS - Auswerteschaltung Testimpuls" VALUE 0x10CFB KwUb 5 spg_ub_b5 0 5 FORMAT "%5.3" /end CHARACTERISTIC
/begin CHARACTERISTIC CDTKRTP "Codewort Tester: Klopfregelung Testimpuls" VALUE 0x11F12 KwUw 65535 dez 0 65535 FORMAT "%8.2" /end CHARACTERISTIC
/begin CHARACTERISTIC CLAKRTP "Fehlerklasse: Klopfregelung Testimpuls" VALUE 0x10127 KwUb 255 dez 0 255 FORMAT "%5.1" /end CHARACTERISTIC
/begin CHARACTERISTIC TSFKRTP "Fehlersummenzeit: Klopfregelung Testimpuls" VALUE 0x101B1 KwUb 255 dez 0 255 FORMAT "%5.1" /end CHARACTERISTIC
/begin CHARACTERISTIC CDKKRTP "Codewort Kunde: Klopfregelung Testimpuls" VALUE 0x11EB6 KwUw 65535 dez 0 65535 FORMAT "%8.2" /end CHARACTERISTIC
/begin CHARACTERISTIC FFTKRTP "Freeze Frame Tabelle: Klopfregelung Testimpuls" VAL_BLK 0x1016C KwbUb 255 dez 0 255 FORMAT "%5.1" NUMBER 2 /end CHARACTERISTIC
/begin CHARACTERISTIC CDTLAP "Codewort Tester: Laptriggersignal" VALUE 0x11F1C KwUw 65535 dez 0 65535 FORMAT "%8.2" /end CHARACTERISTIC
/begin CHARACTERISTIC CLALAP "Fehlerklasse: Laptriggersignal" VALUE 0x1012C KwUb 255 dez 0 255 FORMAT "%5.1" /end CHARACTERISTIC
/begin CHARACTERISTIC TSFLAP "Fehlersummenzeit: Laptriggersignal" VALUE 0x101B6 KwUb 255 dez 0 255 FORMAT "%5.1" /end CHARACTERISTIC
/begin CHARACTERISTIC CDKLAP "Codewort Kunde: Laptriggersignal" VALUE 0x11EC0 KwUw 65535 dez 0 65535 FORMAT "%8.2" /end CHARACTERISTIC
/begin CHARACTERISTIC FFTLAP "Freeze Frame Tabelle: Laptriggersignal" VAL_BLK 0x10176 KwbUb 255 dez 0 255 FORMAT "%5.1" NUMBER 2 /end CHARACTERISTIC
/begin CHARACTERISTIC CDTGSH "Codewort Tester: Anforderung Getriebeschaltfunktion" VALUE 0x11F06 KwUw 65535 dez 0 65535 FORMAT "%8.2" /end CHARACTERISTIC
/begin CHARACTERISTIC CLAGSH "Fehlerklasse: Anforderung Getriebeschaltfunktion" VALUE 0x10121 KwUb 255 dez 0 255 FORMAT "%5.1" /end CHARACTERISTIC
/begin CHARACTERISTIC TSFGSH "Fehlersummenzeit: Anforderung Getriebeschaltfunktion" VALUE 0x101AB KwUb 255 dez 0 255 FORMAT "%5.1" /end CHARACTERISTIC
/begin CHARACTERISTIC CDKGSH "Codewort Kunde: Anforderung für Getriebeschaltfunktion" VALUE 0x11EAA KwUw 65535 dez 0 65535 FORMAT "%8.2" /end CHARACTERISTIC
/begin CHARACTERISTIC FFTGSH "Freeze Frame Tabelle: Anforderung Getriebeschaltfunktion" VAL_BLK 0x10160 KwbUb 255 dez 0 255 FORMAT "%5.1" NUMBER 2 /end CHARACTERISTIC
/begin CHARACTERISTIC TOVERTAKE "Dauer Overtakefunktion" VALUE 0x11128 KwUb 25.5 t100msxs_ub_b25p5 0 25.5 FORMAT "%5.2" /end CHARACTERISTIC
/begin CHARACTERISTIC TDMAP "Verzögerungszeit für Mapschalter" VALUE 0x11126 KwUb 25.5 t100msxs_ub_b25p5 0 25.5 FORMAT "%5.2" /end CHARACTERISTIC
/begin CHARACTERISTIC TDMAPOT "Verzögerungszeit für Mapschalter, Overtakefunktion" VALUE 0x11127 KwUb 25.5 t100msxs_ub_b25p5 0 25.5 FORMAT "%5.2" /end CHARACTERISTIC
/begin CHARACTERISTIC CDTDSOEL "Codewort Tester: Drucksensor Oel" VALUE 0x11EF2 KwUw 65535 dez 0 65535 FORMAT "%8.2" /end CHARACTERISTIC
/begin CHARACTERISTIC CLADSOEL "Fehlerklasse: Drucksensor Oel" VALUE 0x10117 KwUb 255 dez 0 255 FORMAT "%5.1" /end CHARACTERISTIC
/begin CHARACTERISTIC TSFDSOEL "Fehlersummenzeit: Drucksensor Oel" VALUE 0x101A1 KwUb 255 dez 0 255 FORMAT "%5.1" /end CHARACTERISTIC
/begin CHARACTERISTIC CDKDSOEL "Codewort Kunde: Drucksensor Oel" VALUE 0x11E96 KwUw 65535 dez 0 65535 FORMAT "%8.2" /end CHARACTERISTIC
/begin CHARACTERISTIC FFTDSOEL "Freeze Frame Tabelle: Drucksensor Oel" VAL_BLK 0x1014C KwbUb 255 dez 0 255 FORMAT "%5.1" NUMBER 2 /end CHARACTERISTIC
/begin CHARACTERISTIC CDTDSFUE "Codewort Tester: Drucksensor Kraftstoff" VALUE 0x11EEE KwUw 65535 dez 0 65535 FORMAT "%8.2" /end CHARACTERISTIC
/begin CHARACTERISTIC CLADSFUE "Fehlerklasse: Drucksensor Kraftstoff" VALUE 0x10115 KwUb 255 dez 0 255 FORMAT "%5.1" /end CHARACTERISTIC
/begin CHARACTERISTIC TSFDSFUE "Fehlersummenzeit: Drucksensor Kraftstoff" VALUE 0x1019F KwUb 255 dez 0 255 FORMAT "%5.1" /end CHARACTERISTIC
/begin CHARACTERISTIC CDKDSFUE "Codewort Kunde: Drucksensor Kraftstoff" VALUE 0x11E92 KwUw 65535 dez 0 65535 FORMAT "%8.2" /end CHARACTERISTIC
/begin CHARACTERISTIC FFTDSFUE "Freeze Frame Tabelle: Drucksensor Kraftstoff" VAL_BLK 0x10148 KwbUb 255 dez 0 255 FORMAT "%5.1" NUMBER 2 /end CHARACTERISTIC
/begin CHARACTERISTIC CDTTOL "Codewort Tester: Öltemperatur" VALUE 0x11F36 KwUw 65535 dez 0 65535 FORMAT "%8.2" /end CHARACTERISTIC
/begin CHARACTERISTIC CLATOL "Fehlerklasse: (Motor-) Oeltemperatur TOL" VALUE 0x10139 KwUb 255 dez 0 255 FORMAT "%5.1" /end CHARACTERISTIC
/begin CHARACTERISTIC TSFTOL "Fehlersummenzeit: Öltemperatur" VALUE 0x101C3 KwUb 255 dez 0 255 FORMAT "%5.1" /end CHARACTERISTIC
/begin CHARACTERISTIC CDKTOL "Codewort Kunde: Öltemperatur" VALUE 0x11EDA KwUw 65535 dez 0 65535 FORMAT "%8.2" /end CHARACTERISTIC
/begin CHARACTERISTIC FFTTOL "Freeze Frame Tabelle: (Motor-) Oeltemperatur TOL" VAL_BLK 0x10190 KwbUb 255 dez 0 255 FORMAT "%5.1" NUMBER 2 /end CHARACTERISTIC
/begin CHARACTERISTIC CDTTFUEL "Codewort Tester: Kraftstofftemperatur" VALUE 0x11F32 KwUw 65535 dez 0 65535 FORMAT "%8.2" /end CHARACTERISTIC
/begin CHARACTERISTIC CLATFUEL "" VALUE 0x10137 KwUb 255 dez 0 255 FORMAT "%5.1" /end CHARACTERISTIC
/begin CHARACTERISTIC TSFTFUEL "Fehlersummenzeit: Kraftstofftemperatur" VALUE 0x101C1 KwUb 255 dez 0 255 FORMAT "%5.1" /end CHARACTERISTIC
/begin CHARACTERISTIC CDKTFUEL "Codewort Kunde: Kraftstofftemperatur" VALUE 0x11ED6 KwUw 65535 dez 0 65535 FORMAT "%8.2" /end CHARACTERISTIC
/begin CHARACTERISTIC FFTTFUEL "Freeze Frame Tabelle: Kraftstofftemperatur" VAL_BLK 0x1018C KwbUb 255 dez 0 255 FORMAT "%5.1" NUMBER 2 /end CHARACTERISTIC
/begin CHARACTERISTIC CDTATS "Codewort Tester: Abgastemperatursensor" VALUE 0x11EE6 KwUw 65535 dez 0 65535 FORMAT "%8.2" /end CHARACTERISTIC
/begin CHARACTERISTIC CLAATS "Fehlerklasse Abgastemperatursensor" VALUE 0x10111 KwUb 255 dez 0 255 FORMAT "%5.1" /end CHARACTERISTIC
/begin CHARACTERISTIC TSFATS "Fehlerschwere Abgastemperatursensor" VALUE 0x1019B KwUb 255 dez 0 255 FORMAT "%5.1" /end CHARACTERISTIC
/begin CHARACTERISTIC CDKATS "Codewort Kunde: Abgastemperaturesensor" VALUE 0x11E8A KwUw 65535 dez 0 65535 FORMAT "%8.2" /end CHARACTERISTIC
/begin CHARACTERISTIC FFTATS "Tabelle der Umweltbed. Abgastemperatursensor" VAL_BLK 0x10140 KwbUb 255 dez 0 255 FORMAT "%5.1" NUMBER 2 /end CHARACTERISTIC
/begin CHARACTERISTIC CDTATS2 "Codewort Tester: Abgastemperatursensor Bank 2" VALUE 0x11EE8 KwUw 65535 dez 0 65535 FORMAT "%8.2" /end CHARACTERISTIC
/begin CHARACTERISTIC CLAATS2 "Fehlerklasse Abgastemperatursensor Bank 2" VALUE 0x10112 KwUb 255 dez 0 255 FORMAT "%5.1" /end CHARACTERISTIC
/begin CHARACTERISTIC TSFATS2 "Fehlerschwere Abgastemperatursensor Bank 2" VALUE 0x1019C KwUb 255 dez 0 255 FORMAT "%5.1" /end CHARACTERISTIC
/begin CHARACTERISTIC CDKATS2 "Codewort Kunde: Abgastemperatursensor bank 2" VALUE 0x11E8C KwUw 65535 dez 0 65535 FORMAT "%8.2" /end CHARACTERISTIC
/begin CHARACTERISTIC FFTATS2 "Tabelle der Umweltbed. Abgastemperatursensor Bank 2" VAL_BLK 0x10142 KwbUb 255 dez 0 255 FORMAT "%5.1" NUMBER 2 /end CHARACTERISTIC
/begin CHARACTERISTIC UBDLSMX "obere Batteriespannungsschwelle für die  Sonden-Diagnose" VALUE 0x11249 KwUb 17.3655 spg_ubatt 0 17.3655 FORMAT "%5.2" /end CHARACTERISTIC
/begin CHARACTERISTIC UBDLS "Batteriespannungsschwelle zur Freigabe der Sonden-Diagnose" VALUE 0x11248 KwUb 17.3655 spg_ubatt 0 17.3655 FORMAT "%5.2" /end CHARACTERISTIC
/begin CHARACTERISTIC DUMMYKL "" CURVE 0x11243 KlAUbSstUbWUb 255 temp_ub_q1_o40 -40 215 FORMAT "%5.1" /begin AXIS_DESCR STD_AXIS dummyram dez 2 0 255 DEPOSIT ABSOLUTE /end AXIS_DESCR /end CHARACTERISTIC
/begin CHARACTERISTIC CDTDSS "Codewort Tester: Saugrohr-Drucksensor" VALUE 0x11EF4 KwUw 65535 dez 0 65535 FORMAT "%8.2" /end CHARACTERISTIC
/begin CHARACTERISTIC CLADSS "Fehlerklasse: Saugrohrdrucksensor" VALUE 0x10118 KwUb 255 dez 0 255 FORMAT "%5.1" /end CHARACTERISTIC
/begin CHARACTERISTIC TSFDSS "Fehlersummenzeit: Saugrohr-Drucksensor" VALUE 0x101A2 KwUb 255 dez 0 255 FORMAT "%5.1" /end CHARACTERISTIC
/begin CHARACTERISTIC CDKDSS "Codewort Kunde: Saugrohr-Drucksensor" VALUE 0x11E98 KwUw 65535 dez 0 65535 FORMAT "%8.2" /end CHARACTERISTIC
/begin CHARACTERISTIC FFTDSS "Freeze Frame Tabelle: Saugrohrdrucksensor" VAL_BLK 0x1014E KwbUb 255 dez 0 255 FORMAT "%5.1" NUMBER 2 /end CHARACTERISTIC
/begin CHARACTERISTIC CDTTUM "Codewort Tester: Umgebungstemperatur TUM" VALUE 0x11F38 KwUw 65535 dez 0 65535 FORMAT "%8.2" /end CHARACTERISTIC
/begin CHARACTERISTIC CLATUM "Fehlerklasse: Umgebungstemperatur TUM" VALUE 0x1013A KwUb 255 dez 0 255 FORMAT "%5.1" /end CHARACTERISTIC
/begin CHARACTERISTIC TSFTUM "Fehlersummenzeit: Umgebungstemperatur TUM" VALUE 0x101C4 KwUb 255 dez 0 255 FORMAT "%5.1" /end CHARACTERISTIC
/begin CHARACTERISTIC CDKTUM "Codewort Kunde: Umgebungstemperatur" VALUE 0x11EDC KwUw 65535 dez 0 65535 FORMAT "%8.2" /end CHARACTERISTIC
/begin CHARACTERISTIC FFTTUM "Freeze Frame Tabelle: Umgebungstemperatur TUM" VAL_BLK 0x10192 KwbUb 255 dez 0 255 FORMAT "%5.1" NUMBER 2 /end CHARACTERISTIC
/begin MEASUREMENT anztib_w "ti-Einspritzzähler mit Begrenzung" UWORD dez 1 100 0 65535 FORMAT "%8.2" /begin IF_DATA ASAP1B_KWP2000 KP_BLOB 0x380BF0 EXTERN 0x2 /end IF_DATA /begin IF_DATA ETK KP_BLOB 0x380BF0 EXTERN 0x2 /end IF_DATA /end MEASUREMENT
/begin MEASUREMENT bbwuc "Byte für Bedingung B_wuc als Triggerevent in DCLA" UBYTE dez 1 100 0 255 FORMAT "%5.1" /begin IF_DATA ASAP1B_KWP2000 KP_BLOB 0x380344 EXTERN 0x1 /end IF_DATA /begin IF_DATA ETK KP_BLOB 0x380344 EXTERN 0x1 /end IF_DATA /end MEASUREMENT
/begin MEASUREMENT B_betfuel "Bedingung Bandendeanforderung für Kraftstofftemperatursensor" UWORD B_TRUE 1 100 0 1 BIT_MASK 0x20 FORMAT "%5.3" /begin IF_DATA ASAP1B_KWP2000 KP_BLOB 0x382AD2 EXTERN 0x2 /end IF_DATA /begin IF_DATA ETK KP_BLOB 0x382AD2 EXTERN 0x2 /end IF_DATA /end MEASUREMENT
/begin MEASUREMENT B_bkats "Bedingung Ersatzwert aktiv Abgastemperatursensor" UWORD B_TRUE 1 100 0 1 BIT_MASK 0x40 FORMAT "%5.3" /begin IF_DATA ASAP1B_KWP2000 KP_BLOB 0x382A86 EXTERN 0x2 /end IF_DATA /begin IF_DATA ETK KP_BLOB 0x382A86 EXTERN 0x2 /end IF_DATA /end MEASUREMENT
/begin MEASUREMENT B_bkats2 "Bedingung Ersatzwert aktiv Abgastemperatursensor Bank 2" UWORD B_TRUE 1 100 0 1 BIT_MASK 0x40 FORMAT "%5.3" /begin IF_DATA ASAP1B_KWP2000 KP_BLOB 0x382A88 EXTERN 0x2 /end IF_DATA /begin IF_DATA ETK KP_BLOB 0x382A88 EXTERN 0x2 /end IF_DATA /end MEASUREMENT
/begin MEASUREMENT B_bkdsfue "Bedingung Ersatzwert aktiv Drucksensor Kraftstoff" UWORD B_TRUE 1 100 0 1 BIT_MASK 0x40 FORMAT "%5.3" /begin IF_DATA ASAP1B_KWP2000 KP_BLOB 0x382A8E EXTERN 0x2 /end IF_DATA /begin IF_DATA ETK KP_BLOB 0x382A8E EXTERN 0x2 /end IF_DATA /end MEASUREMENT
/begin MEASUREMENT B_bkdsoel "Bedingung Ersatzwert aktiv Drucksensor Oel" UWORD B_TRUE 1 100 0 1 BIT_MASK 0x40 FORMAT "%5.3" /begin IF_DATA ASAP1B_KWP2000 KP_BLOB 0x382A92 EXTERN 0x2 /end IF_DATA /begin IF_DATA ETK KP_BLOB 0x382A92 EXTERN 0x2 /end IF_DATA /end MEASUREMENT
/begin MEASUREMENT B_bkgsh "Bedingung Ersatzwert für Getriebeschaltfunktion" UWORD B_TRUE 1 100 0 1 BIT_MASK 0x40 FORMAT "%5.3" /begin IF_DATA ASAP1B_KWP2000 KP_BLOB 0x382AA6 EXTERN 0x2 /end IF_DATA /begin IF_DATA ETK KP_BLOB 0x382AA6 EXTERN 0x2 /end IF_DATA /end MEASUREMENT
/begin MEASUREMENT B_bklap "Bedingung Ersatzwert für Laptriggererkennung" UWORD B_TRUE 1 100 0 1 BIT_MASK 0x40 FORMAT "%5.3" /begin IF_DATA ASAP1B_KWP2000 KP_BLOB 0x382ABC EXTERN 0x2 /end IF_DATA /begin IF_DATA ETK KP_BLOB 0x382ABC EXTERN 0x2 /end IF_DATA /end MEASUREMENT
/begin MEASUREMENT B_bkmilse "Bedingung Ersatzwert für Endstufe kundenspezifische Fehlerlampe" UWORD B_TRUE 1 100 0 1 BIT_MASK 0x40 FORMAT "%5.3" /begin IF_DATA ASAP1B_KWP2000 KP_BLOB 0x382AC6 EXTERN 0x2 /end IF_DATA /begin IF_DATA ETK KP_BLOB 0x382AC6 EXTERN 0x2 /end IF_DATA /end MEASUREMENT
/begin MEASUREMENT B_bkshlae "Bedingung Ersatzwert für Endstufe Schaltlampe" UWORD B_TRUE 1 100 0 1 BIT_MASK 0x40 FORMAT "%5.3" /begin IF_DATA ASAP1B_KWP2000 KP_BLOB 0x382ACE EXTERN 0x2 /end IF_DATA /begin IF_DATA ETK KP_BLOB 0x382ACE EXTERN 0x2 /end IF_DATA /end MEASUREMENT
/begin MEASUREMENT B_bkta "Bedingung Ersatzwert für Ansauglufttemperatur (/Ladelufttemp.)" UWORD B_TRUE 1 100 0 1 BIT_MASK 0x40 FORMAT "%5.3" /begin IF_DATA ASAP1B_KWP2000 KP_BLOB 0x382AD0 EXTERN 0x2 /end IF_DATA /begin IF_DATA ETK KP_BLOB 0x382AD0 EXTERN 0x2 /end IF_DATA /end MEASUREMENT
/begin MEASUREMENT B_bktfuel "Bedingung Ersatzwert für Kraftstofftemperatur (Back-up)" UWORD B_TRUE 1 100 0 1 BIT_MASK 0x40 FORMAT "%5.3" /begin IF_DATA ASAP1B_KWP2000 KP_BLOB 0x382AD2 EXTERN 0x2 /end IF_DATA /begin IF_DATA ETK KP_BLOB 0x382AD2 EXTERN 0x2 /end IF_DATA /end MEASUREMENT
/begin MEASUREMENT B_bktm "Bedingung Ersatzwert für Motortemperatur" UWORD B_TRUE 1 100 0 1 BIT_MASK 0x40 FORMAT "%5.3" /begin IF_DATA ASAP1B_KWP2000 KP_BLOB 0x382AD4 EXTERN 0x2 /end IF_DATA /begin IF_DATA ETK KP_BLOB 0x382AD4 EXTERN 0x2 /end IF_DATA /end MEASUREMENT
/begin MEASUREMENT B_bktol "Bedingung Ersatzwert für (Motor-)Oel-Temperatur" UWORD B_TRUE 1 100 0 1 BIT_MASK 0x40 FORMAT "%5.3" /begin IF_DATA ASAP1B_KWP2000 KP_BLOB 0x382AD6 EXTERN 0x2 /end IF_DATA /begin IF_DATA ETK KP_BLOB 0x382AD6 EXTERN 0x2 /end IF_DATA /end MEASUREMENT
/begin MEASUREMENT B_bkub "Bedingung Ersatzwert für Batteriespannung (Bordnetz)" UWORD B_TRUE 1 100 0 1 BIT_MASK 0x40 FORMAT "%5.3" /begin IF_DATA ASAP1B_KWP2000 KP_BLOB 0x382ADA EXTERN 0x2 /end IF_DATA /begin IF_DATA ETK KP_BLOB 0x382ADA EXTERN 0x2 /end IF_DATA /end MEASUREMENT
/begin MEASUREMENT B_clats "Bedingung: Fehler Abgastemperatursensor löschen" UWORD B_TRUE 1 100 0 1 BIT_MASK 0x80 FORMAT "%5.3" /begin IF_DATA ASAP1B_KWP2000 KP_BLOB 0x382A86 EXTERN 0x2 /end IF_DATA /begin IF_DATA ETK KP_BLOB 0x382A86 EXTERN 0x2 /end IF_DATA /end MEASUREMENT
/begin MEASUREMENT B_clats2 "Bedingung: Fehler Abgastemperatursensor Bank 2 löschen" UWORD B_TRUE 1 100 0 1 BIT_MASK 0x80 FORMAT "%5.3" /begin IF_DATA ASAP1B_KWP2000 KP_BLOB 0x382A88 EXTERN 0x2 /end IF_DATA /begin IF_DATA ETK KP_BLOB 0x382A88 EXTERN 0x2 /end IF_DATA /end MEASUREMENT
/begin MEASUREMENT B_cldsfue "Bedingung Fehlerpfad DSFUE löschen" UWORD B_TRUE 1 100 0 1 BIT_MASK 0x80 FORMAT "%5.3" /begin IF_DATA ASAP1B_KWP2000 KP_BLOB 0x382A8E EXTERN 0x2 /end IF_DATA /begin IF_DATA ETK KP_BLOB 0x382A8E EXTERN 0x2 /end IF_DATA /end MEASUREMENT
/begin MEASUREMENT B_cldsl "Bedingung: Fehlerpfad Ladedrucksensor löschen" UWORD B_TRUE 1 100 0 1 BIT_MASK 0x80 FORMAT "%5.3" /begin IF_DATA ASAP1B_KWP2000 KP_BLOB 0x382A90 EXTERN 0x2 /end IF_DATA /begin IF_DATA ETK KP_BLOB 0x382A90 EXTERN 0x2 /end IF_DATA /end MEASUREMENT
/begin MEASUREMENT B_cldsoel "Bedingung Fehlerpfad DSOEL löschen" UWORD B_TRUE 1 100 0 1 BIT_MASK 0x80 FORMAT "%5.3" /begin IF_DATA ASAP1B_KWP2000 KP_BLOB 0x382A92 EXTERN 0x2 /end IF_DATA /begin IF_DATA ETK KP_BLOB 0x382A92 EXTERN 0x2 /end IF_DATA /end MEASUREMENT
/begin MEASUREMENT B_cldsu "Bedingung: Fehlerpfad Umgebungsdrucksensor löschen" UWORD B_TRUE 1 100 0 1 BIT_MASK 0x80 FORMAT "%5.3" /begin IF_DATA ASAP1B_KWP2000 KP_BLOB 0x382A96 EXTERN 0x2 /end IF_DATA /begin IF_DATA ETK KP_BLOB 0x382A96 EXTERN 0x2 /end IF_DATA /end MEASUREMENT
/begin MEASUREMENT B_cldsvlu "Bedingung: Fehlerpfad Drucksensorvergleich DS-L DS-U" UWORD B_TRUE 1 100 0 1 BIT_MASK 0x80 FORMAT "%5.3" /begin IF_DATA ASAP1B_KWP2000 KP_BLOB 0x382A98 EXTERN 0x2 /end IF_DATA /begin IF_DATA ETK KP_BLOB 0x382A98 EXTERN 0x2 /end IF_DATA /end MEASUREMENT
/begin MEASUREMENT B_clev1 "Bedingung Fehlerpfad EV 1 löschen" UWORD B_TRUE 1 100 0 1 BIT_MASK 0x80 FORMAT "%5.3" /begin IF_DATA ASAP1B_KWP2000 KP_BLOB 0x382A9A EXTERN 0x2 /end IF_DATA /begin IF_DATA ETK KP_BLOB 0x382A9A EXTERN 0x2 /end IF_DATA /end MEASUREMENT
/begin MEASUREMENT B_clev2 "Bedingung Fehlerpfad EV 2 löschen" UWORD B_TRUE 1 100 0 1 BIT_MASK 0x80 FORMAT "%5.3" /begin IF_DATA ASAP1B_KWP2000 KP_BLOB 0x382A9C EXTERN 0x2 /end IF_DATA /begin IF_DATA ETK KP_BLOB 0x382A9C EXTERN 0x2 /end IF_DATA /end MEASUREMENT
/begin MEASUREMENT B_clev3 "Bedingung Fehlerpfad EV 3 löschen" UWORD B_TRUE 1 100 0 1 BIT_MASK 0x80 FORMAT "%5.3" /begin IF_DATA ASAP1B_KWP2000 KP_BLOB 0x382A9E EXTERN 0x2 /end IF_DATA /begin IF_DATA ETK KP_BLOB 0x382A9E EXTERN 0x2 /end IF_DATA /end MEASUREMENT
/begin MEASUREMENT B_clev4 "Bedingung Fehlerpfad EV 4 löschen" UWORD B_TRUE 1 100 0 1 BIT_MASK 0x80 FORMAT "%5.3" /begin IF_DATA ASAP1B_KWP2000 KP_BLOB 0x382AA0 EXTERN 0x2 /end IF_DATA /begin IF_DATA ETK KP_BLOB 0x382AA0 EXTERN 0x2 /end IF_DATA /end MEASUREMENT
/begin MEASUREMENT B_clev5 "Bedingung Fehlerpfad EV 5 löschen" UWORD B_TRUE 1 100 0 1 BIT_MASK 0x80 FORMAT "%5.3" /begin IF_DATA ASAP1B_KWP2000 KP_BLOB 0x382AA2 EXTERN 0x2 /end IF_DATA /begin IF_DATA ETK KP_BLOB 0x382AA2 EXTERN 0x2 /end IF_DATA /end MEASUREMENT
/begin MEASUREMENT B_clev6 "Bedingung Fehlerpfad EV 6 löschen" UWORD B_TRUE 1 100 0 1 BIT_MASK 0x80 FORMAT "%5.3" /begin IF_DATA ASAP1B_KWP2000 KP_BLOB 0x382AA4 EXTERN 0x2 /end IF_DATA /begin IF_DATA ETK KP_BLOB 0x382AA4 EXTERN 0x2 /end IF_DATA /end MEASUREMENT
/begin MEASUREMENT B_clgsh "Bedingung Fehlerpfad Getriebeschaltfunktion gsh löschen" UWORD B_TRUE 1 100 0 1 BIT_MASK 0x80 FORMAT "%5.3" /begin IF_DATA ASAP1B_KWP2000 KP_BLOB 0x382AA6 EXTERN 0x2 /end IF_DATA /begin IF_DATA ETK KP_BLOB 0x382AA6 EXTERN 0x2 /end IF_DATA /end MEASUREMENT
/begin MEASUREMENT B_clhsv "Bedingung Fehlerpfad DHLSVK löschen" UWORD B_TRUE 1 100 0 1 BIT_MASK 0x80 FORMAT "%5.3" /begin IF_DATA ASAP1B_KWP2000 KP_BLOB 0x382AA8 EXTERN 0x2 /end IF_DATA /begin IF_DATA ETK KP_BLOB 0x382AA8 EXTERN 0x2 /end IF_DATA /end MEASUREMENT
/begin MEASUREMENT B_clhsv2 "Bedingung Fehlerpfad DHLSVK2 löschen" UWORD B_TRUE 1 100 0 1 BIT_MASK 0x80 FORMAT "%5.3" /begin IF_DATA ASAP1B_KWP2000 KP_BLOB 0x382AAA EXTERN 0x2 /end IF_DATA /begin IF_DATA ETK KP_BLOB 0x382AAA EXTERN 0x2 /end IF_DATA /end MEASUREMENT
/begin MEASUREMENT B_clkpe "Bedingung Fehlerpfad EKP-Relais Endstufe löschen" UWORD B_TRUE 1 100 0 1 BIT_MASK 0x80 FORMAT "%5.3" /begin IF_DATA ASAP1B_KWP2000 KP_BLOB 0x382AAC EXTERN 0x2 /end IF_DATA /begin IF_DATA ETK KP_BLOB 0x382AAC EXTERN 0x2 /end IF_DATA /end MEASUREMENT
/begin MEASUREMENT B_clkrtp "Bedingung Fehlerpfad KR-Diagnose Testimpuls löschen" UWORD B_TRUE 1 100 0 1 BIT_MASK 0x80 FORMAT "%5.3" /begin IF_DATA ASAP1B_KWP2000 KP_BLOB 0x382AB2 EXTERN 0x2 /end IF_DATA /begin IF_DATA ETK KP_BLOB 0x382AB2 EXTERN 0x2 /end IF_DATA /end MEASUREMENT
/begin MEASUREMENT B_clks1 "Bedingung: Fehlerpfad löschen, Klopfsensor 1" UWORD B_TRUE 1 100 0 1 BIT_MASK 0x80 FORMAT "%5.3" /begin IF_DATA ASAP1B_KWP2000 KP_BLOB 0x382AB4 EXTERN 0x2 /end IF_DATA /begin IF_DATA ETK KP_BLOB 0x382AB4 EXTERN 0x2 /end IF_DATA /end MEASUREMENT
/begin MEASUREMENT B_clks2 "Bedingung: Fehlerpfad löschen, Klopfsensor 2" UWORD B_TRUE 1 100 0 1 BIT_MASK 0x80 FORMAT "%5.3" /begin IF_DATA ASAP1B_KWP2000 KP_BLOB 0x382AB6 EXTERN 0x2 /end IF_DATA /begin IF_DATA ETK KP_BLOB 0x382AB6 EXTERN 0x2 /end IF_DATA /end MEASUREMENT
/begin MEASUREMENT B_clks3 "Bedingung: Fehlerpfad löschen, Klopfsensor 3" UWORD B_TRUE 1 100 0 1 BIT_MASK 0x80 FORMAT "%5.3" /begin IF_DATA ASAP1B_KWP2000 KP_BLOB 0x382AB8 EXTERN 0x2 /end IF_DATA /begin IF_DATA ETK KP_BLOB 0x382AB8 EXTERN 0x2 /end IF_DATA /end MEASUREMENT
/begin MEASUREMENT B_clks4 "Bedingung: Fehlerpfad löschen, Klopfsensor 4" UWORD B_TRUE 1 100 0 1 BIT_MASK 0x80 FORMAT "%5.3" /begin IF_DATA ASAP1B_KWP2000 KP_BLOB 0x382ABA EXTERN 0x2 /end IF_DATA /begin IF_DATA ETK KP_BLOB 0x382ABA EXTERN 0x2 /end IF_DATA /end MEASUREMENT
/begin MEASUREMENT B_cllap "Bedingung Fehlerpfad Laptriggererkennung löschen" UWORD B_TRUE 1 100 0 1 BIT_MASK 0x80 FORMAT "%5.3" /begin IF_DATA ASAP1B_KWP2000 KP_BLOB 0x382ABC EXTERN 0x2 /end IF_DATA /begin IF_DATA ETK KP_BLOB 0x382ABC EXTERN 0x2 /end IF_DATA /end MEASUREMENT
/begin MEASUREMENT B_cllsv "Fehlerpfad in DLSV löschen." UWORD B_TRUE 1 100 0 1 BIT_MASK 0x80 FORMAT "%5.3" /begin IF_DATA ASAP1B_KWP2000 KP_BLOB 0x382AC0 EXTERN 0x2 /end IF_DATA /begin IF_DATA ETK KP_BLOB 0x382AC0 EXTERN 0x2 /end IF_DATA /end MEASUREMENT
/begin MEASUREMENT B_cllsv2 "Fehlerpfad in DLSV löschen.  Bank2" UWORD B_TRUE 1 100 0 1 BIT_MASK 0x80 FORMAT "%5.3" /begin IF_DATA ASAP1B_KWP2000 KP_BLOB 0x382AC2 EXTERN 0x2 /end IF_DATA /begin IF_DATA ETK KP_BLOB 0x382AC2 EXTERN 0x2 /end IF_DATA /end MEASUREMENT
/begin MEASUREMENT B_clmile "Bedingung Fehlerpfad MIL-Endstufe löschen" UWORD B_TRUE 1 100 0 1 BIT_MASK 0x80 FORMAT "%5.3" /begin IF_DATA ASAP1B_KWP2000 KP_BLOB 0x382AC4 EXTERN 0x2 /end IF_DATA /begin IF_DATA ETK KP_BLOB 0x382AC4 EXTERN 0x2 /end IF_DATA /end MEASUREMENT
/begin MEASUREMENT B_clmilse "Bedingung Fehlerpfad kundenspezifische Fehlerlampe Endstufe löschen" UWORD B_TRUE 1 100 0 1 BIT_MASK 0x80 FORMAT "%5.3" /begin IF_DATA ASAP1B_KWP2000 KP_BLOB 0x382AC6 EXTERN 0x2 /end IF_DATA /begin IF_DATA ETK KP_BLOB 0x382AC6 EXTERN 0x2 /end IF_DATA /end MEASUREMENT
/begin MEASUREMENT B_clollae "Bedingung Fehlerpfad Ölwarnlampe Endstufe löschen" UWORD B_TRUE 1 100 0 1 BIT_MASK 0x80 FORMAT "%5.3" /begin IF_DATA ASAP1B_KWP2000 KP_BLOB 0x382ACA EXTERN 0x2 /end IF_DATA /begin IF_DATA ETK KP_BLOB 0x382ACA EXTERN 0x2 /end IF_DATA /end MEASUREMENT
/begin MEASUREMENT B_clph "Bedingung Fehlerpfad PH löschen" UWORD B_TRUE 1 100 0 1 BIT_MASK 0x80 FORMAT "%5.3" /begin IF_DATA ASAP1B_KWP2000 KP_BLOB 0x382ACC EXTERN 0x2 /end IF_DATA /begin IF_DATA ETK KP_BLOB 0x382ACC EXTERN 0x2 /end IF_DATA /end MEASUREMENT
/begin MEASUREMENT B_clshlae "Bedingung Fehlerpfad Schaltlampe Endstufe löschen" UWORD B_TRUE 1 100 0 1 BIT_MASK 0x80 FORMAT "%5.3" /begin IF_DATA ASAP1B_KWP2000 KP_BLOB 0x382ACE EXTERN 0x2 /end IF_DATA /begin IF_DATA ETK KP_BLOB 0x382ACE EXTERN 0x2 /end IF_DATA /end MEASUREMENT
/begin MEASUREMENT B_clta "Bedingung Fehlerpfad Ansauglufttemperatur (/Ladeluft-) TANS löschen" UWORD B_TRUE 1 100 0 1 BIT_MASK 0x80 FORMAT "%5.3" /begin IF_DATA ASAP1B_KWP2000 KP_BLOB 0x382AD0 EXTERN 0x2 /end IF_DATA /begin IF_DATA ETK KP_BLOB 0x382AD0 EXTERN 0x2 /end IF_DATA /end MEASUREMENT
/begin MEASUREMENT B_cltfuel "Bedingung Fehlerpfad Kraftstofftemperatur tfuel löschen" UWORD B_TRUE 1 100 0 1 BIT_MASK 0x80 FORMAT "%5.3" /begin IF_DATA ASAP1B_KWP2000 KP_BLOB 0x382AD2 EXTERN 0x2 /end IF_DATA /begin IF_DATA ETK KP_BLOB 0x382AD2 EXTERN 0x2 /end IF_DATA /end MEASUREMENT
/begin MEASUREMENT B_cltm "Bedingung Fehlerpfad Motortemperatur TMOT löschen" UWORD B_TRUE 1 100 0 1 BIT_MASK 0x80 FORMAT "%5.3" /begin IF_DATA ASAP1B_KWP2000 KP_BLOB 0x382AD4 EXTERN 0x2 /end IF_DATA /begin IF_DATA ETK KP_BLOB 0x382AD4 EXTERN 0x2 /end IF_DATA /end MEASUREMENT
/begin MEASUREMENT B_cltol "Bedingung Fehlerpfad (Motor-)Oeltemperatur TOL löschen" UWORD B_TRUE 1 100 0 1 BIT_MASK 0x80 FORMAT "%5.3" /begin IF_DATA ASAP1B_KWP2000 KP_BLOB 0x382AD6 EXTERN 0x2 /end IF_DATA /begin IF_DATA ETK KP_BLOB 0x382AD6 EXTERN 0x2 /end IF_DATA /end MEASUREMENT
/begin MEASUREMENT B_club "Bedingung Fehlerpfad Batteriespannung (Bordnetz) löschen" UWORD B_TRUE 1 100 0 1 BIT_MASK 0x80 FORMAT "%5.3" /begin IF_DATA ASAP1B_KWP2000 KP_BLOB 0x382ADA EXTERN 0x2 /end IF_DATA /begin IF_DATA ETK KP_BLOB 0x382ADA EXTERN 0x2 /end IF_DATA /end MEASUREMENT
/begin MEASUREMENT B_clvfz "Bedingung Fehlerpfad VFZ (Fahrzeuggeschwindigkeit) löschen" UWORD B_TRUE 1 100 0 1 BIT_MASK 0x80 FORMAT "%5.3" /begin IF_DATA ASAP1B_KWP2000 KP_BLOB 0x382ADC EXTERN 0x2 /end IF_DATA /begin IF_DATA ETK KP_BLOB 0x382ADC EXTERN 0x2 /end IF_DATA /end MEASUREMENT
/begin MEASUREMENT B_dkpu "Bedingung Sicherheitskraftstoffabschaltung (SKA)" UWORD B_TRUE 1 100 0 1 BIT_MASK 0x1000 FORMAT "%5.3" /begin IF_DATA ASAP1B_KWP2000 KP_BLOB 0xFD44 INTERN 0x2 /end IF_DATA /begin IF_DATA ETK KP_BLOB 0xFD44 INTERN 0x2 /end IF_DATA /end MEASUREMENT
/begin MEASUREMENT B_drlmx "Laständerung unterhalb Schwellwert" UWORD B_TRUE 1 100 0 1 BIT_MASK 0x2000 FORMAT "%5.3" /begin IF_DATA ASAP1B_KWP2000 KP_BLOB 0xFD1C INTERN 0x2 /end IF_DATA /begin IF_DATA ETK KP_BLOB 0xFD1C INTERN 0x2 /end IF_DATA /end MEASUREMENT
/begin MEASUREMENT B_dslvh "Bedingung Ladedrucksensor vorhanden" UWORD B_TRUE 1 100 0 1 BIT_MASK 0x2000 FORMAT "%5.3" /begin IF_DATA ASAP1B_KWP2000 KP_BLOB 0xFD44 INTERN 0x2 /end IF_DATA /begin IF_DATA ETK KP_BLOB 0xFD44 INTERN 0x2 /end IF_DATA /end MEASUREMENT
/begin MEASUREMENT B_ehlsu "Bedingung Fehler Heizung LSU" UWORD B_TRUE 1 100 0 1 BIT_MASK 0x8 FORMAT "%5.3" /begin IF_DATA ASAP1B_KWP2000 KP_BLOB 0xFD1C INTERN 0x2 /end IF_DATA /begin IF_DATA ETK KP_BLOB 0xFD1C INTERN 0x2 /end IF_DATA /end MEASUREMENT
/begin MEASUREMENT B_ehlsu2 "Bedingung Fehler Heizung LSU Bank2" UWORD B_TRUE 1 100 0 1 BIT_MASK 0x10 FORMAT "%5.3" /begin IF_DATA ASAP1B_KWP2000 KP_BLOB 0xFD1C INTERN 0x2 /end IF_DATA /begin IF_DATA ETK KP_BLOB 0xFD1C INTERN 0x2 /end IF_DATA /end MEASUREMENT
/begin MEASUREMENT B_elsu "Bedingung Fehler oder Fehler-Vormerkung LSU (keine Betriebsbereitschaft)" UWORD B_TRUE 1 100 0 1 BIT_MASK 0x4000 FORMAT "%5.3" /begin IF_DATA ASAP1B_KWP2000 KP_BLOB 0xFD1C INTERN 0x2 /end IF_DATA /begin IF_DATA ETK KP_BLOB 0xFD1C INTERN 0x2 /end IF_DATA /end MEASUREMENT
/begin MEASUREMENT B_elsu2 "Bedingung Fehler oder Fehler-Vormerkung LSU Bank2 (keine Betriebsbereitschaft)" UWORD B_TRUE 1 100 0 1 BIT_MASK 0x8000 FORMAT "%5.3" /begin IF_DATA ASAP1B_KWP2000 KP_BLOB 0xFD1C INTERN 0x2 /end IF_DATA /begin IF_DATA ETK KP_BLOB 0xFD1C INTERN 0x2 /end IF_DATA /end MEASUREMENT
/begin MEASUREMENT B_evlsu "Bedingung Fehler LSU vorgemerkt" UWORD B_TRUE 1 100 0 1 BIT_MASK 0x1 FORMAT "%5.3" /begin IF_DATA ASAP1B_KWP2000 KP_BLOB 0xFD1E INTERN 0x2 /end IF_DATA /begin IF_DATA ETK KP_BLOB 0xFD1E INTERN 0x2 /end IF_DATA /end MEASUREMENT
/begin MEASUREMENT B_evlsu2 "Bedingung Fehler LSU2 vorgemerkt" UWORD B_TRUE 1 100 0 1 BIT_MASK 0x2 FORMAT "%5.3" /begin IF_DATA ASAP1B_KWP2000 KP_BLOB 0xFD1E INTERN 0x2 /end IF_DATA /begin IF_DATA ETK KP_BLOB 0xFD1E INTERN 0x2 /end IF_DATA /end MEASUREMENT
/begin MEASUREMENT B_fttfuel "Bedingung Fehlereintrag durch Tester für Diagnose Kraftstofftemperatursensor" UWORD B_TRUE 1 100 0 1 BIT_MASK 0x10 FORMAT "%5.3" /begin IF_DATA ASAP1B_KWP2000 KP_BLOB 0x382AD2 EXTERN 0x2 /end IF_DATA /begin IF_DATA ETK KP_BLOB 0x382AD2 EXTERN 0x2 /end IF_DATA /end MEASUREMENT
/begin MEASUREMENT B_helsu "Diagnose Heizerkopplung LSU erfolgt" UWORD B_TRUE 1 100 0 1 BIT_MASK 0x4 FORMAT "%5.3" /begin IF_DATA ASAP1B_KWP2000 KP_BLOB 0xFD1E INTERN 0x2 /end IF_DATA /begin IF_DATA ETK KP_BLOB 0xFD1E INTERN 0x2 /end IF_DATA /end MEASUREMENT
/begin MEASUREMENT B_helsu2 "Diagnose Heizerkopplung LSU2 erfolgt" UWORD B_TRUE 1 100 0 1 BIT_MASK 0x8 FORMAT "%5.3" /begin IF_DATA ASAP1B_KWP2000 KP_BLOB 0xFD1E INTERN 0x2 /end IF_DATA /begin IF_DATA ETK KP_BLOB 0xFD1E INTERN 0x2 /end IF_DATA /end MEASUREMENT
/begin MEASUREMENT B_hst "Bedingung Heißstart" UBYTE B_TRUE 1 100 0 1 BIT_MASK 0x1 FORMAT "%5.3" /begin IF_DATA ASAP1B_KWP2000 KP_BLOB 0x382857 EXTERN 0x1 /end IF_DATA /begin IF_DATA ETK KP_BLOB 0x382857 EXTERN 0x1 /end IF_DATA /end MEASUREMENT
/begin MEASUREMENT B_krdws "Bedingung Klopfregelung Sicherheitsspätverstellung" UWORD B_TRUE 1 100 0 1 BIT_MASK 0x40 FORMAT "%5.3" /begin IF_DATA ASAP1B_KWP2000 KP_BLOB 0xFD2A INTERN 0x2 /end IF_DATA /begin IF_DATA ETK KP_BLOB 0xFD2A INTERN 0x2 /end IF_DATA /end MEASUREMENT
/begin MEASUREMENT B_lamnse "Bedingung Ende lamns_w-Berechnung" UWORD B_TRUE 1 100 0 1 BIT_MASK 0x8 FORMAT "%5.3" /begin IF_DATA ASAP1B_KWP2000 KP_BLOB 0xFD26 INTERN 0x2 /end IF_DATA /begin IF_DATA ETK KP_BLOB 0xFD26 INTERN 0x2 /end IF_DATA /end MEASUREMENT
/begin MEASUREMENT B_lsuft "LSU Bank1 fett, nicht plausibel" UWORD B_TRUE 1 100 0 1 BIT_MASK 0x400 FORMAT "%5.3" /begin IF_DATA ASAP1B_KWP2000 KP_BLOB 0x380A34 EXTERN 0x2 /end IF_DATA /begin IF_DATA ETK KP_BLOB 0x380A34 EXTERN 0x2 /end IF_DATA /end MEASUREMENT
/begin MEASUREMENT B_lsuft2 "LSU Bank2 fett, nicht plausibel" UWORD B_TRUE 1 100 0 1 BIT_MASK 0x2000 FORMAT "%5.3" /begin IF_DATA ASAP1B_KWP2000 KP_BLOB 0x380A34 EXTERN 0x2 /end IF_DATA /begin IF_DATA ETK KP_BLOB 0x380A34 EXTERN 0x2 /end IF_DATA /end MEASUREMENT
/begin MEASUREMENT B_lsumr "LSU Bank1 mager, nicht plausibel" UWORD B_TRUE 1 100 0 1 BIT_MASK 0x200 FORMAT "%5.3" /begin IF_DATA ASAP1B_KWP2000 KP_BLOB 0x380A34 EXTERN 0x2 /end IF_DATA /begin IF_DATA ETK KP_BLOB 0x380A34 EXTERN 0x2 /end IF_DATA /end MEASUREMENT
/begin MEASUREMENT B_lsumr2 "LSU Bank2 mager, nicht plausibel" UWORD B_TRUE 1 100 0 1 BIT_MASK 0x1000 FORMAT "%5.3" /begin IF_DATA ASAP1B_KWP2000 KP_BLOB 0x380A34 EXTERN 0x2 /end IF_DATA /begin IF_DATA ETK KP_BLOB 0x380A34 EXTERN 0x2 /end IF_DATA /end MEASUREMENT
/begin MEASUREMENT B_lsumx "Maximalwert der LSU-Spannung überschritten (CJ110)" UWORD B_TRUE 1 100 0 1 BIT_MASK 0x10 FORMAT "%5.3" /begin IF_DATA ASAP1B_KWP2000 KP_BLOB 0xFD1E INTERN 0x2 /end IF_DATA /begin IF_DATA ETK KP_BLOB 0xFD1E INTERN 0x2 /end IF_DATA /end MEASUREMENT
/begin MEASUREMENT B_lsumx2 "Maximalwert der LSU2-Spannung überschritten (CJ110)" UWORD B_TRUE 1 100 0 1 BIT_MASK 0x20 FORMAT "%5.3" /begin IF_DATA ASAP1B_KWP2000 KP_BLOB 0xFD1E INTERN 0x2 /end IF_DATA /begin IF_DATA ETK KP_BLOB 0xFD1E INTERN 0x2 /end IF_DATA /end MEASUREMENT
/begin MEASUREMENT B_lsuna "LSU nicht aktiv, Bank1" UWORD B_TRUE 1 100 0 1 BIT_MASK 0x100 FORMAT "%5.3" /begin IF_DATA ASAP1B_KWP2000 KP_BLOB 0x380A34 EXTERN 0x2 /end IF_DATA /begin IF_DATA ETK KP_BLOB 0x380A34 EXTERN 0x2 /end IF_DATA /end MEASUREMENT
/begin MEASUREMENT B_lsuna2 "LSU nicht aktiv, Bank2" UWORD B_TRUE 1 100 0 1 BIT_MASK 0x800 FORMAT "%5.3" /begin IF_DATA ASAP1B_KWP2000 KP_BLOB 0x380A34 EXTERN 0x2 /end IF_DATA /begin IF_DATA ETK KP_BLOB 0x380A34 EXTERN 0x2 /end IF_DATA /end MEASUREMENT
/begin MEASUREMENT B_mappos1 "Bedingung Map Position 1" UWORD B_TRUE 1 100 0 1 BIT_MASK 0x10 FORMAT "%5.3" /begin IF_DATA ASAP1B_KWP2000 KP_BLOB 0xFD3C INTERN 0x2 /end IF_DATA /begin IF_DATA ETK KP_BLOB 0xFD3C INTERN 0x2 /end IF_DATA /end MEASUREMENT
/begin MEASUREMENT B_mappos2 "Bedingung Map Position 2" UWORD B_TRUE 1 100 0 1 BIT_MASK 0x20 FORMAT "%5.3" /begin IF_DATA ASAP1B_KWP2000 KP_BLOB 0xFD3C INTERN 0x2 /end IF_DATA /begin IF_DATA ETK KP_BLOB 0xFD3C INTERN 0x2 /end IF_DATA /end MEASUREMENT
/begin MEASUREMENT B_mappos3 "Bedingung Map Position 3" UWORD B_TRUE 1 100 0 1 BIT_MASK 0x40 FORMAT "%5.3" /begin IF_DATA ASAP1B_KWP2000 KP_BLOB 0xFD3C INTERN 0x2 /end IF_DATA /begin IF_DATA ETK KP_BLOB 0xFD3C INTERN 0x2 /end IF_DATA /end MEASUREMENT
/begin MEASUREMENT B_mnats "Bedingung: Min-Fehler Abgastemperatursensor" UWORD B_TRUE 1 100 0 1 BIT_MASK 0x200 FORMAT "%5.3" /begin IF_DATA ASAP1B_KWP2000 KP_BLOB 0x382A86 EXTERN 0x2 /end IF_DATA /begin IF_DATA ETK KP_BLOB 0x382A86 EXTERN 0x2 /end IF_DATA /end MEASUREMENT
/begin MEASUREMENT B_mnats2 "Bedingung: Min-Fehler Abgastemperatursensor Bank 2" UWORD B_TRUE 1 100 0 1 BIT_MASK 0x200 FORMAT "%5.3" /begin IF_DATA ASAP1B_KWP2000 KP_BLOB 0x382A88 EXTERN 0x2 /end IF_DATA /begin IF_DATA ETK KP_BLOB 0x382A88 EXTERN 0x2 /end IF_DATA /end MEASUREMENT
/begin MEASUREMENT B_mndsfue "Fehlerart: Kurzschluss nach Masse Drucksensor Kraftstoff" UWORD B_TRUE 1 100 0 1 BIT_MASK 0x200 FORMAT "%5.3" /begin IF_DATA ASAP1B_KWP2000 KP_BLOB 0x382A8E EXTERN 0x2 /end IF_DATA /begin IF_DATA ETK KP_BLOB 0x382A8E EXTERN 0x2 /end IF_DATA /end MEASUREMENT
/begin MEASUREMENT B_mndsl "Bedingung min. Fehler Ladedrucksensor" UWORD B_TRUE 1 100 0 1 BIT_MASK 0x200 FORMAT "%5.3" /begin IF_DATA ASAP1B_KWP2000 KP_BLOB 0x382A90 EXTERN 0x2 /end IF_DATA /begin IF_DATA ETK KP_BLOB 0x382A90 EXTERN 0x2 /end IF_DATA /end MEASUREMENT
/begin MEASUREMENT B_mndsoel "Fehlerart: Kurzschluss nach Masse Drucksensor Oel" UWORD B_TRUE 1 100 0 1 BIT_MASK 0x200 FORMAT "%5.3" /begin IF_DATA ASAP1B_KWP2000 KP_BLOB 0x382A92 EXTERN 0x2 /end IF_DATA /begin IF_DATA ETK KP_BLOB 0x382A92 EXTERN 0x2 /end IF_DATA /end MEASUREMENT
/begin MEASUREMENT B_mndsu "Bedingung: min-Fehler Umgebungsdrucksensor" UWORD B_TRUE 1 100 0 1 BIT_MASK 0x200 FORMAT "%5.3" /begin IF_DATA ASAP1B_KWP2000 KP_BLOB 0x382A96 EXTERN 0x2 /end IF_DATA /begin IF_DATA ETK KP_BLOB 0x382A96 EXTERN 0x2 /end IF_DATA /end MEASUREMENT
/begin MEASUREMENT B_mndsvlu "Bedingung: min. Fehler Drucksensorsignalvergleich (DS-L DS-U)" UWORD B_TRUE 1 100 0 1 BIT_MASK 0x200 FORMAT "%5.3" /begin IF_DATA ASAP1B_KWP2000 KP_BLOB 0x382A98 EXTERN 0x2 /end IF_DATA /begin IF_DATA ETK KP_BLOB 0x382A98 EXTERN 0x2 /end IF_DATA /end MEASUREMENT
/begin MEASUREMENT B_mnev1 "Fehlerart: Kurzschluß Masse an Endstufe EV1" UWORD B_TRUE 1 100 0 1 BIT_MASK 0x200 FORMAT "%5.3" /begin IF_DATA ASAP1B_KWP2000 KP_BLOB 0x382A9A EXTERN 0x2 /end IF_DATA /begin IF_DATA ETK KP_BLOB 0x382A9A EXTERN 0x2 /end IF_DATA /end MEASUREMENT
/begin MEASUREMENT B_mnev2 "Fehlerart: Kurzschluß Masse an Endstufe EV2" UWORD B_TRUE 1 100 0 1 BIT_MASK 0x200 FORMAT "%5.3" /begin IF_DATA ASAP1B_KWP2000 KP_BLOB 0x382A9C EXTERN 0x2 /end IF_DATA /begin IF_DATA ETK KP_BLOB 0x382A9C EXTERN 0x2 /end IF_DATA /end MEASUREMENT
/begin MEASUREMENT B_mnev3 "Fehlerart: Kurzschluß Masse an Endstufe EV3" UWORD B_TRUE 1 100 0 1 BIT_MASK 0x200 FORMAT "%5.3" /begin IF_DATA ASAP1B_KWP2000 KP_BLOB 0x382A9E EXTERN 0x2 /end IF_DATA /begin IF_DATA ETK KP_BLOB 0x382A9E EXTERN 0x2 /end IF_DATA /end MEASUREMENT
/begin MEASUREMENT B_mnev4 "Fehlerart: Kurzschluß Masse an Endstufe EV4" UWORD B_TRUE 1 100 0 1 BIT_MASK 0x200 FORMAT "%5.3" /begin IF_DATA ASAP1B_KWP2000 KP_BLOB 0x382AA0 EXTERN 0x2 /end IF_DATA /begin IF_DATA ETK KP_BLOB 0x382AA0 EXTERN 0x2 /end IF_DATA /end MEASUREMENT
/begin MEASUREMENT B_mnev5 "Fehlerart: Kurzschluß Masse an Endstufe EV5" UWORD B_TRUE 1 100 0 1 BIT_MASK 0x200 FORMAT "%5.3" /begin IF_DATA ASAP1B_KWP2000 KP_BLOB 0x382AA2 EXTERN 0x2 /end IF_DATA /begin IF_DATA ETK KP_BLOB 0x382AA2 EXTERN 0x2 /end IF_DATA /end MEASUREMENT
/begin MEASUREMENT B_mnev6 "Fehlerart: Kurzschluß Masse an Endstufe EV6" UWORD B_TRUE 1 100 0 1 BIT_MASK 0x200 FORMAT "%5.3" /begin IF_DATA ASAP1B_KWP2000 KP_BLOB 0x382AA4 EXTERN 0x2 /end IF_DATA /begin IF_DATA ETK KP_BLOB 0x382AA4 EXTERN 0x2 /end IF_DATA /end MEASUREMENT
/begin MEASUREMENT B_mnhlsu "Kurzschluß Heizung LSU1 nach Masse" UWORD B_TRUE 1 100 0 1 BIT_MASK 0x20 FORMAT "%5.3" /begin IF_DATA ASAP1B_KWP2000 KP_BLOB 0xFD1C INTERN 0x2 /end IF_DATA /begin IF_DATA ETK KP_BLOB 0xFD1C INTERN 0x2 /end IF_DATA /end MEASUREMENT
/begin MEASUREMENT B_mnhlsu2 "Kurzschluß Heizung LSU2 nach Masse" UWORD B_TRUE 1 100 0 1 BIT_MASK 0x40 FORMAT "%5.3" /begin IF_DATA ASAP1B_KWP2000 KP_BLOB 0xFD1C INTERN 0x2 /end IF_DATA /begin IF_DATA ETK KP_BLOB 0xFD1C INTERN 0x2 /end IF_DATA /end MEASUREMENT
/begin MEASUREMENT B_mnhsv "Kurzschluß Heizung Lambdasonde vor Kat nach Masse" UWORD B_TRUE 1 100 0 1 BIT_MASK 0x200 FORMAT "%5.3" /begin IF_DATA ASAP1B_KWP2000 KP_BLOB 0x382AA8 EXTERN 0x2 /end IF_DATA /begin IF_DATA ETK KP_BLOB 0x382AA8 EXTERN 0x2 /end IF_DATA /end MEASUREMENT
/begin MEASUREMENT B_mnhsv2 "Kurzschluß Heizung Lambdasonde2 vor Kat nach Masse" UWORD B_TRUE 1 100 0 1 BIT_MASK 0x200 FORMAT "%5.3" /begin IF_DATA ASAP1B_KWP2000 KP_BLOB 0x382AAA EXTERN 0x2 /end IF_DATA /begin IF_DATA ETK KP_BLOB 0x382AAA EXTERN 0x2 /end IF_DATA /end MEASUREMENT
/begin MEASUREMENT B_mnkpe "Bedingung für Fehlertyp Kurzschluß nach Masse für EKP-Relais Endstufe erkannt" UWORD B_TRUE 1 100 0 1 BIT_MASK 0x200 FORMAT "%5.3" /begin IF_DATA ASAP1B_KWP2000 KP_BLOB 0x382AAC EXTERN 0x2 /end IF_DATA /begin IF_DATA ETK KP_BLOB 0x382AAC EXTERN 0x2 /end IF_DATA /end MEASUREMENT
/begin MEASUREMENT B_mnkrnt "Fehlertyp min.: Klopfregelung Nulltest" UWORD B_TRUE 1 100 0 1 BIT_MASK 0x200 FORMAT "%5.3" /begin IF_DATA ASAP1B_KWP2000 KP_BLOB 0x382AAE EXTERN 0x2 /end IF_DATA /begin IF_DATA ETK KP_BLOB 0x382AAE EXTERN 0x2 /end IF_DATA /end MEASUREMENT
/begin MEASUREMENT B_mnkrof "Fehlertyp min.: Klopfregelung Offset" UWORD B_TRUE 1 100 0 1 BIT_MASK 0x200 FORMAT "%5.3" /begin IF_DATA ASAP1B_KWP2000 KP_BLOB 0x382AB0 EXTERN 0x2 /end IF_DATA /begin IF_DATA ETK KP_BLOB 0x382AB0 EXTERN 0x2 /end IF_DATA /end MEASUREMENT
/begin MEASUREMENT B_mnkrtp "Fehlertyp min.: Klopfregelung Testimpuls" UWORD B_TRUE 1 100 0 1 BIT_MASK 0x200 FORMAT "%5.3" /begin IF_DATA ASAP1B_KWP2000 KP_BLOB 0x382AB2 EXTERN 0x2 /end IF_DATA /begin IF_DATA ETK KP_BLOB 0x382AB2 EXTERN 0x2 /end IF_DATA /end MEASUREMENT
/begin MEASUREMENT B_mnks1 "Bedingung: Min-Fehler Klopfsensor 1" UWORD B_TRUE 1 100 0 1 BIT_MASK 0x200 FORMAT "%5.3" /begin IF_DATA ASAP1B_KWP2000 KP_BLOB 0x382AB4 EXTERN 0x2 /end IF_DATA /begin IF_DATA ETK KP_BLOB 0x382AB4 EXTERN 0x2 /end IF_DATA /end MEASUREMENT
/begin MEASUREMENT B_mnks2 "Bedingung: Min-Fehler Klopfsensor 2" UWORD B_TRUE 1 100 0 1 BIT_MASK 0x200 FORMAT "%5.3" /begin IF_DATA ASAP1B_KWP2000 KP_BLOB 0x382AB6 EXTERN 0x2 /end IF_DATA /begin IF_DATA ETK KP_BLOB 0x382AB6 EXTERN 0x2 /end IF_DATA /end MEASUREMENT
/begin MEASUREMENT B_mnks3 "Bedingung: Min-Fehler Klopfsensor 3" UWORD B_TRUE 1 100 0 1 BIT_MASK 0x200 FORMAT "%5.3" /begin IF_DATA ASAP1B_KWP2000 KP_BLOB 0x382AB8 EXTERN 0x2 /end IF_DATA /begin IF_DATA ETK KP_BLOB 0x382AB8 EXTERN 0x2 /end IF_DATA /end MEASUREMENT
/begin MEASUREMENT B_mnks4 "Bedingung: Min-fehler Klopfsensor 4" UWORD B_TRUE 1 100 0 1 BIT_MASK 0x200 FORMAT "%5.3" /begin IF_DATA ASAP1B_KWP2000 KP_BLOB 0x382ABA EXTERN 0x2 /end IF_DATA /begin IF_DATA ETK KP_BLOB 0x382ABA EXTERN 0x2 /end IF_DATA /end MEASUREMENT
/begin MEASUREMENT B_mnmile "Fehlerart: Kurzschluß Masse an MIL-Endstufe" UWORD B_TRUE 1 100 0 1 BIT_MASK 0x200 FORMAT "%5.3" /begin IF_DATA ASAP1B_KWP2000 KP_BLOB 0x382AC4 EXTERN 0x2 /end IF_DATA /begin IF_DATA ETK KP_BLOB 0x382AC4 EXTERN 0x2 /end IF_DATA /end MEASUREMENT
/begin MEASUREMENT B_mnmilse "Fehlerart: Kurzschluß nach Masse an Endstufe kundenspezifische Fehlerlampe" UWORD B_TRUE 1 100 0 1 BIT_MASK 0x200 FORMAT "%5.3" /begin IF_DATA ASAP1B_KWP2000 KP_BLOB 0x382AC6 EXTERN 0x2 /end IF_DATA /begin IF_DATA ETK KP_BLOB 0x382AC6 EXTERN 0x2 /end IF_DATA /end MEASUREMENT
/begin MEASUREMENT B_mnollae "Fehlerart: Kurzschluß nach Masse an Endstufe Ölwarnlampe" UWORD B_TRUE 1 100 0 1 BIT_MASK 0x200 FORMAT "%5.3" /begin IF_DATA ASAP1B_KWP2000 KP_BLOB 0x382ACA EXTERN 0x2 /end IF_DATA /begin IF_DATA ETK KP_BLOB 0x382ACA EXTERN 0x2 /end IF_DATA /end MEASUREMENT
/begin MEASUREMENT B_mnph "Fehlerart: Kurzschluß Masse Phasengeber" UWORD B_TRUE 1 100 0 1 BIT_MASK 0x200 FORMAT "%5.3" /begin IF_DATA ASAP1B_KWP2000 KP_BLOB 0x382ACC EXTERN 0x2 /end IF_DATA /begin IF_DATA ETK KP_BLOB 0x382ACC EXTERN 0x2 /end IF_DATA /end MEASUREMENT
/begin MEASUREMENT B_mnshlae "Fehlerart: Kurzschluß nach Masse an Endstufe Schaltlampe" UWORD B_TRUE 1 100 0 1 BIT_MASK 0x200 FORMAT "%5.3" /begin IF_DATA ASAP1B_KWP2000 KP_BLOB 0x382ACE EXTERN 0x2 /end IF_DATA /begin IF_DATA ETK KP_BLOB 0x382ACE EXTERN 0x2 /end IF_DATA /end MEASUREMENT
/begin MEASUREMENT B_mnta "Fehlertyp: Minimalwertunterschreitung Ansauglufttemperatur TANS" UWORD B_TRUE 1 100 0 1 BIT_MASK 0x200 FORMAT "%5.3" /begin IF_DATA ASAP1B_KWP2000 KP_BLOB 0x382AD0 EXTERN 0x2 /end IF_DATA /begin IF_DATA ETK KP_BLOB 0x382AD0 EXTERN 0x2 /end IF_DATA /end MEASUREMENT
/begin MEASUREMENT B_mntfuel "Fehlertyp: Minimalwertunterschreitung Kraftstofftemperatur" UWORD B_TRUE 1 100 0 1 BIT_MASK 0x200 FORMAT "%5.3" /begin IF_DATA ASAP1B_KWP2000 KP_BLOB 0x382AD2 EXTERN 0x2 /end IF_DATA /begin IF_DATA ETK KP_BLOB 0x382AD2 EXTERN 0x2 /end IF_DATA /end MEASUREMENT
/begin MEASUREMENT B_mntm "Fehlertyp: Minimalwertunterschreitung Motortemperatur" UWORD B_TRUE 1 100 0 1 BIT_MASK 0x200 FORMAT "%5.3" /begin IF_DATA ASAP1B_KWP2000 KP_BLOB 0x382AD4 EXTERN 0x2 /end IF_DATA /begin IF_DATA ETK KP_BLOB 0x382AD4 EXTERN 0x2 /end IF_DATA /end MEASUREMENT
/begin MEASUREMENT B_mntol "Fehlertyp: Minimalwertunterschreitung (Motor-) Oeltemperatur" UWORD B_TRUE 1 100 0 1 BIT_MASK 0x200 FORMAT "%5.3" /begin IF_DATA ASAP1B_KWP2000 KP_BLOB 0x382AD6 EXTERN 0x2 /end IF_DATA /begin IF_DATA ETK KP_BLOB 0x382AD6 EXTERN 0x2 /end IF_DATA /end MEASUREMENT
/begin MEASUREMENT B_mnub "Fehlertyp: Minimalwertunterschreitung Batteriespannung (Bordnetz)" UWORD B_TRUE 1 100 0 1 BIT_MASK 0x200 FORMAT "%5.3" /begin IF_DATA ASAP1B_KWP2000 KP_BLOB 0x382ADA EXTERN 0x2 /end IF_DATA /begin IF_DATA ETK KP_BLOB 0x382ADA EXTERN 0x2 /end IF_DATA /end MEASUREMENT
/begin MEASUREMENT B_mnvfz "Fehlertyp min,: Fahrzeuggeschwindigkeit" UWORD B_TRUE 1 100 0 1 BIT_MASK 0x200 FORMAT "%5.3" /begin IF_DATA ASAP1B_KWP2000 KP_BLOB 0x382ADC EXTERN 0x2 /end IF_DATA /begin IF_DATA ETK KP_BLOB 0x382ADC EXTERN 0x2 /end IF_DATA /end MEASUREMENT
/begin MEASUREMENT B_mxats "Bedingung: Max-Fehler Abgastemperatursensor" UWORD B_TRUE 1 100 0 1 BIT_MASK 0x100 FORMAT "%5.3" /begin IF_DATA ASAP1B_KWP2000 KP_BLOB 0x382A86 EXTERN 0x2 /end IF_DATA /begin IF_DATA ETK KP_BLOB 0x382A86 EXTERN 0x2 /end IF_DATA /end MEASUREMENT
/begin MEASUREMENT B_mxats2 "Bedingung: Max-Fehler Abgastemperatursensor Bank 2" UWORD B_TRUE 1 100 0 1 BIT_MASK 0x100 FORMAT "%5.3" /begin IF_DATA ASAP1B_KWP2000 KP_BLOB 0x382A88 EXTERN 0x2 /end IF_DATA /begin IF_DATA ETK KP_BLOB 0x382A88 EXTERN 0x2 /end IF_DATA /end MEASUREMENT
/begin MEASUREMENT B_mxdsfue "Fehlerart: Kurzschluss nach Ubat Drucksensor Kraftstoff" UWORD B_TRUE 1 100 0 1 BIT_MASK 0x100 FORMAT "%5.3" /begin IF_DATA ASAP1B_KWP2000 KP_BLOB 0x382A8E EXTERN 0x2 /end IF_DATA /begin IF_DATA ETK KP_BLOB 0x382A8E EXTERN 0x2 /end IF_DATA /end MEASUREMENT
/begin MEASUREMENT B_mxdsl "Bedingung max. Fehler Ladedrucksensor" UWORD B_TRUE 1 100 0 1 BIT_MASK 0x100 FORMAT "%5.3" /begin IF_DATA ASAP1B_KWP2000 KP_BLOB 0x382A90 EXTERN 0x2 /end IF_DATA /begin IF_DATA ETK KP_BLOB 0x382A90 EXTERN 0x2 /end IF_DATA /end MEASUREMENT
/begin MEASUREMENT B_mxdsoel "Fehlerart: Kurzschluss nach Ubat Drucksensor Oel" UWORD B_TRUE 1 100 0 1 BIT_MASK 0x100 FORMAT "%5.3" /begin IF_DATA ASAP1B_KWP2000 KP_BLOB 0x382A92 EXTERN 0x2 /end IF_DATA /begin IF_DATA ETK KP_BLOB 0x382A92 EXTERN 0x2 /end IF_DATA /end MEASUREMENT
/begin MEASUREMENT B_mxdsu "Bedingung: max-Fehler Umgebungsdrucksensor" UWORD B_TRUE 1 100 0 1 BIT_MASK 0x100 FORMAT "%5.3" /begin IF_DATA ASAP1B_KWP2000 KP_BLOB 0x382A96 EXTERN 0x2 /end IF_DATA /begin IF_DATA ETK KP_BLOB 0x382A96 EXTERN 0x2 /end IF_DATA /end MEASUREMENT
/begin MEASUREMENT B_mxdsvlu "Fehlertyp 'Maximalwert' erkannt: Drucksensorsignalvergleich (DS-L DS-U)" UWORD B_TRUE 1 100 0 1 BIT_MASK 0x100 FORMAT "%5.3" /begin IF_DATA ASAP1B_KWP2000 KP_BLOB 0x382A98 EXTERN 0x2 /end IF_DATA /begin IF_DATA ETK KP_BLOB 0x382A98 EXTERN 0x2 /end IF_DATA /end MEASUREMENT
/begin MEASUREMENT B_mxev1 "Fehlerart: Kurzschluß UBat an Endstufe EV1" UWORD B_TRUE 1 100 0 1 BIT_MASK 0x100 FORMAT "%5.3" /begin IF_DATA ASAP1B_KWP2000 KP_BLOB 0x382A9A EXTERN 0x2 /end IF_DATA /begin IF_DATA ETK KP_BLOB 0x382A9A EXTERN 0x2 /end IF_DATA /end MEASUREMENT
/begin MEASUREMENT B_mxev2 "Fehlerart: Kurzschluß UBat an Endstufe EV2" UWORD B_TRUE 1 100 0 1 BIT_MASK 0x100 FORMAT "%5.3" /begin IF_DATA ASAP1B_KWP2000 KP_BLOB 0x382A9C EXTERN 0x2 /end IF_DATA /begin IF_DATA ETK KP_BLOB 0x382A9C EXTERN 0x2 /end IF_DATA /end MEASUREMENT
/begin MEASUREMENT B_mxev3 "Fehlerart: Kurzschluß UBat an Endstufe EV3" UWORD B_TRUE 1 100 0 1 BIT_MASK 0x100 FORMAT "%5.3" /begin IF_DATA ASAP1B_KWP2000 KP_BLOB 0x382A9E EXTERN 0x2 /end IF_DATA /begin IF_DATA ETK KP_BLOB 0x382A9E EXTERN 0x2 /end IF_DATA /end MEASUREMENT
/begin MEASUREMENT B_mxev4 "Fehlerart: Kurzschluß UBat an Endstufe EV4" UWORD B_TRUE 1 100 0 1 BIT_MASK 0x100 FORMAT "%5.3" /begin IF_DATA ASAP1B_KWP2000 KP_BLOB 0x382AA0 EXTERN 0x2 /end IF_DATA /begin IF_DATA ETK KP_BLOB 0x382AA0 EXTERN 0x2 /end IF_DATA /end MEASUREMENT
/begin MEASUREMENT B_mxev5 "Fehlerart: Kurzschluß UBat an Endstufe EV5" UWORD B_TRUE 1 100 0 1 BIT_MASK 0x100 FORMAT "%5.3" /begin IF_DATA ASAP1B_KWP2000 KP_BLOB 0x382AA2 EXTERN 0x2 /end IF_DATA /begin IF_DATA ETK KP_BLOB 0x382AA2 EXTERN 0x2 /end IF_DATA /end MEASUREMENT
/begin MEASUREMENT B_mxev6 "Fehlerart: Kurzschluß UBat an Endstufe EV6" UWORD B_TRUE 1 100 0 1 BIT_MASK 0x100 FORMAT "%5.3" /begin IF_DATA ASAP1B_KWP2000 KP_BLOB 0x382AA4 EXTERN 0x2 /end IF_DATA /begin IF_DATA ETK KP_BLOB 0x382AA4 EXTERN 0x2 /end IF_DATA /end MEASUREMENT
/begin MEASUREMENT B_mxhlsu "Kurzschluß Heizung LSU1 nach UB" UWORD B_TRUE 1 100 0 1 BIT_MASK 0x80 FORMAT "%5.3" /begin IF_DATA ASAP1B_KWP2000 KP_BLOB 0xFD1C INTERN 0x2 /end IF_DATA /begin IF_DATA ETK KP_BLOB 0xFD1C INTERN 0x2 /end IF_DATA /end MEASUREMENT
/begin MEASUREMENT B_mxhlsu2 "Kurzschluß Heizung LSU2 nach UB" UWORD B_TRUE 1 100 0 1 BIT_MASK 0x100 FORMAT "%5.3" /begin IF_DATA ASAP1B_KWP2000 KP_BLOB 0xFD1C INTERN 0x2 /end IF_DATA /begin IF_DATA ETK KP_BLOB 0xFD1C INTERN 0x2 /end IF_DATA /end MEASUREMENT
/begin MEASUREMENT B_mxhsv "Kurzschluß Heizung Lambdasonde vor Kat nach UB" UWORD B_TRUE 1 100 0 1 BIT_MASK 0x100 FORMAT "%5.3" /begin IF_DATA ASAP1B_KWP2000 KP_BLOB 0x382AA8 EXTERN 0x2 /end IF_DATA /begin IF_DATA ETK KP_BLOB 0x382AA8 EXTERN 0x2 /end IF_DATA /end MEASUREMENT
/begin MEASUREMENT B_mxhsv2 "Kurzschluß Heizung Lambdasonde2 vor Kat nach UB" UWORD B_TRUE 1 100 0 1 BIT_MASK 0x100 FORMAT "%5.3" /begin IF_DATA ASAP1B_KWP2000 KP_BLOB 0x382AAA EXTERN 0x2 /end IF_DATA /begin IF_DATA ETK KP_BLOB 0x382AAA EXTERN 0x2 /end IF_DATA /end MEASUREMENT
/begin MEASUREMENT B_mxkpe "Fehlertyp Kurzschluß nach Ubat für EKP-Relais Endstufe erkannt" UWORD B_TRUE 1 100 0 1 BIT_MASK 0x100 FORMAT "%5.3" /begin IF_DATA ASAP1B_KWP2000 KP_BLOB 0x382AAC EXTERN 0x2 /end IF_DATA /begin IF_DATA ETK KP_BLOB 0x382AAC EXTERN 0x2 /end IF_DATA /end MEASUREMENT
/begin MEASUREMENT B_mxkrnt "Fehlertyp max.: Klopfregelung Nulltest" UWORD B_TRUE 1 100 0 1 BIT_MASK 0x100 FORMAT "%5.3" /begin IF_DATA ASAP1B_KWP2000 KP_BLOB 0x382AAE EXTERN 0x2 /end IF_DATA /begin IF_DATA ETK KP_BLOB 0x382AAE EXTERN 0x2 /end IF_DATA /end MEASUREMENT
/begin MEASUREMENT B_mxkrof "Fehlertyp max.: Klopfregelung Offset" UWORD B_TRUE 1 100 0 1 BIT_MASK 0x100 FORMAT "%5.3" /begin IF_DATA ASAP1B_KWP2000 KP_BLOB 0x382AB0 EXTERN 0x2 /end IF_DATA /begin IF_DATA ETK KP_BLOB 0x382AB0 EXTERN 0x2 /end IF_DATA /end MEASUREMENT
/begin MEASUREMENT B_mxkrtp "Fehlertyp max.: Klopfregelung Testimpuls" UWORD B_TRUE 1 100 0 1 BIT_MASK 0x100 FORMAT "%5.3" /begin IF_DATA ASAP1B_KWP2000 KP_BLOB 0x382AB2 EXTERN 0x2 /end IF_DATA /begin IF_DATA ETK KP_BLOB 0x382AB2 EXTERN 0x2 /end IF_DATA /end MEASUREMENT
/begin MEASUREMENT B_mxks1 "Bedingung: Max-Fehler Klopfsensor 1" UWORD B_TRUE 1 100 0 1 BIT_MASK 0x100 FORMAT "%5.3" /begin IF_DATA ASAP1B_KWP2000 KP_BLOB 0x382AB4 EXTERN 0x2 /end IF_DATA /begin IF_DATA ETK KP_BLOB 0x382AB4 EXTERN 0x2 /end IF_DATA /end MEASUREMENT
/begin MEASUREMENT B_mxks2 "Bedingung: Max-Fehler Klopfsensor 2" UWORD B_TRUE 1 100 0 1 BIT_MASK 0x100 FORMAT "%5.3" /begin IF_DATA ASAP1B_KWP2000 KP_BLOB 0x382AB6 EXTERN 0x2 /end IF_DATA /begin IF_DATA ETK KP_BLOB 0x382AB6 EXTERN 0x2 /end IF_DATA /end MEASUREMENT
/begin MEASUREMENT B_mxks3 "Bedingung: Max-Fehler Klopfsensor 3" UWORD B_TRUE 1 100 0 1 BIT_MASK 0x100 FORMAT "%5.3" /begin IF_DATA ASAP1B_KWP2000 KP_BLOB 0x382AB8 EXTERN 0x2 /end IF_DATA /begin IF_DATA ETK KP_BLOB 0x382AB8 EXTERN 0x2 /end IF_DATA /end MEASUREMENT
/begin MEASUREMENT B_mxks4 "Bedingung: Max-Fehler Klopfsensor 4" UWORD B_TRUE 1 100 0 1 BIT_MASK 0x100 FORMAT "%5.3" /begin IF_DATA ASAP1B_KWP2000 KP_BLOB 0x382ABA EXTERN 0x2 /end IF_DATA /begin IF_DATA ETK KP_BLOB 0x382ABA EXTERN 0x2 /end IF_DATA /end MEASUREMENT
/begin MEASUREMENT B_mxmile "Fehlerart: Kurzschluß Ubat an MIL-Endstufe" UWORD B_TRUE 1 100 0 1 BIT_MASK 0x100 FORMAT "%5.3" /begin IF_DATA ASAP1B_KWP2000 KP_BLOB 0x382AC4 EXTERN 0x2 /end IF_DATA /begin IF_DATA ETK KP_BLOB 0x382AC4 EXTERN 0x2 /end IF_DATA /end MEASUREMENT
/begin MEASUREMENT B_mxmilse "Fehlerart: Kurzschluß nach Ubat an Endstufe kundenspezifische Fehlerlampe" UWORD B_TRUE 1 100 0 1 BIT_MASK 0x100 FORMAT "%5.3" /begin IF_DATA ASAP1B_KWP2000 KP_BLOB 0x382AC6 EXTERN 0x2 /end IF_DATA /begin IF_DATA ETK KP_BLOB 0x382AC6 EXTERN 0x2 /end IF_DATA /end MEASUREMENT
/begin MEASUREMENT B_mxollae "Fehlerart: Kurzschluß nach Ubat an Endstufe Ölwarnlampe" UWORD B_TRUE 1 100 0 1 BIT_MASK 0x100 FORMAT "%5.3" /begin IF_DATA ASAP1B_KWP2000 KP_BLOB 0x382ACA EXTERN 0x2 /end IF_DATA /begin IF_DATA ETK KP_BLOB 0x382ACA EXTERN 0x2 /end IF_DATA /end MEASUREMENT
/begin MEASUREMENT B_mxph "Fehlerart: Kurzschluß Ubat Phasengeber" UWORD B_TRUE 1 100 0 1 BIT_MASK 0x100 FORMAT "%5.3" /begin IF_DATA ASAP1B_KWP2000 KP_BLOB 0x382ACC EXTERN 0x2 /end IF_DATA /begin IF_DATA ETK KP_BLOB 0x382ACC EXTERN 0x2 /end IF_DATA /end MEASUREMENT
/begin MEASUREMENT B_mxshlae "Fehlerart: Kurzschluß nach Ubat an Endstufe Schaltlampe" UWORD B_TRUE 1 100 0 1 BIT_MASK 0x100 FORMAT "%5.3" /begin IF_DATA ASAP1B_KWP2000 KP_BLOB 0x382ACE EXTERN 0x2 /end IF_DATA /begin IF_DATA ETK KP_BLOB 0x382ACE EXTERN 0x2 /end IF_DATA /end MEASUREMENT
/begin MEASUREMENT B_mxta "Fehlertyp: Maximalwertüberschreitung Ansauglufttemperatur TANS" UWORD B_TRUE 1 100 0 1 BIT_MASK 0x100 FORMAT "%5.3" /begin IF_DATA ASAP1B_KWP2000 KP_BLOB 0x382AD0 EXTERN 0x2 /end IF_DATA /begin IF_DATA ETK KP_BLOB 0x382AD0 EXTERN 0x2 /end IF_DATA /end MEASUREMENT
/begin MEASUREMENT B_mxtfuel "Fehlertyp: Maximalwertüberschreitung Kraftstofftemperatur" UWORD B_TRUE 1 100 0 1 BIT_MASK 0x100 FORMAT "%5.3" /begin IF_DATA ASAP1B_KWP2000 KP_BLOB 0x382AD2 EXTERN 0x2 /end IF_DATA /begin IF_DATA ETK KP_BLOB 0x382AD2 EXTERN 0x2 /end IF_DATA /end MEASUREMENT
/begin MEASUREMENT B_mxtm "Fehlertyp: Maximalwertüberschreitung Motortemperatur" UWORD B_TRUE 1 100 0 1 BIT_MASK 0x100 FORMAT "%5.3" /begin IF_DATA ASAP1B_KWP2000 KP_BLOB 0x382AD4 EXTERN 0x2 /end IF_DATA /begin IF_DATA ETK KP_BLOB 0x382AD4 EXTERN 0x2 /end IF_DATA /end MEASUREMENT
/begin MEASUREMENT B_mxtol "Fehlertyp: Maximalwertüberschreitung (Motor-) Oeltemperatur" UWORD B_TRUE 1 100 0 1 BIT_MASK 0x100 FORMAT "%5.3" /begin IF_DATA ASAP1B_KWP2000 KP_BLOB 0x382AD6 EXTERN 0x2 /end IF_DATA /begin IF_DATA ETK KP_BLOB 0x382AD6 EXTERN 0x2 /end IF_DATA /end MEASUREMENT
/begin MEASUREMENT B_mxub "Fehlertyp: Maximalwertüberschreitung Batteriespannung (Bordnetz)" UWORD B_TRUE 1 100 0 1 BIT_MASK 0x100 FORMAT "%5.3" /begin IF_DATA ASAP1B_KWP2000 KP_BLOB 0x382ADA EXTERN 0x2 /end IF_DATA /begin IF_DATA ETK KP_BLOB 0x382ADA EXTERN 0x2 /end IF_DATA /end MEASUREMENT
/begin MEASUREMENT B_mxvfz "Fehlertyp max.: Fahrzeuggeschwindigkeit" UWORD B_TRUE 1 100 0 1 BIT_MASK 0x100 FORMAT "%5.3" /begin IF_DATA ASAP1B_KWP2000 KP_BLOB 0x382ADC EXTERN 0x2 /end IF_DATA /begin IF_DATA ETK KP_BLOB 0x382ADC EXTERN 0x2 /end IF_DATA /end MEASUREMENT
/begin MEASUREMENT B_nachlram "Steuerung SG-Nachlauf mit Systemcheck" UWORD B_TRUE 1 100 0 1 BIT_MASK 0x4000 FORMAT "%5.3" /begin IF_DATA ASAP1B_KWP2000 KP_BLOB 0xFD44 INTERN 0x2 /end IF_DATA /begin IF_DATA ETK KP_BLOB 0xFD44 INTERN 0x2 /end IF_DATA /end MEASUREMENT
/begin MEASUREMENT B_nnot "Bedingung Drehzahlanhebung im Notlauf" UWORD B_TRUE 1 100 0 1 BIT_MASK 0x8000 FORMAT "%5.3" /begin IF_DATA ASAP1B_KWP2000 KP_BLOB 0xFD44 INTERN 0x2 /end IF_DATA /begin IF_DATA ETK KP_BLOB 0xFD44 INTERN 0x2 /end IF_DATA /end MEASUREMENT
/begin MEASUREMENT B_npats "Bedingung: Unplausible Periodendauer vom Abgastemperatursensor" UWORD B_TRUE 1 100 0 1 BIT_MASK 0x800 FORMAT "%5.3" /begin IF_DATA ASAP1B_KWP2000 KP_BLOB 0x382A86 EXTERN 0x2 /end IF_DATA /begin IF_DATA ETK KP_BLOB 0x382A86 EXTERN 0x2 /end IF_DATA /end MEASUREMENT
/begin MEASUREMENT B_npdsfue "Fehlerart: Drucksensor Kraftstoff nicht plausibel" UWORD B_TRUE 1 100 0 1 BIT_MASK 0x800 FORMAT "%5.3" /begin IF_DATA ASAP1B_KWP2000 KP_BLOB 0x382A8E EXTERN 0x2 /end IF_DATA /begin IF_DATA ETK KP_BLOB 0x382A8E EXTERN 0x2 /end IF_DATA /end MEASUREMENT
/begin MEASUREMENT B_npdsl "Bedingung: Ladedrucksensor nicht plausibel" UWORD B_TRUE 1 100 0 1 BIT_MASK 0x800 FORMAT "%5.3" /begin IF_DATA ASAP1B_KWP2000 KP_BLOB 0x382A90 EXTERN 0x2 /end IF_DATA /begin IF_DATA ETK KP_BLOB 0x382A90 EXTERN 0x2 /end IF_DATA /end MEASUREMENT
/begin MEASUREMENT B_npdsoel "Fehlerart: Drucksensor Oel nicht plausibel" UWORD B_TRUE 1 100 0 1 BIT_MASK 0x800 FORMAT "%5.3" /begin IF_DATA ASAP1B_KWP2000 KP_BLOB 0x382A92 EXTERN 0x2 /end IF_DATA /begin IF_DATA ETK KP_BLOB 0x382A92 EXTERN 0x2 /end IF_DATA /end MEASUREMENT
/begin MEASUREMENT B_npdsu "Bedingung: Umgebungsdrucksensor nicht plausibel" UWORD B_TRUE 1 100 0 1 BIT_MASK 0x800 FORMAT "%5.3" /begin IF_DATA ASAP1B_KWP2000 KP_BLOB 0x382A96 EXTERN 0x2 /end IF_DATA /begin IF_DATA ETK KP_BLOB 0x382A96 EXTERN 0x2 /end IF_DATA /end MEASUREMENT
/begin MEASUREMENT B_npdsvlu "Bedingung: Drucksensorsignalvergleich nicht plausibel (DS-L DS-U)" UWORD B_TRUE 1 100 0 1 BIT_MASK 0x800 FORMAT "%5.3" /begin IF_DATA ASAP1B_KWP2000 KP_BLOB 0x382A98 EXTERN 0x2 /end IF_DATA /begin IF_DATA ETK KP_BLOB 0x382A98 EXTERN 0x2 /end IF_DATA /end MEASUREMENT
/begin MEASUREMENT B_npev1 "Fehlerart: Zustand nicht plausibel EV1" UWORD B_TRUE 1 100 0 1 BIT_MASK 0x800 FORMAT "%5.3" /begin IF_DATA ASAP1B_KWP2000 KP_BLOB 0x382A9A EXTERN 0x2 /end IF_DATA /begin IF_DATA ETK KP_BLOB 0x382A9A EXTERN 0x2 /end IF_DATA /end MEASUREMENT
/begin MEASUREMENT B_npev2 "Fehlerart: Zustand nicht plausibel EV2" UWORD B_TRUE 1 100 0 1 BIT_MASK 0x800 FORMAT "%5.3" /begin IF_DATA ASAP1B_KWP2000 KP_BLOB 0x382A9C EXTERN 0x2 /end IF_DATA /begin IF_DATA ETK KP_BLOB 0x382A9C EXTERN 0x2 /end IF_DATA /end MEASUREMENT
/begin MEASUREMENT B_npev3 "Fehlerart: Zustand nicht plausibel EV3" UWORD B_TRUE 1 100 0 1 BIT_MASK 0x800 FORMAT "%5.3" /begin IF_DATA ASAP1B_KWP2000 KP_BLOB 0x382A9E EXTERN 0x2 /end IF_DATA /begin IF_DATA ETK KP_BLOB 0x382A9E EXTERN 0x2 /end IF_DATA /end MEASUREMENT
/begin MEASUREMENT B_npev4 "Fehlerart: Zustand nicht plausibel EV4" UWORD B_TRUE 1 100 0 1 BIT_MASK 0x800 FORMAT "%5.3" /begin IF_DATA ASAP1B_KWP2000 KP_BLOB 0x382AA0 EXTERN 0x2 /end IF_DATA /begin IF_DATA ETK KP_BLOB 0x382AA0 EXTERN 0x2 /end IF_DATA /end MEASUREMENT
/begin MEASUREMENT B_npev5 "Fehlerart: Zustand nicht plausibel EV5" UWORD B_TRUE 1 100 0 1 BIT_MASK 0x800 FORMAT "%5.3" /begin IF_DATA ASAP1B_KWP2000 KP_BLOB 0x382AA2 EXTERN 0x2 /end IF_DATA /begin IF_DATA ETK KP_BLOB 0x382AA2 EXTERN 0x2 /end IF_DATA /end MEASUREMENT
/begin MEASUREMENT B_npev6 "Fehlerart: Zustand nicht plausibel EV6" UWORD B_TRUE 1 100 0 1 BIT_MASK 0x800 FORMAT "%5.3" /begin IF_DATA ASAP1B_KWP2000 KP_BLOB 0x382AA4 EXTERN 0x2 /end IF_DATA /begin IF_DATA ETK KP_BLOB 0x382AA4 EXTERN 0x2 /end IF_DATA /end MEASUREMENT
/begin MEASUREMENT B_npgsh "Fehlerart: Anforderung Getriebeschaltfunktion nicht plausibel" UWORD B_TRUE 1 100 0 1 BIT_MASK 0x800 FORMAT "%5.3" /begin IF_DATA ASAP1B_KWP2000 KP_BLOB 0x382AA6 EXTERN 0x2 /end IF_DATA /begin IF_DATA ETK KP_BLOB 0x382AA6 EXTERN 0x2 /end IF_DATA /end MEASUREMENT
/begin MEASUREMENT B_nphlsu "Bedingung Signal LSU1 ist unplausibel" UWORD B_TRUE 1 100 0 1 BIT_MASK 0x200 FORMAT "%5.3" /begin IF_DATA ASAP1B_KWP2000 KP_BLOB 0xFD1C INTERN 0x2 /end IF_DATA /begin IF_DATA ETK KP_BLOB 0xFD1C INTERN 0x2 /end IF_DATA /end MEASUREMENT
/begin MEASUREMENT B_nphlsu2 "Bedingung Signal LSU2 ist unplausibel" UWORD B_TRUE 1 100 0 1 BIT_MASK 0x400 FORMAT "%5.3" /begin IF_DATA ASAP1B_KWP2000 KP_BLOB 0xFD1C INTERN 0x2 /end IF_DATA /begin IF_DATA ETK KP_BLOB 0xFD1C INTERN 0x2 /end IF_DATA /end MEASUREMENT
/begin MEASUREMENT B_nphsv "Nernstwiderstand Sonde vor Kat zu groß" UWORD B_TRUE 1 100 0 1 BIT_MASK 0x800 FORMAT "%5.3" /begin IF_DATA ASAP1B_KWP2000 KP_BLOB 0x382AA8 EXTERN 0x2 /end IF_DATA /begin IF_DATA ETK KP_BLOB 0x382AA8 EXTERN 0x2 /end IF_DATA /end MEASUREMENT
/begin MEASUREMENT B_nphsv2 "Nernstwiderstand Sonde 2 vor Kat zu groß" UWORD B_TRUE 1 100 0 1 BIT_MASK 0x800 FORMAT "%5.3" /begin IF_DATA ASAP1B_KWP2000 KP_BLOB 0x382AAA EXTERN 0x2 /end IF_DATA /begin IF_DATA ETK KP_BLOB 0x382AAA EXTERN 0x2 /end IF_DATA /end MEASUREMENT
/begin MEASUREMENT B_npkpe "Bedingung für Fehlertyp 'Wert unplausibel' für EKP-Relais Endstufe erkannt" UWORD B_TRUE 1 100 0 1 BIT_MASK 0x800 FORMAT "%5.3" /begin IF_DATA ASAP1B_KWP2000 KP_BLOB 0x382AAC EXTERN 0x2 /end IF_DATA /begin IF_DATA ETK KP_BLOB 0x382AAC EXTERN 0x2 /end IF_DATA /end MEASUREMENT
/begin MEASUREMENT B_npkrnt "Bedingung Plausibilitätsfehler der KR-Diagnose Integratorsteigung" UWORD B_TRUE 1 100 0 1 BIT_MASK 0x800 FORMAT "%5.3" /begin IF_DATA ASAP1B_KWP2000 KP_BLOB 0x382AAE EXTERN 0x2 /end IF_DATA /begin IF_DATA ETK KP_BLOB 0x382AAE EXTERN 0x2 /end IF_DATA /end MEASUREMENT
/begin MEASUREMENT B_npkrof "Bedingung Plausibilitätsfehler der KR-Diagnose Resetwert" UWORD B_TRUE 1 100 0 1 BIT_MASK 0x800 FORMAT "%5.3" /begin IF_DATA ASAP1B_KWP2000 KP_BLOB 0x382AB0 EXTERN 0x2 /end IF_DATA /begin IF_DATA ETK KP_BLOB 0x382AB0 EXTERN 0x2 /end IF_DATA /end MEASUREMENT
/begin MEASUREMENT B_npkrtp "Bedingung Plausibilitätsfehler der KR-Diagnose Testimpuls" UWORD B_TRUE 1 100 0 1 BIT_MASK 0x800 FORMAT "%5.3" /begin IF_DATA ASAP1B_KWP2000 KP_BLOB 0x382AB2 EXTERN 0x2 /end IF_DATA /begin IF_DATA ETK KP_BLOB 0x382AB2 EXTERN 0x2 /end IF_DATA /end MEASUREMENT
/begin MEASUREMENT B_npks1 "Nicht plausibler Fehler: Klopfsensor 1" UWORD B_TRUE 1 100 0 1 BIT_MASK 0x800 FORMAT "%5.3" /begin IF_DATA ASAP1B_KWP2000 KP_BLOB 0x382AB4 EXTERN 0x2 /end IF_DATA /begin IF_DATA ETK KP_BLOB 0x382AB4 EXTERN 0x2 /end IF_DATA /end MEASUREMENT
/begin MEASUREMENT B_npks2 "Nicht plausibler Fehler: Klopfsensor 2" UWORD B_TRUE 1 100 0 1 BIT_MASK 0x800 FORMAT "%5.3" /begin IF_DATA ASAP1B_KWP2000 KP_BLOB 0x382AB6 EXTERN 0x2 /end IF_DATA /begin IF_DATA ETK KP_BLOB 0x382AB6 EXTERN 0x2 /end IF_DATA /end MEASUREMENT
/begin MEASUREMENT B_npks3 "Nicht plausibler Fehler: Klopfsensor 3" UWORD B_TRUE 1 100 0 1 BIT_MASK 0x800 FORMAT "%5.3" /begin IF_DATA ASAP1B_KWP2000 KP_BLOB 0x382AB8 EXTERN 0x2 /end IF_DATA /begin IF_DATA ETK KP_BLOB 0x382AB8 EXTERN 0x2 /end IF_DATA /end MEASUREMENT
/begin MEASUREMENT B_npks4 "Nicht plausibler Fehler: Klopfsensor 4" UWORD B_TRUE 1 100 0 1 BIT_MASK 0x800 FORMAT "%5.3" /begin IF_DATA ASAP1B_KWP2000 KP_BLOB 0x382ABA EXTERN 0x2 /end IF_DATA /begin IF_DATA ETK KP_BLOB 0x382ABA EXTERN 0x2 /end IF_DATA /end MEASUREMENT
/begin MEASUREMENT B_nplap "Fehlerart: Laptriggersignal nicht plausibel" UWORD B_TRUE 1 100 0 1 BIT_MASK 0x800 FORMAT "%5.3" /begin IF_DATA ASAP1B_KWP2000 KP_BLOB 0x382ABC EXTERN 0x2 /end IF_DATA /begin IF_DATA ETK KP_BLOB 0x382ABC EXTERN 0x2 /end IF_DATA /end MEASUREMENT
/begin MEASUREMENT B_nplflsu "Lambdasignal nicht plausibel" UWORD B_TRUE 1 100 0 1 BIT_MASK 0x8 FORMAT "%5.3" /begin IF_DATA ASAP1B_KWP2000 KP_BLOB 0x380A34 EXTERN 0x2 /end IF_DATA /begin IF_DATA ETK KP_BLOB 0x380A34 EXTERN 0x2 /end IF_DATA /end MEASUREMENT
/begin MEASUREMENT B_nplflsu2 "Lambdasignal nicht plausibel, Bank2" UWORD B_TRUE 1 100 0 1 BIT_MASK 0x80 FORMAT "%5.3" /begin IF_DATA ASAP1B_KWP2000 KP_BLOB 0x380A34 EXTERN 0x2 /end IF_DATA /begin IF_DATA ETK KP_BLOB 0x380A34 EXTERN 0x2 /end IF_DATA /end MEASUREMENT
/begin MEASUREMENT B_nplsv "Fehlertyp 'Wert unplausibel' erkannt" UWORD B_TRUE 1 100 0 1 BIT_MASK 0x800 FORMAT "%5.3" /begin IF_DATA ASAP1B_KWP2000 KP_BLOB 0x382AC0 EXTERN 0x2 /end IF_DATA /begin IF_DATA ETK KP_BLOB 0x382AC0 EXTERN 0x2 /end IF_DATA /end MEASUREMENT
/begin MEASUREMENT B_nplsv2 "Fehlertyp 'Wert unplausibel' erkannt Bank2" UWORD B_TRUE 1 100 0 1 BIT_MASK 0x800 FORMAT "%5.3" /begin IF_DATA ASAP1B_KWP2000 KP_BLOB 0x382AC2 EXTERN 0x2 /end IF_DATA /begin IF_DATA ETK KP_BLOB 0x382AC2 EXTERN 0x2 /end IF_DATA /end MEASUREMENT
/begin MEASUREMENT B_npmile "Fehlerart: Zustand nicht plausibel an MIL-Endstufe" UWORD B_TRUE 1 100 0 1 BIT_MASK 0x800 FORMAT "%5.3" /begin IF_DATA ASAP1B_KWP2000 KP_BLOB 0x382AC4 EXTERN 0x2 /end IF_DATA /begin IF_DATA ETK KP_BLOB 0x382AC4 EXTERN 0x2 /end IF_DATA /end MEASUREMENT
/begin MEASUREMENT B_npmilse "Fehlerart: Endstufe kundenspezifische Fehlerlampe nicht plausibel" UWORD B_TRUE 1 100 0 1 BIT_MASK 0x800 FORMAT "%5.3" /begin IF_DATA ASAP1B_KWP2000 KP_BLOB 0x382AC6 EXTERN 0x2 /end IF_DATA /begin IF_DATA ETK KP_BLOB 0x382AC6 EXTERN 0x2 /end IF_DATA /end MEASUREMENT
/begin MEASUREMENT B_npollae "Fehlerart: Endstufe Ölwarnlampe nicht plausibel" UWORD B_TRUE 1 100 0 1 BIT_MASK 0x800 FORMAT "%5.3" /begin IF_DATA ASAP1B_KWP2000 KP_BLOB 0x382ACA EXTERN 0x2 /end IF_DATA /begin IF_DATA ETK KP_BLOB 0x382ACA EXTERN 0x2 /end IF_DATA /end MEASUREMENT
/begin MEASUREMENT B_npph "Bedingung Phasengebersignal ist unplausibel (ph)" UWORD B_TRUE 1 100 0 1 BIT_MASK 0x800 FORMAT "%5.3" /begin IF_DATA ASAP1B_KWP2000 KP_BLOB 0x382ACC EXTERN 0x2 /end IF_DATA /begin IF_DATA ETK KP_BLOB 0x382ACC EXTERN 0x2 /end IF_DATA /end MEASUREMENT
/begin MEASUREMENT B_npshlae "Fehlerart: Endstufe Schaltlampe nicht plausibel" UWORD B_TRUE 1 100 0 1 BIT_MASK 0x800 FORMAT "%5.3" /begin IF_DATA ASAP1B_KWP2000 KP_BLOB 0x382ACE EXTERN 0x2 /end IF_DATA /begin IF_DATA ETK KP_BLOB 0x382ACE EXTERN 0x2 /end IF_DATA /end MEASUREMENT
/begin MEASUREMENT B_npta "Fehlertyp unplaus.: Ansauglufttemperatur TANS (-Ladeluft)" UWORD B_TRUE 1 100 0 1 BIT_MASK 0x800 FORMAT "%5.3" /begin IF_DATA ASAP1B_KWP2000 KP_BLOB 0x382AD0 EXTERN 0x2 /end IF_DATA /begin IF_DATA ETK KP_BLOB 0x382AD0 EXTERN 0x2 /end IF_DATA /end MEASUREMENT
/begin MEASUREMENT B_nptfuel "Fehlertyp: Kraftstofftemperatur nicht plausibel" UWORD B_TRUE 1 100 0 1 BIT_MASK 0x800 FORMAT "%5.3" /begin IF_DATA ASAP1B_KWP2000 KP_BLOB 0x382AD2 EXTERN 0x2 /end IF_DATA /begin IF_DATA ETK KP_BLOB 0x382AD2 EXTERN 0x2 /end IF_DATA /end MEASUREMENT
/begin MEASUREMENT B_nptm "Fehlerart: Motortemperatursignal nicht plausibel ggü. Modell" UWORD B_TRUE 1 100 0 1 BIT_MASK 0x800 FORMAT "%5.3" /begin IF_DATA ASAP1B_KWP2000 KP_BLOB 0x382AD4 EXTERN 0x2 /end IF_DATA /begin IF_DATA ETK KP_BLOB 0x382AD4 EXTERN 0x2 /end IF_DATA /end MEASUREMENT
/begin MEASUREMENT B_nptol "Nicht plausibler Fehler: Öltemperatur" UWORD B_TRUE 1 100 0 1 BIT_MASK 0x800 FORMAT "%5.3" /begin IF_DATA ASAP1B_KWP2000 KP_BLOB 0x382AD6 EXTERN 0x2 /end IF_DATA /begin IF_DATA ETK KP_BLOB 0x382AD6 EXTERN 0x2 /end IF_DATA /end MEASUREMENT
/begin MEASUREMENT B_npub "Fehlerart: Batteriespannungssignal nicht plausibel" UWORD B_TRUE 1 100 0 1 BIT_MASK 0x800 FORMAT "%5.3" /begin IF_DATA ASAP1B_KWP2000 KP_BLOB 0x382ADA EXTERN 0x2 /end IF_DATA /begin IF_DATA ETK KP_BLOB 0x382ADA EXTERN 0x2 /end IF_DATA /end MEASUREMENT
/begin MEASUREMENT B_nws "Bedingung Nockenwellensteuerung" UWORD B_TRUE 1 100 0 1 BIT_MASK 0x1 FORMAT "%5.3" /begin IF_DATA ASAP1B_KWP2000 KP_BLOB 0xFD46 INTERN 0x2 /end IF_DATA /begin IF_DATA ETK KP_BLOB 0xFD46 INTERN 0x2 /end IF_DATA /end MEASUREMENT
/begin MEASUREMENT B_overtake "Bedingung Overtakefunktion aktiv" UWORD B_TRUE 1 100 0 1 BIT_MASK 0x80 FORMAT "%5.3" /begin IF_DATA ASAP1B_KWP2000 KP_BLOB 0xFD3C INTERN 0x2 /end IF_DATA /begin IF_DATA ETK KP_BLOB 0xFD3C INTERN 0x2 /end IF_DATA /end MEASUREMENT
/begin MEASUREMENT B_phas2 "Bedingung Phase 2 low/high" UWORD B_TRUE 1 100 0 1 BIT_MASK 0x20 FORMAT "%5.3" /begin IF_DATA ASAP1B_KWP2000 KP_BLOB 0xFD1A INTERN 0x2 /end IF_DATA /begin IF_DATA ETK KP_BLOB 0xFD1A INTERN 0x2 /end IF_DATA /end MEASUREMENT
/begin MEASUREMENT B_phase "Bedingung Phase low/high" UWORD B_TRUE 1 100 0 1 BIT_MASK 0x40 FORMAT "%5.3" /begin IF_DATA ASAP1B_KWP2000 KP_BLOB 0xFD1A INTERN 0x2 /end IF_DATA /begin IF_DATA ETK KP_BLOB 0xFD1A INTERN 0x2 /end IF_DATA /end MEASUREMENT
/begin MEASUREMENT B_phsok "Bedingung Phasensignal ok" UWORD B_TRUE 1 100 0 1 BIT_MASK 0x80 FORMAT "%5.3" /begin IF_DATA ASAP1B_KWP2000 KP_BLOB 0xFD1A INTERN 0x2 /end IF_DATA /begin IF_DATA ETK KP_BLOB 0xFD1A INTERN 0x2 /end IF_DATA /end MEASUREMENT
/begin MEASUREMENT B_phsok2 "Bedingung Phasensignal 2 ok" UWORD B_TRUE 1 100 0 1 BIT_MASK 0x100 FORMAT "%5.3" /begin IF_DATA ASAP1B_KWP2000 KP_BLOB 0xFD1A INTERN 0x2 /end IF_DATA /begin IF_DATA ETK KP_BLOB 0xFD1A INTERN 0x2 /end IF_DATA /end MEASUREMENT
/begin MEASUREMENT B_siats "Signalfehler Abgastemperatursensor" UWORD B_TRUE 1 100 0 1 BIT_MASK 0x400 FORMAT "%5.3" /begin IF_DATA ASAP1B_KWP2000 KP_BLOB 0x382A86 EXTERN 0x2 /end IF_DATA /begin IF_DATA ETK KP_BLOB 0x382A86 EXTERN 0x2 /end IF_DATA /end MEASUREMENT
/begin MEASUREMENT B_sidsfue "Fehlerart: Signalfehler Drucksensor Kraftstoff" UWORD B_TRUE 1 100 0 1 BIT_MASK 0x400 FORMAT "%5.3" /begin IF_DATA ASAP1B_KWP2000 KP_BLOB 0x382A8E EXTERN 0x2 /end IF_DATA /begin IF_DATA ETK KP_BLOB 0x382A8E EXTERN 0x2 /end IF_DATA /end MEASUREMENT
/begin MEASUREMENT B_sidsl "Bedingung Signalfehler Ladedrucksensor" UWORD B_TRUE 1 100 0 1 BIT_MASK 0x400 FORMAT "%5.3" /begin IF_DATA ASAP1B_KWP2000 KP_BLOB 0x382A90 EXTERN 0x2 /end IF_DATA /begin IF_DATA ETK KP_BLOB 0x382A90 EXTERN 0x2 /end IF_DATA /end MEASUREMENT
/begin MEASUREMENT B_sidsoel "Fehlerart: Signalfehler Drucksensor Oel" UWORD B_TRUE 1 100 0 1 BIT_MASK 0x400 FORMAT "%5.3" /begin IF_DATA ASAP1B_KWP2000 KP_BLOB 0x382A92 EXTERN 0x2 /end IF_DATA /begin IF_DATA ETK KP_BLOB 0x382A92 EXTERN 0x2 /end IF_DATA /end MEASUREMENT
/begin MEASUREMENT B_sidsu "Fehlerart: Umgebungsdrucksensor" UWORD B_TRUE 1 100 0 1 BIT_MASK 0x400 FORMAT "%5.3" /begin IF_DATA ASAP1B_KWP2000 KP_BLOB 0x382A96 EXTERN 0x2 /end IF_DATA /begin IF_DATA ETK KP_BLOB 0x382A96 EXTERN 0x2 /end IF_DATA /end MEASUREMENT
/begin MEASUREMENT B_sidsvlu "Fehlerart: Drucksensorsingalvergleich (DS-L DS-U)" UWORD B_TRUE 1 100 0 1 BIT_MASK 0x400 FORMAT "%5.3" /begin IF_DATA ASAP1B_KWP2000 KP_BLOB 0x382A98 EXTERN 0x2 /end IF_DATA /begin IF_DATA ETK KP_BLOB 0x382A98 EXTERN 0x2 /end IF_DATA /end MEASUREMENT
/begin MEASUREMENT B_siev1 "Fehlerart: Unterbrechung an Endstufe EV1" UWORD B_TRUE 1 100 0 1 BIT_MASK 0x400 FORMAT "%5.3" /begin IF_DATA ASAP1B_KWP2000 KP_BLOB 0x382A9A EXTERN 0x2 /end IF_DATA /begin IF_DATA ETK KP_BLOB 0x382A9A EXTERN 0x2 /end IF_DATA /end MEASUREMENT
/begin MEASUREMENT B_siev2 "Fehlerart: Unterbrechung an Endstufe EV2" UWORD B_TRUE 1 100 0 1 BIT_MASK 0x400 FORMAT "%5.3" /begin IF_DATA ASAP1B_KWP2000 KP_BLOB 0x382A9C EXTERN 0x2 /end IF_DATA /begin IF_DATA ETK KP_BLOB 0x382A9C EXTERN 0x2 /end IF_DATA /end MEASUREMENT
/begin MEASUREMENT B_siev3 "Fehlerart: Unterbrechung an Endstufe EV3" UWORD B_TRUE 1 100 0 1 BIT_MASK 0x400 FORMAT "%5.3" /begin IF_DATA ASAP1B_KWP2000 KP_BLOB 0x382A9E EXTERN 0x2 /end IF_DATA /begin IF_DATA ETK KP_BLOB 0x382A9E EXTERN 0x2 /end IF_DATA /end MEASUREMENT
/begin MEASUREMENT B_siev4 "Fehlerart: Unterbrechung an Endstufe EV4" UWORD B_TRUE 1 100 0 1 BIT_MASK 0x400 FORMAT "%5.3" /begin IF_DATA ASAP1B_KWP2000 KP_BLOB 0x382AA0 EXTERN 0x2 /end IF_DATA /begin IF_DATA ETK KP_BLOB 0x382AA0 EXTERN 0x2 /end IF_DATA /end MEASUREMENT
/begin MEASUREMENT B_siev5 "Fehlerart: Unterbrechung an Endstufe EV5" UWORD B_TRUE 1 100 0 1 BIT_MASK 0x400 FORMAT "%5.3" /begin IF_DATA ASAP1B_KWP2000 KP_BLOB 0x382AA2 EXTERN 0x2 /end IF_DATA /begin IF_DATA ETK KP_BLOB 0x382AA2 EXTERN 0x2 /end IF_DATA /end MEASUREMENT
/begin MEASUREMENT B_siev6 "Fehlerart: Unterbrechung an Endstufe EV6" UWORD B_TRUE 1 100 0 1 BIT_MASK 0x400 FORMAT "%5.3" /begin IF_DATA ASAP1B_KWP2000 KP_BLOB 0x382AA4 EXTERN 0x2 /end IF_DATA /begin IF_DATA ETK KP_BLOB 0x382AA4 EXTERN 0x2 /end IF_DATA /end MEASUREMENT
/begin MEASUREMENT B_sigflsu "Übersprechen vom Heizertakt auf Lambdasignal" UWORD B_TRUE 1 100 0 1 BIT_MASK 0x4 FORMAT "%5.3" /begin IF_DATA ASAP1B_KWP2000 KP_BLOB 0x380A34 EXTERN 0x2 /end IF_DATA /begin IF_DATA ETK KP_BLOB 0x380A34 EXTERN 0x2 /end IF_DATA /end MEASUREMENT
/begin MEASUREMENT B_sigflsu2 "Übersprechen vom Heizertakt auf Lambdasignal, Bank2" UWORD B_TRUE 1 100 0 1 BIT_MASK 0x40 FORMAT "%5.3" /begin IF_DATA ASAP1B_KWP2000 KP_BLOB 0x380A34 EXTERN 0x2 /end IF_DATA /begin IF_DATA ETK KP_BLOB 0x380A34 EXTERN 0x2 /end IF_DATA /end MEASUREMENT
/begin MEASUREMENT B_sihlsu "Unterbrechung im Heizstromkreis LSU1" UWORD B_TRUE 1 100 0 1 BIT_MASK 0x800 FORMAT "%5.3" /begin IF_DATA ASAP1B_KWP2000 KP_BLOB 0xFD1C INTERN 0x2 /end IF_DATA /begin IF_DATA ETK KP_BLOB 0xFD1C INTERN 0x2 /end IF_DATA /end MEASUREMENT
/begin MEASUREMENT B_sihlsu2 "Unterbrechung im Heizstromkreis LSU2" UWORD B_TRUE 1 100 0 1 BIT_MASK 0x1000 FORMAT "%5.3" /begin IF_DATA ASAP1B_KWP2000 KP_BLOB 0xFD1C INTERN 0x2 /end IF_DATA /begin IF_DATA ETK KP_BLOB 0xFD1C INTERN 0x2 /end IF_DATA /end MEASUREMENT
/begin MEASUREMENT B_sihsv "Lastabfall Sondenheizung vor Kat" UWORD B_TRUE 1 100 0 1 BIT_MASK 0x400 FORMAT "%5.3" /begin IF_DATA ASAP1B_KWP2000 KP_BLOB 0x382AA8 EXTERN 0x2 /end IF_DATA /begin IF_DATA ETK KP_BLOB 0x382AA8 EXTERN 0x2 /end IF_DATA /end MEASUREMENT
/begin MEASUREMENT B_sihsv2 "Lastabfall Sondenheizung2 vor Kat" UWORD B_TRUE 1 100 0 1 BIT_MASK 0x400 FORMAT "%5.3" /begin IF_DATA ASAP1B_KWP2000 KP_BLOB 0x382AAA EXTERN 0x2 /end IF_DATA /begin IF_DATA ETK KP_BLOB 0x382AAA EXTERN 0x2 /end IF_DATA /end MEASUREMENT
/begin MEASUREMENT B_sikpe "Bedingung für Fehlertyp Leitungsabfall für EKP-Relais Endstufe erkannt" UWORD B_TRUE 1 100 0 1 BIT_MASK 0x400 FORMAT "%5.3" /begin IF_DATA ASAP1B_KWP2000 KP_BLOB 0x382AAC EXTERN 0x2 /end IF_DATA /begin IF_DATA ETK KP_BLOB 0x382AAC EXTERN 0x2 /end IF_DATA /end MEASUREMENT
/begin MEASUREMENT B_sikrnt "Fehlertyp: Klopfregelung Nulltest" UWORD B_TRUE 1 100 0 1 BIT_MASK 0x400 FORMAT "%5.3" /begin IF_DATA ASAP1B_KWP2000 KP_BLOB 0x382AAE EXTERN 0x2 /end IF_DATA /begin IF_DATA ETK KP_BLOB 0x382AAE EXTERN 0x2 /end IF_DATA /end MEASUREMENT
/begin MEASUREMENT B_sikrof "Fehlertyp: Klopfregelung Offset" UWORD B_TRUE 1 100 0 1 BIT_MASK 0x400 FORMAT "%5.3" /begin IF_DATA ASAP1B_KWP2000 KP_BLOB 0x382AB0 EXTERN 0x2 /end IF_DATA /begin IF_DATA ETK KP_BLOB 0x382AB0 EXTERN 0x2 /end IF_DATA /end MEASUREMENT
/begin MEASUREMENT B_sikrtp "Fehlertyp: Klopfregelung Testimpuls" UWORD B_TRUE 1 100 0 1 BIT_MASK 0x400 FORMAT "%5.3" /begin IF_DATA ASAP1B_KWP2000 KP_BLOB 0x382AB2 EXTERN 0x2 /end IF_DATA /begin IF_DATA ETK KP_BLOB 0x382AB2 EXTERN 0x2 /end IF_DATA /end MEASUREMENT
/begin MEASUREMENT B_siks1 "Fehlertyp: Klopfsensor 1" UWORD B_TRUE 1 100 0 1 BIT_MASK 0x400 FORMAT "%5.3" /begin IF_DATA ASAP1B_KWP2000 KP_BLOB 0x382AB4 EXTERN 0x2 /end IF_DATA /begin IF_DATA ETK KP_BLOB 0x382AB4 EXTERN 0x2 /end IF_DATA /end MEASUREMENT
/begin MEASUREMENT B_siks2 "Fehlertyp: Klopfsensor 2" UWORD B_TRUE 1 100 0 1 BIT_MASK 0x400 FORMAT "%5.3" /begin IF_DATA ASAP1B_KWP2000 KP_BLOB 0x382AB6 EXTERN 0x2 /end IF_DATA /begin IF_DATA ETK KP_BLOB 0x382AB6 EXTERN 0x2 /end IF_DATA /end MEASUREMENT
/begin MEASUREMENT B_siks3 "Fehlertyp: Klopfsensor 3" UWORD B_TRUE 1 100 0 1 BIT_MASK 0x400 FORMAT "%5.3" /begin IF_DATA ASAP1B_KWP2000 KP_BLOB 0x382AB8 EXTERN 0x2 /end IF_DATA /begin IF_DATA ETK KP_BLOB 0x382AB8 EXTERN 0x2 /end IF_DATA /end MEASUREMENT
/begin MEASUREMENT B_siks4 "Fehlertyp: Klopfsensor 4" UWORD B_TRUE 1 100 0 1 BIT_MASK 0x400 FORMAT "%5.3" /begin IF_DATA ASAP1B_KWP2000 KP_BLOB 0x382ABA EXTERN 0x2 /end IF_DATA /begin IF_DATA ETK KP_BLOB 0x382ABA EXTERN 0x2 /end IF_DATA /end MEASUREMENT
/begin MEASUREMENT B_silsv "Fehlertyp 'Signal fehlt' vor KAT erkannt" UWORD B_TRUE 1 100 0 1 BIT_MASK 0x400 FORMAT "%5.3" /begin IF_DATA ASAP1B_KWP2000 KP_BLOB 0x382AC0 EXTERN 0x2 /end IF_DATA /begin IF_DATA ETK KP_BLOB 0x382AC0 EXTERN 0x2 /end IF_DATA /end MEASUREMENT
/begin MEASUREMENT B_silsv2 "Fehlertyp 'Signal fehlt' vor KAT erkannt Bank2" UWORD B_TRUE 1 100 0 1 BIT_MASK 0x400 FORMAT "%5.3" /begin IF_DATA ASAP1B_KWP2000 KP_BLOB 0x382AC2 EXTERN 0x2 /end IF_DATA /begin IF_DATA ETK KP_BLOB 0x382AC2 EXTERN 0x2 /end IF_DATA /end MEASUREMENT
/begin MEASUREMENT B_simile "Fehlerart: Unterbrechung an MIL-Endstufe" UWORD B_TRUE 1 100 0 1 BIT_MASK 0x400 FORMAT "%5.3" /begin IF_DATA ASAP1B_KWP2000 KP_BLOB 0x382AC4 EXTERN 0x2 /end IF_DATA /begin IF_DATA ETK KP_BLOB 0x382AC4 EXTERN 0x2 /end IF_DATA /end MEASUREMENT
/begin MEASUREMENT B_similse "Fehlerart: Unterbrechung an Endstufe kundenspezifische Fehlerlampe" UWORD B_TRUE 1 100 0 1 BIT_MASK 0x400 FORMAT "%5.3" /begin IF_DATA ASAP1B_KWP2000 KP_BLOB 0x382AC6 EXTERN 0x2 /end IF_DATA /begin IF_DATA ETK KP_BLOB 0x382AC6 EXTERN 0x2 /end IF_DATA /end MEASUREMENT
/begin MEASUREMENT B_siollae "Fehlerart: Unterbrechung an Endstufe Ölwarnlampe" UWORD B_TRUE 1 100 0 1 BIT_MASK 0x400 FORMAT "%5.3" /begin IF_DATA ASAP1B_KWP2000 KP_BLOB 0x382ACA EXTERN 0x2 /end IF_DATA /begin IF_DATA ETK KP_BLOB 0x382ACA EXTERN 0x2 /end IF_DATA /end MEASUREMENT
/begin MEASUREMENT B_siph "Bedingung keine alternierende Phasenpegel PG in den Bezugsmarken" UWORD B_TRUE 1 100 0 1 BIT_MASK 0x400 FORMAT "%5.3" /begin IF_DATA ASAP1B_KWP2000 KP_BLOB 0x382ACC EXTERN 0x2 /end IF_DATA /begin IF_DATA ETK KP_BLOB 0x382ACC EXTERN 0x2 /end IF_DATA /end MEASUREMENT
/begin MEASUREMENT B_sishlae "Fehlerart: Unterbrechung an Endstufe Schaltlampe" UWORD B_TRUE 1 100 0 1 BIT_MASK 0x400 FORMAT "%5.3" /begin IF_DATA ASAP1B_KWP2000 KP_BLOB 0x382ACE EXTERN 0x2 /end IF_DATA /begin IF_DATA ETK KP_BLOB 0x382ACE EXTERN 0x2 /end IF_DATA /end MEASUREMENT
/begin MEASUREMENT B_sita "Fehlertyp: Ansauglufttemperatur TANS (-Ladeluft)" UWORD B_TRUE 1 100 0 1 BIT_MASK 0x400 FORMAT "%5.3" /begin IF_DATA ASAP1B_KWP2000 KP_BLOB 0x382AD0 EXTERN 0x2 /end IF_DATA /begin IF_DATA ETK KP_BLOB 0x382AD0 EXTERN 0x2 /end IF_DATA /end MEASUREMENT
/begin MEASUREMENT B_sitfuel "Fehlertyp: Signalfehler Kraftstofftemperatur" UWORD B_TRUE 1 100 0 1 BIT_MASK 0x400 FORMAT "%5.3" /begin IF_DATA ASAP1B_KWP2000 KP_BLOB 0x382AD2 EXTERN 0x2 /end IF_DATA /begin IF_DATA ETK KP_BLOB 0x382AD2 EXTERN 0x2 /end IF_DATA /end MEASUREMENT
/begin MEASUREMENT B_sitm "Fehlerart: Motortemperaturschwelle für Lambdaregelungsfreigabe nicht erreicht" UWORD B_TRUE 1 100 0 1 BIT_MASK 0x400 FORMAT "%5.3" /begin IF_DATA ASAP1B_KWP2000 KP_BLOB 0x382AD4 EXTERN 0x2 /end IF_DATA /begin IF_DATA ETK KP_BLOB 0x382AD4 EXTERN 0x2 /end IF_DATA /end MEASUREMENT
/begin MEASUREMENT B_sitol "Fehlertyp: Öltemperatur" UWORD B_TRUE 1 100 0 1 BIT_MASK 0x400 FORMAT "%5.3" /begin IF_DATA ASAP1B_KWP2000 KP_BLOB 0x382AD6 EXTERN 0x2 /end IF_DATA /begin IF_DATA ETK KP_BLOB 0x382AD6 EXTERN 0x2 /end IF_DATA /end MEASUREMENT
/begin MEASUREMENT B_siub "Fehlertyp: Umweltbedingungen" UWORD B_TRUE 1 100 0 1 BIT_MASK 0x400 FORMAT "%5.3" /begin IF_DATA ASAP1B_KWP2000 KP_BLOB 0x382ADA EXTERN 0x2 /end IF_DATA /begin IF_DATA ETK KP_BLOB 0x382ADA EXTERN 0x2 /end IF_DATA /end MEASUREMENT
/begin MEASUREMENT B_sivfz "Bedingung fehlendes Signal Fahrzeuggeschwindigkeit" UWORD B_TRUE 1 100 0 1 BIT_MASK 0x400 FORMAT "%5.3" /begin IF_DATA ASAP1B_KWP2000 KP_BLOB 0x382ADC EXTERN 0x2 /end IF_DATA /begin IF_DATA ETK KP_BLOB 0x382ADC EXTERN 0x2 /end IF_DATA /end MEASUREMENT
/begin MEASUREMENT B_wuc "Bedingung 'warm up cycle' erkannt" UBYTE B_TRUE 1 100 0 1 BIT_MASK 0x1 FORMAT "%5.3" /begin IF_DATA ASAP1B_KWP2000 KP_BLOB 0x380344 EXTERN 0x1 /end IF_DATA /begin IF_DATA ETK KP_BLOB 0x380344 EXTERN 0x1 /end IF_DATA /end MEASUREMENT
/begin MEASUREMENT DLSUebits "" UWORD dez 1 100 0 65535 FORMAT "%8.2" /begin IF_DATA ASAP1B_KWP2000 KP_BLOB 0x380A34 EXTERN 0x2 /end IF_DATA /begin IF_DATA ETK KP_BLOB 0x380A34 EXTERN 0x2 /end IF_DATA /end MEASUREMENT
/begin MEASUREMENT dummyram "" UBYTE dez 1 100 0 255 FORMAT "%5.1" /begin IF_DATA ASAP1B_KWP2000 KP_BLOB 0x38045F EXTERN 0x1 /end IF_DATA /begin IF_DATA ETK KP_BLOB 0x38045F EXTERN 0x1 /end IF_DATA /end MEASUREMENT
/begin MEASUREMENT dynlsu2_w "Dynamikwert der LSU, Bank 2" UWORD fak_uw_b16 1 100 0 15.9998 FORMAT "%8.5" /begin IF_DATA ASAP1B_KWP2000 KP_BLOB 0x382AE6 EXTERN 0x2 /end IF_DATA /begin IF_DATA ETK KP_BLOB 0x382AE6 EXTERN 0x2 /end IF_DATA /end MEASUREMENT
/begin MEASUREMENT ESSTTbits "Bits zur Funktion Start" UBYTE dez 1 100 0 255 FORMAT "%5.1" /begin IF_DATA ASAP1B_KWP2000 KP_BLOB 0x382857 EXTERN 0x1 /end IF_DATA /begin IF_DATA ETK KP_BLOB 0x382857 EXTERN 0x1 /end IF_DATA /end MEASUREMENT
/begin MEASUREMENT E_ats "Errorflag Abgastemperatursensor" UWORD B_TRUE 1 100 0 1 BIT_MASK 0x1 FORMAT "%5.3" /begin IF_DATA ASAP1B_KWP2000 KP_BLOB 0x382A86 EXTERN 0x2 /end IF_DATA /begin IF_DATA ETK KP_BLOB 0x382A86 EXTERN 0x2 /end IF_DATA /end MEASUREMENT
/begin MEASUREMENT E_ats2 "Fehlerflag: Abgastemperatursensor Bank 2" UWORD B_TRUE 1 100 0 1 BIT_MASK 0x1 FORMAT "%5.3" /begin IF_DATA ASAP1B_KWP2000 KP_BLOB 0x382A88 EXTERN 0x2 /end IF_DATA /begin IF_DATA ETK KP_BLOB 0x382A88 EXTERN 0x2 /end IF_DATA /end MEASUREMENT
/begin MEASUREMENT E_dsfue "Errorflag: Drucksensor Kraftstoff" UWORD B_TRUE 1 100 0 1 BIT_MASK 0x1 FORMAT "%5.3" /begin IF_DATA ASAP1B_KWP2000 KP_BLOB 0x382A8E EXTERN 0x2 /end IF_DATA /begin IF_DATA ETK KP_BLOB 0x382A8E EXTERN 0x2 /end IF_DATA /end MEASUREMENT
/begin MEASUREMENT E_dsl "Errorflag: Drucksensor Ladedruck" UWORD B_TRUE 1 100 0 1 BIT_MASK 0x1 FORMAT "%5.3" /begin IF_DATA ASAP1B_KWP2000 KP_BLOB 0x382A90 EXTERN 0x2 /end IF_DATA /begin IF_DATA ETK KP_BLOB 0x382A90 EXTERN 0x2 /end IF_DATA /end MEASUREMENT
/begin MEASUREMENT E_dsoel "Errorflag: Drucksensor Oel" UWORD B_TRUE 1 100 0 1 BIT_MASK 0x1 FORMAT "%5.3" /begin IF_DATA ASAP1B_KWP2000 KP_BLOB 0x382A92 EXTERN 0x2 /end IF_DATA /begin IF_DATA ETK KP_BLOB 0x382A92 EXTERN 0x2 /end IF_DATA /end MEASUREMENT
/begin MEASUREMENT E_dss "Errorflag: Saugrohr-Drucksensor" UWORD B_TRUE 1 100 0 1 BIT_MASK 0x1 FORMAT "%5.3" /begin IF_DATA ASAP1B_KWP2000 KP_BLOB 0x382A94 EXTERN 0x2 /end IF_DATA /begin IF_DATA ETK KP_BLOB 0x382A94 EXTERN 0x2 /end IF_DATA /end MEASUREMENT
/begin MEASUREMENT E_dsu "Errorflag: Umgebungsdrucksensor" UWORD B_TRUE 1 100 0 1 BIT_MASK 0x1 FORMAT "%5.3" /begin IF_DATA ASAP1B_KWP2000 KP_BLOB 0x382A96 EXTERN 0x2 /end IF_DATA /begin IF_DATA ETK KP_BLOB 0x382A96 EXTERN 0x2 /end IF_DATA /end MEASUREMENT
/begin MEASUREMENT E_dsvlu "Errorflag: Drucksensorsignalvergleich (DS-L DS-U)" UWORD B_TRUE 1 100 0 1 BIT_MASK 0x1 FORMAT "%5.3" /begin IF_DATA ASAP1B_KWP2000 KP_BLOB 0x382A98 EXTERN 0x2 /end IF_DATA /begin IF_DATA ETK KP_BLOB 0x382A98 EXTERN 0x2 /end IF_DATA /end MEASUREMENT
/begin MEASUREMENT E_ev1 "Errorflag: EV von Zyl. 1" UWORD B_TRUE 1 100 0 1 BIT_MASK 0x1 FORMAT "%5.3" /begin IF_DATA ASAP1B_KWP2000 KP_BLOB 0x382A9A EXTERN 0x2 /end IF_DATA /begin IF_DATA ETK KP_BLOB 0x382A9A EXTERN 0x2 /end IF_DATA /end MEASUREMENT
/begin MEASUREMENT E_ev2 "Errorflag: EV von Zyl. 2" UWORD B_TRUE 1 100 0 1 BIT_MASK 0x1 FORMAT "%5.3" /begin IF_DATA ASAP1B_KWP2000 KP_BLOB 0x382A9C EXTERN 0x2 /end IF_DATA /begin IF_DATA ETK KP_BLOB 0x382A9C EXTERN 0x2 /end IF_DATA /end MEASUREMENT
/begin MEASUREMENT E_ev3 "Errorflag: EV von Zyl. 3" UWORD B_TRUE 1 100 0 1 BIT_MASK 0x1 FORMAT "%5.3" /begin IF_DATA ASAP1B_KWP2000 KP_BLOB 0x382A9E EXTERN 0x2 /end IF_DATA /begin IF_DATA ETK KP_BLOB 0x382A9E EXTERN 0x2 /end IF_DATA /end MEASUREMENT
/begin MEASUREMENT E_ev4 "Errorflag: EV von Zyl. 4" UWORD B_TRUE 1 100 0 1 BIT_MASK 0x1 FORMAT "%5.3" /begin IF_DATA ASAP1B_KWP2000 KP_BLOB 0x382AA0 EXTERN 0x2 /end IF_DATA /begin IF_DATA ETK KP_BLOB 0x382AA0 EXTERN 0x2 /end IF_DATA /end MEASUREMENT
/begin MEASUREMENT E_ev5 "Errorflag: EV von Zyl. 5" UWORD B_TRUE 1 100 0 1 BIT_MASK 0x1 FORMAT "%5.3" /begin IF_DATA ASAP1B_KWP2000 KP_BLOB 0x382AA2 EXTERN 0x2 /end IF_DATA /begin IF_DATA ETK KP_BLOB 0x382AA2 EXTERN 0x2 /end IF_DATA /end MEASUREMENT
/begin MEASUREMENT E_ev6 "Errorflag: EV von Zyl. 6" UWORD B_TRUE 1 100 0 1 BIT_MASK 0x1 FORMAT "%5.3" /begin IF_DATA ASAP1B_KWP2000 KP_BLOB 0x382AA4 EXTERN 0x2 /end IF_DATA /begin IF_DATA ETK KP_BLOB 0x382AA4 EXTERN 0x2 /end IF_DATA /end MEASUREMENT
/begin MEASUREMENT E_gsh "Errorflag Anforderung für Getriebeschaltfunktion" UWORD B_TRUE 1 100 0 1 BIT_MASK 0x1 FORMAT "%5.3" /begin IF_DATA ASAP1B_KWP2000 KP_BLOB 0x382AA6 EXTERN 0x2 /end IF_DATA /begin IF_DATA ETK KP_BLOB 0x382AA6 EXTERN 0x2 /end IF_DATA /end MEASUREMENT
/begin MEASUREMENT E_hsv "Errorflag: Lambdasonden-Heizung vor Katalysator" UWORD B_TRUE 1 100 0 1 BIT_MASK 0x1 FORMAT "%5.3" /begin IF_DATA ASAP1B_KWP2000 KP_BLOB 0x382AA8 EXTERN 0x2 /end IF_DATA /begin IF_DATA ETK KP_BLOB 0x382AA8 EXTERN 0x2 /end IF_DATA /end MEASUREMENT
/begin MEASUREMENT E_hsv2 "Errorflag: Lambdasonden-Heizung vor Katalysator Bank 2" UWORD B_TRUE 1 100 0 1 BIT_MASK 0x1 FORMAT "%5.3" /begin IF_DATA ASAP1B_KWP2000 KP_BLOB 0x382AAA EXTERN 0x2 /end IF_DATA /begin IF_DATA ETK KP_BLOB 0x382AAA EXTERN 0x2 /end IF_DATA /end MEASUREMENT
/begin MEASUREMENT E_kpe "Errorflag: EKP-Relais Endstufe" UWORD B_TRUE 1 100 0 1 BIT_MASK 0x1 FORMAT "%5.3" /begin IF_DATA ASAP1B_KWP2000 KP_BLOB 0x382AAC EXTERN 0x2 /end IF_DATA /begin IF_DATA ETK KP_BLOB 0x382AAC EXTERN 0x2 /end IF_DATA /end MEASUREMENT
/begin MEASUREMENT E_krnt "Errorflag: Klopfregelung Nulltest" UWORD B_TRUE 1 100 0 1 BIT_MASK 0x1 FORMAT "%5.3" /begin IF_DATA ASAP1B_KWP2000 KP_BLOB 0x382AAE EXTERN 0x2 /end IF_DATA /begin IF_DATA ETK KP_BLOB 0x382AAE EXTERN 0x2 /end IF_DATA /end MEASUREMENT
/begin MEASUREMENT E_krof "Errorflag: Klopfregelung Offset" UWORD B_TRUE 1 100 0 1 BIT_MASK 0x1 FORMAT "%5.3" /begin IF_DATA ASAP1B_KWP2000 KP_BLOB 0x382AB0 EXTERN 0x2 /end IF_DATA /begin IF_DATA ETK KP_BLOB 0x382AB0 EXTERN 0x2 /end IF_DATA /end MEASUREMENT
/begin MEASUREMENT E_krtp "Errorflag: Klopfregelung Testimpuls" UWORD B_TRUE 1 100 0 1 BIT_MASK 0x1 FORMAT "%5.3" /begin IF_DATA ASAP1B_KWP2000 KP_BLOB 0x382AB2 EXTERN 0x2 /end IF_DATA /begin IF_DATA ETK KP_BLOB 0x382AB2 EXTERN 0x2 /end IF_DATA /end MEASUREMENT
/begin MEASUREMENT E_ks1 "Errorflag: Klopfsensor 1" UWORD B_TRUE 1 100 0 1 BIT_MASK 0x1 FORMAT "%5.3" /begin IF_DATA ASAP1B_KWP2000 KP_BLOB 0x382AB4 EXTERN 0x2 /end IF_DATA /begin IF_DATA ETK KP_BLOB 0x382AB4 EXTERN 0x2 /end IF_DATA /end MEASUREMENT
/begin MEASUREMENT E_ks2 "Errorflag: Klopfsensor 2" UWORD B_TRUE 1 100 0 1 BIT_MASK 0x1 FORMAT "%5.3" /begin IF_DATA ASAP1B_KWP2000 KP_BLOB 0x382AB6 EXTERN 0x2 /end IF_DATA /begin IF_DATA ETK KP_BLOB 0x382AB6 EXTERN 0x2 /end IF_DATA /end MEASUREMENT
/begin MEASUREMENT E_ks3 "Errorflag: Klopfsensor 3" UWORD B_TRUE 1 100 0 1 BIT_MASK 0x1 FORMAT "%5.3" /begin IF_DATA ASAP1B_KWP2000 KP_BLOB 0x382AB8 EXTERN 0x2 /end IF_DATA /begin IF_DATA ETK KP_BLOB 0x382AB8 EXTERN 0x2 /end IF_DATA /end MEASUREMENT
/begin MEASUREMENT E_ks4 "Errorflag: Klopfsensor 4" UWORD B_TRUE 1 100 0 1 BIT_MASK 0x1 FORMAT "%5.3" /begin IF_DATA ASAP1B_KWP2000 KP_BLOB 0x382ABA EXTERN 0x2 /end IF_DATA /begin IF_DATA ETK KP_BLOB 0x382ABA EXTERN 0x2 /end IF_DATA /end MEASUREMENT
/begin MEASUREMENT E_lap "Errorflag Laptriggersignal" UWORD B_TRUE 1 100 0 1 BIT_MASK 0x1 FORMAT "%5.3" /begin IF_DATA ASAP1B_KWP2000 KP_BLOB 0x382ABC EXTERN 0x2 /end IF_DATA /begin IF_DATA ETK KP_BLOB 0x382ABC EXTERN 0x2 /end IF_DATA /end MEASUREMENT
/begin MEASUREMENT E_lsv "Errorflag: Lambda-Sonde vor Kat" UWORD B_TRUE 1 100 0 1 BIT_MASK 0x1 FORMAT "%5.3" /begin IF_DATA ASAP1B_KWP2000 KP_BLOB 0x382AC0 EXTERN 0x2 /end IF_DATA /begin IF_DATA ETK KP_BLOB 0x382AC0 EXTERN 0x2 /end IF_DATA /end MEASUREMENT
/begin MEASUREMENT E_lsv2 "Errorflag: Lambda-Sonde 2 vor Kat" UWORD B_TRUE 1 100 0 1 BIT_MASK 0x1 FORMAT "%5.3" /begin IF_DATA ASAP1B_KWP2000 KP_BLOB 0x382AC2 EXTERN 0x2 /end IF_DATA /begin IF_DATA ETK KP_BLOB 0x382AC2 EXTERN 0x2 /end IF_DATA /end MEASUREMENT
/begin MEASUREMENT E_mile "Fehlerflag: MIL-Endstufe" UWORD B_TRUE 1 100 0 1 BIT_MASK 0x1 FORMAT "%5.3" /begin IF_DATA ASAP1B_KWP2000 KP_BLOB 0x382AC4 EXTERN 0x2 /end IF_DATA /begin IF_DATA ETK KP_BLOB 0x382AC4 EXTERN 0x2 /end IF_DATA /end MEASUREMENT
/begin MEASUREMENT E_milse "Fehlerflag: Endstufe kundenspezifische Fehlerlampe" UWORD B_TRUE 1 100 0 1 BIT_MASK 0x1 FORMAT "%5.3" /begin IF_DATA ASAP1B_KWP2000 KP_BLOB 0x382AC6 EXTERN 0x2 /end IF_DATA /begin IF_DATA ETK KP_BLOB 0x382AC6 EXTERN 0x2 /end IF_DATA /end MEASUREMENT
/begin MEASUREMENT E_ollae "Fehlerflag: Endstufe Ölwarnlampe" UWORD B_TRUE 1 100 0 1 BIT_MASK 0x1 FORMAT "%5.3" /begin IF_DATA ASAP1B_KWP2000 KP_BLOB 0x382ACA EXTERN 0x2 /end IF_DATA /begin IF_DATA ETK KP_BLOB 0x382ACA EXTERN 0x2 /end IF_DATA /end MEASUREMENT
/begin MEASUREMENT E_ph "Errorflag: Phasensensor" UWORD B_TRUE 1 100 0 1 BIT_MASK 0x1 FORMAT "%5.3" /begin IF_DATA ASAP1B_KWP2000 KP_BLOB 0x382ACC EXTERN 0x2 /end IF_DATA /begin IF_DATA ETK KP_BLOB 0x382ACC EXTERN 0x2 /end IF_DATA /end MEASUREMENT
/begin MEASUREMENT E_shlae "Fehlerflag: Endstufe Schaltlampe" UWORD B_TRUE 1 100 0 1 BIT_MASK 0x1 FORMAT "%5.3" /begin IF_DATA ASAP1B_KWP2000 KP_BLOB 0x382ACE EXTERN 0x2 /end IF_DATA /begin IF_DATA ETK KP_BLOB 0x382ACE EXTERN 0x2 /end IF_DATA /end MEASUREMENT
/begin MEASUREMENT E_ta "Errorflag: Ansauglufttemperatur" UWORD B_TRUE 1 100 0 1 BIT_MASK 0x1 FORMAT "%5.3" /begin IF_DATA ASAP1B_KWP2000 KP_BLOB 0x382AD0 EXTERN 0x2 /end IF_DATA /begin IF_DATA ETK KP_BLOB 0x382AD0 EXTERN 0x2 /end IF_DATA /end MEASUREMENT
/begin MEASUREMENT E_tfuel "Errorflag Kraftstofftemperatur" UWORD B_TRUE 1 100 0 1 BIT_MASK 0x1 FORMAT "%5.3" /begin IF_DATA ASAP1B_KWP2000 KP_BLOB 0x382AD2 EXTERN 0x2 /end IF_DATA /begin IF_DATA ETK KP_BLOB 0x382AD2 EXTERN 0x2 /end IF_DATA /end MEASUREMENT
/begin MEASUREMENT E_tm "Errorflag: TMOT" UWORD B_TRUE 1 100 0 1 BIT_MASK 0x1 FORMAT "%5.3" /begin IF_DATA ASAP1B_KWP2000 KP_BLOB 0x382AD4 EXTERN 0x2 /end IF_DATA /begin IF_DATA ETK KP_BLOB 0x382AD4 EXTERN 0x2 /end IF_DATA /end MEASUREMENT
/begin MEASUREMENT E_tol "Errorflag: Öltemperatur" UWORD B_TRUE 1 100 0 1 BIT_MASK 0x1 FORMAT "%5.3" /begin IF_DATA ASAP1B_KWP2000 KP_BLOB 0x382AD6 EXTERN 0x2 /end IF_DATA /begin IF_DATA ETK KP_BLOB 0x382AD6 EXTERN 0x2 /end IF_DATA /end MEASUREMENT
/begin MEASUREMENT E_tum "Errorflag:  Umgebungstemperatur tumg" UWORD B_TRUE 1 100 0 1 BIT_MASK 0x1 FORMAT "%5.3" /begin IF_DATA ASAP1B_KWP2000 KP_BLOB 0x382AD8 EXTERN 0x2 /end IF_DATA /begin IF_DATA ETK KP_BLOB 0x382AD8 EXTERN 0x2 /end IF_DATA /end MEASUREMENT
/begin MEASUREMENT E_ub "Errorflag: UB" UWORD B_TRUE 1 100 0 1 BIT_MASK 0x1 FORMAT "%5.3" /begin IF_DATA ASAP1B_KWP2000 KP_BLOB 0x382ADA EXTERN 0x2 /end IF_DATA /begin IF_DATA ETK KP_BLOB 0x382ADA EXTERN 0x2 /end IF_DATA /end MEASUREMENT
/begin MEASUREMENT E_vfz "Errorflag: Fahrzeug-Geschwindigkeit" UWORD B_TRUE 1 100 0 1 BIT_MASK 0x1 FORMAT "%5.3" /begin IF_DATA ASAP1B_KWP2000 KP_BLOB 0x382ADC EXTERN 0x2 /end IF_DATA /begin IF_DATA ETK KP_BLOB 0x382ADC EXTERN 0x2 /end IF_DATA /end MEASUREMENT
/begin MEASUREMENT ffzdfp "Fehlerpfadidentifikationsnummer (dfp) zum Freeze-Frame Zero" UBYTE dez 1 100 0 255 FORMAT "%5.1" /begin IF_DATA ASAP1B_KWP2000 KP_BLOB 0x380342 EXTERN 0x1 /end IF_DATA /begin IF_DATA ETK KP_BLOB 0x380342 EXTERN 0x1 /end IF_DATA /end MEASUREMENT
/begin MEASUREMENT fktns "Nachstartanhebung" UBYTE fak_ub_b8 1 100 0 7.96875 FORMAT "%5.3" /begin IF_DATA ASAP1B_KWP2000 KP_BLOB 0x38038E EXTERN 0x1 /end IF_DATA /begin IF_DATA ETK KP_BLOB 0x38038E EXTERN 0x1 /end IF_DATA /end MEASUREMENT
/begin MEASUREMENT fns "Faktor Nachstart" UBYTE fak_ub_b8 1 100 0 7.96875 FORMAT "%5.3" /begin IF_DATA ASAP1B_KWP2000 KP_BLOB 0x38038F EXTERN 0x1 /end IF_DATA /begin IF_DATA ETK KP_BLOB 0x38038F EXTERN 0x1 /end IF_DATA /end MEASUREMENT
/begin MEASUREMENT frz2 "" UBYTE dez 1 100 0 255 FORMAT "%5.1" /begin IF_DATA ASAP1B_KWP2000 KP_BLOB 0x382852 EXTERN 0x1 /end IF_DATA /begin IF_DATA ETK KP_BLOB 0x382852 EXTERN 0x1 /end IF_DATA /end MEASUREMENT
/begin MEASUREMENT frz4 "" UBYTE dez 1 100 0 255 FORMAT "%5.1" /begin IF_DATA ASAP1B_KWP2000 KP_BLOB 0x382853 EXTERN 0x1 /end IF_DATA /begin IF_DATA ETK KP_BLOB 0x382853 EXTERN 0x1 /end IF_DATA /end MEASUREMENT
/begin MEASUREMENT frz5 "" UBYTE dez 1 100 0 255 FORMAT "%5.1" /begin IF_DATA ASAP1B_KWP2000 KP_BLOB 0x382854 EXTERN 0x1 /end IF_DATA /begin IF_DATA ETK KP_BLOB 0x382854 EXTERN 0x1 /end IF_DATA /end MEASUREMENT
/begin MEASUREMENT frz6 "" UBYTE dez 1 100 0 255 FORMAT "%5.1" /begin IF_DATA ASAP1B_KWP2000 KP_BLOB 0x382855 EXTERN 0x1 /end IF_DATA /begin IF_DATA ETK KP_BLOB 0x382855 EXTERN 0x1 /end IF_DATA /end MEASUREMENT
/begin MEASUREMENT frz7 "" UBYTE dez 1 100 0 255 FORMAT "%5.1" /begin IF_DATA ASAP1B_KWP2000 KP_BLOB 0x382856 EXTERN 0x1 /end IF_DATA /begin IF_DATA ETK KP_BLOB 0x382856 EXTERN 0x1 /end IF_DATA /end MEASUREMENT
/begin MEASUREMENT fstva_w "Faktor Abmagerung im Start/Nachstart" UWORD fak_uw_b2 1 100 0 1.99997 FORMAT "%8.6" /begin IF_DATA ASAP1B_KWP2000 KP_BLOB 0x381508 EXTERN 0x2 /end IF_DATA /begin IF_DATA ETK KP_BLOB 0x381508 EXTERN 0x2 /end IF_DATA /end MEASUREMENT
/begin MEASUREMENT fst_w "Faktor Starteinspritzung" UWORD fak_uw_b64 1 100 0 63.999 FORMAT "%8.5" /begin IF_DATA ASAP1B_KWP2000 KP_BLOB 0x380C08 EXTERN 0x2 /end IF_DATA /begin IF_DATA ETK KP_BLOB 0x380C08 EXTERN 0x2 /end IF_DATA /end MEASUREMENT
/begin MEASUREMENT fzans1 "Faktor Abregelung Nachstart ohne Berücksichtigung des Startmengenadaptionswerts" UBYTE fak_ub_b0p25 1 100 0 0.249023 FORMAT "%5.3" /begin IF_DATA ASAP1B_KWP2000 KP_BLOB 0x380390 EXTERN 0x1 /end IF_DATA /begin IF_DATA ETK KP_BLOB 0x380390 EXTERN 0x1 /end IF_DATA /end MEASUREMENT
/begin MEASUREMENT kl_fnsmxtm "" UBYTE fak_ub_b8 1 100 0 7.96875 FORMAT "%5.3" /begin IF_DATA ASAP1B_KWP2000 KP_BLOB 0x380391 EXTERN 0x1 /end IF_DATA /begin IF_DATA ETK KP_BLOB 0x380391 EXTERN 0x1 /end IF_DATA /end MEASUREMENT
/begin MEASUREMENT lamns_w "Lambda-Motor-Soll für Nachstart" UWORD fak_uw_b16 1 100 0 15.9998 FORMAT "%8.5" /begin IF_DATA ASAP1B_KWP2000 KP_BLOB 0x380BF2 EXTERN 0x2 /end IF_DATA /begin IF_DATA ETK KP_BLOB 0x380BF2 EXTERN 0x2 /end IF_DATA /end MEASUREMENT
/begin MEASUREMENT lamsam2_w "Lambdaamplitude nach Filterung Bank 2" SWORD fak_sw_b8 1 100 -8 7.99976 FORMAT "%8.6" /begin IF_DATA ASAP1B_KWP2000 KP_BLOB 0x380A36 EXTERN 0x2 /end IF_DATA /begin IF_DATA ETK KP_BLOB 0x380A36 EXTERN 0x2 /end IF_DATA /end MEASUREMENT
/begin MEASUREMENT lamsam_w "Lambdaamplitude nach Filterung" SWORD fak_sw_b8 1 100 -8 7.99976 FORMAT "%8.6" /begin IF_DATA ASAP1B_KWP2000 KP_BLOB 0x380A38 EXTERN 0x2 /end IF_DATA /begin IF_DATA ETK KP_BLOB 0x380A38 EXTERN 0x2 /end IF_DATA /end MEASUREMENT
/begin MEASUREMENT mappos "Mapposition" UBYTE default 1 100 0 255 FORMAT "%5.1" /begin IF_DATA ASAP1B_KWP2000 KP_BLOB 0x380441 EXTERN 0x1 /end IF_DATA /begin IF_DATA ETK KP_BLOB 0x380441 EXTERN 0x1 /end IF_DATA /end MEASUREMENT
/begin MEASUREMENT mifal_w "Indiziertes Fahrerwunschmoment für Momentenkoordination Füllung" UWORD rel_uw_b100 1 100 0 99.9985 FORMAT "%8.5" /begin IF_DATA ASAP1B_KWP2000 KP_BLOB 0x38150A EXTERN 0x2 /end IF_DATA /begin IF_DATA ETK KP_BLOB 0x38150A EXTERN 0x2 /end IF_DATA /end MEASUREMENT
/begin MEASUREMENT nsactr "Nachstartcounter" UBYTE fak_ub_b2 1 100 0 1.99219 FORMAT "%5.3" /begin IF_DATA ASAP1B_KWP2000 KP_BLOB 0x380392 EXTERN 0x1 /end IF_DATA /begin IF_DATA ETK KP_BLOB 0x380392 EXTERN 0x1 /end IF_DATA /end MEASUREMENT
/begin MEASUREMENT nsactr1 "Nachstartcounter ohne Berücksichtigung des Startmengenadaptionswerts" UBYTE fak_ub_b2 1 100 0 1.99219 FORMAT "%5.3" /begin IF_DATA ASAP1B_KWP2000 KP_BLOB 0x380393 EXTERN 0x1 /end IF_DATA /begin IF_DATA ETK KP_BLOB 0x380393 EXTERN 0x1 /end IF_DATA /end MEASUREMENT
/begin MEASUREMENT phpw "Phasensignal Pegelwechsel (8 Bit Schieberegister)" UBYTE dez 1 100 0 255 FORMAT "%5.1" /begin IF_DATA ASAP1B_KWP2000 KP_BLOB 0x38034D EXTERN 0x1 /end IF_DATA /begin IF_DATA ETK KP_BLOB 0x38034D EXTERN 0x1 /end IF_DATA /end MEASUREMENT
/begin MEASUREMENT phpw2 "Phasensignal 2 Pegelwechsel (8 Bit Schieberegister)" UBYTE dez 1 100 0 255 FORMAT "%5.1" /begin IF_DATA ASAP1B_KWP2000 KP_BLOB 0x38034E EXTERN 0x1 /end IF_DATA /begin IF_DATA ETK KP_BLOB 0x38034E EXTERN 0x1 /end IF_DATA /end MEASUREMENT
/begin MEASUREMENT rkrn_w "normierter Referenzpegel Klopfregelung" UWORD spg_uw_b1280 1 100 0 1279.98 FORMAT "%8.3" ARRAY_SIZE 8 /begin IF_DATA ASAP1B_KWP2000 KP_BLOB 0x380CA6 EXTERN 0x2 /end IF_DATA /begin IF_DATA ETK KP_BLOB 0x380CA6 EXTERN 0x2 /end IF_DATA /end MEASUREMENT
/begin MEASUREMENT sfpaaa "Status Fehlerpfad: Tabellenanfang" UWORD dez 1 100 0 65535 FORMAT "%8.2" /begin IF_DATA ASAP1B_KWP2000 KP_BLOB 0x382A84 EXTERN 0x2 /end IF_DATA /begin IF_DATA ETK KP_BLOB 0x382A84 EXTERN 0x2 /end IF_DATA /end MEASUREMENT
/begin MEASUREMENT sfpats "Status Fehlerpfad Abgastemperatursensor" UWORD dez 1 100 0 65535 FORMAT "%8.2" /begin IF_DATA ASAP1B_KWP2000 KP_BLOB 0x382A86 EXTERN 0x2 /end IF_DATA /begin IF_DATA ETK KP_BLOB 0x382A86 EXTERN 0x2 /end IF_DATA /end MEASUREMENT
/begin MEASUREMENT sfpats2 "Status Fehlerpfad Abgastemperatursensor Bank 2" UWORD dez 1 100 0 65535 FORMAT "%8.2" /begin IF_DATA ASAP1B_KWP2000 KP_BLOB 0x382A88 EXTERN 0x2 /end IF_DATA /begin IF_DATA ETK KP_BLOB 0x382A88 EXTERN 0x2 /end IF_DATA /end MEASUREMENT
/begin MEASUREMENT sfpdsfue "Status Fehlerpfad: Drucksensor Kraftstoff" UWORD dez 1 100 0 65535 FORMAT "%8.2" /begin IF_DATA ASAP1B_KWP2000 KP_BLOB 0x382A8E EXTERN 0x2 /end IF_DATA /begin IF_DATA ETK KP_BLOB 0x382A8E EXTERN 0x2 /end IF_DATA /end MEASUREMENT
/begin MEASUREMENT sfpdsl "Status Fehlerpfad: Drucksensor Ladedruck" UWORD dez 1 100 0 65535 FORMAT "%8.2" /begin IF_DATA ASAP1B_KWP2000 KP_BLOB 0x382A90 EXTERN 0x2 /end IF_DATA /begin IF_DATA ETK KP_BLOB 0x382A90 EXTERN 0x2 /end IF_DATA /end MEASUREMENT
/begin MEASUREMENT sfpdsoel "Status Fehlerpfad: Drucksensor Oel" UWORD dez 1 100 0 65535 FORMAT "%8.2" /begin IF_DATA ASAP1B_KWP2000 KP_BLOB 0x382A92 EXTERN 0x2 /end IF_DATA /begin IF_DATA ETK KP_BLOB 0x382A92 EXTERN 0x2 /end IF_DATA /end MEASUREMENT
/begin MEASUREMENT sfpdss "Status Fehlerpfad: DSS" UWORD dez 1 100 0 65535 FORMAT "%8.2" /begin IF_DATA ASAP1B_KWP2000 KP_BLOB 0x382A94 EXTERN 0x2 /end IF_DATA /begin IF_DATA ETK KP_BLOB 0x382A94 EXTERN 0x2 /end IF_DATA /end MEASUREMENT
/begin MEASUREMENT sfpdsu "Status Fehlerpfad: Umgebungsdrucksensor" UWORD dez 1 100 0 65535 FORMAT "%8.2" /begin IF_DATA ASAP1B_KWP2000 KP_BLOB 0x382A96 EXTERN 0x2 /end IF_DATA /begin IF_DATA ETK KP_BLOB 0x382A96 EXTERN 0x2 /end IF_DATA /end MEASUREMENT
/begin MEASUREMENT sfpdsvlu "Status Fehlerpfad:Drucksensorsignalvergleich (DS-L DS-U)" UWORD dez 1 100 0 65535 FORMAT "%8.2" /begin IF_DATA ASAP1B_KWP2000 KP_BLOB 0x382A98 EXTERN 0x2 /end IF_DATA /begin IF_DATA ETK KP_BLOB 0x382A98 EXTERN 0x2 /end IF_DATA /end MEASUREMENT
/begin MEASUREMENT sfpev1 "Status Fehlerpfad: EV1" UWORD default 1 100 0 65535 FORMAT "%8.2" /begin IF_DATA ASAP1B_KWP2000 KP_BLOB 0x382A9A EXTERN 0x2 /end IF_DATA /begin IF_DATA ETK KP_BLOB 0x382A9A EXTERN 0x2 /end IF_DATA /end MEASUREMENT
/begin MEASUREMENT sfpev2 "Status Fehlerpfad: EV2" UWORD default 1 100 0 65535 FORMAT "%8.2" /begin IF_DATA ASAP1B_KWP2000 KP_BLOB 0x382A9C EXTERN 0x2 /end IF_DATA /begin IF_DATA ETK KP_BLOB 0x382A9C EXTERN 0x2 /end IF_DATA /end MEASUREMENT
/begin MEASUREMENT sfpev3 "Status Fehlerpfad: EV3" UWORD default 1 100 0 65535 FORMAT "%8.2" /begin IF_DATA ASAP1B_KWP2000 KP_BLOB 0x382A9E EXTERN 0x2 /end IF_DATA /begin IF_DATA ETK KP_BLOB 0x382A9E EXTERN 0x2 /end IF_DATA /end MEASUREMENT
/begin MEASUREMENT sfpev4 "Status Fehlerpfad: EV4" UWORD default 1 100 0 65535 FORMAT "%8.2" /begin IF_DATA ASAP1B_KWP2000 KP_BLOB 0x382AA0 EXTERN 0x2 /end IF_DATA /begin IF_DATA ETK KP_BLOB 0x382AA0 EXTERN 0x2 /end IF_DATA /end MEASUREMENT
/begin MEASUREMENT sfpev5 "Status Fehlerpfad: EV5" UWORD default 1 100 0 65535 FORMAT "%8.2" /begin IF_DATA ASAP1B_KWP2000 KP_BLOB 0x382AA2 EXTERN 0x2 /end IF_DATA /begin IF_DATA ETK KP_BLOB 0x382AA2 EXTERN 0x2 /end IF_DATA /end MEASUREMENT
/begin MEASUREMENT sfpev6 "Status Fehlerpfad: EV6" UWORD default 1 100 0 65535 FORMAT "%8.2" /begin IF_DATA ASAP1B_KWP2000 KP_BLOB 0x382AA4 EXTERN 0x2 /end IF_DATA /begin IF_DATA ETK KP_BLOB 0x382AA4 EXTERN 0x2 /end IF_DATA /end MEASUREMENT
/begin MEASUREMENT sfpgsh "Status Fehlerpfad: Anforderung Getriebeschaltfunktion" UWORD dez 1 100 0 65535 FORMAT "%8.2" /begin IF_DATA ASAP1B_KWP2000 KP_BLOB 0x382AA6 EXTERN 0x2 /end IF_DATA /begin IF_DATA ETK KP_BLOB 0x382AA6 EXTERN 0x2 /end IF_DATA /end MEASUREMENT
/begin MEASUREMENT sfphsv "Status Fehlerpfad: Heizung Lambdasonde vor Kat" UWORD dez 1 100 0 65535 FORMAT "%8.2" /begin IF_DATA ASAP1B_KWP2000 KP_BLOB 0x382AA8 EXTERN 0x2 /end IF_DATA /begin IF_DATA ETK KP_BLOB 0x382AA8 EXTERN 0x2 /end IF_DATA /end MEASUREMENT
/begin MEASUREMENT sfphsv2 "Status Fehlerpfad: Heizung Lambdasonde 2 vor Kat" UWORD dez 1 100 0 65535 FORMAT "%8.2" /begin IF_DATA ASAP1B_KWP2000 KP_BLOB 0x382AAA EXTERN 0x2 /end IF_DATA /begin IF_DATA ETK KP_BLOB 0x382AAA EXTERN 0x2 /end IF_DATA /end MEASUREMENT
/begin MEASUREMENT sfpkpe "Status Fehlerpfad: EKP-Relais Endstufe" UWORD default 1 100 0 65535 FORMAT "%8.2" /begin IF_DATA ASAP1B_KWP2000 KP_BLOB 0x382AAC EXTERN 0x2 /end IF_DATA /begin IF_DATA ETK KP_BLOB 0x382AAC EXTERN 0x2 /end IF_DATA /end MEASUREMENT
/begin MEASUREMENT sfpkrnt "Status Fehlerpfad: Klopfregelung Nulltest" UWORD dez 1 100 0 65535 FORMAT "%8.2" /begin IF_DATA ASAP1B_KWP2000 KP_BLOB 0x382AAE EXTERN 0x2 /end IF_DATA /begin IF_DATA ETK KP_BLOB 0x382AAE EXTERN 0x2 /end IF_DATA /end MEASUREMENT
/begin MEASUREMENT sfpkrof "Status Fehlerpfad: Klopfregelung Offset" UWORD dez 1 100 0 65535 FORMAT "%8.2" /begin IF_DATA ASAP1B_KWP2000 KP_BLOB 0x382AB0 EXTERN 0x2 /end IF_DATA /begin IF_DATA ETK KP_BLOB 0x382AB0 EXTERN 0x2 /end IF_DATA /end MEASUREMENT
/begin MEASUREMENT sfpkrtp "Status Fehlerpfad: Klopfregelung Testimpuls" UWORD dez 1 100 0 65535 FORMAT "%8.2" /begin IF_DATA ASAP1B_KWP2000 KP_BLOB 0x382AB2 EXTERN 0x2 /end IF_DATA /begin IF_DATA ETK KP_BLOB 0x382AB2 EXTERN 0x2 /end IF_DATA /end MEASUREMENT
/begin MEASUREMENT sfpks1 "Status Fehlerpfad: Klopfsensor 1" UWORD dez 1 100 0 65535 FORMAT "%8.2" /begin IF_DATA ASAP1B_KWP2000 KP_BLOB 0x382AB4 EXTERN 0x2 /end IF_DATA /begin IF_DATA ETK KP_BLOB 0x382AB4 EXTERN 0x2 /end IF_DATA /end MEASUREMENT
/begin MEASUREMENT sfpks2 "Status Fehlerpfad: Klopfsensor 2" UWORD dez 1 100 0 65535 FORMAT "%8.2" /begin IF_DATA ASAP1B_KWP2000 KP_BLOB 0x382AB6 EXTERN 0x2 /end IF_DATA /begin IF_DATA ETK KP_BLOB 0x382AB6 EXTERN 0x2 /end IF_DATA /end MEASUREMENT
/begin MEASUREMENT sfpks3 "Status Fehlerpfad: Klopfsensor 3" UWORD dez 1 100 0 65535 FORMAT "%8.2" /begin IF_DATA ASAP1B_KWP2000 KP_BLOB 0x382AB8 EXTERN 0x2 /end IF_DATA /begin IF_DATA ETK KP_BLOB 0x382AB8 EXTERN 0x2 /end IF_DATA /end MEASUREMENT
/begin MEASUREMENT sfpks4 "Status Fehlerpfad: Klopfsensor 4" UWORD dez 1 100 0 65535 FORMAT "%8.2" /begin IF_DATA ASAP1B_KWP2000 KP_BLOB 0x382ABA EXTERN 0x2 /end IF_DATA /begin IF_DATA ETK KP_BLOB 0x382ABA EXTERN 0x2 /end IF_DATA /end MEASUREMENT
/begin MEASUREMENT sfplap "Status Fehlerpfad: Laptriggersignal" UWORD dez 1 100 0 65535 FORMAT "%8.2" /begin IF_DATA ASAP1B_KWP2000 KP_BLOB 0x382ABC EXTERN 0x2 /end IF_DATA /begin IF_DATA ETK KP_BLOB 0x382ABC EXTERN 0x2 /end IF_DATA /end MEASUREMENT
/begin MEASUREMENT sfplsv "Status Fehlerpfad: Diagnose Lambdasonde vor Kat" UWORD dez 1 100 0 65535 FORMAT "%8.2" /begin IF_DATA ASAP1B_KWP2000 KP_BLOB 0x382AC0 EXTERN 0x2 /end IF_DATA /begin IF_DATA ETK KP_BLOB 0x382AC0 EXTERN 0x2 /end IF_DATA /end MEASUREMENT
/begin MEASUREMENT sfplsv2 "Status Fehlerpfad: Diagnose Lambdasonde vor Kat Bank2" UWORD dez 1 100 0 65535 FORMAT "%8.2" /begin IF_DATA ASAP1B_KWP2000 KP_BLOB 0x382AC2 EXTERN 0x2 /end IF_DATA /begin IF_DATA ETK KP_BLOB 0x382AC2 EXTERN 0x2 /end IF_DATA /end MEASUREMENT
/begin MEASUREMENT sfpmile "Status Fehlerpfad: Mil - Endstufe" UWORD default 1 100 0 65535 FORMAT "%8.2" /begin IF_DATA ASAP1B_KWP2000 KP_BLOB 0x382AC4 EXTERN 0x2 /end IF_DATA /begin IF_DATA ETK KP_BLOB 0x382AC4 EXTERN 0x2 /end IF_DATA /end MEASUREMENT
/begin MEASUREMENT sfpmilse "Status Fehlerpfad: Endstufe kundenspezifische Fehlerlampe" UWORD default 1 100 0 65535 FORMAT "%8.2" /begin IF_DATA ASAP1B_KWP2000 KP_BLOB 0x382AC6 EXTERN 0x2 /end IF_DATA /begin IF_DATA ETK KP_BLOB 0x382AC6 EXTERN 0x2 /end IF_DATA /end MEASUREMENT
/begin MEASUREMENT sfpollae "Status Fehlerpfad: Endstufe Ölwarnlampe" UWORD default 1 100 0 65535 FORMAT "%8.2" /begin IF_DATA ASAP1B_KWP2000 KP_BLOB 0x382ACA EXTERN 0x2 /end IF_DATA /begin IF_DATA ETK KP_BLOB 0x382ACA EXTERN 0x2 /end IF_DATA /end MEASUREMENT
/begin MEASUREMENT sfpph "Status Fehlerpfad: Phasengeber" UWORD dez 1 100 0 65535 FORMAT "%8.2" /begin IF_DATA ASAP1B_KWP2000 KP_BLOB 0x382ACC EXTERN 0x2 /end IF_DATA /begin IF_DATA ETK KP_BLOB 0x382ACC EXTERN 0x2 /end IF_DATA /end MEASUREMENT
/begin MEASUREMENT sfpshlae "Status Fehlerpfad: Endstufe Schaltlampe" UWORD default 1 100 0 65535 FORMAT "%8.2" /begin IF_DATA ASAP1B_KWP2000 KP_BLOB 0x382ACE EXTERN 0x2 /end IF_DATA /begin IF_DATA ETK KP_BLOB 0x382ACE EXTERN 0x2 /end IF_DATA /end MEASUREMENT
/begin MEASUREMENT sfpta "Status Fehlerpfad: Ansauglufttemperatur (Ladeluft-) TANS" UWORD dez 1 100 0 65535 FORMAT "%8.2" /begin IF_DATA ASAP1B_KWP2000 KP_BLOB 0x382AD0 EXTERN 0x2 /end IF_DATA /begin IF_DATA ETK KP_BLOB 0x382AD0 EXTERN 0x2 /end IF_DATA /end MEASUREMENT
/begin MEASUREMENT sfptfuel "Status Fehlerpfad: Kraftstofftemperatur" UWORD dez 1 100 0 65535 FORMAT "%8.2" /begin IF_DATA ASAP1B_KWP2000 KP_BLOB 0x382AD2 EXTERN 0x2 /end IF_DATA /begin IF_DATA ETK KP_BLOB 0x382AD2 EXTERN 0x2 /end IF_DATA /end MEASUREMENT
/begin MEASUREMENT sfptm "Status Fehlerpfad: Motortemperatur TMOT" UWORD dez 1 100 0 65535 FORMAT "%8.2" /begin IF_DATA ASAP1B_KWP2000 KP_BLOB 0x382AD4 EXTERN 0x2 /end IF_DATA /begin IF_DATA ETK KP_BLOB 0x382AD4 EXTERN 0x2 /end IF_DATA /end MEASUREMENT
/begin MEASUREMENT sfptol "Status Fehlerpfad: (Motor-) Oeltemperatur TOL" UWORD dez 1 100 0 65535 FORMAT "%8.2" /begin IF_DATA ASAP1B_KWP2000 KP_BLOB 0x382AD6 EXTERN 0x2 /end IF_DATA /begin IF_DATA ETK KP_BLOB 0x382AD6 EXTERN 0x2 /end IF_DATA /end MEASUREMENT
/begin MEASUREMENT sfptum "Status Fehlerpfad: Umgebungstemperatur TUM" UWORD dez 1 100 0 65535 FORMAT "%8.2" /begin IF_DATA ASAP1B_KWP2000 KP_BLOB 0x382AD8 EXTERN 0x2 /end IF_DATA /begin IF_DATA ETK KP_BLOB 0x382AD8 EXTERN 0x2 /end IF_DATA /end MEASUREMENT
/begin MEASUREMENT sfpub "Status Fehlerpfad: Batteriespannung UB (Bordnetz)" UWORD dez 1 100 0 65535 FORMAT "%8.2" /begin IF_DATA ASAP1B_KWP2000 KP_BLOB 0x382ADA EXTERN 0x2 /end IF_DATA /begin IF_DATA ETK KP_BLOB 0x382ADA EXTERN 0x2 /end IF_DATA /end MEASUREMENT
/begin MEASUREMENT sfpvfz "Status Fehlerpfad: Fahrzeuggeschwindigkeit" UWORD dez 1 100 0 65535 FORMAT "%8.2" /begin IF_DATA ASAP1B_KWP2000 KP_BLOB 0x382ADC EXTERN 0x2 /end IF_DATA /begin IF_DATA ETK KP_BLOB 0x382ADC EXTERN 0x2 /end IF_DATA /end MEASUREMENT
/begin MEASUREMENT sfpzzz "Dummy: Tabellenende" UWORD dez 1 100 0 65535 FORMAT "%8.2" /begin IF_DATA ASAP1B_KWP2000 KP_BLOB 0x382ADE EXTERN 0x2 /end IF_DATA /begin IF_DATA ETK KP_BLOB 0x382ADE EXTERN 0x2 /end IF_DATA /end MEASUREMENT
/begin MEASUREMENT tabst_w "Abstellzeit" UWORD t1sxs_uw_q1 1 100 0 65535 FORMAT "%8.2" /begin IF_DATA ASAP1B_KWP2000 KP_BLOB 0x381506 EXTERN 0x2 /end IF_DATA /begin IF_DATA ETK KP_BLOB 0x381506 EXTERN 0x2 /end IF_DATA /end MEASUREMENT
/begin MEASUREMENT tmstem "Motortemperatur bei Startende in Memory" UBYTE temp_ub_q0p75_o48 1 100 -48 143.25 FORMAT "%5.1" /begin IF_DATA ASAP1B_KWP2000 KP_BLOB 0x380343 EXTERN 0x1 /end IF_DATA /begin IF_DATA ETK KP_BLOB 0x380343 EXTERN 0x1 /end IF_DATA /end MEASUREMENT
/begin MEASUREMENT tumg "Umgebungstemperatur" UBYTE dez 1 100 0 255 FORMAT "%5.1" /begin IF_DATA ASAP1B_KWP2000 KP_BLOB 0x380460 EXTERN 0x1 /end IF_DATA /begin IF_DATA ETK KP_BLOB 0x380460 EXTERN 0x1 /end IF_DATA /end MEASUREMENT
/begin MEASUREMENT TYP_ats "" UWORD B_TRUE 1 100 0 15 BIT_MASK 0xf00 FORMAT "%5.2" /begin IF_DATA ASAP1B_KWP2000 KP_BLOB 0x382A86 EXTERN 0x2 /end IF_DATA /begin IF_DATA ETK KP_BLOB 0x382A86 EXTERN 0x2 /end IF_DATA /end MEASUREMENT
/begin MEASUREMENT TYP_ats2 "" UWORD B_TRUE 1 100 0 15 BIT_MASK 0xf00 FORMAT "%5.2" /begin IF_DATA ASAP1B_KWP2000 KP_BLOB 0x382A88 EXTERN 0x2 /end IF_DATA /begin IF_DATA ETK KP_BLOB 0x382A88 EXTERN 0x2 /end IF_DATA /end MEASUREMENT
/begin MEASUREMENT TYP_dsfue "" UWORD B_TRUE 1 100 0 15 BIT_MASK 0xf00 FORMAT "%5.2" /begin IF_DATA ASAP1B_KWP2000 KP_BLOB 0x382A8E EXTERN 0x2 /end IF_DATA /begin IF_DATA ETK KP_BLOB 0x382A8E EXTERN 0x2 /end IF_DATA /end MEASUREMENT
/begin MEASUREMENT TYP_dsl "" UWORD B_TRUE 1 100 0 15 BIT_MASK 0xf00 FORMAT "%5.2" /begin IF_DATA ASAP1B_KWP2000 KP_BLOB 0x382A90 EXTERN 0x2 /end IF_DATA /begin IF_DATA ETK KP_BLOB 0x382A90 EXTERN 0x2 /end IF_DATA /end MEASUREMENT
/begin MEASUREMENT TYP_dsoel "" UWORD B_TRUE 1 100 0 15 BIT_MASK 0xf00 FORMAT "%5.2" /begin IF_DATA ASAP1B_KWP2000 KP_BLOB 0x382A92 EXTERN 0x2 /end IF_DATA /begin IF_DATA ETK KP_BLOB 0x382A92 EXTERN 0x2 /end IF_DATA /end MEASUREMENT
/begin MEASUREMENT TYP_dsu "" UWORD B_TRUE 1 100 0 15 BIT_MASK 0xf00 FORMAT "%5.2" /begin IF_DATA ASAP1B_KWP2000 KP_BLOB 0x382A96 EXTERN 0x2 /end IF_DATA /begin IF_DATA ETK KP_BLOB 0x382A96 EXTERN 0x2 /end IF_DATA /end MEASUREMENT
/begin MEASUREMENT TYP_dsvlu "" UWORD B_TRUE 1 100 0 15 BIT_MASK 0xf00 FORMAT "%5.2" /begin IF_DATA ASAP1B_KWP2000 KP_BLOB 0x382A98 EXTERN 0x2 /end IF_DATA /begin IF_DATA ETK KP_BLOB 0x382A98 EXTERN 0x2 /end IF_DATA /end MEASUREMENT
/begin MEASUREMENT TYP_ev1 "" UWORD B_TRUE 1 100 0 15 BIT_MASK 0xf00 FORMAT "%5.2" /begin IF_DATA ASAP1B_KWP2000 KP_BLOB 0x382A9A EXTERN 0x2 /end IF_DATA /begin IF_DATA ETK KP_BLOB 0x382A9A EXTERN 0x2 /end IF_DATA /end MEASUREMENT
/begin MEASUREMENT TYP_ev2 "" UWORD B_TRUE 1 100 0 15 BIT_MASK 0xf00 FORMAT "%5.2" /begin IF_DATA ASAP1B_KWP2000 KP_BLOB 0x382A9C EXTERN 0x2 /end IF_DATA /begin IF_DATA ETK KP_BLOB 0x382A9C EXTERN 0x2 /end IF_DATA /end MEASUREMENT
/begin MEASUREMENT TYP_ev3 "" UWORD B_TRUE 1 100 0 15 BIT_MASK 0xf00 FORMAT "%5.2" /begin IF_DATA ASAP1B_KWP2000 KP_BLOB 0x382A9E EXTERN 0x2 /end IF_DATA /begin IF_DATA ETK KP_BLOB 0x382A9E EXTERN 0x2 /end IF_DATA /end MEASUREMENT
/begin MEASUREMENT TYP_ev4 "" UWORD B_TRUE 1 100 0 15 BIT_MASK 0xf00 FORMAT "%5.2" /begin IF_DATA ASAP1B_KWP2000 KP_BLOB 0x382AA0 EXTERN 0x2 /end IF_DATA /begin IF_DATA ETK KP_BLOB 0x382AA0 EXTERN 0x2 /end IF_DATA /end MEASUREMENT
/begin MEASUREMENT TYP_ev5 "" UWORD B_TRUE 1 100 0 15 BIT_MASK 0xf00 FORMAT "%5.2" /begin IF_DATA ASAP1B_KWP2000 KP_BLOB 0x382AA2 EXTERN 0x2 /end IF_DATA /begin IF_DATA ETK KP_BLOB 0x382AA2 EXTERN 0x2 /end IF_DATA /end MEASUREMENT
/begin MEASUREMENT TYP_ev6 "" UWORD B_TRUE 1 100 0 15 BIT_MASK 0xf00 FORMAT "%5.2" /begin IF_DATA ASAP1B_KWP2000 KP_BLOB 0x382AA4 EXTERN 0x2 /end IF_DATA /begin IF_DATA ETK KP_BLOB 0x382AA4 EXTERN 0x2 /end IF_DATA /end MEASUREMENT
/begin MEASUREMENT TYP_gsh "" UWORD B_TRUE 1 100 0 15 BIT_MASK 0xf00 FORMAT "%5.2" /begin IF_DATA ASAP1B_KWP2000 KP_BLOB 0x382AA6 EXTERN 0x2 /end IF_DATA /begin IF_DATA ETK KP_BLOB 0x382AA6 EXTERN 0x2 /end IF_DATA /end MEASUREMENT
/begin MEASUREMENT TYP_hsv "Fehlertyp: Heizung Lambdasonde 1 vor Kat" UWORD B_TRUE 1 100 0 15 BIT_MASK 0xf00 FORMAT "%5.2" /begin IF_DATA ASAP1B_KWP2000 KP_BLOB 0x382AA8 EXTERN 0x2 /end IF_DATA /begin IF_DATA ETK KP_BLOB 0x382AA8 EXTERN 0x2 /end IF_DATA /end MEASUREMENT
/begin MEASUREMENT TYP_hsv2 "Fehlertyp: Heizung Lambdasonde 2 vor Kat" UWORD B_TRUE 1 100 0 15 BIT_MASK 0xf00 FORMAT "%5.2" /begin IF_DATA ASAP1B_KWP2000 KP_BLOB 0x382AAA EXTERN 0x2 /end IF_DATA /begin IF_DATA ETK KP_BLOB 0x382AAA EXTERN 0x2 /end IF_DATA /end MEASUREMENT
/begin MEASUREMENT TYP_kpe "Fehlertyp: EKP-Relais Endstufe" UWORD B_TRUE 1 100 0 15 BIT_MASK 0xf00 FORMAT "%5.2" /begin IF_DATA ASAP1B_KWP2000 KP_BLOB 0x382AAC EXTERN 0x2 /end IF_DATA /begin IF_DATA ETK KP_BLOB 0x382AAC EXTERN 0x2 /end IF_DATA /end MEASUREMENT
/begin MEASUREMENT TYP_krnt "" UWORD B_TRUE 1 100 0 15 BIT_MASK 0xf00 FORMAT "%5.2" /begin IF_DATA ASAP1B_KWP2000 KP_BLOB 0x382AAE EXTERN 0x2 /end IF_DATA /begin IF_DATA ETK KP_BLOB 0x382AAE EXTERN 0x2 /end IF_DATA /end MEASUREMENT
/begin MEASUREMENT TYP_krof "" UWORD B_TRUE 1 100 0 15 BIT_MASK 0xf00 FORMAT "%5.2" /begin IF_DATA ASAP1B_KWP2000 KP_BLOB 0x382AB0 EXTERN 0x2 /end IF_DATA /begin IF_DATA ETK KP_BLOB 0x382AB0 EXTERN 0x2 /end IF_DATA /end MEASUREMENT
/begin MEASUREMENT TYP_krtp "" UWORD B_TRUE 1 100 0 15 BIT_MASK 0xf00 FORMAT "%5.2" /begin IF_DATA ASAP1B_KWP2000 KP_BLOB 0x382AB2 EXTERN 0x2 /end IF_DATA /begin IF_DATA ETK KP_BLOB 0x382AB2 EXTERN 0x2 /end IF_DATA /end MEASUREMENT
/begin MEASUREMENT TYP_ks1 "" UWORD B_TRUE 1 100 0 15 BIT_MASK 0xf00 FORMAT "%5.2" /begin IF_DATA ASAP1B_KWP2000 KP_BLOB 0x382AB4 EXTERN 0x2 /end IF_DATA /begin IF_DATA ETK KP_BLOB 0x382AB4 EXTERN 0x2 /end IF_DATA /end MEASUREMENT
/begin MEASUREMENT TYP_ks2 "" UWORD B_TRUE 1 100 0 15 BIT_MASK 0xf00 FORMAT "%5.2" /begin IF_DATA ASAP1B_KWP2000 KP_BLOB 0x382AB6 EXTERN 0x2 /end IF_DATA /begin IF_DATA ETK KP_BLOB 0x382AB6 EXTERN 0x2 /end IF_DATA /end MEASUREMENT
/begin MEASUREMENT TYP_ks3 "" UWORD B_TRUE 1 100 0 15 BIT_MASK 0xf00 FORMAT "%5.2" /begin IF_DATA ASAP1B_KWP2000 KP_BLOB 0x382AB8 EXTERN 0x2 /end IF_DATA /begin IF_DATA ETK KP_BLOB 0x382AB8 EXTERN 0x2 /end IF_DATA /end MEASUREMENT
/begin MEASUREMENT TYP_ks4 "" UWORD B_TRUE 1 100 0 15 BIT_MASK 0xf00 FORMAT "%5.2" /begin IF_DATA ASAP1B_KWP2000 KP_BLOB 0x382ABA EXTERN 0x2 /end IF_DATA /begin IF_DATA ETK KP_BLOB 0x382ABA EXTERN 0x2 /end IF_DATA /end MEASUREMENT
/begin MEASUREMENT TYP_lap "" UWORD B_TRUE 1 100 0 15 BIT_MASK 0xf00 FORMAT "%5.2" /begin IF_DATA ASAP1B_KWP2000 KP_BLOB 0x382ABC EXTERN 0x2 /end IF_DATA /begin IF_DATA ETK KP_BLOB 0x382ABC EXTERN 0x2 /end IF_DATA /end MEASUREMENT
/begin MEASUREMENT TYP_lsv "Fehlertyp: Lambdasonde 1 vor Kat" UWORD B_TRUE 1 100 0 15 BIT_MASK 0xf00 FORMAT "%5.2" /begin IF_DATA ASAP1B_KWP2000 KP_BLOB 0x382AC0 EXTERN 0x2 /end IF_DATA /begin IF_DATA ETK KP_BLOB 0x382AC0 EXTERN 0x2 /end IF_DATA /end MEASUREMENT
/begin MEASUREMENT TYP_lsv2 "Fehlertyp: Lambdasonde 2 vor Kat" UWORD B_TRUE 1 100 0 15 BIT_MASK 0xf00 FORMAT "%5.2" /begin IF_DATA ASAP1B_KWP2000 KP_BLOB 0x382AC2 EXTERN 0x2 /end IF_DATA /begin IF_DATA ETK KP_BLOB 0x382AC2 EXTERN 0x2 /end IF_DATA /end MEASUREMENT
/begin MEASUREMENT TYP_mile "" UWORD B_TRUE 1 100 0 15 BIT_MASK 0xf00 FORMAT "%5.2" /begin IF_DATA ASAP1B_KWP2000 KP_BLOB 0x382AC4 EXTERN 0x2 /end IF_DATA /begin IF_DATA ETK KP_BLOB 0x382AC4 EXTERN 0x2 /end IF_DATA /end MEASUREMENT
/begin MEASUREMENT TYP_milse "" UWORD B_TRUE 1 100 0 15 BIT_MASK 0xf00 FORMAT "%5.2" /begin IF_DATA ASAP1B_KWP2000 KP_BLOB 0x382AC6 EXTERN 0x2 /end IF_DATA /begin IF_DATA ETK KP_BLOB 0x382AC6 EXTERN 0x2 /end IF_DATA /end MEASUREMENT
/begin MEASUREMENT TYP_ollae "" UWORD B_TRUE 1 100 0 15 BIT_MASK 0xf00 FORMAT "%5.2" /begin IF_DATA ASAP1B_KWP2000 KP_BLOB 0x382ACA EXTERN 0x2 /end IF_DATA /begin IF_DATA ETK KP_BLOB 0x382ACA EXTERN 0x2 /end IF_DATA /end MEASUREMENT
/begin MEASUREMENT TYP_ph "" UWORD B_TRUE 1 100 0 15 BIT_MASK 0xf00 FORMAT "%5.2" /begin IF_DATA ASAP1B_KWP2000 KP_BLOB 0x382ACC EXTERN 0x2 /end IF_DATA /begin IF_DATA ETK KP_BLOB 0x382ACC EXTERN 0x2 /end IF_DATA /end MEASUREMENT
/begin MEASUREMENT TYP_shlae "" UWORD B_TRUE 1 100 0 15 BIT_MASK 0xf00 FORMAT "%5.2" /begin IF_DATA ASAP1B_KWP2000 KP_BLOB 0x382ACE EXTERN 0x2 /end IF_DATA /begin IF_DATA ETK KP_BLOB 0x382ACE EXTERN 0x2 /end IF_DATA /end MEASUREMENT
/begin MEASUREMENT TYP_ta "" UWORD B_TRUE 1 100 0 15 BIT_MASK 0xf00 FORMAT "%5.2" /begin IF_DATA ASAP1B_KWP2000 KP_BLOB 0x382AD0 EXTERN 0x2 /end IF_DATA /begin IF_DATA ETK KP_BLOB 0x382AD0 EXTERN 0x2 /end IF_DATA /end MEASUREMENT
/begin MEASUREMENT TYP_tfuel "" UWORD B_TRUE 1 100 0 15 BIT_MASK 0xf00 FORMAT "%5.2" /begin IF_DATA ASAP1B_KWP2000 KP_BLOB 0x382AD2 EXTERN 0x2 /end IF_DATA /begin IF_DATA ETK KP_BLOB 0x382AD2 EXTERN 0x2 /end IF_DATA /end MEASUREMENT
/begin MEASUREMENT TYP_tm "" UWORD B_TRUE 1 100 0 15 BIT_MASK 0xf00 FORMAT "%5.2" /begin IF_DATA ASAP1B_KWP2000 KP_BLOB 0x382AD4 EXTERN 0x2 /end IF_DATA /begin IF_DATA ETK KP_BLOB 0x382AD4 EXTERN 0x2 /end IF_DATA /end MEASUREMENT
/begin MEASUREMENT TYP_tol "" UWORD B_TRUE 1 100 0 15 BIT_MASK 0xf00 FORMAT "%5.2" /begin IF_DATA ASAP1B_KWP2000 KP_BLOB 0x382AD6 EXTERN 0x2 /end IF_DATA /begin IF_DATA ETK KP_BLOB 0x382AD6 EXTERN 0x2 /end IF_DATA /end MEASUREMENT
/begin MEASUREMENT TYP_ub "" UWORD B_TRUE 1 100 0 15 BIT_MASK 0xf00 FORMAT "%5.2" /begin IF_DATA ASAP1B_KWP2000 KP_BLOB 0x382ADA EXTERN 0x2 /end IF_DATA /begin IF_DATA ETK KP_BLOB 0x382ADA EXTERN 0x2 /end IF_DATA /end MEASUREMENT
/begin MEASUREMENT TYP_vfz "" UWORD B_TRUE 1 100 0 15 BIT_MASK 0xf00 FORMAT "%5.2" /begin IF_DATA ASAP1B_KWP2000 KP_BLOB 0x382ADC EXTERN 0x2 /end IF_DATA /begin IF_DATA ETK KP_BLOB 0x382ADC EXTERN 0x2 /end IF_DATA /end MEASUREMENT
/begin MEASUREMENT usvk "Spannung Lambdasonde vor Kat" UBYTE ULSQ 1 100 0 5 FORMAT "%5.3" /begin IF_DATA ASAP1B_KWP2000 KP_BLOB 0x380461 EXTERN 0x1 /end IF_DATA /begin IF_DATA ETK KP_BLOB 0x380461 EXTERN 0x1 /end IF_DATA /end MEASUREMENT
/begin MEASUREMENT usvk2 "Spannung Lambdasonde vor Kat 2" UBYTE ULSQ 1 100 0 5 FORMAT "%5.3" /begin IF_DATA ASAP1B_KWP2000 KP_BLOB 0x380462 EXTERN 0x1 /end IF_DATA /begin IF_DATA ETK KP_BLOB 0x380462 EXTERN 0x1 /end IF_DATA /end MEASUREMENT
/begin MEASUREMENT wnwue "Winkel Nockenwellenueberschneidung" UBYTE kw_ub_q0p5 1 100 0 127.5 FORMAT "%5.1" /begin IF_DATA ASAP1B_KWP2000 KP_BLOB 0x380463 EXTERN 0x1 /end IF_DATA /begin IF_DATA ETK KP_BLOB 0x380463 EXTERN 0x1 /end IF_DATA /end MEASUREMENT
/begin MEASUREMENT wped "Normierter Fahrpedalwinkel" UBYTE relPED_ub_b100 1 100 0 100 FORMAT "%5.1" /begin IF_DATA ASAP1B_KWP2000 KP_BLOB 0x380464 EXTERN 0x1 /end IF_DATA /begin IF_DATA ETK KP_BLOB 0x380464 EXTERN 0x1 /end IF_DATA /end MEASUREMENT
/begin MEASUREMENT xzkrznt "Zähler Klopfregelung Zyklusflag Z_krnt" UBYTE dez 1 100 0 255 FORMAT "%5.1" /begin IF_DATA ASAP1B_KWP2000 KP_BLOB 0x3803AE EXTERN 0x1 /end IF_DATA /begin IF_DATA ETK KP_BLOB 0x3803AE EXTERN 0x1 /end IF_DATA /end MEASUREMENT
/begin MEASUREMENT xzkrzof "Zähler Klopfregelung Zyklusflag Z_krof" UBYTE dez 1 100 0 255 FORMAT "%5.1" /begin IF_DATA ASAP1B_KWP2000 KP_BLOB 0x3803AF EXTERN 0x1 /end IF_DATA /begin IF_DATA ETK KP_BLOB 0x3803AF EXTERN 0x1 /end IF_DATA /end MEASUREMENT
/begin MEASUREMENT xzkrzs "Zähler für Zyklusflag Diagnose Klopfsensor" UBYTE dez 1 100 0 255 FORMAT "%5.1" ARRAY_SIZE 4 /begin IF_DATA ASAP1B_KWP2000 KP_BLOB 0x3803B2 EXTERN 0x1 /end IF_DATA /begin IF_DATA ETK KP_BLOB 0x3803B2 EXTERN 0x1 /end IF_DATA /end MEASUREMENT
/begin MEASUREMENT xzkrztp "Zähler Klopfregelung Zyklusflag Z_krtp" UBYTE dez 1 100 0 255 FORMAT "%5.1" /begin IF_DATA ASAP1B_KWP2000 KP_BLOB 0x3803BA EXTERN 0x1 /end IF_DATA /begin IF_DATA ETK KP_BLOB 0x3803BA EXTERN 0x1 /end IF_DATA /end MEASUREMENT
/begin MEASUREMENT xzsen "Entprellzähler Diagnose Klopfsensor" UBYTE dez 1 100 0 255 FORMAT "%5.1" ARRAY_SIZE 4 /begin IF_DATA ASAP1B_KWP2000 KP_BLOB 0x3803B6 EXTERN 0x1 /end IF_DATA /begin IF_DATA ETK KP_BLOB 0x3803B6 EXTERN 0x1 /end IF_DATA /end MEASUREMENT
/begin MEASUREMENT xzskrnt "Sicherheitszähler Klopfregelung Nulltest" UBYTE dez 1 100 0 255 FORMAT "%5.1" /begin IF_DATA ASAP1B_KWP2000 KP_BLOB 0x3803B0 EXTERN 0x1 /end IF_DATA /begin IF_DATA ETK KP_BLOB 0x3803B0 EXTERN 0x1 /end IF_DATA /end MEASUREMENT
/begin MEASUREMENT xzskrof "Sicherheitszähler Klopfregelung Offset" UBYTE dez 1 100 0 255 FORMAT "%5.1" /begin IF_DATA ASAP1B_KWP2000 KP_BLOB 0x3803B1 EXTERN 0x1 /end IF_DATA /begin IF_DATA ETK KP_BLOB 0x3803B1 EXTERN 0x1 /end IF_DATA /end MEASUREMENT
/begin MEASUREMENT xzskrtp "Zähler Klopfregelung Errorflag E_krtp" UBYTE dez 1 100 0 255 FORMAT "%5.1" /begin IF_DATA ASAP1B_KWP2000 KP_BLOB 0x3803BB EXTERN 0x1 /end IF_DATA /begin IF_DATA ETK KP_BLOB 0x3803BB EXTERN 0x1 /end IF_DATA /end MEASUREMENT
/begin MEASUREMENT zhklsu "Zähler Heizerkopplung LSU" UBYTE dez 1 100 0 255 FORMAT "%5.1" /begin IF_DATA ASAP1B_KWP2000 KP_BLOB 0x380357 EXTERN 0x1 /end IF_DATA /begin IF_DATA ETK KP_BLOB 0x380357 EXTERN 0x1 /end IF_DATA /end MEASUREMENT
/begin MEASUREMENT zhklsu2 "Zähler Heizerkopplung LSU2" UBYTE dez 1 100 0 255 FORMAT "%5.1" /begin IF_DATA ASAP1B_KWP2000 KP_BLOB 0x380358 EXTERN 0x1 /end IF_DATA /begin IF_DATA ETK KP_BLOB 0x380358 EXTERN 0x1 /end IF_DATA /end MEASUREMENT
/begin MEASUREMENT zphnok "Zähler Fehler auf Phasensignal" UBYTE dez 1 100 0 255 FORMAT "%5.1" /begin IF_DATA ASAP1B_KWP2000 KP_BLOB 0x38034F EXTERN 0x1 /end IF_DATA /begin IF_DATA ETK KP_BLOB 0x38034F EXTERN 0x1 /end IF_DATA /end MEASUREMENT
/begin MEASUREMENT zphnok2 "Zähler Fehler auf Phasensignal 2" UBYTE dez 1 100 0 255 FORMAT "%5.1" /begin IF_DATA ASAP1B_KWP2000 KP_BLOB 0x380350 EXTERN 0x1 /end IF_DATA /begin IF_DATA ETK KP_BLOB 0x380350 EXTERN 0x1 /end IF_DATA /end MEASUREMENT
/begin MEASUREMENT zylvirt "Stand Zylinderzähler vor Umsynchronisation aus Schnellstart" UBYTE dez 1 100 0 255 FORMAT "%5.1" /begin IF_DATA ASAP1B_KWP2000 KP_BLOB 0x380465 EXTERN 0x1 /end IF_DATA /begin IF_DATA ETK KP_BLOB 0x380465 EXTERN 0x1 /end IF_DATA /end MEASUREMENT
/begin MEASUREMENT zzvirt "virtueller Zahnzähler im Start bis zur Synchronisation" UBYTE dez 1 100 0 255 FORMAT "%5.1" /begin IF_DATA ASAP1B_KWP2000 KP_BLOB 0x380466 EXTERN 0x1 /end IF_DATA /begin IF_DATA ETK KP_BLOB 0x380466 EXTERN 0x1 /end IF_DATA /end MEASUREMENT
/begin MEASUREMENT Z_ats "Zyklusflag: Abgastemperatursensor" UWORD B_TRUE 1 100 0 1 BIT_MASK 0x2 FORMAT "%5.3" /begin IF_DATA ASAP1B_KWP2000 KP_BLOB 0x382A86 EXTERN 0x2 /end IF_DATA /begin IF_DATA ETK KP_BLOB 0x382A86 EXTERN 0x2 /end IF_DATA /end MEASUREMENT
/begin MEASUREMENT Z_ats2 "Zyklusflag: Abgastemperatursensor Bank 2" UWORD B_TRUE 1 100 0 1 BIT_MASK 0x2 FORMAT "%5.3" /begin IF_DATA ASAP1B_KWP2000 KP_BLOB 0x382A88 EXTERN 0x2 /end IF_DATA /begin IF_DATA ETK KP_BLOB 0x382A88 EXTERN 0x2 /end IF_DATA /end MEASUREMENT
/begin MEASUREMENT Z_dsfue "Zyklusflag: Drucksensor Kraftstoff" UWORD B_TRUE 1 100 0 1 BIT_MASK 0x2 FORMAT "%5.3" /begin IF_DATA ASAP1B_KWP2000 KP_BLOB 0x382A8E EXTERN 0x2 /end IF_DATA /begin IF_DATA ETK KP_BLOB 0x382A8E EXTERN 0x2 /end IF_DATA /end MEASUREMENT
/begin MEASUREMENT Z_dsl "Zyklusflag: Drucksensor Ladedruck" UWORD B_TRUE 1 100 0 1 BIT_MASK 0x2 FORMAT "%5.3" /begin IF_DATA ASAP1B_KWP2000 KP_BLOB 0x382A90 EXTERN 0x2 /end IF_DATA /begin IF_DATA ETK KP_BLOB 0x382A90 EXTERN 0x2 /end IF_DATA /end MEASUREMENT
/begin MEASUREMENT Z_dsoel "Zyklusflag: Drucksensor Oel" UWORD B_TRUE 1 100 0 1 BIT_MASK 0x2 FORMAT "%5.3" /begin IF_DATA ASAP1B_KWP2000 KP_BLOB 0x382A92 EXTERN 0x2 /end IF_DATA /begin IF_DATA ETK KP_BLOB 0x382A92 EXTERN 0x2 /end IF_DATA /end MEASUREMENT
/begin MEASUREMENT Z_dss "Zyklusflag: Saugrohr-Drucksensor" UWORD B_TRUE 1 100 0 1 BIT_MASK 0x2 FORMAT "%5.3" /begin IF_DATA ASAP1B_KWP2000 KP_BLOB 0x382A94 EXTERN 0x2 /end IF_DATA /begin IF_DATA ETK KP_BLOB 0x382A94 EXTERN 0x2 /end IF_DATA /end MEASUREMENT
/begin MEASUREMENT Z_dsu "Zyklusflag: Umgebungsdrucksensor" UWORD B_TRUE 1 100 0 1 BIT_MASK 0x2 FORMAT "%5.3" /begin IF_DATA ASAP1B_KWP2000 KP_BLOB 0x382A96 EXTERN 0x2 /end IF_DATA /begin IF_DATA ETK KP_BLOB 0x382A96 EXTERN 0x2 /end IF_DATA /end MEASUREMENT
/begin MEASUREMENT Z_dsvlu "Zyklusflag: Drucksensorsignalvergleich (DS-L DS-U)" UWORD B_TRUE 1 100 0 1 BIT_MASK 0x2 FORMAT "%5.3" /begin IF_DATA ASAP1B_KWP2000 KP_BLOB 0x382A98 EXTERN 0x2 /end IF_DATA /begin IF_DATA ETK KP_BLOB 0x382A98 EXTERN 0x2 /end IF_DATA /end MEASUREMENT
/begin MEASUREMENT Z_ev1 "Zyklusflag: EV von Zyl. 1" UWORD B_TRUE 1 100 0 1 BIT_MASK 0x2 FORMAT "%5.3" /begin IF_DATA ASAP1B_KWP2000 KP_BLOB 0x382A9A EXTERN 0x2 /end IF_DATA /begin IF_DATA ETK KP_BLOB 0x382A9A EXTERN 0x2 /end IF_DATA /end MEASUREMENT
/begin MEASUREMENT Z_ev2 "Zyklusflag:	EV von Zyl. 2" UWORD B_TRUE 1 100 0 1 BIT_MASK 0x2 FORMAT "%5.3" /begin IF_DATA ASAP1B_KWP2000 KP_BLOB 0x382A9C EXTERN 0x2 /end IF_DATA /begin IF_DATA ETK KP_BLOB 0x382A9C EXTERN 0x2 /end IF_DATA /end MEASUREMENT
/begin MEASUREMENT Z_ev3 "Zyklusflag:	EV von Zyl. 3" UWORD B_TRUE 1 100 0 1 BIT_MASK 0x2 FORMAT "%5.3" /begin IF_DATA ASAP1B_KWP2000 KP_BLOB 0x382A9E EXTERN 0x2 /end IF_DATA /begin IF_DATA ETK KP_BLOB 0x382A9E EXTERN 0x2 /end IF_DATA /end MEASUREMENT
/begin MEASUREMENT Z_ev4 "Zyklusflag:	EV von Zyl. 4" UWORD B_TRUE 1 100 0 1 BIT_MASK 0x2 FORMAT "%5.3" /begin IF_DATA ASAP1B_KWP2000 KP_BLOB 0x382AA0 EXTERN 0x2 /end IF_DATA /begin IF_DATA ETK KP_BLOB 0x382AA0 EXTERN 0x2 /end IF_DATA /end MEASUREMENT
/begin MEASUREMENT Z_ev5 "Zyklusflag:	EV von Zyl. 5" UWORD B_TRUE 1 100 0 1 BIT_MASK 0x2 FORMAT "%5.3" /begin IF_DATA ASAP1B_KWP2000 KP_BLOB 0x382AA2 EXTERN 0x2 /end IF_DATA /begin IF_DATA ETK KP_BLOB 0x382AA2 EXTERN 0x2 /end IF_DATA /end MEASUREMENT
/begin MEASUREMENT Z_ev6 "Zyklusflag:	EV von Zyl. 6" UWORD B_TRUE 1 100 0 1 BIT_MASK 0x2 FORMAT "%5.3" /begin IF_DATA ASAP1B_KWP2000 KP_BLOB 0x382AA4 EXTERN 0x2 /end IF_DATA /begin IF_DATA ETK KP_BLOB 0x382AA4 EXTERN 0x2 /end IF_DATA /end MEASUREMENT
/begin MEASUREMENT Z_gsh "Zyklusflag Anforderung für Getriebeschaltfunktion" UWORD B_TRUE 1 100 0 1 BIT_MASK 0x2 FORMAT "%5.3" /begin IF_DATA ASAP1B_KWP2000 KP_BLOB 0x382AA6 EXTERN 0x2 /end IF_DATA /begin IF_DATA ETK KP_BLOB 0x382AA6 EXTERN 0x2 /end IF_DATA /end MEASUREMENT
/begin MEASUREMENT Z_hsv "Zyklusflag:Lambdasonden-Heizung vor Katalysator" UWORD B_TRUE 1 100 0 1 BIT_MASK 0x2 FORMAT "%5.3" /begin IF_DATA ASAP1B_KWP2000 KP_BLOB 0x382AA8 EXTERN 0x2 /end IF_DATA /begin IF_DATA ETK KP_BLOB 0x382AA8 EXTERN 0x2 /end IF_DATA /end MEASUREMENT
/begin MEASUREMENT Z_hsv2 "Zyklusflag:Lambdasonden-Heizung vor Katalysator, Bank2" UWORD B_TRUE 1 100 0 1 BIT_MASK 0x2 FORMAT "%5.3" /begin IF_DATA ASAP1B_KWP2000 KP_BLOB 0x382AAA EXTERN 0x2 /end IF_DATA /begin IF_DATA ETK KP_BLOB 0x382AAA EXTERN 0x2 /end IF_DATA /end MEASUREMENT
/begin MEASUREMENT Z_kpe "Zyklusflag: EKP-Relais Endstufe" UWORD B_TRUE 1 100 0 1 BIT_MASK 0x2 FORMAT "%5.3" /begin IF_DATA ASAP1B_KWP2000 KP_BLOB 0x382AAC EXTERN 0x2 /end IF_DATA /begin IF_DATA ETK KP_BLOB 0x382AAC EXTERN 0x2 /end IF_DATA /end MEASUREMENT
/begin MEASUREMENT Z_krnt "Zyklusflag: Klopfregelung Nulltest" UWORD B_TRUE 1 100 0 1 BIT_MASK 0x2 FORMAT "%5.3" /begin IF_DATA ASAP1B_KWP2000 KP_BLOB 0x382AAE EXTERN 0x2 /end IF_DATA /begin IF_DATA ETK KP_BLOB 0x382AAE EXTERN 0x2 /end IF_DATA /end MEASUREMENT
/begin MEASUREMENT Z_krof "Zyklusflag: Klopfregelung Offset" UWORD B_TRUE 1 100 0 1 BIT_MASK 0x2 FORMAT "%5.3" /begin IF_DATA ASAP1B_KWP2000 KP_BLOB 0x382AB0 EXTERN 0x2 /end IF_DATA /begin IF_DATA ETK KP_BLOB 0x382AB0 EXTERN 0x2 /end IF_DATA /end MEASUREMENT
/begin MEASUREMENT Z_krtp "Zyklusflag: Klopfregelung Testimpuls" UWORD B_TRUE 1 100 0 1 BIT_MASK 0x2 FORMAT "%5.3" /begin IF_DATA ASAP1B_KWP2000 KP_BLOB 0x382AB2 EXTERN 0x2 /end IF_DATA /begin IF_DATA ETK KP_BLOB 0x382AB2 EXTERN 0x2 /end IF_DATA /end MEASUREMENT
/begin MEASUREMENT Z_ks1 "Zyklusflag: Klopfsensor 1" UWORD B_TRUE 1 100 0 1 BIT_MASK 0x2 FORMAT "%5.3" /begin IF_DATA ASAP1B_KWP2000 KP_BLOB 0x382AB4 EXTERN 0x2 /end IF_DATA /begin IF_DATA ETK KP_BLOB 0x382AB4 EXTERN 0x2 /end IF_DATA /end MEASUREMENT
/begin MEASUREMENT Z_ks2 "Zyklusflag: Klopfsensor 2" UWORD B_TRUE 1 100 0 1 BIT_MASK 0x2 FORMAT "%5.3" /begin IF_DATA ASAP1B_KWP2000 KP_BLOB 0x382AB6 EXTERN 0x2 /end IF_DATA /begin IF_DATA ETK KP_BLOB 0x382AB6 EXTERN 0x2 /end IF_DATA /end MEASUREMENT
/begin MEASUREMENT Z_ks3 "Zyklusflag: Klopfsensor 3" UWORD B_TRUE 1 100 0 1 BIT_MASK 0x2 FORMAT "%5.3" /begin IF_DATA ASAP1B_KWP2000 KP_BLOB 0x382AB8 EXTERN 0x2 /end IF_DATA /begin IF_DATA ETK KP_BLOB 0x382AB8 EXTERN 0x2 /end IF_DATA /end MEASUREMENT
/begin MEASUREMENT Z_ks4 "Zyklusflag: Klopfsensor 4" UWORD B_TRUE 1 100 0 1 BIT_MASK 0x2 FORMAT "%5.3" /begin IF_DATA ASAP1B_KWP2000 KP_BLOB 0x382ABA EXTERN 0x2 /end IF_DATA /begin IF_DATA ETK KP_BLOB 0x382ABA EXTERN 0x2 /end IF_DATA /end MEASUREMENT
/begin MEASUREMENT Z_lap "Zyklusflag Laptriggersignal" UWORD B_TRUE 1 100 0 1 BIT_MASK 0x2 FORMAT "%5.3" /begin IF_DATA ASAP1B_KWP2000 KP_BLOB 0x382ABC EXTERN 0x2 /end IF_DATA /begin IF_DATA ETK KP_BLOB 0x382ABC EXTERN 0x2 /end IF_DATA /end MEASUREMENT
/begin MEASUREMENT Z_lsv "Zyklusflag: Lambda-Sonde vor Kat" UWORD B_TRUE 1 100 0 1 BIT_MASK 0x2 FORMAT "%5.3" /begin IF_DATA ASAP1B_KWP2000 KP_BLOB 0x382AC0 EXTERN 0x2 /end IF_DATA /begin IF_DATA ETK KP_BLOB 0x382AC0 EXTERN 0x2 /end IF_DATA /end MEASUREMENT
/begin MEASUREMENT Z_lsv2 "Zyklusflag: Lambda-Sonde 2 vor Kat" UWORD B_TRUE 1 100 0 1 BIT_MASK 0x2 FORMAT "%5.3" /begin IF_DATA ASAP1B_KWP2000 KP_BLOB 0x382AC2 EXTERN 0x2 /end IF_DATA /begin IF_DATA ETK KP_BLOB 0x382AC2 EXTERN 0x2 /end IF_DATA /end MEASUREMENT
/begin MEASUREMENT Z_mile "Zyklusflag: MIL-Endstufe" UWORD B_TRUE 1 100 0 1 BIT_MASK 0x2 FORMAT "%5.3" /begin IF_DATA ASAP1B_KWP2000 KP_BLOB 0x382AC4 EXTERN 0x2 /end IF_DATA /begin IF_DATA ETK KP_BLOB 0x382AC4 EXTERN 0x2 /end IF_DATA /end MEASUREMENT
/begin MEASUREMENT Z_milse "Zyklusflag: Endstufe kundenspezifische Fehlerlampe" UWORD B_TRUE 1 100 0 1 BIT_MASK 0x2 FORMAT "%5.3" /begin IF_DATA ASAP1B_KWP2000 KP_BLOB 0x382AC6 EXTERN 0x2 /end IF_DATA /begin IF_DATA ETK KP_BLOB 0x382AC6 EXTERN 0x2 /end IF_DATA /end MEASUREMENT
/begin MEASUREMENT Z_ollae "Zyklusflag: Endstufe Ölwarnlampe" UWORD B_TRUE 1 100 0 1 BIT_MASK 0x2 FORMAT "%5.3" /begin IF_DATA ASAP1B_KWP2000 KP_BLOB 0x382ACA EXTERN 0x2 /end IF_DATA /begin IF_DATA ETK KP_BLOB 0x382ACA EXTERN 0x2 /end IF_DATA /end MEASUREMENT
/begin MEASUREMENT Z_ph "Zyklusflag: Phasensensor" UWORD B_TRUE 1 100 0 1 BIT_MASK 0x2 FORMAT "%5.3" /begin IF_DATA ASAP1B_KWP2000 KP_BLOB 0x382ACC EXTERN 0x2 /end IF_DATA /begin IF_DATA ETK KP_BLOB 0x382ACC EXTERN 0x2 /end IF_DATA /end MEASUREMENT
/begin MEASUREMENT Z_shlae "Zyklusflag: Endstufe Schaltlampe" UWORD B_TRUE 1 100 0 1 BIT_MASK 0x2 FORMAT "%5.3" /begin IF_DATA ASAP1B_KWP2000 KP_BLOB 0x382ACE EXTERN 0x2 /end IF_DATA /begin IF_DATA ETK KP_BLOB 0x382ACE EXTERN 0x2 /end IF_DATA /end MEASUREMENT
/begin MEASUREMENT Z_ta "Zyklusflag: TANS" UWORD B_TRUE 1 100 0 1 BIT_MASK 0x2 FORMAT "%5.3" /begin IF_DATA ASAP1B_KWP2000 KP_BLOB 0x382AD0 EXTERN 0x2 /end IF_DATA /begin IF_DATA ETK KP_BLOB 0x382AD0 EXTERN 0x2 /end IF_DATA /end MEASUREMENT
/begin MEASUREMENT Z_tfuel "Zyklusflag Kraftstofftemperatur" UWORD B_TRUE 1 100 0 1 BIT_MASK 0x2 FORMAT "%5.3" /begin IF_DATA ASAP1B_KWP2000 KP_BLOB 0x382AD2 EXTERN 0x2 /end IF_DATA /begin IF_DATA ETK KP_BLOB 0x382AD2 EXTERN 0x2 /end IF_DATA /end MEASUREMENT
/begin MEASUREMENT Z_tm "Zyklusflag:	TMOT" UWORD B_TRUE 1 100 0 1 BIT_MASK 0x2 FORMAT "%5.3" /begin IF_DATA ASAP1B_KWP2000 KP_BLOB 0x382AD4 EXTERN 0x2 /end IF_DATA /begin IF_DATA ETK KP_BLOB 0x382AD4 EXTERN 0x2 /end IF_DATA /end MEASUREMENT
/begin MEASUREMENT Z_tol "Zyklusflag: Öltemperatur" UWORD B_TRUE 1 100 0 1 BIT_MASK 0x2 FORMAT "%5.3" /begin IF_DATA ASAP1B_KWP2000 KP_BLOB 0x382AD6 EXTERN 0x2 /end IF_DATA /begin IF_DATA ETK KP_BLOB 0x382AD6 EXTERN 0x2 /end IF_DATA /end MEASUREMENT
/begin MEASUREMENT Z_tum "Zyklusflag: Umgebungstemperatur TUM" UWORD B_TRUE 1 100 0 1 BIT_MASK 0x2 FORMAT "%5.3" /begin IF_DATA ASAP1B_KWP2000 KP_BLOB 0x382AD8 EXTERN 0x2 /end IF_DATA /begin IF_DATA ETK KP_BLOB 0x382AD8 EXTERN 0x2 /end IF_DATA /end MEASUREMENT
/begin MEASUREMENT Z_ub "Zyklusflag:	UB" UWORD B_TRUE 1 100 0 1 BIT_MASK 0x2 FORMAT "%5.3" /begin IF_DATA ASAP1B_KWP2000 KP_BLOB 0x382ADA EXTERN 0x2 /end IF_DATA /begin IF_DATA ETK KP_BLOB 0x382ADA EXTERN 0x2 /end IF_DATA /end MEASUREMENT
/begin MEASUREMENT Z_vfz "Zyklusflag: Fahrzeug-Geschwindigkeit" UWORD B_TRUE 1 100 0 1 BIT_MASK 0x2 FORMAT "%5.3" /begin IF_DATA ASAP1B_KWP2000 KP_BLOB 0x382ADC EXTERN 0x2 /end IF_DATA /begin IF_DATA ETK KP_BLOB 0x382ADC EXTERN 0x2 /end IF_DATA /end MEASUREMENT
/begin FUNCTION DFPM_DEKON ""
 /begin DEF_CHARACTERISTIC CDTEV1 CLAEV1 TSFEV1 CDKEV1 FFTEV1 CDTEV2 CLAEV2 TSFEV2 CDKEV2 FFTEV2 CDTEV3 CLAEV3 TSFEV3 CDKEV3 FFTEV3 CDTEV4 CLAEV4 TSFEV4 CDKEV4 FFTEV4 CDTEV5 CLAEV5 TSFEV5 CDKEV5 FFTEV5 CDTEV6 CLAEV6 TSFEV6 CDKEV6 FFTEV6 CDTMILE CLAMILE TSFMILE CDKMILE FFTMILE CDTKPE CLAKPE TSFKPE CDKKPE FFTKPE CDTOLLAE CLAOLLAE TSFOLLAE CDKOLLAE FFTOLLAE CDTSHLAE CLASHLAE TSFSHLAE CDKSHLAE FFTSHLAE CDTMILSE CLAMILSE TSFMILSE CDKMILSE FFTMILSE /end DEF_CHARACTERISTIC
 /begin REF_CHARACTERISTIC /end REF_CHARACTERISTIC
 /begin IN_MEASUREMENT /end IN_MEASUREMENT
 /begin OUT_MEASUREMENT B_bkmilse B_bkshlae B_clev1 B_clev2 B_clev3 B_clev4 B_clev5 B_clev6 B_clkpe B_clmile B_clmilse B_clollae B_clshlae B_mnev1 B_mnev2 B_mnev3 B_mnev4 B_mnev5 B_mnev6 B_mnkpe B_mnmile B_mnmilse B_mnollae B_mnshlae B_mxev1 B_mxev2 B_mxev3 B_mxev4 B_mxev5 B_mxev6 B_mxkpe B_mxmile B_mxmilse B_mxollae B_mxshlae B_npev1 B_npev2 B_npev3 B_npev4 B_npev5 B_npev6 B_npkpe B_npmile B_npmilse B_npollae B_npshlae B_siev1 B_siev2 B_siev3 B_siev4 B_siev5 B_siev6 B_sikpe B_simile B_similse B_siollae B_sishlae E_ev1 E_ev2 E_ev3 E_ev4 E_ev5 E_ev6 E_kpe E_mile E_milse E_ollae E_shlae sfpev1 sfpev2 sfpev3 sfpev4 sfpev5 sfpev6 sfpkpe sfpmile sfpmilse sfpollae sfpshlae TYP_ev1 TYP_ev2 TYP_ev3 TYP_ev4 TYP_ev5 TYP_ev6 TYP_kpe TYP_mile TYP_milse TYP_ollae TYP_shlae Z_ev1 Z_ev2 Z_ev3 Z_ev4 Z_ev5 Z_ev6 Z_kpe Z_mile Z_milse Z_ollae Z_shlae /end OUT_MEASUREMENT
 /begin LOC_MEASUREMENT /end LOC_MEASUREMENT
 /begin SUB_FUNCTION /end SUB_FUNCTION
/end FUNCTION
/begin FUNCTION DFPM_DFPM ""
 /begin DEF_CHARACTERISTIC CDTAAA CLAAAA TSFAAA CDKAAA FFTAAA CDTZZZ CLAZZZ TSFZZZ CDKZZZ FFTZZZ /end DEF_CHARACTERISTIC
 /begin REF_CHARACTERISTIC /end REF_CHARACTERISTIC
 /begin IN_MEASUREMENT /end IN_MEASUREMENT
 /begin OUT_MEASUREMENT sfpaaa sfpzzz /end OUT_MEASUREMENT
 /begin LOC_MEASUREMENT /end LOC_MEASUREMENT
 /begin SUB_FUNCTION /end SUB_FUNCTION
/end FUNCTION
/begin FUNCTION DFPM_DHLSU ""
 /begin DEF_CHARACTERISTIC CDTHSV CLAHSV TSFHSV CDKHSV FFTHSV CDTHSV2 CLAHSV2 TSFHSV2 CDKHSV2 FFTHSV2 /end DEF_CHARACTERISTIC
 /begin REF_CHARACTERISTIC /end REF_CHARACTERISTIC
 /begin IN_MEASUREMENT /end IN_MEASUREMENT
 /begin OUT_MEASUREMENT B_clhsv B_clhsv2 B_mnhsv B_mnhsv2 B_mxhsv B_mxhsv2 B_nphsv B_nphsv2 B_sihsv B_sihsv2 E_hsv E_hsv2 sfphsv sfphsv2 TYP_hsv TYP_hsv2 Z_hsv Z_hsv2 /end OUT_MEASUREMENT
 /begin LOC_MEASUREMENT /end LOC_MEASUREMENT
 /begin SUB_FUNCTION /end SUB_FUNCTION
/end FUNCTION
/begin FUNCTION DFPM_DKRNT ""
 /begin DEF_CHARACTERISTIC CDTKRNT CLAKRNT TSFKRNT CDKKRNT FFTKRNT CDTKROF CLAKROF TSFKROF CDKKROF FFTKROF /end DEF_CHARACTERISTIC
 /begin REF_CHARACTERISTIC /end REF_CHARACTERISTIC
 /begin IN_MEASUREMENT /end IN_MEASUREMENT
 /begin OUT_MEASUREMENT B_mnkrnt B_mnkrof B_mxkrnt B_mxkrof B_npkrnt B_npkrof B_sikrnt B_sikrof E_krnt E_krof sfpkrnt sfpkrof TYP_krnt TYP_krof Z_krnt Z_krof /end OUT_MEASUREMENT
 /begin LOC_MEASUREMENT /end LOC_MEASUREMENT
 /begin SUB_FUNCTION /end SUB_FUNCTION
/end FUNCTION
/begin FUNCTION DFPM_DKRS ""
 /begin DEF_CHARACTERISTIC CDTKS1 CLAKS1 TSFKS1 CDKKS1 FFTKS1 CDTKS2 CLAKS2 TSFKS2 CDKKS2 FFTKS2 CDTKS3 CLAKS3 TSFKS3 CDKKS3 FFTKS3 CDTKS4 CLAKS4 TSFKS4 CDKKS4 FFTKS4 /end DEF_CHARACTERISTIC
 /begin REF_CHARACTERISTIC /end REF_CHARACTERISTIC
 /begin IN_MEASUREMENT /end IN_MEASUREMENT
 /begin OUT_MEASUREMENT B_clks1 B_clks2 B_clks3 B_clks4 B_mnks1 B_mnks2 B_mnks3 B_mnks4 B_mxks1 B_mxks2 B_mxks3 B_mxks4 B_npks1 B_npks2 B_npks3 B_npks4 B_siks1 B_siks2 B_siks3 B_siks4 E_ks1 E_ks2 E_ks3 E_ks4 sfpks1 sfpks2 sfpks3 sfpks4 TYP_ks1 TYP_ks2 TYP_ks3 TYP_ks4 Z_ks1 Z_ks2 Z_ks3 Z_ks4 /end OUT_MEASUREMENT
 /begin LOC_MEASUREMENT /end LOC_MEASUREMENT
 /begin SUB_FUNCTION /end SUB_FUNCTION
/end FUNCTION
/begin FUNCTION DFPM_DKRTP "" /begin DEF_CHARACTERISTIC CDTKRTP CLAKRTP TSFKRTP CDKKRTP FFTKRTP /end DEF_CHARACTERISTIC /begin REF_CHARACTERISTIC /end REF_CHARACTERISTIC /begin IN_MEASUREMENT /end IN_MEASUREMENT
 /begin OUT_MEASUREMENT B_clkrtp B_mnkrtp B_mxkrtp B_npkrtp B_sikrtp E_krtp sfpkrtp TYP_krtp Z_krtp /end OUT_MEASUREMENT
 /begin LOC_MEASUREMENT /end LOC_MEASUREMENT
 /begin SUB_FUNCTION /end SUB_FUNCTION
/end FUNCTION
/begin FUNCTION DFPM_DLSU ""
 /begin DEF_CHARACTERISTIC CDTLSV CLALSV TSFLSV CDKLSV FFTLSV CDTLSV2 CLALSV2 TSFLSV2 CDKLSV2 FFTLSV2 /end DEF_CHARACTERISTIC
 /begin REF_CHARACTERISTIC /end REF_CHARACTERISTIC
 /begin IN_MEASUREMENT /end IN_MEASUREMENT
 /begin OUT_MEASUREMENT B_cllsv B_cllsv2 B_nplsv B_nplsv2 B_silsv B_silsv2 E_lsv E_lsv2 sfplsv sfplsv2 TYP_lsv TYP_lsv2 Z_lsv Z_lsv2 /end OUT_MEASUREMENT
 /begin LOC_MEASUREMENT /end LOC_MEASUREMENT
 /begin SUB_FUNCTION /end SUB_FUNCTION
/end FUNCTION
/begin FUNCTION DFPM_DPH "" /begin DEF_CHARACTERISTIC CDTPH CLAPH TSFPH CDKPH FFTPH /end DEF_CHARACTERISTIC /begin REF_CHARACTERISTIC /end REF_CHARACTERISTIC /begin IN_MEASUREMENT /end IN_MEASUREMENT /begin OUT_MEASUREMENT B_clph B_mnph B_mxph B_npph B_siph E_ph sfpph TYP_ph Z_ph /end OUT_MEASUREMENT /begin LOC_MEASUREMENT /end LOC_MEASUREMENT /begin SUB_FUNCTION /end SUB_FUNCTION /end FUNCTION
/begin FUNCTION DFPM_DUMMY_D ""
 /begin DEF_CHARACTERISTIC CDTDSS CLADSS TSFDSS CDKDSS FFTDSS CDTTUM CLATUM TSFTUM CDKTUM FFTTUM /end DEF_CHARACTERISTIC
 /begin REF_CHARACTERISTIC /end REF_CHARACTERISTIC
 /begin IN_MEASUREMENT /end IN_MEASUREMENT
 /begin OUT_MEASUREMENT E_dss E_tum sfpdss sfptum Z_dss Z_tum /end OUT_MEASUREMENT
 /begin LOC_MEASUREMENT /end LOC_MEASUREMENT
 /begin SUB_FUNCTION /end SUB_FUNCTION
/end FUNCTION
/begin FUNCTION DFPM_GGATS ""
 /begin DEF_CHARACTERISTIC CDTATS CLAATS TSFATS CDKATS FFTATS CDTATS2 CLAATS2 TSFATS2 CDKATS2 FFTATS2 /end DEF_CHARACTERISTIC
 /begin REF_CHARACTERISTIC /end REF_CHARACTERISTIC
 /begin IN_MEASUREMENT /end IN_MEASUREMENT
 /begin OUT_MEASUREMENT B_bkats B_bkats2 B_clats B_clats2 B_mnats B_mnats2 B_mxats B_mxats2 B_npats B_siats E_ats E_ats2 sfpats sfpats2 TYP_ats TYP_ats2 Z_ats Z_ats2 /end OUT_MEASUREMENT
 /begin LOC_MEASUREMENT /end LOC_MEASUREMENT
 /begin SUB_FUNCTION /end SUB_FUNCTION
/end FUNCTION
/begin FUNCTION DFPM_GGDSAS ""
 /begin DEF_CHARACTERISTIC CDTDSU CLADSU TSFDSU CDKDSU FFTDSU CDTDSL CLADSL TSFDSL CDKDSL FFTDSL CDTDSVLU CLADSVLU TSFDSVLU CDKDSVLU FFTDSVLU /end DEF_CHARACTERISTIC
 /begin REF_CHARACTERISTIC /end REF_CHARACTERISTIC
 /begin IN_MEASUREMENT /end IN_MEASUREMENT
 /begin OUT_MEASUREMENT B_cldsl B_cldsu B_cldsvlu B_mndsl B_mndsu B_mndsvlu B_mxdsl B_mxdsu B_mxdsvlu B_npdsl B_npdsu B_npdsvlu B_sidsl B_sidsu B_sidsvlu E_dsl E_dsu E_dsvlu sfpdsl sfpdsu sfpdsvlu TYP_dsl TYP_dsu TYP_dsvlu Z_dsl Z_dsu Z_dsvlu /end OUT_MEASUREMENT
 /begin LOC_MEASUREMENT /end LOC_MEASUREMENT
 /begin SUB_FUNCTION /end SUB_FUNCTION
/end FUNCTION
/begin FUNCTION DFPM_GGPFUEL "" /begin DEF_CHARACTERISTIC CDTDSFUE CLADSFUE TSFDSFUE CDKDSFUE FFTDSFUE /end DEF_CHARACTERISTIC /begin REF_CHARACTERISTIC /end REF_CHARACTERISTIC /begin IN_MEASUREMENT /end IN_MEASUREMENT
 /begin OUT_MEASUREMENT B_bkdsfue B_cldsfue B_mndsfue B_mxdsfue B_npdsfue B_sidsfue E_dsfue sfpdsfue TYP_dsfue Z_dsfue /end OUT_MEASUREMENT
 /begin LOC_MEASUREMENT /end LOC_MEASUREMENT
 /begin SUB_FUNCTION /end SUB_FUNCTION
/end FUNCTION
/begin FUNCTION DFPM_GGPOEL "" /begin DEF_CHARACTERISTIC CDTDSOEL CLADSOEL TSFDSOEL CDKDSOEL FFTDSOEL /end DEF_CHARACTERISTIC /begin REF_CHARACTERISTIC /end REF_CHARACTERISTIC /begin IN_MEASUREMENT /end IN_MEASUREMENT
 /begin OUT_MEASUREMENT B_bkdsoel B_cldsoel B_mndsoel B_mxdsoel B_npdsoel B_sidsoel E_dsoel sfpdsoel TYP_dsoel Z_dsoel /end OUT_MEASUREMENT
 /begin LOC_MEASUREMENT /end LOC_MEASUREMENT
 /begin SUB_FUNCTION /end SUB_FUNCTION
/end FUNCTION
/begin FUNCTION DFPM_GGTFA "" /begin DEF_CHARACTERISTIC CDTTA CLATA TSFTA CDKTA FFTTA /end DEF_CHARACTERISTIC /begin REF_CHARACTERISTIC /end REF_CHARACTERISTIC /begin IN_MEASUREMENT /end IN_MEASUREMENT
 /begin OUT_MEASUREMENT B_bkta B_clta B_mnta B_mxta B_npta B_sita E_ta sfpta TYP_ta Z_ta /end OUT_MEASUREMENT
 /begin LOC_MEASUREMENT /end LOC_MEASUREMENT
 /begin SUB_FUNCTION /end SUB_FUNCTION
/end FUNCTION
/begin FUNCTION DFPM_GGTFM "" /begin DEF_CHARACTERISTIC CDTTM CLATM TSFTM CDKTM FFTTM /end DEF_CHARACTERISTIC /begin REF_CHARACTERISTIC /end REF_CHARACTERISTIC /begin IN_MEASUREMENT /end IN_MEASUREMENT
 /begin OUT_MEASUREMENT B_bktm B_cltm B_mntm B_mxtm B_nptm B_sitm E_tm sfptm TYP_tm Z_tm /end OUT_MEASUREMENT
 /begin LOC_MEASUREMENT /end LOC_MEASUREMENT
 /begin SUB_FUNCTION /end SUB_FUNCTION
/end FUNCTION
/begin FUNCTION DFPM_GGTFOL "" /begin DEF_CHARACTERISTIC CDTTOL CLATOL TSFTOL CDKTOL FFTTOL /end DEF_CHARACTERISTIC /begin REF_CHARACTERISTIC /end REF_CHARACTERISTIC /begin IN_MEASUREMENT /end IN_MEASUREMENT
 /begin OUT_MEASUREMENT B_bktol B_cltol B_mntol B_mxtol B_nptol B_sitol E_tol sfptol TYP_tol Z_tol /end OUT_MEASUREMENT
 /begin LOC_MEASUREMENT /end LOC_MEASUREMENT
 /begin SUB_FUNCTION /end SUB_FUNCTION
/end FUNCTION
/begin FUNCTION DFPM_GGTFUEL "" /begin DEF_CHARACTERISTIC CDTTFUEL CLATFUEL TSFTFUEL CDKTFUEL FFTTFUEL /end DEF_CHARACTERISTIC /begin REF_CHARACTERISTIC /end REF_CHARACTERISTIC /begin IN_MEASUREMENT /end IN_MEASUREMENT
 /begin OUT_MEASUREMENT B_betfuel B_bktfuel B_cltfuel B_fttfuel B_mntfuel B_mxtfuel B_nptfuel B_sitfuel E_tfuel sfptfuel TYP_tfuel Z_tfuel /end OUT_MEASUREMENT
 /begin LOC_MEASUREMENT /end LOC_MEASUREMENT
 /begin SUB_FUNCTION /end SUB_FUNCTION
/end FUNCTION
/begin FUNCTION DFPM_GGUB "" /begin DEF_CHARACTERISTIC CDTUB CLAUB TSFUB CDKUB FFTUB /end DEF_CHARACTERISTIC /begin REF_CHARACTERISTIC /end REF_CHARACTERISTIC /begin IN_MEASUREMENT /end IN_MEASUREMENT
 /begin OUT_MEASUREMENT B_bkub B_club B_mnub B_mxub B_npub B_siub E_ub sfpub TYP_ub Z_ub /end OUT_MEASUREMENT
 /begin LOC_MEASUREMENT /end LOC_MEASUREMENT
 /begin SUB_FUNCTION /end SUB_FUNCTION
/end FUNCTION
/begin FUNCTION DFPM_GGVFZG "" /begin DEF_CHARACTERISTIC CDTVFZ CLAVFZ TSFVFZ CDKVFZ FFTVFZ /end DEF_CHARACTERISTIC /begin REF_CHARACTERISTIC /end REF_CHARACTERISTIC /begin IN_MEASUREMENT /end IN_MEASUREMENT /begin OUT_MEASUREMENT B_clvfz B_mnvfz B_mxvfz B_sivfz E_vfz sfpvfz TYP_vfz Z_vfz /end OUT_MEASUREMENT /begin LOC_MEASUREMENT /end LOC_MEASUREMENT /begin SUB_FUNCTION /end SUB_FUNCTION /end FUNCTION
/begin FUNCTION DFPM_GSH "" /begin DEF_CHARACTERISTIC CDTGSH CLAGSH TSFGSH CDKGSH FFTGSH /end DEF_CHARACTERISTIC /begin REF_CHARACTERISTIC /end REF_CHARACTERISTIC /begin IN_MEASUREMENT /end IN_MEASUREMENT /begin OUT_MEASUREMENT B_bkgsh B_clgsh B_npgsh E_gsh sfpgsh TYP_gsh Z_gsh /end OUT_MEASUREMENT /begin LOC_MEASUREMENT /end LOC_MEASUREMENT /begin SUB_FUNCTION /end SUB_FUNCTION /end FUNCTION
/begin FUNCTION DFPM_KWPDATR "" /begin DEF_CHARACTERISTIC /end DEF_CHARACTERISTIC /begin REF_CHARACTERISTIC /end REF_CHARACTERISTIC /begin IN_MEASUREMENT /end IN_MEASUREMENT /begin OUT_MEASUREMENT /end OUT_MEASUREMENT /begin LOC_MEASUREMENT /end LOC_MEASUREMENT /begin SUB_FUNCTION /end SUB_FUNCTION /end FUNCTION
/begin FUNCTION DFPM_LAP "" /begin DEF_CHARACTERISTIC CDTLAP CLALAP TSFLAP CDKLAP FFTLAP /end DEF_CHARACTERISTIC /begin REF_CHARACTERISTIC /end REF_CHARACTERISTIC /begin IN_MEASUREMENT /end IN_MEASUREMENT /begin OUT_MEASUREMENT B_bklap B_cllap B_nplap E_lap sfplap TYP_lap Z_lap /end OUT_MEASUREMENT /begin LOC_MEASUREMENT /end LOC_MEASUREMENT /begin SUB_FUNCTION /end SUB_FUNCTION /end FUNCTION
/begin FUNCTION DFRZ "OBDII; Beschreibung 'freeze frame'" /begin DEF_CHARACTERISTIC /end DEF_CHARACTERISTIC /begin REF_CHARACTERISTIC /end REF_CHARACTERISTIC /begin IN_MEASUREMENT fr2_w fra2_w fra_w fr_w nmot_w rl_w /end IN_MEASUREMENT /begin OUT_MEASUREMENT frz2 frz4 frz5 frz6 frz7 /end OUT_MEASUREMENT /begin LOC_MEASUREMENT /end LOC_MEASUREMENT /begin SUB_FUNCTION /end SUB_FUNCTION /end FUNCTION
/begin FUNCTION DHLSU "Diagnose Heizung LSU" /begin DEF_CHARACTERISTIC TDFHS TVLSUBM TVLSUST UHEMN UHEMX /end DEF_CHARACTERISTIC /begin REF_CHARACTERISTIC UBDLSMX UBDLS /end REF_CHARACTERISTIC
 /begin IN_MEASUREMENT B_cdhsv B_elsu B_elsu2 B_hsv B_hsv2 B_hsve B_hsve2 B_kl15 B_pwf B_sbbvk B_sbbvk2 B_stend cd_bits1_w ub uhsv uhsv2 /end IN_MEASUREMENT
 /begin OUT_MEASUREMENT B_ehlsu B_ehlsu2 /end OUT_MEASUREMENT
 /begin LOC_MEASUREMENT B_mnhlsu B_mnhlsu2 B_mxhlsu B_mxhlsu2 B_nphlsu B_nphlsu2 B_sihlsu B_sihlsu2 /end LOC_MEASUREMENT
 /begin SUB_FUNCTION /end SUB_FUNCTION
/end FUNCTION
/begin FUNCTION diavalve "" /begin DEF_CHARACTERISTIC /end DEF_CHARACTERISTIC /begin REF_CHARACTERISTIC /end REF_CHARACTERISTIC /begin IN_MEASUREMENT eevx /end IN_MEASUREMENT /begin OUT_MEASUREMENT /end OUT_MEASUREMENT /begin LOC_MEASUREMENT /end LOC_MEASUREMENT /begin SUB_FUNCTION /end SUB_FUNCTION /end FUNCTION
/begin FUNCTION DKRNT "4.30      Diagnose; Klopfregelung, Nulltest (OBDII)" /begin DEF_CHARACTERISTIC CDKRNT CDKROF DKRISNT DKROKU KRFHT UDKRGOFS /end DEF_CHARACTERISTIC /begin REF_CHARACTERISTIC DKROKO /end REF_CHARACTERISTIC /begin IN_MEASUREMENT B_dnt B_pwf B_stend igokr_w ikrma nmot tpnt_aktiv /end IN_MEASUREMENT /begin OUT_MEASUREMENT xzskrnt xzskrof /end OUT_MEASUREMENT /begin LOC_MEASUREMENT xzkrznt xzkrzof /end LOC_MEASUREMENT /begin SUB_FUNCTION /end SUB_FUNCTION /end FUNCTION
/begin FUNCTION DKRS "Diagnose; Klopfsensor (OBDII)" /begin DEF_CHARACTERISTIC KRFHKS CDKS1 CDKS2 CDKS3 CDKS4 NDKS UDKSNO UDKSNU /end DEF_CHARACTERISTIC /begin REF_CHARACTERISTIC SNM16KRUB KSZA /end REF_CHARACTERISTIC
 /begin IN_MEASUREMENT B_kr B_krldy B_krndy B_phsok B_pwf B_tmkr esst_snm16krub ks_sym nmot rkr sen_c95 vkr /end IN_MEASUREMENT
 /begin OUT_MEASUREMENT B_krdws rkrn_w xzkrzs xzsen /end OUT_MEASUREMENT
 /begin LOC_MEASUREMENT /end LOC_MEASUREMENT
 /begin SUB_FUNCTION /end SUB_FUNCTION
/end FUNCTION
/begin FUNCTION DKRTP "6.30      Diagnose; Klopfregelung, Testimpuls (OBDII)" /begin DEF_CHARACTERISTIC CDKRTP UDKRTP /end DEF_CHARACTERISTIC /begin REF_CHARACTERISTIC KRFHT /end REF_CHARACTERISTIC /begin IN_MEASUREMENT B_dtp B_pwf ikrma ikrmet tpnt_aktiv /end IN_MEASUREMENT /begin OUT_MEASUREMENT xzskrtp /end OUT_MEASUREMENT /begin LOC_MEASUREMENT xzkrztp /end LOC_MEASUREMENT /begin SUB_FUNCTION /end SUB_FUNCTION /end FUNCTION
/begin FUNCTION DLL "" /begin DEF_CHARACTERISTIC BITTIME /end DEF_CHARACTERISTIC /begin REF_CHARACTERISTIC /end REF_CHARACTERISTIC /begin IN_MEASUREMENT /end IN_MEASUREMENT /begin OUT_MEASUREMENT /end OUT_MEASUREMENT /begin LOC_MEASUREMENT /end LOC_MEASUREMENT /begin SUB_FUNCTION /end SUB_FUNCTION /end FUNCTION
/begin FUNCTION DLSU "Diagnose stetige Lambdasonde LSU"
 /begin DEF_CHARACTERISTIC DRLMX LAMMN LAMMX LSUNAMN LSUNAMX SDLAMX SULSUMX TALAMX TALSUMX TVCJLSU TVHKLSU TVHKLSUV TVLSUHK TVNOLSU ZEHK TVPLMSA /end DEF_CHARACTERISTIC
 /begin REF_CHARACTERISTIC /end REF_CHARACTERISTIC
 /begin IN_MEASUREMENT B_cdlsv B_ehlsu B_ehlsu2 B_frmax B_frmax2 B_frmin B_frmin2 B_hsv B_hsv2 B_hsve B_hsve2 B_lrs B_lrs2 B_lsuab B_lsuab2 B_nmot B_pwf B_sa B_st B_stend cd_bits1_w lamsoni2_w lamsoni_w lamsons2_w lamsons_w ml nmot rl tabgm tabgm2 tnst_w uulsuv2_w uulsuv_w /end IN_MEASUREMENT
 /begin OUT_MEASUREMENT B_elsu B_elsu2 dynlsu2_w zhklsu zhklsu2 /end OUT_MEASUREMENT
 /begin LOC_MEASUREMENT B_drlmx B_evlsu B_evlsu2 B_helsu B_helsu2 B_lsuft B_lsuft2 B_lsumr B_lsumr2 B_lsumx B_lsumx2 B_lsuna B_lsuna2 B_nplflsu B_nplflsu2 B_sigflsu B_sigflsu2 DLSUebits lamsam2_w lamsam_w /end LOC_MEASUREMENT
 /begin SUB_FUNCTION /end SUB_FUNCTION
/end FUNCTION
/begin FUNCTION dmile "OBDII; MIL-Endstufe" /begin DEF_CHARACTERISTIC /end DEF_CHARACTERISTIC /begin REF_CHARACTERISTIC /end REF_CHARACTERISTIC /begin IN_MEASUREMENT B_desee B_mil /end IN_MEASUREMENT /begin OUT_MEASUREMENT /end OUT_MEASUREMENT /begin LOC_MEASUREMENT /end LOC_MEASUREMENT /begin SUB_FUNCTION /end SUB_FUNCTION /end FUNCTION
/begin FUNCTION DPH "Diagnose; Plausibilitätsprüfung Phasensensor" /begin DEF_CHARACTERISTIC PHNOKA /end DEF_CHARACTERISTIC /begin REF_CHARACTERISTIC /end REF_CHARACTERISTIC /begin IN_MEASUREMENT B_st /end IN_MEASUREMENT /begin OUT_MEASUREMENT B_phas2 B_phase B_phsok B_phsok2 phpw phpw2 zphnok zphnok2 /end OUT_MEASUREMENT /begin LOC_MEASUREMENT /end LOC_MEASUREMENT /begin SUB_FUNCTION /end SUB_FUNCTION /end FUNCTION
/begin FUNCTION dsu2e "Diagnose; Saugrohrumschaltung Endstufe" /begin DEF_CHARACTERISTIC /end DEF_CHARACTERISTIC /begin REF_CHARACTERISTIC /end REF_CHARACTERISTIC /begin IN_MEASUREMENT B_desee /end IN_MEASUREMENT /begin OUT_MEASUREMENT /end OUT_MEASUREMENT /begin LOC_MEASUREMENT /end LOC_MEASUREMENT /begin SUB_FUNCTION /end SUB_FUNCTION /end FUNCTION
/begin FUNCTION DTIP "OBDII; Tester-Interface Package" /begin DEF_CHARACTERISTIC /end DEF_CHARACTERISTIC /begin REF_CHARACTERISTIC /end REF_CHARACTERISTIC /begin IN_MEASUREMENT fcmEnd FCMTab /end IN_MEASUREMENT /begin OUT_MEASUREMENT ffzdfp /end OUT_MEASUREMENT /begin LOC_MEASUREMENT /end LOC_MEASUREMENT /begin SUB_FUNCTION /end SUB_FUNCTION /end FUNCTION
/begin FUNCTION DTRIG "OBDII; Auswählbare Trigger für Fehlerpfad-Management" /begin DEF_CHARACTERISTIC /end DEF_CHARACTERISTIC /begin REF_CHARACTERISTIC /end REF_CHARACTERISTIC /begin IN_MEASUREMENT bbdcy bbsp3 bbtim bbwuc /end IN_MEASUREMENT /begin OUT_MEASUREMENT /end OUT_MEASUREMENT /begin LOC_MEASUREMENT /end LOC_MEASUREMENT /begin SUB_FUNCTION /end SUB_FUNCTION /end FUNCTION
/begin FUNCTION DUMMY "DUMMY SEKTION" /begin DEF_CHARACTERISTIC UBDLSMX UBDLS DUMMYKL /end DEF_CHARACTERISTIC /begin REF_CHARACTERISTIC /end REF_CHARACTERISTIC /begin IN_MEASUREMENT migs_w misol_w wdkba wdkba_w /end IN_MEASUREMENT
 /begin OUT_MEASUREMENT B_dkpu B_dslvh B_nachlram B_nnot B_nws dummyram fstva_w mifal_w tabst_w tumg usvk usvk2 wnwue wped zylvirt zzvirt /end OUT_MEASUREMENT
 /begin LOC_MEASUREMENT /end LOC_MEASUREMENT
 /begin SUB_FUNCTION /end SUB_FUNCTION
/end FUNCTION
/begin FUNCTION DUMWEX "Diagose; Erweiterte Umweltbedingumgen" /begin DEF_CHARACTERISTIC /end DEF_CHARACTERISTIC /begin REF_CHARACTERISTIC /end REF_CHARACTERISTIC
 /begin IN_MEASUREMENT fr2_w fra2_w fra_w fr_w lamsoni2_w lamsoni_w ltmot_w nmot psdss_w rl ti_b1 wdkba wub /end IN_MEASUREMENT
 /begin OUT_MEASUREMENT /end OUT_MEASUREMENT
 /begin LOC_MEASUREMENT /end LOC_MEASUREMENT
 /begin SUB_FUNCTION /end SUB_FUNCTION
/end FUNCTION
/begin FUNCTION DWUC "OBDII; Erfüllung Bedingung 'warm up cycle'" /begin DEF_CHARACTERISTIC TMWUCST DTMWUC TMWUC /end DEF_CHARACTERISTIC /begin REF_CHARACTERISTIC /end REF_CHARACTERISTIC /begin IN_MEASUREMENT B_stend tmot /end IN_MEASUREMENT /begin OUT_MEASUREMENT bbwuc B_wuc /end OUT_MEASUREMENT /begin LOC_MEASUREMENT tmstem /end LOC_MEASUREMENT /begin SUB_FUNCTION /end SUB_FUNCTION /end FUNCTION
/begin FUNCTION EDB "Eingabe Dashboard" /begin DEF_CHARACTERISTIC TOVERTAKE TDMAP TDMAPOT /end DEF_CHARACTERISTIC /begin REF_CHARACTERISTIC /end REF_CHARACTERISTIC /begin IN_MEASUREMENT B_mappin1 B_mappin2 /end IN_MEASUREMENT /begin OUT_MEASUREMENT B_mappos1 B_mappos2 B_mappos3 B_overtake mappos /end OUT_MEASUREMENT /begin LOC_MEASUREMENT /end LOC_MEASUREMENT /begin SUB_FUNCTION /end SUB_FUNCTION /end FUNCTION
/begin FUNCTION EEPROM "EEPROM-Behandlung" /begin DEF_CHARACTERISTIC /end DEF_CHARACTERISTIC /begin REF_CHARACTERISTIC /end REF_CHARACTERISTIC /begin IN_MEASUREMENT B_nlEEPR B_pwf swOffDlBits /end IN_MEASUREMENT /begin OUT_MEASUREMENT /end OUT_MEASUREMENT /begin LOC_MEASUREMENT /end LOC_MEASUREMENT /begin SUB_FUNCTION /end SUB_FUNCTION /end FUNCTION
/begin FUNCTION ESNST "Einspritzung Nachstart"
 /begin DEF_CHARACTERISTIC ANZTIBMX ZDGZA1 ZDGZA2 FNSMXTM FNSSM SZANSSM FZANSSM1 FZANSSM2 FNSA FZANSSA1 FZANSSA2 KFNSWRL KFLANS /end DEF_CHARACTERISTIC
 /begin REF_CHARACTERISTIC SAN12ESUW STS12ESUB STA06ESUB FKFVHO /end REF_CHARACTERISTIC
 /begin IN_MEASUREMENT anzti_w B_hst B_st B_stend ESSTTbits esst_san12esuw esst_sta06esub esst_sts12esub fho rl tans tmst /end IN_MEASUREMENT
 /begin OUT_MEASUREMENT anztib_w B_lamnse fns lamns_w /end OUT_MEASUREMENT
 /begin LOC_MEASUREMENT fktns fzans1 kl_fnsmxtm nsactr nsactr1 /end LOC_MEASUREMENT
 /begin SUB_FUNCTION /end SUB_FUNCTION
/end FUNCTION
/begin FUNCTION ESSTT "Einspritzzeit Start"
 /begin DEF_CHARACTERISTIC TMH TMHSG IMLHS FKSTT FHSTT TANDT TWSTT FKFVHO KFWHSTT KFWKSTT KFWKSTN /end DEF_CHARACTERISTIC
 /begin REF_CHARACTERISTIC /end REF_CHARACTERISTIC
 /begin IN_MEASUREMENT anzti B_pwf B_st B_stend dnmot_w fho imlatm nmot tans tansab tistzyl tmotab tmst zzyl /end IN_MEASUREMENT
 /begin OUT_MEASUREMENT B_hst ESSTTbits fst_w /end OUT_MEASUREMENT
 /begin LOC_MEASUREMENT /end LOC_MEASUREMENT
 /begin SUB_FUNCTION /end SUB_FUNCTION
/end FUNCTION
/begin COMPU_METHOD B_TRUE "boolsche Zustände, positive Logik" TAB_VERB "%6.3" "" COMPU_TAB_REF B_TRUE /end COMPU_METHOD
/begin COMPU_VTAB B_TRUE "boolsche Zustände, positive Logik" TAB_VERB 2 0 "----" 1 "TRUE" /end COMPU_VTAB
/begin COMPU_METHOD dez "1 : 1 Umrechnug (dez/hex)" RAT_FUNC "%6.2" "" COEFFS 0 1 0 0 0 1 /end COMPU_METHOD
/begin COMPU_METHOD fak_sw_b8 "" RAT_FUNC "%6.5" "-" COEFFS 0 65536 0 0 0 16 /end COMPU_METHOD
/begin COMPU_METHOD fak_ub_b0p25 "" RAT_FUNC "%6.5" "-" COEFFS 0 256 0 0 0 0.25 /end COMPU_METHOD
/begin COMPU_METHOD fak_ub_b1 "" RAT_FUNC "%6.4" "-" COEFFS 0 256 0 0 0 1 /end COMPU_METHOD
/begin COMPU_METHOD fak_ub_b2 "" RAT_FUNC "%6.4" "-" COEFFS 0 256 0 0 0 2 /end COMPU_METHOD
/begin COMPU_METHOD fak_ub_b4 "" RAT_FUNC "%6.4" "-" COEFFS 0 256 0 0 0 4 /end COMPU_METHOD
/begin COMPU_METHOD fak_ub_b64 "" RAT_FUNC "%6.3" "-" COEFFS 0 256 0 0 0 64 /end COMPU_METHOD
/begin COMPU_METHOD fak_ub_b8 "" RAT_FUNC "%6.4" "-" COEFFS 0 256 0 0 0 8 /end COMPU_METHOD
/begin COMPU_METHOD fak_uw_b16 "" RAT_FUNC "%6.5" "-" COEFFS 0 65536 0 0 0 16 /end COMPU_METHOD
/begin COMPU_METHOD fak_uw_b2 "" RAT_FUNC "%7.6" "-" COEFFS 0 65536 0 0 0 2 /end COMPU_METHOD
/begin COMPU_METHOD fak_uw_b64 "" RAT_FUNC "%6.5" "-" COEFFS 0 65536 0 0 0 64 /end COMPU_METHOD
/begin COMPU_METHOD kw_ub_q0p5 "" RAT_FUNC "%6.3" "°KW" COEFFS 0 256 0 0 0 128 /end COMPU_METHOD
/begin COMPU_METHOD m_ub_b1020 "" RAT_FUNC "%6.2" "kg/h" COEFFS 0 1 0 0 0 4 /end COMPU_METHOD
/begin COMPU_METHOD m_ub_b23p3 "" RAT_FUNC "%6.3" "kg" COEFFS 0 2812.5 0 0 0 256 /end COMPU_METHOD
/begin COMPU_METHOD nmot_ub_q40 "" RAT_FUNC "%6.1" "Upm" COEFFS 0 1 0 0 0 40 /end COMPU_METHOD
/begin COMPU_METHOD relPED_ub_b100 "" RAT_FUNC "%6.3" "% PED" COEFFS 0 255 0 0 0 100 /end COMPU_METHOD
/begin COMPU_METHOD rel_ub_q0p75 "" RAT_FUNC "%6.3" "%" COEFFS 0 1 0 0 0 0.75 /end COMPU_METHOD
/begin COMPU_METHOD rel_uw_b100 "" RAT_FUNC "%6.4" "%" COEFFS 0 65536 0 0 0 100 /end COMPU_METHOD
/begin COMPU_METHOD spgg_sw_b3052 "" RAT_FUNC "%6.3" "V/s" COEFFS 0 1 0 0 0 0.0931323 /end COMPU_METHOD
/begin COMPU_METHOD spg_ubatt "" RAT_FUNC "%6.4" "V" COEFFS 0 1 0 0 0 0.0681 /end COMPU_METHOD
/begin COMPU_METHOD spg_ub_b5 "" RAT_FUNC "%6.4" "V" COEFFS 0 255 0 0 0 5 /end COMPU_METHOD
/begin COMPU_METHOD spg_ub_q0p019 "" RAT_FUNC "%6.4" "V" COEFFS 0 256 0 0 0 5 /end COMPU_METHOD
/begin COMPU_METHOD spg_uw_b1280 "" RAT_FUNC "%6.4" "V" COEFFS 0 1000 0 0 0 19.5313 /end COMPU_METHOD
/begin COMPU_METHOD spg_uw_q0p00488 "" RAT_FUNC "%6.4" "V" COEFFS 0 1024 0 0 0 5 /end COMPU_METHOD
/begin COMPU_METHOD t100msxs_ub_b25p5 "" RAT_FUNC "%6.3" "s" COEFFS 0 1 0 0 0 0.1 /end COMPU_METHOD
/begin COMPU_METHOD t10msxs_ub_b2p55 "" RAT_FUNC "%6.4" "s" COEFFS 0 1 0 0 0 0.01 /end COMPU_METHOD
/begin COMPU_METHOD t10msxs_uw_b655p35 "" RAT_FUNC "%6.4" "s" COEFFS 0 1 0 0 0 0.01 /end COMPU_METHOD
/begin COMPU_METHOD t1sxs_ub_b255 "" RAT_FUNC "%6.2" "s" COEFFS 0 1 0 0 0 1 /end COMPU_METHOD
/begin COMPU_METHOD t1sxs_uw_q1 "" RAT_FUNC "%6.2" "s" COEFFS 0 1 0 0 0 1 /end COMPU_METHOD
/begin COMPU_METHOD t50msxs_uw_b3276p75 "" RAT_FUNC "%6.4" "s" COEFFS 0 1 0 0 0 0.05 /end COMPU_METHOD
/begin COMPU_METHOD temp_ub_b191p25 "" RAT_FUNC "%6.3" "Grad C" COEFFS 0 1 0 0 0 0.75 /end COMPU_METHOD
/begin COMPU_METHOD temp_ub_q0p75_o48 "" RAT_FUNC "%6.2" "Grad C" COEFFS 0 1 48 0 0 0.75 /end COMPU_METHOD
/begin COMPU_METHOD temp_ub_q1_o40 "" RAT_FUNC "%6.2" "Grad C" COEFFS 0 1 40 0 0 1 /end COMPU_METHOD
/begin COMPU_METHOD temp_ub_q5_o50 "" RAT_FUNC "%6.2" "Grad C" COEFFS 0 1 50 0 0 5 /end COMPU_METHOD
/begin COMPU_METHOD ULSQ "Lambdasonden-Spannung" RAT_FUNC "%6.4" "V" COEFFS 0 51 0 0 0 1 /end COMPU_METHOD
/begin COMPU_METHOD default "" RAT_FUNC "%6.2" "" COEFFS 0 1 0 0 0 1 /end COMPU_METHOD
/begin RECORD_LAYOUT GkfWUw FNC_VALUES 1 UWORD COLUMN_DIR DIRECT /end RECORD_LAYOUT
/begin RECORD_LAYOUT GklWUb FNC_VALUES 1 UBYTE COLUMN_DIR DIRECT /end RECORD_LAYOUT
/begin RECORD_LAYOUT GklWUw FNC_VALUES 1 UWORD COLUMN_DIR DIRECT /end RECORD_LAYOUT
/begin RECORD_LAYOUT KfAxUbAyUbSstxUbSstyUbWUb NO_AXIS_PTS_X 1 UBYTE NO_AXIS_PTS_Y 2 UBYTE AXIS_PTS_X 3 UBYTE INDEX_INCR DIRECT AXIS_PTS_Y 4 UBYTE INDEX_INCR DIRECT FNC_VALUES 5 UBYTE COLUMN_DIR DIRECT /end RECORD_LAYOUT
/begin RECORD_LAYOUT KlAUbSstUbWUb NO_AXIS_PTS_X 1 UBYTE AXIS_PTS_X 2 UBYTE INDEX_INCR DIRECT FNC_VALUES 3 UBYTE COLUMN_DIR DIRECT /end RECORD_LAYOUT
/begin RECORD_LAYOUT KwbUb FNC_VALUES 1 UBYTE COLUMN_DIR DIRECT /end RECORD_LAYOUT
/begin RECORD_LAYOUT KwUb FNC_VALUES 1 UBYTE COLUMN_DIR DIRECT /end RECORD_LAYOUT
/begin RECORD_LAYOUT KwUw FNC_VALUES 1 UWORD COLUMN_DIR DIRECT /end RECORD_LAYOUT
/begin RECORD_LAYOUT SstAUbSstUb NO_AXIS_PTS_X 1 UBYTE AXIS_PTS_X 2 UBYTE INDEX_INCR DIRECT /end RECORD_LAYOUT
/begin RECORD_LAYOUT SstAUwSstUw NO_AXIS_PTS_X 1 UWORD AXIS_PTS_X 2 UWORD INDEX_INCR DIRECT /end RECORD_LAYOUT
/end MODULE
/end PROJECT
