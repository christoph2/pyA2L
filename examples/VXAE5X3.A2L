/begin PROJECT DPU-2XX "Visteon Diesel"
/begin HEADER " " VERSION "1" PROJECT_NO Global /end HEADER
/begin MODULE ENGINE "International Engine Controller"
/begin MOD_COMMON " " BYTE_ORDER MSB_FIRST /end MOD_COMMON
/begin MEASUREMENT IAT_ENG_C "Intake Air Temperature without FMEM substitutions, degree C" FLOAT32_IEEE MC_IAT_ENG_C 0 0 0 0 ECU_ADDRESS 0x3FAA78 /end MEASUREMENT
/begin COMPU_METHOD MC_IAT_ENG_C "IAT_ENG_C conversion" RAT_FUNC "%10.5" "Unitless" COEFFS 0 1 0 0 0 1 /end COMPU_METHOD
/begin MEASUREMENT IAT_FILT_TIME_CONST "IAT  filter time constant" FLOAT32_IEEE MC_IAT_FILT_TIME_CONST 0 0 0 0 ECU_ADDRESS 0x3FA1D4 /end MEASUREMENT
/begin COMPU_METHOD MC_IAT_FILT_TIME_CONST "IAT_FILT_TIME_CONST conversion" RAT_FUNC "%10.5" "Unitless" COEFFS 0 1 0 0 0 1 /end COMPU_METHOD
/begin MEASUREMENT IAT_FLT_RECOVERY_CNTR "IAT fault recovery counter" SLONG MC_IAT_FLT_RECOVERY_CNTR 0 0 0 0 ECU_ADDRESS 0x3FA1C0 /end MEASUREMENT
/begin COMPU_METHOD MC_IAT_FLT_RECOVERY_CNTR "IAT_FLT_RECOVERY_CNTR conversion" RAT_FUNC "%10.0" "Unitless" COEFFS 0 1 0 0 0 1 /end COMPU_METHOD
/begin MEASUREMENT IAT_FLT_RECOVERY_FLG "1-> Indicates IAT fault recovery is occuring" UBYTE MC_IAT_FLT_RECOVERY_FLG 0 0 0 0 ECU_ADDRESS 0x3FA1E0 /end MEASUREMENT
/begin COMPU_METHOD MC_IAT_FLT_RECOVERY_FLG "IAT_FLT_RECOVERY_FLG conversion" RAT_FUNC "%3.0" "Unitless" COEFFS 0 1 0 0 0 1 /end COMPU_METHOD
/begin CHARACTERISTIC IAT_F_DEC "IAT malf failure/update counter decrement value" VALUE 0x567A4 SD_SLONG 0 SC_IAT_F_DEC 0 65535 /end CHARACTERISTIC
/begin COMPU_METHOD SC_IAT_F_DEC "IAT_F_DEC conversion" RAT_FUNC "%10.0" "unitless" COEFFS 0 1 0 0 0 1 /end COMPU_METHOD
/begin CHARACTERISTIC IAT_F_INC "IAT ORH/ORL failure counter increment value" VALUE 0x567A8 SD_SLONG 0 SC_IAT_F_INC 0 65535 /end CHARACTERISTIC
/begin COMPU_METHOD SC_IAT_F_INC "IAT_F_INC conversion" RAT_FUNC "%10.0" "unitless" COEFFS 0 1 0 0 0 1 /end COMPU_METHOD
/begin CHARACTERISTIC IAT_HI_VOLTS "Intake Air Temperature out of range high limit" VALUE 0x5751C SD_FLOAT32_IEEE 0 SC_IAT_HI_VOLTS 0 5 /end CHARACTERISTIC
/begin COMPU_METHOD SC_IAT_HI_VOLTS "IAT_HI_VOLTS conversion" RAT_FUNC "%10.5" "V" COEFFS 0 1 0 0 0 1 /end COMPU_METHOD
/begin CHARACTERISTIC IAT_LO_VOLTS "Intake Air Temperature out of range low limit" VALUE 0x57520 SD_FLOAT32_IEEE 0 SC_IAT_LO_VOLTS 0 5 /end CHARACTERISTIC
/begin COMPU_METHOD SC_IAT_LO_VOLTS "IAT_LO_VOLTS conversion" RAT_FUNC "%10.5" "V" COEFFS 0 1 0 0 0 1 /end COMPU_METHOD
/begin MEASUREMENT IAT_MALF_SET "Indicate IAT malf  high or low failure" UBYTE MC_IAT_MALF_SET 0 0 0 0 ECU_ADDRESS 0x3FA1E2 /end MEASUREMENT
/begin COMPU_METHOD MC_IAT_MALF_SET "IAT_MALF_SET conversion" RAT_FUNC "%3.0" "Unitless" COEFFS 0 1 0 0 0 1 /end COMPU_METHOD
/begin MEASUREMENT IAT_ORH_CNTR "Intake Air Temperature out of range high counter" SLONG MC_IAT_ORH_CNTR 0 0 0 0 ECU_ADDRESS 0x3FA1D0 /end MEASUREMENT
/begin COMPU_METHOD MC_IAT_ORH_CNTR "IAT_ORH_CNTR conversion" RAT_FUNC "%10.0" "Unitless" COEFFS 0 1 0 0 0 1 /end COMPU_METHOD
/begin MEASUREMENT IAT_ORL_CNTR "Intake Air Temperature out of range low counter" SLONG MC_IAT_ORL_CNTR 0 0 0 0 ECU_ADDRESS 0x3FA1CC /end MEASUREMENT
/begin COMPU_METHOD MC_IAT_ORL_CNTR "IAT_ORL_CNTR conversion" RAT_FUNC "%10.0" "Unitless" COEFFS 0 1 0 0 0 1 /end COMPU_METHOD
/begin CHARACTERISTIC IAT_REC_INC "IAT  fault recovery counter increment value" VALUE 0x56790 SD_SLONG 0 SC_IAT_REC_INC 0 65535 /end CHARACTERISTIC
/begin COMPU_METHOD SC_IAT_REC_INC "IAT_REC_INC conversion" RAT_FUNC "%10.0" "unitless" COEFFS 0 1 0 0 0 1 /end COMPU_METHOD
/begin MEASUREMENT IAT_STATUS "Status of Intake Air Temperature sensor,  0 = no error" UBYTE MC_IAT_STATUS 0 0 0 0 ECU_ADDRESS 0x3FAA80 /end MEASUREMENT
/begin COMPU_METHOD MC_IAT_STATUS "IAT_STATUS conversion" RAT_FUNC "%3.0" "Unitless" COEFFS 0 1 0 0 0 1 /end COMPU_METHOD
/begin CHARACTERISTIC IAT_TCREC_SEL "Switch to select IAT filter time constant during fault recovery and during fault occurance before malf is set" VALUE 0x56798 SD_UBYTE 0 SC_IAT_TCREC_SEL 0 1 /end CHARACTERISTIC
/begin COMPU_METHOD SC_IAT_TCREC_SEL "IAT_TCREC_SEL conversion" RAT_FUNC "%3.0" "unitless" COEFFS 0 1 0 0 0 1 /end COMPU_METHOD
/begin CHARACTERISTIC ICPDES_OLLMN "Minimum ICP_DES during open loop control (MPa)" VALUE 0x56C8C SD_FLOAT32_IEEE 0 SC_ICPDES_OLLMN 0 30 /end CHARACTERISTIC
/begin COMPU_METHOD SC_ICPDES_OLLMN "ICPDES_OLLMN conversion" RAT_FUNC "%10.5" "MPa" COEFFS 0 1 0 0 0 1 /end COMPU_METHOD
/begin CHARACTERISTIC ICPDES_OLLMX "Maximum ICP_DES during open loop control (MPa)" VALUE 0x56C88 SD_FLOAT32_IEEE 0 SC_ICPDES_OLLMX 0 30 /end CHARACTERISTIC
/begin COMPU_METHOD SC_ICPDES_OLLMX "ICPDES_OLLMX conversion" RAT_FUNC "%10.5" "MPa" COEFFS 0 1 0 0 0 1 /end COMPU_METHOD
/begin CHARACTERISTIC ICP_AD_TC "Injection control pressure filter time constant" VALUE 0x56578 SD_FLOAT32_IEEE 0 SC_ICP_AD_TC 0 64 /end CHARACTERISTIC
/begin COMPU_METHOD SC_ICP_AD_TC "ICP_AD_TC conversion" RAT_FUNC "%10.5" "s" COEFFS 0 1 0 0 0 1 /end COMPU_METHOD
/begin CHARACTERISTIC ICP_CAL "Calibration value for desired ICP (MPa)" VALUE 0x56CD8 SD_FLOAT32_IEEE 0 SC_ICP_CAL 0 30 /end CHARACTERISTIC
/begin COMPU_METHOD SC_ICP_CAL "ICP_CAL conversion" RAT_FUNC "%10.5" "MPa" COEFFS 0 1 0 0 0 1 /end COMPU_METHOD
/begin CHARACTERISTIC ICP_CRNKRUN_TM "" VALUE 0x56CD4 SD_FLOAT32_IEEE 0 SC_ICP_CRNKRUN_TM 0 1e+06 /end CHARACTERISTIC
/begin COMPU_METHOD SC_ICP_CRNKRUN_TM "ICP_CRNKRUN_TM conversion" RAT_FUNC "%10.5" "s" COEFFS 0 1 0 0 0 1 /end COMPU_METHOD
/begin MEASUREMENT ICP_CRNKRUN_TMR "" FLOAT32_IEEE MC_ICP_CRNKRUN_TMR 0 0 0 0 ECU_ADDRESS 0x3FA508 /end MEASUREMENT
/begin COMPU_METHOD MC_ICP_CRNKRUN_TMR "ICP_CRNKRUN_TMR conversion" RAT_FUNC "%10.5" "Unitless" COEFFS 0 1 0 0 0 1 /end COMPU_METHOD
/begin MEASUREMENT ICP_DASH "ICP Dashpot value.  Added to ICP_DES" FLOAT32_IEEE MC_ICP_DASH 0 0 0 0 ECU_ADDRESS 0x3FA504 /end MEASUREMENT
/begin COMPU_METHOD MC_ICP_DASH "ICP_DASH conversion" RAT_FUNC "%10.5" "Unitless" COEFFS 0 1 0 0 0 1 /end COMPU_METHOD
/begin CHARACTERISTIC ICP_DASH_CAL "ICP Dashpot on/off switch" VALUE 0x56CDE SD_UBYTE 0 SC_ICP_DASH_CAL 0 1 /end CHARACTERISTIC
/begin COMPU_METHOD SC_ICP_DASH_CAL "ICP_DASH_CAL conversion" RAT_FUNC "%3.0" "unitless" COEFFS 0 1 0 0 0 1 /end COMPU_METHOD
/begin CHARACTERISTIC ICP_DASH_LMN "Minimum limit for ICP dashpot term (MPa)" VALUE 0x56CD0 SD_FLOAT32_IEEE 0 SC_ICP_DASH_LMN -21 21 /end CHARACTERISTIC
/begin COMPU_METHOD SC_ICP_DASH_LMN "ICP_DASH_LMN conversion" RAT_FUNC "%10.5" "MPa" COEFFS 0 1 0 0 0 1 /end COMPU_METHOD
/begin CHARACTERISTIC ICP_DASH_LMX "Maximum limit for ICP dashpot term (MPa)" VALUE 0x56CCC SD_FLOAT32_IEEE 0 SC_ICP_DASH_LMX -21 21 /end CHARACTERISTIC
/begin COMPU_METHOD SC_ICP_DASH_LMX "ICP_DASH_LMX conversion" RAT_FUNC "%10.5" "MPa" COEFFS 0 1 0 0 0 1 /end COMPU_METHOD
/begin CHARACTERISTIC ICP_DASH_TC "Time constant for ICP Dashpot filtering" VALUE 0x56CC8 SD_FLOAT32_IEEE 0 SC_ICP_DASH_TC 0 0.45 /end CHARACTERISTIC
/begin COMPU_METHOD SC_ICP_DASH_TC "ICP_DASH_TC conversion" RAT_FUNC "%10.5" "s" COEFFS 0 1 0 0 0 1 /end COMPU_METHOD
/begin MEASUREMENT ICP_DES "Desired Injection Control Pressure (in MPa)" FLOAT32_IEEE MC_ICP_DES 0 0 0 0 ECU_ADDRESS 0x3FA500 /end MEASUREMENT
/begin COMPU_METHOD MC_ICP_DES "ICP_DES conversion" RAT_FUNC "%10.5" "Unitless" COEFFS 0 1 0 0 0 1 /end COMPU_METHOD
/begin MEASUREMENT ICP_DES_LMT_HI "" FLOAT32_IEEE MC_ICP_DES_LMT_HI 0 0 0 0 ECU_ADDRESS 0x3FA4C0 /end MEASUREMENT
/begin COMPU_METHOD MC_ICP_DES_LMT_HI "ICP_DES_LMT_HI conversion" RAT_FUNC "%10.5" "Unitless" COEFFS 0 1 0 0 0 1 /end COMPU_METHOD
/begin MEASUREMENT ICP_DES_LMT_LO "" FLOAT32_IEEE MC_ICP_DES_LMT_LO 0 0 0 0 ECU_ADDRESS 0x3FA4BC /end MEASUREMENT
/begin COMPU_METHOD MC_ICP_DES_LMT_LO "ICP_DES_LMT_LO conversion" RAT_FUNC "%10.5" "Unitless" COEFFS 0 1 0 0 0 1 /end COMPU_METHOD
/begin CHARACTERISTIC ICP_DES_LMX "Maximum limit for desired ICP (MPa)" VALUE 0x56CC4 SD_FLOAT32_IEEE 0 SC_ICP_DES_LMX 15 25 /end CHARACTERISTIC
/begin COMPU_METHOD SC_ICP_DES_LMX "ICP_DES_LMX conversion" RAT_FUNC "%10.5" "MPa" COEFFS 0 1 0 0 0 1 /end COMPU_METHOD
/begin MEASUREMENT ICP_DES_OFST "Offset to ICP_DES based on viscosity (MPa)" FLOAT32_IEEE MC_ICP_DES_OFST 0 0 0 0 ECU_ADDRESS 0x3FA4F8 /end MEASUREMENT
/begin COMPU_METHOD MC_ICP_DES_OFST "ICP_DES_OFST conversion" RAT_FUNC "%10.5" "Unitless" COEFFS 0 1 0 0 0 1 /end COMPU_METHOD
/begin MEASUREMENT ICP_DES_RAW "Desired Injection Control Pressure (in MPa)" FLOAT32_IEEE MC_ICP_DES_RAW 0 0 0 0 ECU_ADDRESS 0x3FA4FC /end MEASUREMENT
/begin COMPU_METHOD MC_ICP_DES_RAW "ICP_DES_RAW conversion" RAT_FUNC "%10.5" "Unitless" COEFFS 0 1 0 0 0 1 /end COMPU_METHOD
/begin MEASUREMENT ICP_DES_RAW_LMTD "" FLOAT32_IEEE MC_ICP_DES_RAW_LMTD 0 0 0 0 ECU_ADDRESS 0x3FA4C4 /end MEASUREMENT
/begin COMPU_METHOD MC_ICP_DES_RAW_LMTD "ICP_DES_RAW_LMTD conversion" RAT_FUNC "%10.5" "Unitless" COEFFS 0 1 0 0 0 1 /end COMPU_METHOD
/begin CHARACTERISTIC ICP_DES_ROC "" VALUE 0x56CC0 SD_FLOAT32_IEEE 0 SC_ICP_DES_ROC -100000 100000 /end CHARACTERISTIC
/begin COMPU_METHOD SC_ICP_DES_ROC "ICP_DES_ROC conversion" RAT_FUNC "%10.5" "unitless" COEFFS 0 1 0 0 0 1 /end COMPU_METHOD
/begin MEASUREMENT ICP_DES_TBL "Output of table FN1300P" FLOAT32_IEEE MC_ICP_DES_TBL 0 0 0 0 ECU_ADDRESS 0x3FA4F4 /end MEASUREMENT
/begin COMPU_METHOD MC_ICP_DES_TBL "ICP_DES_TBL conversion" RAT_FUNC "%10.5" "Unitless" COEFFS 0 1 0 0 0 1 /end COMPU_METHOD
/begin MEASUREMENT ICP_DTY "ICP valve duty cycle" FLOAT32_IEEE MC_ICP_DTY 0 0 0 0 ECU_ADDRESS 0x3FA4F0 /end MEASUREMENT
/begin COMPU_METHOD MC_ICP_DTY "ICP_DTY conversion" RAT_FUNC "%10.5" "Unitless" COEFFS 0 1 0 0 0 1 /end COMPU_METHOD
/begin CHARACTERISTIC ICP_DTY_CAL "ICP valve duty cycle calibration constant" VALUE 0x56CBC SD_FLOAT32_IEEE 0 SC_ICP_DTY_CAL 0 0.999 /end CHARACTERISTIC
/begin COMPU_METHOD SC_ICP_DTY_CAL "ICP_DTY_CAL conversion" RAT_FUNC "%10.5" "unitless" COEFFS 0 1 0 0 0 1 /end COMPU_METHOD
/begin CHARACTERISTIC ICP_DTY_LMN "ICP valve duty cycle minimum limit" VALUE 0x56CB8 SD_FLOAT32_IEEE 0 SC_ICP_DTY_LMN 0 0.999 /end CHARACTERISTIC
/begin COMPU_METHOD SC_ICP_DTY_LMN "ICP_DTY_LMN conversion" RAT_FUNC "%10.5" "unitless" COEFFS 0 1 0 0 0 1 /end COMPU_METHOD
/begin MEASUREMENT ICP_DTY_LMTD "" FLOAT32_IEEE MC_ICP_DTY_LMTD 0 0 0 0 ECU_ADDRESS 0x3FA4B4 /end MEASUREMENT
/begin COMPU_METHOD MC_ICP_DTY_LMTD "ICP_DTY_LMTD conversion" RAT_FUNC "%10.5" "Unitless" COEFFS 0 1 0 0 0 1 /end COMPU_METHOD
/begin CHARACTERISTIC ICP_DTY_LMX "ICP valve duty cycle maximum limit" VALUE 0x56CB4 SD_FLOAT32_IEEE 0 SC_ICP_DTY_LMX 0 0.999 /end CHARACTERISTIC
/begin COMPU_METHOD SC_ICP_DTY_LMX "ICP_DTY_LMX conversion" RAT_FUNC "%10.5" "unitless" COEFFS 0 1 0 0 0 1 /end COMPU_METHOD
/begin CHARACTERISTIC ICP_DTY_NST "ICP valve duty cycle during NO_START mode" VALUE 0x56CB0 SD_FLOAT32_IEEE 0 SC_ICP_DTY_NST 0 0.5 /end CHARACTERISTIC
/begin COMPU_METHOD SC_ICP_DTY_NST "ICP_DTY_NST conversion" RAT_FUNC "%10.5" "unitless" COEFFS 0 1 0 0 0 1 /end COMPU_METHOD
/begin MEASUREMENT ICP_DTY_RAW "" FLOAT32_IEEE MC_ICP_DTY_RAW 0 0 0 0 ECU_ADDRESS 0x3FA4B8 /end MEASUREMENT
/begin COMPU_METHOD MC_ICP_DTY_RAW "ICP_DTY_RAW conversion" RAT_FUNC "%10.5" "Unitless" COEFFS 0 1 0 0 0 1 /end COMPU_METHOD
/begin MEASUREMENT ICP_ENG "injection control pressure , MPA" FLOAT32_IEEE MC_ICP_ENG 0 0 0 0 ECU_ADDRESS 0x3FAA04 /end MEASUREMENT
/begin COMPU_METHOD MC_ICP_ENG "ICP_ENG conversion" RAT_FUNC "%10.5" "Unitless" COEFFS 0 1 0 0 0 1 /end COMPU_METHOD
/begin MEASUREMENT ICP_EOT_MULT "ICP engine oil temperature multiplier" FLOAT32_IEEE MC_ICP_EOT_MULT 0 0 0 0 ECU_ADDRESS 0x3FA4EC /end MEASUREMENT
/begin COMPU_METHOD MC_ICP_EOT_MULT "ICP_EOT_MULT conversion" RAT_FUNC "%10.5" "Unitless" COEFFS 0 1 0 0 0 1 /end COMPU_METHOD
/begin MEASUREMENT ICP_ERR "Injection control pressure error (MPa)" FLOAT32_IEEE MC_ICP_ERR 0 0 0 0 ECU_ADDRESS 0x3FA4E8 /end MEASUREMENT
/begin COMPU_METHOD MC_ICP_ERR "ICP_ERR conversion" RAT_FUNC "%10.5" "Unitless" COEFFS 0 1 0 0 0 1 /end COMPU_METHOD
/begin CHARACTERISTIC ICP_ERR_LMN "Minimum limit for ICP error (MPa)" VALUE 0x56CAC SD_FLOAT32_IEEE 0 SC_ICP_ERR_LMN -20 0 /end CHARACTERISTIC
/begin COMPU_METHOD SC_ICP_ERR_LMN "ICP_ERR_LMN conversion" RAT_FUNC "%10.5" "MPa" COEFFS 0 1 0 0 0 1 /end COMPU_METHOD
/begin CHARACTERISTIC ICP_ERR_LMX "Maximum limit for ICP error (MPa)" VALUE 0x56CA8 SD_FLOAT32_IEEE 0 SC_ICP_ERR_LMX 0 20 /end CHARACTERISTIC
/begin COMPU_METHOD SC_ICP_ERR_LMX "ICP_ERR_LMX conversion" RAT_FUNC "%10.5" "MPa" COEFFS 0 1 0 0 0 1 /end COMPU_METHOD
/begin MEASUREMENT ICP_FF_DTY "Feed forward term of ICP duty cycle" FLOAT32_IEEE MC_ICP_FF_DTY 0 0 0 0 ECU_ADDRESS 0x3FA4E4 /end MEASUREMENT
/begin COMPU_METHOD MC_ICP_FF_DTY "ICP_FF_DTY conversion" RAT_FUNC "%10.5" "Unitless" COEFFS 0 1 0 0 0 1 /end COMPU_METHOD
/begin MEASUREMENT ICP_FILT "filtered icp value" FLOAT32_IEEE MC_ICP_FILT 0 0 0 0 ECU_ADDRESS 0x3FAF08 /end MEASUREMENT
/begin COMPU_METHOD MC_ICP_FILT "ICP_FILT conversion" RAT_FUNC "%10.5" "Unitless" COEFFS 0 1 0 0 0 1 /end COMPU_METHOD
/begin MEASUREMENT ICP_FILT_TIME_CONST "icp filter time constant" FLOAT32_IEEE MC_ICP_FILT_TIME_CONST 0 0 0 0 ECU_ADDRESS 0x3FA034 /end MEASUREMENT
/begin COMPU_METHOD MC_ICP_FILT_TIME_CONST "ICP_FILT_TIME_CONST conversion" RAT_FUNC "%10.5" "Unitless" COEFFS 0 1 0 0 0 1 /end COMPU_METHOD
/begin MEASUREMENT ICP_FLT_RECOVERY_CNTR "icp fault recover counter" SLONG MC_ICP_FLT_RECOVERY_CNTR 0 0 0 0 ECU_ADDRESS 0x3FA020 /end MEASUREMENT
/begin COMPU_METHOD MC_ICP_FLT_RECOVERY_CNTR "ICP_FLT_RECOVERY_CNTR conversion" RAT_FUNC "%10.0" "Unitless" COEFFS 0 1 0 0 0 1 /end COMPU_METHOD
/begin MEASUREMENT ICP_FLT_RECOVERY_FLG "icp fault recovery flag" UBYTE MC_ICP_FLT_RECOVERY_FLG 0 0 0 0 ECU_ADDRESS 0x3FA042 /end MEASUREMENT
/begin COMPU_METHOD MC_ICP_FLT_RECOVERY_FLG "ICP_FLT_RECOVERY_FLG conversion" RAT_FUNC "%3.0" "Unitless" COEFFS 0 1 0 0 0 1 /end COMPU_METHOD
/begin CHARACTERISTIC ICP_F_DEC "ICP ORH/ORL failure counter decrement value" VALUE 0x5658C SD_SLONG 0 SC_ICP_F_DEC 0 65535 /end CHARACTERISTIC
/begin COMPU_METHOD SC_ICP_F_DEC "ICP_F_DEC conversion" RAT_FUNC "%10.0" "unitless" COEFFS 0 1 0 0 0 1 /end COMPU_METHOD
/begin CHARACTERISTIC ICP_F_INC "ICP ORH/ORL failure counter increment value" VALUE 0x56590 SD_SLONG 0 SC_ICP_F_INC 0 65535 /end CHARACTERISTIC
/begin COMPU_METHOD SC_ICP_F_INC "ICP_F_INC conversion" RAT_FUNC "%10.0" "unitless" COEFFS 0 1 0 0 0 1 /end COMPU_METHOD
/begin CHARACTERISTIC ICP_HI_VOLTS "Maximum acceptable voltage for icp (engine fuel pressure) sensor" VALUE 0x573CC SD_FLOAT32_IEEE 0 SC_ICP_HI_VOLTS 0 5 /end CHARACTERISTIC
/begin COMPU_METHOD SC_ICP_HI_VOLTS "ICP_HI_VOLTS conversion" RAT_FUNC "%10.5" "V" COEFFS 0 1 0 0 0 1 /end COMPU_METHOD
/begin MEASUREMENT ICP_I_DTY "Integral term of ICP duty cycle" FLOAT32_IEEE MC_ICP_I_DTY 0 0 0 0 ECU_ADDRESS 0x3FA4E0 /end MEASUREMENT
/begin COMPU_METHOD MC_ICP_I_DTY "ICP_I_DTY conversion" RAT_FUNC "%10.5" "Unitless" COEFFS 0 1 0 0 0 1 /end COMPU_METHOD
/begin MEASUREMENT ICP_KI_N "" FLOAT32_IEEE MC_ICP_KI_N 0 0 0 0 ECU_ADDRESS 0x3FA4DC /end MEASUREMENT
/begin COMPU_METHOD MC_ICP_KI_N "ICP_KI_N conversion" RAT_FUNC "%10.5" "Unitless" COEFFS 0 1 0 0 0 1 /end COMPU_METHOD
/begin CHARACTERISTIC ICP_KP "ICP control proportional gain" VALUE 0x56C9C SD_FLOAT32_IEEE 0 SC_ICP_KP 0 0.24999 /end CHARACTERISTIC
/begin COMPU_METHOD SC_ICP_KP "ICP_KP conversion" RAT_FUNC "%10.5" "unitless" COEFFS 0 1 0 0 0 1 /end COMPU_METHOD
/begin CHARACTERISTIC ICP_LO_VOLTS "Minimum acceptable voltage for icp (engine fuel pressure) sensor" VALUE 0x573D0 SD_FLOAT32_IEEE 0 SC_ICP_LO_VOLTS 0 5 /end CHARACTERISTIC
/begin COMPU_METHOD SC_ICP_LO_VOLTS "ICP_LO_VOLTS conversion" RAT_FUNC "%10.5" "V" COEFFS 0 1 0 0 0 1 /end COMPU_METHOD
/begin MEASUREMENT ICP_MALF_SET "indicates icp malf high or low failure" UBYTE MC_ICP_MALF_SET 0 0 0 0 ECU_ADDRESS 0x3FA044 /end MEASUREMENT
/begin COMPU_METHOD MC_ICP_MALF_SET "ICP_MALF_SET conversion" RAT_FUNC "%3.0" "Unitless" COEFFS 0 1 0 0 0 1 /end COMPU_METHOD
/begin CHARACTERISTIC ICP_MFDSHLMN "Minimum clip for ICP_DASH (MPa)" VALUE 0x56C98 SD_FLOAT32_IEEE 0 SC_ICP_MFDSHLMN -21 21 /end CHARACTERISTIC
/begin COMPU_METHOD SC_ICP_MFDSHLMN "ICP_MFDSHLMN conversion" RAT_FUNC "%10.5" "MPa" COEFFS 0 1 0 0 0 1 /end COMPU_METHOD
/begin CHARACTERISTIC ICP_MFDSHLMX "Maximum clip for ICP_DASH (MPa)" VALUE 0x56C94 SD_FLOAT32_IEEE 0 SC_ICP_MFDSHLMX -21 21 /end CHARACTERISTIC
/begin COMPU_METHOD SC_ICP_MFDSHLMX "ICP_MFDSHLMX conversion" RAT_FUNC "%10.5" "MPa" COEFFS 0 1 0 0 0 1 /end COMPU_METHOD
/begin MEASUREMENT ICP_MF_KDSH "Resultant multiplier from table FN1401" FLOAT32_IEEE MC_ICP_MF_KDSH 0 0 0 0 ECU_ADDRESS 0x3FA4D8 /end MEASUREMENT
/begin COMPU_METHOD MC_ICP_MF_KDSH "ICP_MF_KDSH conversion" RAT_FUNC "%10.5" "Unitless" COEFFS 0 1 0 0 0 1 /end COMPU_METHOD
/begin CHARACTERISTIC ICP_MIN "Minimum Injection Control Pressure (MPa)" VALUE 0x56C80 SD_FLOAT32_IEEE 0 SC_ICP_MIN 0 5 /end CHARACTERISTIC
/begin COMPU_METHOD SC_ICP_MIN "ICP_MIN conversion" RAT_FUNC "%10.5" "MPa" COEFFS 0 1 0 0 0 1 /end COMPU_METHOD
/begin MEASUREMENT ICP_MPA "Injection Control Pressure (in MPa)" FLOAT32_IEEE MC_ICP_MPA 0 0 0 0 ECU_ADDRESS 0x3FA03C /end MEASUREMENT
/begin COMPU_METHOD MC_ICP_MPA "ICP_MPA conversion" RAT_FUNC "%10.5" "Unitless" COEFFS 0 1 0 0 0 1 /end COMPU_METHOD
/begin MEASUREMENT ICP_NERR_D "Differential part of the ICP feedback loop" FLOAT32_IEEE MC_ICP_NERR_D 0 0 0 0 ECU_ADDRESS 0x3FA4D4 /end MEASUREMENT
/begin COMPU_METHOD MC_ICP_NERR_D "ICP_NERR_D conversion" RAT_FUNC "%10.5" "Unitless" COEFFS 0 1 0 0 0 1 /end COMPU_METHOD
/begin MEASUREMENT ICP_NERR_I "Integral part of the ICP feedback loop" FLOAT32_IEEE MC_ICP_NERR_I 0 0 0 0 ECU_ADDRESS 0x3FA4D0 /end MEASUREMENT
/begin COMPU_METHOD MC_ICP_NERR_I "ICP_NERR_I conversion" RAT_FUNC "%10.5" "Unitless" COEFFS 0 1 0 0 0 1 /end COMPU_METHOD
/begin CHARACTERISTIC ICP_OFST "" VALUE 0x56C90 SD_FLOAT32_IEEE 0 SC_ICP_OFST 0 255 /end CHARACTERISTIC
/begin COMPU_METHOD SC_ICP_OFST "ICP_OFST conversion" RAT_FUNC "%10.5" "unitless" COEFFS 0 1 0 0 0 1 /end COMPU_METHOD
/begin CHARACTERISTIC ICP_OL_FLG "ICP control open loop flag (1: open loop)" VALUE 0x56CDD SD_UBYTE 0 SC_ICP_OL_FLG 0 1 /end CHARACTERISTIC
/begin COMPU_METHOD SC_ICP_OL_FLG "ICP_OL_FLG conversion" RAT_FUNC "%3.0" "unitless" COEFFS 0 1 0 0 0 1 /end COMPU_METHOD
/begin MEASUREMENT ICP_ORH_CNTR "Injection Control Pressure out of range high counter" SLONG MC_ICP_ORH_CNTR 0 0 0 0 ECU_ADDRESS 0x3FA030 /end MEASUREMENT
/begin COMPU_METHOD MC_ICP_ORH_CNTR "ICP_ORH_CNTR conversion" RAT_FUNC "%10.0" "Unitless" COEFFS 0 1 0 0 0 1 /end COMPU_METHOD
/begin MEASUREMENT ICP_ORL_CNTR "Injection Control Pressure out of range low counter" SLONG MC_ICP_ORL_CNTR 0 0 0 0 ECU_ADDRESS 0x3FA02C /end MEASUREMENT
/begin COMPU_METHOD MC_ICP_ORL_CNTR "ICP_ORL_CNTR conversion" RAT_FUNC "%10.0" "Unitless" COEFFS 0 1 0 0 0 1 /end COMPU_METHOD
/begin MEASUREMENT ICP_P_DTY "Proportional term of ICP duty cycle" FLOAT32_IEEE MC_ICP_P_DTY 0 0 0 0 ECU_ADDRESS 0x3FA4CC /end MEASUREMENT
/begin COMPU_METHOD MC_ICP_P_DTY "ICP_P_DTY conversion" RAT_FUNC "%10.5" "Unitless" COEFFS 0 1 0 0 0 1 /end COMPU_METHOD
/begin CHARACTERISTIC ICP_REC_INC "ICP recovery counter increment value" VALUE 0x5657C SD_SLONG 0 SC_ICP_REC_INC 0 65535 /end CHARACTERISTIC
/begin COMPU_METHOD SC_ICP_REC_INC "ICP_REC_INC conversion" RAT_FUNC "%10.0" "unitless" COEFFS 0 1 0 0 0 1 /end COMPU_METHOD
/begin CHARACTERISTIC ICP_SEL "ICP control mode selection" VALUE 0x56CDC SD_UBYTE 0 SC_ICP_SEL 0 4 /end CHARACTERISTIC
/begin COMPU_METHOD SC_ICP_SEL "ICP_SEL conversion" RAT_FUNC "%3.0" "unitless" COEFFS 0 1 0 0 0 1 /end COMPU_METHOD
/begin MEASUREMENT ICP_STATUS "Status of icp (engine fuel pressure ) sensor, 0 = no error" UBYTE MC_ICP_STATUS 0 0 0 0 ECU_ADDRESS 0x3FAA08 /end MEASUREMENT
/begin COMPU_METHOD MC_ICP_STATUS "ICP_STATUS conversion" RAT_FUNC "%3.0" "Unitless" COEFFS 0 1 0 0 0 1 /end COMPU_METHOD
/begin CHARACTERISTIC ICP_TCREC_SEL "switch to select ICP filter time constant" VALUE 0x56580 SD_UBYTE 0 SC_ICP_TCREC_SEL 0 1 /end CHARACTERISTIC
/begin COMPU_METHOD SC_ICP_TCREC_SEL "ICP_TCREC_SEL conversion" RAT_FUNC "%3.0" "unitless" COEFFS 0 1 0 0 0 1 /end COMPU_METHOD
/begin MEASUREMENT ICP_VOLTAGE "ICP sensor voltage seen at A to D input channel" FLOAT32_IEEE MC_ICP_VOLTAGE 0 0 0 0 ECU_ADDRESS 0x3FAA00 /end MEASUREMENT
/begin COMPU_METHOD MC_ICP_VOLTAGE "ICP_VOLTAGE conversion" RAT_FUNC "%10.5" "Unitless" COEFFS 0 1 0 0 0 1 /end COMPU_METHOD
/begin MEASUREMENT ID_BRAKE_SW "PTEC high level driver input indicating BRAKE ON" UBYTE MC_ID_BRAKE_SW 0 0 0 0 ECU_ADDRESS 0x3FADAB /end MEASUREMENT
/begin COMPU_METHOD MC_ID_BRAKE_SW "ID_BRAKE_SW conversion" RAT_FUNC "%3.0" "Unitless" COEFFS 0 1 0 0 0 1 /end COMPU_METHOD
/begin MEASUREMENT INDS "Neutral/Drive input" FLOAT32_IEEE MC_INDS 0 0 0 0 ECU_ADDRESS 0x3FAA98 /end MEASUREMENT
/begin COMPU_METHOD MC_INDS "INDS conversion" RAT_FUNC "%10.5" "Unitless" COEFFS 0 1 0 0 0 1 /end COMPU_METHOD
/begin MEASUREMENT INF_MAT "Inferred MAT" FLOAT32_IEEE MC_INF_MAT 0 0 0 0 ECU_ADDRESS 0x3FA0E4 /end MEASUREMENT
/begin COMPU_METHOD MC_INF_MAT "INF_MAT conversion" RAT_FUNC "%10.5" "Unitless" COEFFS 0 1 0 0 0 1 /end COMPU_METHOD
/begin MEASUREMENT INTEGRATOR_ERROR "" FLOAT32_IEEE MC_INTEGRATOR_ERROR 0 0 0 0 ECU_ADDRESS 0x3FA900 /end MEASUREMENT
/begin COMPU_METHOD MC_INTEGRATOR_ERROR "INTEGRATOR_ERROR conversion" RAT_FUNC "%10.5" "Unitless" COEFFS 0 1 0 0 0 1 /end COMPU_METHOD
/begin MEASUREMENT INTEGRATOR_ERROR_OVER_TIME "" FLOAT32_IEEE MC_INTEGRATOR_ERROR_OVER_TIME 0 0 0 0 ECU_ADDRESS 0x3FA8FC /end MEASUREMENT
/begin COMPU_METHOD MC_INTEGRATOR_ERROR_OVER_TIME "INTEGRATOR_ERROR_OVER_TIME conversion" RAT_FUNC "%10.5" "Unitless" COEFFS 0 1 0 0 0 1 /end COMPU_METHOD
/begin CHARACTERISTIC INVRT_CPP "Indicates weather read input is inverted,  planned option to cope with unknown PTEC circuit." VALUE 0x5754C SD_UBYTE 0 SC_INVRT_CPP 0 1 /end CHARACTERISTIC
/begin COMPU_METHOD SC_INVRT_CPP "INVRT_CPP conversion" RAT_FUNC "%3.0" "unitless" COEFFS 0 1 0 0 0 1 /end COMPU_METHOD
/begin MEASUREMENT IPR_FLOW "Injection pressure regulator flow (l/m)" FLOAT32_IEEE MC_IPR_FLOW 0 0 0 0 ECU_ADDRESS 0x3FA4C8 /end MEASUREMENT
/begin COMPU_METHOD MC_IPR_FLOW "IPR_FLOW conversion" RAT_FUNC "%10.5" "Unitless" COEFFS 0 1 0 0 0 1 /end COMPU_METHOD
/begin CHARACTERISTIC IPR_FLW_KINJ "Injector oil flow gain (l-stroke/cu mm-rev)" VALUE 0x56CA4 SD_FLOAT32_IEEE 0 SC_IPR_FLW_KINJ 0 0.0001 /end CHARACTERISTIC
/begin COMPU_METHOD SC_IPR_FLW_KINJ "IPR_FLW_KINJ conversion" RAT_FUNC "%10.5" "unitless" COEFFS 0 1 0 0 0 1 /end COMPU_METHOD
/begin CHARACTERISTIC IPR_FLW_KPMP "Oil pump gain (l/rev)" VALUE 0x56CA0 SD_FLOAT32_IEEE 0 SC_IPR_FLW_KPMP 0 0.009 /end CHARACTERISTIC
/begin COMPU_METHOD SC_IPR_FLW_KPMP "IPR_FLW_KPMP conversion" RAT_FUNC "%10.5" "unitless" COEFFS 0 1 0 0 0 1 /end COMPU_METHOD
/begin MEASUREMENT ISC_ER_ENA "Enables Engine running on demand ISC test" UBYTE MC_ISC_ER_ENA 0 0 0 0 ECU_ADDRESS 0x3FAB8E /end MEASUREMENT
/begin COMPU_METHOD MC_ISC_ER_ENA "ISC_ER_ENA conversion" RAT_FUNC "%3.0" "Unitless" COEFFS 0 1 0 0 0 1 /end COMPU_METHOD
/begin CHARACTERISTIC ISC_HI_CHECK "Value for state of ER_STATUS when testing RPM during engine running high speed ISC test" VALUE 0x57836 SD_UBYTE 0 SC_ISC_HI_CHECK 0 100 /end CHARACTERISTIC
/begin COMPU_METHOD SC_ISC_HI_CHECK "ISC_HI_CHECK conversion" RAT_FUNC "%3.0" "unitless" COEFFS 0 1 0 0 0 1 /end COMPU_METHOD
/begin CHARACTERISTIC ISC_HI_DONE "Value for state of ER_STATUS when ISC high rpm test is complete" VALUE 0x57835 SD_UBYTE 0 SC_ISC_HI_DONE 0 100 /end CHARACTERISTIC
/begin COMPU_METHOD SC_ISC_HI_DONE "ISC_HI_DONE conversion" RAT_FUNC "%3.0" "unitless" COEFFS 0 1 0 0 0 1 /end COMPU_METHOD
/begin CHARACTERISTIC ISC_HI_WAIT "Value for state of ER_STATUS while waiting for engine running high speed ISC test" VALUE 0x57837 SD_UBYTE 0 SC_ISC_HI_WAIT 0 100 /end CHARACTERISTIC
/begin COMPU_METHOD SC_ISC_HI_WAIT "ISC_HI_WAIT conversion" RAT_FUNC "%3.0" "unitless" COEFFS 0 1 0 0 0 1 /end COMPU_METHOD
/begin CHARACTERISTIC ISC_HI_WAIT2 "Value for state of ER_STATUS while waiting for ISC to settle after EGR test." VALUE 0x57832 SD_UBYTE 0 SC_ISC_HI_WAIT2 0 100 /end CHARACTERISTIC
/begin COMPU_METHOD SC_ISC_HI_WAIT2 "ISC_HI_WAIT2 conversion" RAT_FUNC "%3.0" "unitless" COEFFS 0 1 0 0 0 1 /end COMPU_METHOD
/begin CHARACTERISTIC ISC_LO_CHECK "Value for ER_STATUS when performing ISC low rpm test" VALUE 0x5782C SD_UBYTE 0 SC_ISC_LO_CHECK 0 100 /end CHARACTERISTIC
/begin COMPU_METHOD SC_ISC_LO_CHECK "ISC_LO_CHECK conversion" RAT_FUNC "%3.0" "unitless" COEFFS 0 1 0 0 0 1 /end COMPU_METHOD
/begin CHARACTERISTIC ISC_LO_DONE "Value for ER_STATUS to indicate that ISC low RPM test is complete" VALUE 0x5782B SD_UBYTE 0 SC_ISC_LO_DONE 0 100 /end CHARACTERISTIC
/begin COMPU_METHOD SC_ISC_LO_DONE "ISC_LO_DONE conversion" RAT_FUNC "%3.0" "unitless" COEFFS 0 1 0 0 0 1 /end COMPU_METHOD
/begin CHARACTERISTIC ISC_LO_WAIT "Value for ER_STATUS when waiting for ISC low rpm test" VALUE 0x5782D SD_UBYTE 0 SC_ISC_LO_WAIT 0 100 /end CHARACTERISTIC
/begin COMPU_METHOD SC_ISC_LO_WAIT "ISC_LO_WAIT conversion" RAT_FUNC "%3.0" "unitless" COEFFS 0 1 0 0 0 1 /end COMPU_METHOD
/begin MEASUREMENT ITHP "Intake Throttle Position" FLOAT32_IEEE MC_ITHP 0 0 0 0 ECU_ADDRESS 0x3FA238 /end MEASUREMENT
/begin COMPU_METHOD MC_ITHP "ITHP conversion" RAT_FUNC "%10.5" "Unitless" COEFFS 0 1 0 0 0 1 /end COMPU_METHOD
/begin CHARACTERISTIC ITHP_AD_TC "Intake Throttle Position filter time constant" VALUE 0x567E4 SD_FLOAT32_IEEE 0 SC_ITHP_AD_TC 0 64 /end CHARACTERISTIC
/begin COMPU_METHOD SC_ITHP_AD_TC "ITHP_AD_TC conversion" RAT_FUNC "%10.5" "s" COEFFS 0 1 0 0 0 1 /end COMPU_METHOD
/begin CHARACTERISTIC ITHP_DEF "Default FMEM value for intake throttle position" VALUE 0x567EC SD_FLOAT32_IEEE 0 SC_ITHP_DEF 0 1 /end CHARACTERISTIC
/begin COMPU_METHOD SC_ITHP_DEF "ITHP_DEF conversion" RAT_FUNC "%10.5" "unitless" COEFFS 0 1 0 0 0 1 /end COMPU_METHOD
/begin MEASUREMENT ITHP_FILT_TIME_CONST "ITHP filter time constant" FLOAT32_IEEE MC_ITHP_FILT_TIME_CONST 0 0 0 0 ECU_ADDRESS 0x3FA230 /end MEASUREMENT
/begin COMPU_METHOD MC_ITHP_FILT_TIME_CONST "ITHP_FILT_TIME_CONST conversion" RAT_FUNC "%10.5" "Unitless" COEFFS 0 1 0 0 0 1 /end COMPU_METHOD
/begin MEASUREMENT ITHP_FLT_RECOVERY_CNTR "ITHP fault recovery counter" SLONG MC_ITHP_FLT_RECOVERY_CNTR 0 0 0 0 ECU_ADDRESS 0x3FA21C /end MEASUREMENT
/begin COMPU_METHOD MC_ITHP_FLT_RECOVERY_CNTR "ITHP_FLT_RECOVERY_CNTR conversion" RAT_FUNC "%10.0" "Unitless" COEFFS 0 1 0 0 0 1 /end COMPU_METHOD
/begin MEASUREMENT ITHP_FLT_RECOVERY_FLG "1-> Indicates ITHP fault recovery is occuring" UBYTE MC_ITHP_FLT_RECOVERY_FLG 0 0 0 0 ECU_ADDRESS 0x3FA23D /end MEASUREMENT
/begin COMPU_METHOD MC_ITHP_FLT_RECOVERY_FLG "ITHP_FLT_RECOVERY_FLG conversion" RAT_FUNC "%3.0" "Unitless" COEFFS 0 1 0 0 0 1 /end COMPU_METHOD
/begin CHARACTERISTIC ITHP_F_DEC "ITHP malf failure/update counter decrement value" VALUE 0x567FC SD_SLONG 0 SC_ITHP_F_DEC 0 65535 /end CHARACTERISTIC
/begin COMPU_METHOD SC_ITHP_F_DEC "ITHP_F_DEC conversion" RAT_FUNC "%10.0" "unitless" COEFFS 0 1 0 0 0 1 /end COMPU_METHOD
/begin CHARACTERISTIC ITHP_F_INC "ITHP ORH/ORL failure counter increment value" VALUE 0x56800 SD_SLONG 0 SC_ITHP_F_INC 0 65535 /end CHARACTERISTIC
/begin COMPU_METHOD SC_ITHP_F_INC "ITHP_F_INC conversion" RAT_FUNC "%10.0" "unitless" COEFFS 0 1 0 0 0 1 /end COMPU_METHOD
/begin MEASUREMENT ITHP_F_ORH "Intake Throttle Position Out of range high flag" UBYTE MC_ITHP_F_ORH 0 0 0 0 ECU_ADDRESS 0x3FA243 /end MEASUREMENT
/begin COMPU_METHOD MC_ITHP_F_ORH "ITHP_F_ORH conversion" RAT_FUNC "%3.0" "Unitless" COEFFS 0 1 0 0 0 1 /end COMPU_METHOD
/begin MEASUREMENT ITHP_F_ORL "Intake Throttle Position Out of range low flag" UBYTE MC_ITHP_F_ORL 0 0 0 0 ECU_ADDRESS 0x3FA242 /end MEASUREMENT
/begin COMPU_METHOD MC_ITHP_F_ORL "ITHP_F_ORL conversion" RAT_FUNC "%3.0" "Unitless" COEFFS 0 1 0 0 0 1 /end COMPU_METHOD
/begin MEASUREMENT ITHP_MALF_SET "Indicate ITHP malf  high or low failure" UBYTE MC_ITHP_MALF_SET 0 0 0 0 ECU_ADDRESS 0x3FA23F /end MEASUREMENT
/begin COMPU_METHOD MC_ITHP_MALF_SET "ITHP_MALF_SET conversion" RAT_FUNC "%3.0" "Unitless" COEFFS 0 1 0 0 0 1 /end COMPU_METHOD
/begin MEASUREMENT ITHP_ORH_CNTR "Intake Throttle Position out of range high counter" SLONG MC_ITHP_ORH_CNTR 0 0 0 0 ECU_ADDRESS 0x3FA22C /end MEASUREMENT
/begin COMPU_METHOD MC_ITHP_ORH_CNTR "ITHP_ORH_CNTR conversion" RAT_FUNC "%10.0" "Unitless" COEFFS 0 1 0 0 0 1 /end COMPU_METHOD
/begin MEASUREMENT ITHP_ORL_CNTR "Intake Throttle Position out of range low counter" SLONG MC_ITHP_ORL_CNTR 0 0 0 0 ECU_ADDRESS 0x3FA228 /end MEASUREMENT
/begin COMPU_METHOD MC_ITHP_ORL_CNTR "ITHP_ORL_CNTR conversion" RAT_FUNC "%10.0" "Unitless" COEFFS 0 1 0 0 0 1 /end COMPU_METHOD
/begin CHARACTERISTIC ITHP_REC_INC "ITHP fault recovery counter increment value" VALUE 0x567E8 SD_SLONG 0 SC_ITHP_REC_INC 0 65535 /end CHARACTERISTIC
/begin COMPU_METHOD SC_ITHP_REC_INC "ITHP_REC_INC conversion" RAT_FUNC "%10.0" "unitless" COEFFS 0 1 0 0 0 1 /end COMPU_METHOD
/begin CHARACTERISTIC ITHP_TCREC_SEL "Switch to select ITHP filter time constant during fault recovery and during fault occurance before malf is set" VALUE 0x567F0 SD_UBYTE 0 SC_ITHP_TCREC_SEL 0 1 /end CHARACTERISTIC
/begin COMPU_METHOD SC_ITHP_TCREC_SEL "ITHP_TCREC_SEL conversion" RAT_FUNC "%3.0" "unitless" COEFFS 0 1 0 0 0 1 /end COMPU_METHOD
/begin MEASUREMENT ITH_ANTI_FOUL_MULT "" FLOAT32_IEEE MC_ITH_ANTI_FOUL_MULT 0 0 0 0 ECU_ADDRESS 0x3FA6EC /end MEASUREMENT
/begin COMPU_METHOD MC_ITH_ANTI_FOUL_MULT "ITH_ANTI_FOUL_MULT conversion" RAT_FUNC "%10.5" "Unitless" COEFFS 0 1 0 0 0 1 /end COMPU_METHOD
/begin MEASUREMENT ITH_CMD "" FLOAT32_IEEE MC_ITH_CMD 0 0 0 0 ECU_ADDRESS 0x3FA6E8 /end MEASUREMENT
/begin COMPU_METHOD MC_ITH_CMD "ITH_CMD conversion" RAT_FUNC "%10.5" "Unitless" COEFFS 0 1 0 0 0 1 /end COMPU_METHOD
/begin CHARACTERISTIC ITH_COND_CAL "" VALUE 0x56FB4 SD_FLOAT32_IEEE 0 SC_ITH_COND_CAL 0 1 /end CHARACTERISTIC
/begin COMPU_METHOD SC_ITH_COND_CAL "ITH_COND_CAL conversion" RAT_FUNC "%10.5" "unitless" COEFFS 0 1 0 0 0 1 /end COMPU_METHOD
/begin MEASUREMENT ITH_COND_MULT "" FLOAT32_IEEE MC_ITH_COND_MULT 0 0 0 0 ECU_ADDRESS 0x3FA6E4 /end MEASUREMENT
/begin COMPU_METHOD MC_ITH_COND_MULT "ITH_COND_MULT conversion" RAT_FUNC "%10.5" "Unitless" COEFFS 0 1 0 0 0 1 /end COMPU_METHOD
/begin CHARACTERISTIC ITH_COND_SEL "" VALUE 0x570B1 SD_UBYTE 0 SC_ITH_COND_SEL 0 1 /end CHARACTERISTIC
/begin COMPU_METHOD SC_ITH_COND_SEL "ITH_COND_SEL conversion" RAT_FUNC "%3.0" "unitless" COEFFS 0 1 0 0 0 1 /end COMPU_METHOD
/begin MEASUREMENT ITH_D "" FLOAT32_IEEE MC_ITH_D 0 0 0 0 ECU_ADDRESS 0x3FA6E0 /end MEASUREMENT
/begin COMPU_METHOD MC_ITH_D "ITH_D conversion" RAT_FUNC "%10.5" "Unitless" COEFFS 0 1 0 0 0 1 /end COMPU_METHOD
/begin MEASUREMENT ITH_DD "" FLOAT32_IEEE MC_ITH_DD 0 0 0 0 ECU_ADDRESS 0x3FA6DC /end MEASUREMENT
/begin COMPU_METHOD MC_ITH_DD "ITH_DD conversion" RAT_FUNC "%10.5" "Unitless" COEFFS 0 1 0 0 0 1 /end COMPU_METHOD
/begin MEASUREMENT ITH_DES "" FLOAT32_IEEE MC_ITH_DES 0 0 0 0 ECU_ADDRESS 0x3FA6D8 /end MEASUREMENT
/begin COMPU_METHOD MC_ITH_DES "ITH_DES conversion" RAT_FUNC "%10.5" "Unitless" COEFFS 0 1 0 0 0 1 /end COMPU_METHOD
/begin CHARACTERISTIC ITH_DES_DEF "" VALUE 0x56FA4 SD_FLOAT32_IEEE 0 SC_ITH_DES_DEF 0 1 /end CHARACTERISTIC
/begin COMPU_METHOD SC_ITH_DES_DEF "ITH_DES_DEF conversion" RAT_FUNC "%10.5" "unitless" COEFFS 0 1 0 0 0 1 /end COMPU_METHOD
/begin CHARACTERISTIC ITH_DES_LMN "" VALUE 0x56FA0 SD_FLOAT32_IEEE 0 SC_ITH_DES_LMN 0 1 /end CHARACTERISTIC
/begin COMPU_METHOD SC_ITH_DES_LMN "ITH_DES_LMN conversion" RAT_FUNC "%10.5" "unitless" COEFFS 0 1 0 0 0 1 /end COMPU_METHOD
/begin CHARACTERISTIC ITH_DES_LMX "" VALUE 0x56F9C SD_FLOAT32_IEEE 0 SC_ITH_DES_LMX 0 1 /end CHARACTERISTIC
/begin COMPU_METHOD SC_ITH_DES_LMX "ITH_DES_LMX conversion" RAT_FUNC "%10.5" "unitless" COEFFS 0 1 0 0 0 1 /end COMPU_METHOD
/begin MEASUREMENT ITH_DI "" FLOAT32_IEEE MC_ITH_DI 0 0 0 0 ECU_ADDRESS 0x3FA6D4 /end MEASUREMENT
/begin COMPU_METHOD MC_ITH_DI "ITH_DI conversion" RAT_FUNC "%10.5" "Unitless" COEFFS 0 1 0 0 0 1 /end COMPU_METHOD
/begin MEASUREMENT ITH_DISABLE "H-bridge disable flag: 1= H-bridge enabled (V8 AP3.2+)" UBYTE MC_ITH_DISABLE 0 0 0 0 ECU_ADDRESS 0x3FADEE /end MEASUREMENT
/begin COMPU_METHOD MC_ITH_DISABLE "ITH_DISABLE conversion" RAT_FUNC "%3.0" "Unitless" COEFFS 0 1 0 0 0 1 /end COMPU_METHOD
/begin CHARACTERISTIC ITH_DTC "" VALUE 0x56F98 SD_FLOAT32_IEEE 0 SC_ITH_DTC 0 1000 /end CHARACTERISTIC
/begin COMPU_METHOD SC_ITH_DTC "ITH_DTC conversion" RAT_FUNC "%10.5" "unitless" COEFFS 0 1 0 0 0 1 /end COMPU_METHOD
/begin CHARACTERISTIC ITH_DTS "" VALUE 0x56F94 SD_FLOAT32_IEEE 0 SC_ITH_DTS 0 1000 /end CHARACTERISTIC
/begin COMPU_METHOD SC_ITH_DTS "ITH_DTS conversion" RAT_FUNC "%10.5" "unitless" COEFFS 0 1 0 0 0 1 /end COMPU_METHOD
/begin MEASUREMENT ITH_DTY "" FLOAT32_IEEE MC_ITH_DTY 0 0 0 0 ECU_ADDRESS 0x3FA6D0 /end MEASUREMENT
/begin COMPU_METHOD MC_ITH_DTY "ITH_DTY conversion" RAT_FUNC "%10.5" "Unitless" COEFFS 0 1 0 0 0 1 /end COMPU_METHOD
/begin CHARACTERISTIC ITH_DTY_CAL "" VALUE 0x56F90 SD_FLOAT32_IEEE 0 SC_ITH_DTY_CAL -1000 1000 /end CHARACTERISTIC
/begin COMPU_METHOD SC_ITH_DTY_CAL "ITH_DTY_CAL conversion" RAT_FUNC "%10.5" "unitless" COEFFS 0 1 0 0 0 1 /end COMPU_METHOD
/begin MEASUREMENT ITH_DTY_DIR "" FLOAT32_IEEE MC_ITH_DTY_DIR 0 0 0 0 ECU_ADDRESS 0x3FA6CC /end MEASUREMENT
/begin COMPU_METHOD MC_ITH_DTY_DIR "ITH_DTY_DIR conversion" RAT_FUNC "%10.5" "Unitless" COEFFS 0 1 0 0 0 1 /end COMPU_METHOD
/begin CHARACTERISTIC ITH_DTY_DIR1 "" VALUE 0x56F84 SD_FLOAT32_IEEE 0 SC_ITH_DTY_DIR1 -1000 1000 /end CHARACTERISTIC
/begin COMPU_METHOD SC_ITH_DTY_DIR1 "ITH_DTY_DIR1 conversion" RAT_FUNC "%10.5" "unitless" COEFFS 0 1 0 0 0 1 /end COMPU_METHOD
/begin CHARACTERISTIC ITH_DTY_DIR2 "" VALUE 0x56F80 SD_FLOAT32_IEEE 0 SC_ITH_DTY_DIR2 -1000 1000 /end CHARACTERISTIC
/begin COMPU_METHOD SC_ITH_DTY_DIR2 "ITH_DTY_DIR2 conversion" RAT_FUNC "%10.5" "unitless" COEFFS 0 1 0 0 0 1 /end COMPU_METHOD
/begin CHARACTERISTIC ITH_DTY_LMN "" VALUE 0x56F8C SD_FLOAT32_IEEE 0 SC_ITH_DTY_LMN -1 0 /end CHARACTERISTIC
/begin COMPU_METHOD SC_ITH_DTY_LMN "ITH_DTY_LMN conversion" RAT_FUNC "%10.5" "unitless" COEFFS 0 1 0 0 0 1 /end COMPU_METHOD
/begin CHARACTERISTIC ITH_DTY_LMX "" VALUE 0x56F88 SD_FLOAT32_IEEE 0 SC_ITH_DTY_LMX 0 1 /end CHARACTERISTIC
/begin COMPU_METHOD SC_ITH_DTY_LMX "ITH_DTY_LMX conversion" RAT_FUNC "%10.5" "unitless" COEFFS 0 1 0 0 0 1 /end COMPU_METHOD
/begin MEASUREMENT ITH_DTY_MAG "" FLOAT32_IEEE MC_ITH_DTY_MAG 0 0 0 0 ECU_ADDRESS 0x3FA6C8 /end MEASUREMENT
/begin COMPU_METHOD MC_ITH_DTY_MAG "ITH_DTY_MAG conversion" RAT_FUNC "%10.5" "Unitless" COEFFS 0 1 0 0 0 1 /end COMPU_METHOD
/begin CHARACTERISTIC ITH_D_LMN "" VALUE 0x56FAC SD_FLOAT32_IEEE 0 SC_ITH_D_LMN -100 100 /end CHARACTERISTIC
/begin COMPU_METHOD SC_ITH_D_LMN "ITH_D_LMN conversion" RAT_FUNC "%10.5" "unitless" COEFFS 0 1 0 0 0 1 /end COMPU_METHOD
/begin CHARACTERISTIC ITH_D_LMX "" VALUE 0x56FA8 SD_FLOAT32_IEEE 0 SC_ITH_D_LMX -100 100 /end CHARACTERISTIC
/begin COMPU_METHOD SC_ITH_D_LMX "ITH_D_LMX conversion" RAT_FUNC "%10.5" "unitless" COEFFS 0 1 0 0 0 1 /end COMPU_METHOD
/begin MEASUREMENT ITH_ERR "" FLOAT32_IEEE MC_ITH_ERR 0 0 0 0 ECU_ADDRESS 0x3FA6C4 /end MEASUREMENT
/begin COMPU_METHOD MC_ITH_ERR "ITH_ERR conversion" RAT_FUNC "%10.5" "Unitless" COEFFS 0 1 0 0 0 1 /end COMPU_METHOD
/begin CHARACTERISTIC ITH_ERR_SS "" VALUE 0x56F7C SD_FLOAT32_IEEE 0 SC_ITH_ERR_SS 0 10000 /end CHARACTERISTIC
/begin COMPU_METHOD SC_ITH_ERR_SS "ITH_ERR_SS conversion" RAT_FUNC "%10.5" "unitless" COEFFS 0 1 0 0 0 1 /end COMPU_METHOD
/begin MEASUREMENT ITH_FF "" FLOAT32_IEEE MC_ITH_FF 0 0 0 0 ECU_ADDRESS 0x3FA6C0 /end MEASUREMENT
/begin COMPU_METHOD MC_ITH_FF "ITH_FF conversion" RAT_FUNC "%10.5" "Unitless" COEFFS 0 1 0 0 0 1 /end COMPU_METHOD
/begin MEASUREMENT ITH_F_SS "" UBYTE MC_ITH_F_SS 0 0 0 0 ECU_ADDRESS 0x3FA7E9 /end MEASUREMENT
/begin COMPU_METHOD MC_ITH_F_SS "ITH_F_SS conversion" RAT_FUNC "%3.0" "Unitless" COEFFS 0 1 0 0 0 1 /end COMPU_METHOD
/begin MEASUREMENT ITH_HIALT_SP "" FLOAT32_IEEE MC_ITH_HIALT_SP 0 0 0 0 ECU_ADDRESS 0x3FA6BC /end MEASUREMENT
/begin COMPU_METHOD MC_ITH_HIALT_SP "ITH_HIALT_SP conversion" RAT_FUNC "%10.5" "Unitless" COEFFS 0 1 0 0 0 1 /end COMPU_METHOD
/begin MEASUREMENT ITH_I "" FLOAT32_IEEE MC_ITH_I 0 0 0 0 ECU_ADDRESS 0x3FA6B8 /end MEASUREMENT
/begin COMPU_METHOD MC_ITH_I "ITH_I conversion" RAT_FUNC "%10.5" "Unitless" COEFFS 0 1 0 0 0 1 /end COMPU_METHOD
/begin MEASUREMENT ITH_IVP_MLT "" FLOAT32_IEEE MC_ITH_IVP_MLT 0 0 0 0 ECU_ADDRESS 0x3FA6B4 /end MEASUREMENT
/begin COMPU_METHOD MC_ITH_IVP_MLT "ITH_IVP_MLT conversion" RAT_FUNC "%10.5" "Unitless" COEFFS 0 1 0 0 0 1 /end COMPU_METHOD
/begin CHARACTERISTIC ITH_I_LMN "" VALUE 0x56F78 SD_FLOAT32_IEEE 0 SC_ITH_I_LMN -10000 10000 /end CHARACTERISTIC
/begin COMPU_METHOD SC_ITH_I_LMN "ITH_I_LMN conversion" RAT_FUNC "%10.5" "unitless" COEFFS 0 1 0 0 0 1 /end COMPU_METHOD
/begin CHARACTERISTIC ITH_I_LMX "" VALUE 0x56F74 SD_FLOAT32_IEEE 0 SC_ITH_I_LMX -10000 10000 /end CHARACTERISTIC
/begin COMPU_METHOD SC_ITH_I_LMX "ITH_I_LMX conversion" RAT_FUNC "%10.5" "unitless" COEFFS 0 1 0 0 0 1 /end COMPU_METHOD
/begin CHARACTERISTIC ITH_KD "" VALUE 0x56F70 SD_FLOAT32_IEEE 0 SC_ITH_KD -10000 10000 /end CHARACTERISTIC
/begin COMPU_METHOD SC_ITH_KD "ITH_KD conversion" RAT_FUNC "%10.5" "unitless" COEFFS 0 1 0 0 0 1 /end COMPU_METHOD
/begin CHARACTERISTIC ITH_KI "" VALUE 0x56F6C SD_FLOAT32_IEEE 0 SC_ITH_KI -10000 10000 /end CHARACTERISTIC
/begin COMPU_METHOD SC_ITH_KI "ITH_KI conversion" RAT_FUNC "%10.5" "unitless" COEFFS 0 1 0 0 0 1 /end COMPU_METHOD
/begin CHARACTERISTIC ITH_KP "" VALUE 0x56F5C SD_FLOAT32_IEEE 0 SC_ITH_KP -1000 1000 /end CHARACTERISTIC
/begin COMPU_METHOD SC_ITH_KP "ITH_KP conversion" RAT_FUNC "%10.5" "unitless" COEFFS 0 1 0 0 0 1 /end COMPU_METHOD
/begin MEASUREMENT ITH_LOALT_SP "" FLOAT32_IEEE MC_ITH_LOALT_SP 0 0 0 0 ECU_ADDRESS 0x3FA6B0 /end MEASUREMENT
/begin COMPU_METHOD MC_ITH_LOALT_SP "ITH_LOALT_SP conversion" RAT_FUNC "%10.5" "Unitless" COEFFS 0 1 0 0 0 1 /end COMPU_METHOD
/begin CHARACTERISTIC ITH_MAX_MF_INC "" VALUE 0x56F58 SD_FLOAT32_IEEE 0 SC_ITH_MAX_MF_INC 0 2000 /end CHARACTERISTIC
/begin COMPU_METHOD SC_ITH_MAX_MF_INC "ITH_MAX_MF_INC conversion" RAT_FUNC "%10.5" "unitless" COEFFS 0 1 0 0 0 1 /end COMPU_METHOD
/begin CHARACTERISTIC ITH_MAX_MF_TM "" VALUE 0x56F54 SD_FLOAT32_IEEE 0 SC_ITH_MAX_MF_TM 0 3000 /end CHARACTERISTIC
/begin COMPU_METHOD SC_ITH_MAX_MF_TM "ITH_MAX_MF_TM conversion" RAT_FUNC "%10.5" "unitless" COEFFS 0 1 0 0 0 1 /end COMPU_METHOD
/begin MEASUREMENT ITH_MAX_MF_TMR "" FLOAT32_IEEE MC_ITH_MAX_MF_TMR 0 0 0 0 ECU_ADDRESS 0x3FA6AC /end MEASUREMENT
/begin COMPU_METHOD MC_ITH_MAX_MF_TMR "ITH_MAX_MF_TMR conversion" RAT_FUNC "%10.5" "Unitless" COEFFS 0 1 0 0 0 1 /end COMPU_METHOD
/begin MEASUREMENT ITH_MEALT_SP "" FLOAT32_IEEE MC_ITH_MEALT_SP 0 0 0 0 ECU_ADDRESS 0x3FA6A8 /end MEASUREMENT
/begin COMPU_METHOD MC_ITH_MEALT_SP "ITH_MEALT_SP conversion" RAT_FUNC "%10.5" "Unitless" COEFFS 0 1 0 0 0 1 /end COMPU_METHOD
/begin MEASUREMENT ITH_MFDES_DIFF "" FLOAT32_IEEE MC_ITH_MFDES_DIFF 0 0 0 0 ECU_ADDRESS 0x3FA69C /end MEASUREMENT
/begin COMPU_METHOD MC_ITH_MFDES_DIFF "ITH_MFDES_DIFF conversion" RAT_FUNC "%10.5" "Unitless" COEFFS 0 1 0 0 0 1 /end COMPU_METHOD
/begin MEASUREMENT ITH_MF_TRNS_FILT "" FLOAT32_IEEE MC_ITH_MF_TRNS_FILT 0 0 0 0 ECU_ADDRESS 0x3FA6A4 /end MEASUREMENT
/begin COMPU_METHOD MC_ITH_MF_TRNS_FILT "ITH_MF_TRNS_FILT conversion" RAT_FUNC "%10.5" "Unitless" COEFFS 0 1 0 0 0 1 /end COMPU_METHOD
/begin CHARACTERISTIC ITH_MF_TRNS_KF "" VALUE 0x56F50 SD_FLOAT32_IEEE 0 SC_ITH_MF_TRNS_KF 0 1 /end CHARACTERISTIC
/begin COMPU_METHOD SC_ITH_MF_TRNS_KF "ITH_MF_TRNS_KF conversion" RAT_FUNC "%10.5" "unitless" COEFFS 0 1 0 0 0 1 /end COMPU_METHOD
/begin MEASUREMENT ITH_MF_TRNS_MULT "" FLOAT32_IEEE MC_ITH_MF_TRNS_MULT 0 0 0 0 ECU_ADDRESS 0x3FA6A0 /end MEASUREMENT
/begin COMPU_METHOD MC_ITH_MF_TRNS_MULT "ITH_MF_TRNS_MULT conversion" RAT_FUNC "%10.5" "Unitless" COEFFS 0 1 0 0 0 1 /end COMPU_METHOD
/begin MEASUREMENT ITH_P "" FLOAT32_IEEE MC_ITH_P 0 0 0 0 ECU_ADDRESS 0x3FA698 /end MEASUREMENT
/begin COMPU_METHOD MC_ITH_P "ITH_P conversion" RAT_FUNC "%10.5" "Unitless" COEFFS 0 1 0 0 0 1 /end COMPU_METHOD
/begin CHARACTERISTIC ITH_P_CAL "" VALUE 0x56FB0 SD_FLOAT32_IEEE 0 SC_ITH_P_CAL 0 1 /end CHARACTERISTIC
/begin COMPU_METHOD SC_ITH_P_CAL "ITH_P_CAL conversion" RAT_FUNC "%10.5" "unitless" COEFFS 0 1 0 0 0 1 /end COMPU_METHOD
/begin CHARACTERISTIC ITH_P_LMN "" VALUE 0x56F48 SD_FLOAT32_IEEE 0 SC_ITH_P_LMN -10000 10000 /end CHARACTERISTIC
/begin COMPU_METHOD SC_ITH_P_LMN "ITH_P_LMN conversion" RAT_FUNC "%10.5" "unitless" COEFFS 0 1 0 0 0 1 /end COMPU_METHOD
/begin CHARACTERISTIC ITH_P_LMX "" VALUE 0x56F44 SD_FLOAT32_IEEE 0 SC_ITH_P_LMX -10000 10000 /end CHARACTERISTIC
/begin COMPU_METHOD SC_ITH_P_LMX "ITH_P_LMX conversion" RAT_FUNC "%10.5" "unitless" COEFFS 0 1 0 0 0 1 /end COMPU_METHOD
/begin CHARACTERISTIC ITH_SEL "" VALUE 0x570B0 SD_UBYTE 0 SC_ITH_SEL 0 10 /end CHARACTERISTIC
/begin COMPU_METHOD SC_ITH_SEL "ITH_SEL conversion" RAT_FUNC "%3.0" "unitless" COEFFS 0 1 0 0 0 1 /end COMPU_METHOD
/begin MEASUREMENT ITH_SP "" FLOAT32_IEEE MC_ITH_SP 0 0 0 0 ECU_ADDRESS 0x3FA694 /end MEASUREMENT
/begin COMPU_METHOD MC_ITH_SP "ITH_SP conversion" RAT_FUNC "%10.5" "Unitless" COEFFS 0 1 0 0 0 1 /end COMPU_METHOD
/begin CHARACTERISTIC ITH_SS_DT "" VALUE 0x56F40 SD_FLOAT32_IEEE 0 SC_ITH_SS_DT 0 10000 /end CHARACTERISTIC
/begin COMPU_METHOD SC_ITH_SS_DT "ITH_SS_DT conversion" RAT_FUNC "%10.5" "unitless" COEFFS 0 1 0 0 0 1 /end COMPU_METHOD
/begin MEASUREMENT ITH_SS_DTR "" FLOAT32_IEEE MC_ITH_SS_DTR 0 0 0 0 ECU_ADDRESS 0x3FA690 /end MEASUREMENT
/begin COMPU_METHOD MC_ITH_SS_DTR "ITH_SS_DTR conversion" RAT_FUNC "%10.5" "Unitless" COEFFS 0 1 0 0 0 1 /end COMPU_METHOD
/begin CHARACTERISTIC ITH_SS_RT "" VALUE 0x56F3C SD_FLOAT32_IEEE 0 SC_ITH_SS_RT 0 10000 /end CHARACTERISTIC
/begin COMPU_METHOD SC_ITH_SS_RT "ITH_SS_RT conversion" RAT_FUNC "%10.5" "unitless" COEFFS 0 1 0 0 0 1 /end COMPU_METHOD
/begin MEASUREMENT ITH_SS_RTR "" FLOAT32_IEEE MC_ITH_SS_RTR 0 0 0 0 ECU_ADDRESS 0x3FA68C /end MEASUREMENT
/begin COMPU_METHOD MC_ITH_SS_RTR "ITH_SS_RTR conversion" RAT_FUNC "%10.5" "Unitless" COEFFS 0 1 0 0 0 1 /end COMPU_METHOD
/begin CHARACTERISTIC ITH_VEA_TM "" VALUE 0x56F34 SD_FLOAT32_IEEE 0 SC_ITH_VEA_TM 0 3000 /end CHARACTERISTIC
/begin COMPU_METHOD SC_ITH_VEA_TM "ITH_VEA_TM conversion" RAT_FUNC "%10.5" "unitless" COEFFS 0 1 0 0 0 1 /end COMPU_METHOD
/begin CHARACTERISTIC ITH_VEW_TM "" VALUE 0x56F30 SD_FLOAT32_IEEE 0 SC_ITH_VEW_TM 0 3000 /end CHARACTERISTIC
/begin COMPU_METHOD SC_ITH_VEW_TM "ITH_VEW_TM conversion" RAT_FUNC "%10.5" "unitless" COEFFS 0 1 0 0 0 1 /end COMPU_METHOD
/begin MEASUREMENT ITH_VE_ACTV "" UBYTE MC_ITH_VE_ACTV 0 0 0 0 ECU_ADDRESS 0x3FA7E8 /end MEASUREMENT
/begin COMPU_METHOD MC_ITH_VE_ACTV "ITH_VE_ACTV conversion" RAT_FUNC "%3.0" "Unitless" COEFFS 0 1 0 0 0 1 /end COMPU_METHOD
/begin CHARACTERISTIC ITH_VE_DES "" VALUE 0x56F38 SD_FLOAT32_IEEE 0 SC_ITH_VE_DES 0 1 /end CHARACTERISTIC
/begin COMPU_METHOD SC_ITH_VE_DES "ITH_VE_DES conversion" RAT_FUNC "%10.5" "unitless" COEFFS 0 1 0 0 0 1 /end COMPU_METHOD
/begin MEASUREMENT ITH_VE_TMR "" FLOAT32_IEEE MC_ITH_VE_TMR 0 0 0 0 ECU_ADDRESS 0x3FA688 /end MEASUREMENT
/begin COMPU_METHOD MC_ITH_VE_TMR "ITH_VE_TMR conversion" RAT_FUNC "%10.5" "Unitless" COEFFS 0 1 0 0 0 1 /end COMPU_METHOD
/begin MEASUREMENT IVPWR "" FLOAT32_IEEE MC_IVPWR 0 0 0 0 ECU_ADDRESS 0x3FA61C /end MEASUREMENT
/begin COMPU_METHOD MC_IVPWR "IVPWR conversion" RAT_FUNC "%10.5" "Unitless" COEFFS 0 1 0 0 0 1 /end COMPU_METHOD
/begin CHARACTERISTIC IVPWR_AD_TC "System Battery Voltage  filter time constant" VALUE 0x56820 SD_FLOAT32_IEEE 0 SC_IVPWR_AD_TC 0 64 /end CHARACTERISTIC
/begin COMPU_METHOD SC_IVPWR_AD_TC "IVPWR_AD_TC conversion" RAT_FUNC "%10.5" "s" COEFFS 0 1 0 0 0 1 /end COMPU_METHOD
/begin CHARACTERISTIC IVPWR_DEF "Default FMEM value for System voltage" VALUE 0x56824 SD_FLOAT32_IEEE 0 SC_IVPWR_DEF 0 25.2 /end CHARACTERISTIC
/begin COMPU_METHOD SC_IVPWR_DEF "IVPWR_DEF conversion" RAT_FUNC "%10.5" "V" COEFFS 0 1 0 0 0 1 /end COMPU_METHOD
/begin MEASUREMENT IVPWR_FILT_TIME_CONST "IVPWR filter time constant" FLOAT32_IEEE MC_IVPWR_FILT_TIME_CONST 0 0 0 0 ECU_ADDRESS 0x3FA24C /end MEASUREMENT
/begin COMPU_METHOD MC_IVPWR_FILT_TIME_CONST "IVPWR_FILT_TIME_CONST conversion" RAT_FUNC "%10.5" "Unitless" COEFFS 0 1 0 0 0 1 /end COMPU_METHOD
/begin MEASUREMENT IVPWR_FLT_RECOVERY_CNTR "IVPWR fault recovery counter" SLONG MC_IVPWR_FLT_RECOVERY_CNTR 0 0 0 0 ECU_ADDRESS 0x3FA250 /end MEASUREMENT
/begin COMPU_METHOD MC_IVPWR_FLT_RECOVERY_CNTR "IVPWR_FLT_RECOVERY_CNTR conversion" RAT_FUNC "%10.0" "Unitless" COEFFS 0 1 0 0 0 1 /end COMPU_METHOD
/begin MEASUREMENT IVPWR_FLT_RECOVERY_FLG "1-> Indicates System Voltage fault recovery is occuring" UBYTE MC_IVPWR_FLT_RECOVERY_FLG 0 0 0 0 ECU_ADDRESS 0x3FA264 /end MEASUREMENT
/begin COMPU_METHOD MC_IVPWR_FLT_RECOVERY_FLG "IVPWR_FLT_RECOVERY_FLG conversion" RAT_FUNC "%3.0" "Unitless" COEFFS 0 1 0 0 0 1 /end COMPU_METHOD
/begin CHARACTERISTIC IVPWR_F_DEC "IVPWR malf failure/update counter decrement value" VALUE 0x56814 SD_SLONG 0 SC_IVPWR_F_DEC 0 65535 /end CHARACTERISTIC
/begin COMPU_METHOD SC_IVPWR_F_DEC "IVPWR_F_DEC conversion" RAT_FUNC "%10.0" "unitless" COEFFS 0 1 0 0 0 1 /end COMPU_METHOD
/begin CHARACTERISTIC IVPWR_F_INC "IVPWR ORH/ORL failure counter increment value" VALUE 0x56818 SD_SLONG 0 SC_IVPWR_F_INC 0 65535 /end CHARACTERISTIC
/begin COMPU_METHOD SC_IVPWR_F_INC "IVPWR_F_INC conversion" RAT_FUNC "%10.0" "unitless" COEFFS 0 1 0 0 0 1 /end COMPU_METHOD
/begin MEASUREMENT IVPWR_MALF_SET "Indicate system voltage malf  high or low failure" UBYTE MC_IVPWR_MALF_SET 0 0 0 0 ECU_ADDRESS 0x3FA266 /end MEASUREMENT
/begin COMPU_METHOD MC_IVPWR_MALF_SET "IVPWR_MALF_SET conversion" RAT_FUNC "%3.0" "Unitless" COEFFS 0 1 0 0 0 1 /end COMPU_METHOD
/begin MEASUREMENT IVPWR_ORH_CNTR "System voltage out of range high counter" SLONG MC_IVPWR_ORH_CNTR 0 0 0 0 ECU_ADDRESS 0x3FA258 /end MEASUREMENT
/begin COMPU_METHOD MC_IVPWR_ORH_CNTR "IVPWR_ORH_CNTR conversion" RAT_FUNC "%10.0" "Unitless" COEFFS 0 1 0 0 0 1 /end COMPU_METHOD
/begin MEASUREMENT IVPWR_ORL_CNTR "System voltage out of range low counter" SLONG MC_IVPWR_ORL_CNTR 0 0 0 0 ECU_ADDRESS 0x3FA254 /end MEASUREMENT
/begin COMPU_METHOD MC_IVPWR_ORL_CNTR "IVPWR_ORL_CNTR conversion" RAT_FUNC "%10.0" "Unitless" COEFFS 0 1 0 0 0 1 /end COMPU_METHOD
/begin CHARACTERISTIC IVPWR_REC_INC "IVPWR fault recovery counter increment value" VALUE 0x56810 SD_SLONG 0 SC_IVPWR_REC_INC 0 65535 /end CHARACTERISTIC
/begin COMPU_METHOD SC_IVPWR_REC_INC "IVPWR_REC_INC conversion" RAT_FUNC "%10.0" "unitless" COEFFS 0 1 0 0 0 1 /end COMPU_METHOD
/begin CHARACTERISTIC IVPWR_TCREC_SEL "Switch to select IVPWR filter time constant during fault recovery and during fault occurance before malf is set" VALUE 0x56828 SD_UBYTE 0 SC_IVPWR_TCREC_SEL 0 1 /end CHARACTERISTIC
/begin COMPU_METHOD SC_IVPWR_TCREC_SEL "IVPWR_TCREC_SEL conversion" RAT_FUNC "%3.0" "unitless" COEFFS 0 1 0 0 0 1 /end COMPU_METHOD
/begin MEASUREMENT J1979_01_00D "Double word (4 bytes) register containing the data for SCP J1979 Mode $01 PID ^00. (MSB is Data A, ... LSB is Data D.)" ULONG MC_J1979_01_00D 0 0 0 0 ECU_ADDRESS 0x3F9ECC /end MEASUREMENT
/begin COMPU_METHOD MC_J1979_01_00D "J1979_01_00D conversion" RAT_FUNC "%10.0" "Unitless" COEFFS 0 1 0 0 0 1 /end COMPU_METHOD
/begin MEASUREMENT J1979_01_01 "Double word (4 bytes) register containing the data for SCP J1979 Mode $01 PID ^01. (MSB is Data A, ... LSB is Data D.)" ULONG MC_J1979_01_01 0 0 0 0 ECU_ADDRESS 0x3F9ED0 /end MEASUREMENT
/begin COMPU_METHOD MC_J1979_01_01 "J1979_01_01 conversion" RAT_FUNC "%10.0" "Unitless" COEFFS 0 1 0 0 0 1 /end COMPU_METHOD
/begin MEASUREMENT J1979_01_03 "Word register containing the data for SCP J1979 Mode $01 PID ^03. More signif icant byte (Data A) is bitmap of fuel system status." UWORD MC_J1979_01_03 0 0 0 0 ECU_ADDRESS 0x3FAD9A /end MEASUREMENT
/begin COMPU_METHOD MC_J1979_01_03 "J1979_01_03 conversion" RAT_FUNC "%5.0" "Unitless" COEFFS 0 1 0 0 0 1 /end COMPU_METHOD
/begin MEASUREMENT J1979_01_04 "Current load*255, for SAE J1979" UBYTE MC_J1979_01_04 0 0 0 0 ECU_ADDRESS 0x3FADB7 /end MEASUREMENT
/begin COMPU_METHOD MC_J1979_01_04 "J1979_01_04 conversion" RAT_FUNC "%3.0" "Unitless" COEFFS 0 1 0 0 0 1 /end COMPU_METHOD
/begin MEASUREMENT J1979_01_05 "ECT" UBYTE MC_J1979_01_05 0 0 0 0 ECU_ADDRESS 0x3FADB6 /end MEASUREMENT
/begin COMPU_METHOD MC_J1979_01_05 "J1979_01_05 conversion" RAT_FUNC "%3.0" "Unitless" COEFFS 0 1 0 0 0 1 /end COMPU_METHOD
/begin MEASUREMENT J1979_01_06 "Bank1 short term fuel trim" UBYTE MC_J1979_01_06 0 0 0 0 ECU_ADDRESS 0x3FADB5 /end MEASUREMENT
/begin COMPU_METHOD MC_J1979_01_06 "J1979_01_06 conversion" RAT_FUNC "%3.0" "Unitless" COEFFS 0 1 0 0 0 1 /end COMPU_METHOD
/begin MEASUREMENT J1979_01_07 "Bank1 long term fuel trim" UBYTE MC_J1979_01_07 0 0 0 0 ECU_ADDRESS 0x3FADB4 /end MEASUREMENT
/begin COMPU_METHOD MC_J1979_01_07 "J1979_01_07 conversion" RAT_FUNC "%3.0" "Unitless" COEFFS 0 1 0 0 0 1 /end COMPU_METHOD
/begin MEASUREMENT J1979_01_08 "Bank2 short term fuel trim" UBYTE MC_J1979_01_08 0 0 0 0 ECU_ADDRESS 0x3FADB3 /end MEASUREMENT
/begin COMPU_METHOD MC_J1979_01_08 "J1979_01_08 conversion" RAT_FUNC "%3.0" "Unitless" COEFFS 0 1 0 0 0 1 /end COMPU_METHOD
/begin MEASUREMENT J1979_01_09 "Bank2 long term fuel trim" UBYTE MC_J1979_01_09 0 0 0 0 ECU_ADDRESS 0x3FADB2 /end MEASUREMENT
/begin COMPU_METHOD MC_J1979_01_09 "J1979_01_09 conversion" RAT_FUNC "%3.0" "Unitless" COEFFS 0 1 0 0 0 1 /end COMPU_METHOD
/begin MEASUREMENT J1979_01_0D "Vehicle Speed" UBYTE MC_J1979_01_0D 0 0 0 0 ECU_ADDRESS 0x3FADB1 /end MEASUREMENT
/begin COMPU_METHOD MC_J1979_01_0D "J1979_01_0D conversion" RAT_FUNC "%3.0" "Unitless" COEFFS 0 1 0 0 0 1 /end COMPU_METHOD
/begin MEASUREMENT J1979_01_0F "Inlet air temperature." UBYTE MC_J1979_01_0F 0 0 0 0 ECU_ADDRESS 0x3FADAF /end MEASUREMENT
/begin COMPU_METHOD MC_J1979_01_0F "J1979_01_0F conversion" RAT_FUNC "%3.0" "Unitless" COEFFS 0 1 0 0 0 1 /end COMPU_METHOD
/begin MEASUREMENT J1979_01_10 "Current mass air flow rate, for SAE J1979" UWORD MC_J1979_01_10 0 0 0 0 ECU_ADDRESS 0x3FAD98 /end MEASUREMENT
/begin COMPU_METHOD MC_J1979_01_10 "J1979_01_10 conversion" RAT_FUNC "%5.0" "Unitless" COEFFS 0 1 0 0 0 1 /end COMPU_METHOD
/begin MEASUREMENT J1979_01_11 "TP_ENG / 4,  for SAE J1979" UBYTE MC_J1979_01_11 0 0 0 0 ECU_ADDRESS 0x3FADAE /end MEASUREMENT
/begin COMPU_METHOD MC_J1979_01_11 "J1979_01_11 conversion" RAT_FUNC "%3.0" "Unitless" COEFFS 0 1 0 0 0 1 /end COMPU_METHOD
/begin MEASUREMENT J1979_01_12 "Bitmap of commanded SAIR system." UBYTE MC_J1979_01_12 0 0 0 0 ECU_ADDRESS 0x3FADAD /end MEASUREMENT
/begin COMPU_METHOD MC_J1979_01_12 "J1979_01_12 conversion" RAT_FUNC "%3.0" "Unitless" COEFFS 0 1 0 0 0 1 /end COMPU_METHOD
/begin MEASUREMENT J1979_01_13 "Bitmap of oxygen sensor locations" UBYTE MC_J1979_01_13 0 0 0 0 ECU_ADDRESS 0x3FADAC /end MEASUREMENT
/begin COMPU_METHOD MC_J1979_01_13 "J1979_01_13 conversion" RAT_FUNC "%3.0" "Unitless" COEFFS 0 1 0 0 0 1 /end COMPU_METHOD
/begin MEASUREMENT J1979_01_14W "Word (2 bytes) register containing the data for SCP J1979 Mode $01 PID ^14. (MSB is Data A(voltage), LSB is Data B(fuel trim).)" UWORD MC_J1979_01_14W 0 0 0 0 ECU_ADDRESS 0x3FAD96 /end MEASUREMENT
/begin COMPU_METHOD MC_J1979_01_14W "J1979_01_14W conversion" RAT_FUNC "%5.0" "Unitless" COEFFS 0 1 0 0 0 1 /end COMPU_METHOD
/begin MEASUREMENT J1979_01_15W "Word (2 bytes) register containing the data for SCP J1979 Mode $01 PID ^15. (MSB is Data A(voltage), LSB is Data B(fuel trim).)" UWORD MC_J1979_01_15W 0 0 0 0 ECU_ADDRESS 0x3FAD94 /end MEASUREMENT
/begin COMPU_METHOD MC_J1979_01_15W "J1979_01_15W conversion" RAT_FUNC "%5.0" "Unitless" COEFFS 0 1 0 0 0 1 /end COMPU_METHOD
/begin MEASUREMENT J1979_01_18W "Word (2 bytes) register containing the data for SCP J1979 Mode $01 PID ^18. (MSB is Data A(voltage), LSB is Data B(fuel trim).)" UWORD MC_J1979_01_18W 0 0 0 0 ECU_ADDRESS 0x3FAD92 /end MEASUREMENT
/begin COMPU_METHOD MC_J1979_01_18W "J1979_01_18W conversion" RAT_FUNC "%5.0" "Unitless" COEFFS 0 1 0 0 0 1 /end COMPU_METHOD
/begin MEASUREMENT J1979_01_19W "Word (2 bytes) register containing the data for SCP J1979 Mode $01 PID ^19. (MSB is Data A(voltage), LSB is Data B(fuel trim).)" UWORD MC_J1979_01_19W 0 0 0 0 ECU_ADDRESS 0x3FAD90 /end MEASUREMENT
/begin COMPU_METHOD MC_J1979_01_19W "J1979_01_19W conversion" RAT_FUNC "%5.0" "Unitless" COEFFS 0 1 0 0 0 1 /end COMPU_METHOD
/begin CHARACTERISTIC J1979_01_1C "OBD req'ments to which vehicle is designed: 1=OBDII(CARB),2=OBD(FedEPA),3=OBD&OBDII,4=OBDI,5=none" VALUE 0x5633C SD_UBYTE 0 SC_J1979_01_1C 0 255 /end CHARACTERISTIC
/begin COMPU_METHOD SC_J1979_01_1C "J1979_01_1C conversion" RAT_FUNC "%3.0" "unitless" COEFFS 0 1 0 0 0 1 /end COMPU_METHOD
/begin MEASUREMENT J1979_02_00D "Double word (4 bytes) register containing the data for SCP J1979 Mode $02 PID #00. (MSB is Data A, ... LSB is Data D.)" ULONG MC_J1979_02_00D 0 0 0 0 ECU_ADDRESS 0x3F9EC8 /end MEASUREMENT
/begin COMPU_METHOD MC_J1979_02_00D "J1979_02_00D conversion" RAT_FUNC "%10.0" "Unitless" COEFFS 0 1 0 0 0 1 /end COMPU_METHOD
/begin MEASUREMENT J1979_02_03 "Word register containing the data for SCP J1979 Mode $02 PID ^03. More signif icant byte (Data A) is bitmap of fuel system status." UWORD MC_J1979_02_03 0 0 0 0 ECU_ADDRESS 0x3F9EC0 /end MEASUREMENT
/begin COMPU_METHOD MC_J1979_02_03 "J1979_02_03 conversion" RAT_FUNC "%5.0" "Unitless" COEFFS 0 1 0 0 0 1 /end COMPU_METHOD
/begin MEASUREMENT J1979_02_05 "Freeze frame ECT (°C + 40)" UBYTE MC_J1979_02_05 0 0 0 0 ECU_ADDRESS 0x3F9EC7 /end MEASUREMENT
/begin COMPU_METHOD MC_J1979_02_05 "J1979_02_05 conversion" RAT_FUNC "%3.0" "Unitless" COEFFS 0 1 0 0 0 1 /end COMPU_METHOD
/begin MEASUREMENT J1979_02_06 "Short term freeze frame fuel trim adjustment for bank 1." UBYTE MC_J1979_02_06 0 0 0 0 ECU_ADDRESS 0x3F9EC6 /end MEASUREMENT
/begin COMPU_METHOD MC_J1979_02_06 "J1979_02_06 conversion" RAT_FUNC "%3.0" "Unitless" COEFFS 0 1 0 0 0 1 /end COMPU_METHOD
/begin MEASUREMENT J1979_02_07 "Long term freeze frame fuel trim adjustment for bank 1." UBYTE MC_J1979_02_07 0 0 0 0 ECU_ADDRESS 0x3F9EC5 /end MEASUREMENT
/begin COMPU_METHOD MC_J1979_02_07 "J1979_02_07 conversion" RAT_FUNC "%3.0" "Unitless" COEFFS 0 1 0 0 0 1 /end COMPU_METHOD
/begin MEASUREMENT J1979_02_08 "Short term freeze frame fuel trim adjustment for bank 2." UBYTE MC_J1979_02_08 0 0 0 0 ECU_ADDRESS 0x3F9EC4 /end MEASUREMENT
/begin COMPU_METHOD MC_J1979_02_08 "J1979_02_08 conversion" RAT_FUNC "%3.0" "Unitless" COEFFS 0 1 0 0 0 1 /end COMPU_METHOD
/begin MEASUREMENT J1979_02_09 "Long term freeze frame fuel trim adjustment for bank 2." UBYTE MC_J1979_02_09 0 0 0 0 ECU_ADDRESS 0x3F9EC3 /end MEASUREMENT
/begin COMPU_METHOD MC_J1979_02_09 "J1979_02_09 conversion" RAT_FUNC "%3.0" "Unitless" COEFFS 0 1 0 0 0 1 /end COMPU_METHOD
/begin MEASUREMENT J1979_02_0D "Freeze frame vehicle speed." UBYTE MC_J1979_02_0D 0 0 0 0 ECU_ADDRESS 0x3F9EC2 /end MEASUREMENT
/begin COMPU_METHOD MC_J1979_02_0D "J1979_02_0D conversion" RAT_FUNC "%3.0" "Unitless" COEFFS 0 1 0 0 0 1 /end COMPU_METHOD
/begin MEASUREMENT J1979_1_000B "a one byte register which contains the data for SCP J1979 Mode $01 PID ^0B" UBYTE MC_J1979_1_000B 0 0 0 0 ECU_ADDRESS 0x3FADA4 /end MEASUREMENT
/begin COMPU_METHOD MC_J1979_1_000B "J1979_1_000B conversion" RAT_FUNC "%3.0" "Unitless" COEFFS 0 1 0 0 0 1 /end COMPU_METHOD
/begin MEASUREMENT J1979_2_000B "a one byte register which contains the data for SCP J1979 Mode $02 PID ^0B" UBYTE MC_J1979_2_000B 0 0 0 0 ECU_ADDRESS 0x3FAEB0 /end MEASUREMENT
/begin COMPU_METHOD MC_J1979_2_000B "J1979_2_000B conversion" RAT_FUNC "%3.0" "Unitless" COEFFS 0 1 0 0 0 1 /end COMPU_METHOD
/begin MEASUREMENT JGATE_POS3 "EPRNDL J-Gate position code 3" UBYTE MC_JGATE_POS3 0 0 0 0 ECU_ADDRESS 0x3FADA6 /end MEASUREMENT
/begin COMPU_METHOD MC_JGATE_POS3 "JGATE_POS3 conversion" RAT_FUNC "%3.0" "Unitless" COEFFS 0 1 0 0 0 1 /end COMPU_METHOD
/begin MEASUREMENT KAMM_FL "Flag indicating that KAM voltage is below hardware defined threshold. (Controlled in HWINT_IO Chapter - see URD 21298)" UBYTE MC_KAMM_FL 0 0 0 0 ECU_ADDRESS 0x3FB034 /end MEASUREMENT
/begin COMPU_METHOD MC_KAMM_FL "KAMM_FL conversion" RAT_FUNC "%3.0" "Unitless" COEFFS 0 1 0 0 0 1 /end COMPU_METHOD
/begin MEASUREMENT KAMM_FL_TMR "Timer indicating time since kamm_fl flag set, i.e low KAM voltage." FLOAT32_IEEE MC_KAMM_FL_TMR 0 0 0 0 ECU_ADDRESS 0x3FB038 /end MEASUREMENT
/begin COMPU_METHOD MC_KAMM_FL_TMR "KAMM_FL_TMR conversion" RAT_FUNC "%10.5" "Unitless" COEFFS 0 1 0 0 0 1 /end COMPU_METHOD
/begin MEASUREMENT KAMRF[0] "Adaptive fuel-air ratio correction factor" FLOAT32_IEEE MC_KAMRF 0 0 0 255.99 ECU_ADDRESS 0x3FAC94 /end MEASUREMENT
/begin COMPU_METHOD MC_KAMRF "KAMRF conversion" RAT_FUNC "%10.5" "UNITLESS" COEFFS 0 1 0 0 0 1 /end COMPU_METHOD
/begin MEASUREMENT KAMRF[1] "Adaptive fuel-air ratio correction factor" FLOAT32_IEEE MC_KAMRF 0 0 0 255.99 ECU_ADDRESS 0x3FAC98 /end MEASUREMENT
/begin MEASUREMENT KAM_ERROR "Indicates keep alive RAM invalid." UBYTE MC_KAM_ERROR 0 0 0 0 ECU_ADDRESS 0x3FAAB9 /end MEASUREMENT
/begin COMPU_METHOD MC_KAM_ERROR "KAM_ERROR conversion" RAT_FUNC "%3.0" "Unitless" COEFFS 0 1 0 0 0 1 /end COMPU_METHOD
/begin MEASUREMENT KAM_FPA_ERROR "Floating point kam error" UBYTE MC_KAM_FPA_ERROR 0 0 0 0 ECU_ADDRESS 0x3FAAB8 /end MEASUREMENT
/begin COMPU_METHOD MC_KAM_FPA_ERROR "KAM_FPA_ERROR conversion" RAT_FUNC "%3.0" "Unitless" COEFFS 0 1 0 0 0 1 /end COMPU_METHOD
/begin CHARACTERISTIC KAM_ROM_SW "KAM/ROM test switch; 0 = No KAM/ROM test; 1 = KAM/ROM test" VALUE 0x57858 SD_UBYTE 0 SC_KAM_ROM_SW 0 1 /end CHARACTERISTIC
/begin COMPU_METHOD SC_KAM_ROM_SW "KAM_ROM_SW conversion" RAT_FUNC "%3.0" "unitless" COEFFS 0 1 0 0 0 1 /end COMPU_METHOD
/begin CHARACTERISTIC KNCRANK "Run to Crank Mode transition speed (RPM)" VALUE 0x56ADC SD_FLOAT32_IEEE 0 SC_KNCRANK 0 650 /end CHARACTERISTIC
/begin COMPU_METHOD SC_KNCRANK "KNCRANK conversion" RAT_FUNC "%10.5" "RPM" COEFFS 0 1 0 0 0 1 /end COMPU_METHOD
/begin CHARACTERISTIC KNNOSTART "Run to No-Start Mode transition speed (RPM)" VALUE 0x56AD8 SD_FLOAT32_IEEE 0 SC_KNNOSTART 0 650 /end CHARACTERISTIC
/begin COMPU_METHOD SC_KNNOSTART "KNNOSTART conversion" RAT_FUNC "%10.5" "RPM" COEFFS 0 1 0 0 0 1 /end COMPU_METHOD
/begin CHARACTERISTIC KOER_MINMPH "Minimum vehicle speed to conduct KOER self test." VALUE 0x57827 SD_UBYTE 0 SC_KOER_MINMPH 0 120 /end CHARACTERISTIC
/begin COMPU_METHOD SC_KOER_MINMPH "KOER_MINMPH conversion" RAT_FUNC "%3.0" "MPH" COEFFS 0 1 0 0 0 1 /end COMPU_METHOD
/begin MEASUREMENT KOER_MODE "KOER Mode Selector" UBYTE MC_KOER_MODE 0 0 0 0 ECU_ADDRESS 0x3FA7F0 /end MEASUREMENT
/begin COMPU_METHOD MC_KOER_MODE "KOER_MODE conversion" RAT_FUNC "%3.0" "Unitless" COEFFS 0 1 0 0 0 1 /end COMPU_METHOD
/begin CHARACTERISTIC KOER_TST_TM "Maximum amount of time that KOER can run." VALUE 0x57828 SD_UBYTE 0 SC_KOER_TST_TM 0 255 /end CHARACTERISTIC
/begin COMPU_METHOD SC_KOER_TST_TM "KOER_TST_TM conversion" RAT_FUNC "%3.0" "s" COEFFS 0 1 0 0 0 1 /end COMPU_METHOD
/begin MEASUREMENT KOER_TST_TMR "Amount of time that key on engine running has been executing." FLOAT32_IEEE MC_KOER_TST_TMR 0 0 0 0 ECU_ADDRESS 0x3FAB70 /end MEASUREMENT
/begin COMPU_METHOD MC_KOER_TST_TMR "KOER_TST_TMR conversion" RAT_FUNC "%10.5" "Unitless" COEFFS 0 1 0 0 0 1 /end COMPU_METHOD
/begin CHARACTERISTIC KSF "Keypower scaling factor, reciprocal." VALUE 0x57574 SD_FLOAT32_IEEE 0 SC_KSF 0 7.99988 /end CHARACTERISTIC
/begin COMPU_METHOD SC_KSF "KSF conversion" RAT_FUNC "%10.5" "UNITLESS" COEFFS 0 1 0 0 0 1 /end COMPU_METHOD
/begin MEASUREMENT LAMBSE[0] "Commanded Equivalence Ratio." FLOAT32_IEEE MC_LAMBSE 0 0 0 1.99997 ECU_ADDRESS 0x3FAC98 /end MEASUREMENT
/begin COMPU_METHOD MC_LAMBSE "LAMBSE conversion" RAT_FUNC "%10.5" "unitless" COEFFS 0 1 0 0 0 1 /end COMPU_METHOD
/begin MEASUREMENT LAMBSE[1] "Commanded Equivalence Ratio." FLOAT32_IEEE MC_LAMBSE 0 0 0 1.99997 ECU_ADDRESS 0x3FAC9C /end MEASUREMENT
/begin MEASUREMENT LAST_MODE "Last valid engine mode at camp sync loss" UBYTE MC_LAST_MODE 0 0 0 0 ECU_ADDRESS 0x3FA3E0 /end MEASUREMENT
/begin COMPU_METHOD MC_LAST_MODE "LAST_MODE conversion" RAT_FUNC "%3.0" "Unitless" COEFFS 0 1 0 0 0 1 /end COMPU_METHOD
/begin CHARACTERISTIC LEAN_AMP_M "U.S. EGO voltage amplitude to signal a failure when area ratio is not shifted rich or lean (meadian)" VALUE 0x3FB058 SD_FLOAT32_IEEE 0 SC_LEAN_AMP_M 0 5 /end CHARACTERISTIC
/begin COMPU_METHOD SC_LEAN_AMP_M "LEAN_AMP_M conversion" RAT_FUNC "%10.5" "VOLTS" COEFFS 0 1 0 0 0 1 /end COMPU_METHOD
/begin MEASUREMENT LO_ALT_BP_MULT "Low altitude Barometric Pressure Multiplier" FLOAT32_IEEE MC_LO_ALT_BP_MULT 0 0 0 0 ECU_ADDRESS 0x3F9F5C /end MEASUREMENT
/begin COMPU_METHOD MC_LO_ALT_BP_MULT "LO_ALT_BP_MULT conversion" RAT_FUNC "%10.5" "Unitless" COEFFS 0 1 0 0 0 1 /end COMPU_METHOD
/begin MEASUREMENT M6_TABLE_PTR "Index indicating current position within MODE 06 table." UBYTE MC_M6_TABLE_PTR 0 0 0 0 ECU_ADDRESS 0x3FAB64 /end MEASUREMENT
/begin COMPU_METHOD MC_M6_TABLE_PTR "M6_TABLE_PTR conversion" RAT_FUNC "%3.0" "Unitless" COEFFS 0 1 0 0 0 1 /end COMPU_METHOD
/begin MEASUREMENT M6_TEST_ID "Test ID requested by MODE 06 command." UBYTE MC_M6_TEST_ID 0 0 0 0 ECU_ADDRESS 0x3FAB21 /end MEASUREMENT
/begin COMPU_METHOD MC_M6_TEST_ID "M6_TEST_ID conversion" RAT_FUNC "%3.0" "Unitless" COEFFS 0 1 0 0 0 1 /end COMPU_METHOD
/begin MEASUREMENT M9_STATE "State of MODE 09 state machine (0=Initial, 1= VIN request, 2= CAL ID request, 4= CAL verification request." UBYTE MC_M9_STATE 0 0 0 0 ECU_ADDRESS 0x3FAB19 /end MEASUREMENT
/begin COMPU_METHOD MC_M9_STATE "M9_STATE conversion" RAT_FUNC "%3.0" "Unitless" COEFFS 0 1 0 0 0 1 /end COMPU_METHOD
/begin MEASUREMENT MAF_AATMULT "Mass Air Flow temperature compensation multiplier" FLOAT32_IEEE MC_MAF_AATMULT 0 0 0 0 ECU_ADDRESS 0x3FA078 /end MEASUREMENT
/begin COMPU_METHOD MC_MAF_AATMULT "MAF_AATMULT conversion" RAT_FUNC "%10.5" "Unitless" COEFFS 0 1 0 0 0 1 /end COMPU_METHOD
/begin MEASUREMENT MAF_CNTS "Mass Air Flow sensor A/D counts" SLONG MC_MAF_CNTS 0 0 0 0 ECU_ADDRESS 0x3FAA60 /end MEASUREMENT
/begin COMPU_METHOD MC_MAF_CNTS "MAF_CNTS conversion" RAT_FUNC "%10.0" "Unitless" COEFFS 0 1 0 0 0 1 /end COMPU_METHOD
/begin CHARACTERISTIC MAF_DEF "MAF default value" VALUE 0x565E8 SD_FLOAT32_IEEE 0 SC_MAF_DEF 0 750 /end CHARACTERISTIC
/begin COMPU_METHOD SC_MAF_DEF "MAF_DEF conversion" RAT_FUNC "%10.5" "g/s" COEFFS 0 1 0 0 0 1 /end COMPU_METHOD
/begin MEASUREMENT MAF_ENG_UNITS "Mass air flow in grams/sec (from input driver)" FLOAT32_IEEE MC_MAF_ENG_UNITS 0 0 0 0 ECU_ADDRESS 0x3FAA5C /end MEASUREMENT
/begin COMPU_METHOD MC_MAF_ENG_UNITS "MAF_ENG_UNITS conversion" RAT_FUNC "%10.5" "Unitless" COEFFS 0 1 0 0 0 1 /end COMPU_METHOD
/begin MEASUREMENT MAF_FIL "Intermittent fault filter for the MAF sensor." UBYTE MC_MAF_FIL 0 0 0 0 ECU_ADDRESS 0x3F9EFB /end MEASUREMENT
/begin COMPU_METHOD MC_MAF_FIL "MAF_FIL conversion" RAT_FUNC "%3.0" "Unitless" COEFFS 0 1 0 0 0 1 /end COMPU_METHOD
/begin MEASUREMENT MAF_FILT_TIME_CONST "MAF filter time constant" FLOAT32_IEEE MC_MAF_FILT_TIME_CONST 0 0 0 0 ECU_ADDRESS 0x3FA088 /end MEASUREMENT
/begin COMPU_METHOD MC_MAF_FILT_TIME_CONST "MAF_FILT_TIME_CONST conversion" RAT_FUNC "%10.5" "Unitless" COEFFS 0 1 0 0 0 1 /end COMPU_METHOD
/begin MEASUREMENT MAF_FIL_MAX "HIGHEST VALUE THE FUALT FILTER MAF_FIL SEES" UBYTE MC_MAF_FIL_MAX 0 0 0 0 ECU_ADDRESS 0x3FAEDB /end MEASUREMENT
/begin COMPU_METHOD MC_MAF_FIL_MAX "MAF_FIL_MAX conversion" RAT_FUNC "%3.0" "Unitless" COEFFS 0 1 0 0 0 1 /end COMPU_METHOD
/begin MEASUREMENT MAF_FLT_RECOVERY_CNTR "MAF fault recovery counter" SLONG MC_MAF_FLT_RECOVERY_CNTR 0 0 0 0 ECU_ADDRESS 0x3FA064 /end MEASUREMENT
/begin COMPU_METHOD MC_MAF_FLT_RECOVERY_CNTR "MAF_FLT_RECOVERY_CNTR conversion" RAT_FUNC "%10.0" "Unitless" COEFFS 0 1 0 0 0 1 /end COMPU_METHOD
/begin MEASUREMENT MAF_FLT_RECOVERY_FLG "1-> Indicates MAF fault recovery is occuring" UBYTE MC_MAF_FLT_RECOVERY_FLG 0 0 0 0 ECU_ADDRESS 0x3FA08E /end MEASUREMENT
/begin COMPU_METHOD MC_MAF_FLT_RECOVERY_FLG "MAF_FLT_RECOVERY_FLG conversion" RAT_FUNC "%3.0" "Unitless" COEFFS 0 1 0 0 0 1 /end COMPU_METHOD
/begin CHARACTERISTIC MAF_F_DEC "MAF malf failure/update counter decrement value" VALUE 0x565F0 SD_SLONG 0 SC_MAF_F_DEC 0 65535 /end CHARACTERISTIC
/begin COMPU_METHOD SC_MAF_F_DEC "MAF_F_DEC conversion" RAT_FUNC "%10.0" "unitless" COEFFS 0 1 0 0 0 1 /end COMPU_METHOD
/begin CHARACTERISTIC MAF_F_INC "MAF out of range failure increment value" VALUE 0x565F4 SD_SLONG 0 SC_MAF_F_INC 0 65535 /end CHARACTERISTIC
/begin COMPU_METHOD SC_MAF_F_INC "MAF_F_INC conversion" RAT_FUNC "%10.0" "unitless" COEFFS 0 1 0 0 0 1 /end COMPU_METHOD
/begin MEASUREMENT MAF_F_ORH "MAF out of range high fault" UBYTE MC_MAF_F_ORH 0 0 0 0 ECU_ADDRESS 0x3FA094 /end MEASUREMENT
/begin COMPU_METHOD MC_MAF_F_ORH "MAF_F_ORH conversion" RAT_FUNC "%3.0" "Unitless" COEFFS 0 1 0 0 0 1 /end COMPU_METHOD
/begin MEASUREMENT MAF_F_ORL "MAF out of range low fault" UBYTE MC_MAF_F_ORL 0 0 0 0 ECU_ADDRESS 0x3FA093 /end MEASUREMENT
/begin COMPU_METHOD MC_MAF_F_ORL "MAF_F_ORL conversion" RAT_FUNC "%3.0" "Unitless" COEFFS 0 1 0 0 0 1 /end COMPU_METHOD
/begin MEASUREMENT MAF_GMS "Filtered Mass Air Flow, in grams/second" FLOAT32_IEEE MC_MAF_GMS 0 0 0 0 ECU_ADDRESS 0x3FA080 /end MEASUREMENT
/begin COMPU_METHOD MC_MAF_GMS "MAF_GMS conversion" RAT_FUNC "%10.5" "Unitless" COEFFS 0 1 0 0 0 1 /end COMPU_METHOD
/begin MEASUREMENT MAF_GMS_COMP "Mass Air Flow compensated for air temperature, in grams/second" FLOAT32_IEEE MC_MAF_GMS_COMP 0 0 0 0 ECU_ADDRESS 0x3FA07C /end MEASUREMENT
/begin COMPU_METHOD MC_MAF_GMS_COMP "MAF_GMS_COMP conversion" RAT_FUNC "%10.5" "Unitless" COEFFS 0 1 0 0 0 1 /end COMPU_METHOD
/begin CHARACTERISTIC MAF_HI_ER "MAFS test upper limit" VALUE 0x574B8 SD_FLOAT32_IEEE 0 SC_MAF_HI_ER 0 1023 /end CHARACTERISTIC
/begin COMPU_METHOD SC_MAF_HI_ER "MAF_HI_ER conversion" RAT_FUNC "%10.5" "COUNTS" COEFFS 0 1 0 0 0 1 /end COMPU_METHOD
/begin MEASUREMENT MAF_INT "Flag set when intermittent is detected on the MAF sensor." UBYTE MC_MAF_INT 0 0 0 0 ECU_ADDRESS 0x3F9EF8 /end MEASUREMENT
/begin COMPU_METHOD MC_MAF_INT "MAF_INT conversion" RAT_FUNC "%3.0" "Unitless" COEFFS 0 1 0 0 0 1 /end COMPU_METHOD
/begin CHARACTERISTIC MAF_LO_ER "MAFS test lower limit" VALUE 0x574B4 SD_FLOAT32_IEEE 0 SC_MAF_LO_ER 0 1023 /end CHARACTERISTIC
/begin COMPU_METHOD SC_MAF_LO_ER "MAF_LO_ER conversion" RAT_FUNC "%10.5" "COUNTS" COEFFS 0 1 0 0 0 1 /end COMPU_METHOD
/begin CHARACTERISTIC MAF_LVL "Fault level for intermittent MAF sensor." VALUE 0x563A5 SD_UBYTE 0 SC_MAF_LVL 0 255 /end CHARACTERISTIC
/begin COMPU_METHOD SC_MAF_LVL "MAF_LVL conversion" RAT_FUNC "%3.0" "LEVEL" COEFFS 0 1 0 0 0 1 /end COMPU_METHOD
/begin MEASUREMENT MAF_MALF_SET "Indicate MAF malf  high or low failure" UBYTE MC_MAF_MALF_SET 0 0 0 0 ECU_ADDRESS 0x3FA090 /end MEASUREMENT
/begin COMPU_METHOD MC_MAF_MALF_SET "MAF_MALF_SET conversion" RAT_FUNC "%3.0" "Unitless" COEFFS 0 1 0 0 0 1 /end COMPU_METHOD
/begin MEASUREMENT MAF_MG_STK "Mass air flow, in mg/stk" FLOAT32_IEEE MC_MAF_MG_STK 0 0 0 0 ECU_ADDRESS 0x3FA084 /end MEASUREMENT
/begin COMPU_METHOD MC_MAF_MG_STK "MAF_MG_STK conversion" RAT_FUNC "%10.5" "Unitless" COEFFS 0 1 0 0 0 1 /end COMPU_METHOD
/begin MEASUREMENT MAF_MULTLOOKUP "Mass Air Flow temperature compensation multiplier" FLOAT32_IEEE MC_MAF_MULTLOOKUP 0 0 0 0 ECU_ADDRESS 0x3FA060 /end MEASUREMENT
/begin COMPU_METHOD MC_MAF_MULTLOOKUP "MAF_MULTLOOKUP conversion" RAT_FUNC "%10.5" "Unitless" COEFFS 0 1 0 0 0 1 /end COMPU_METHOD
/begin MEASUREMENT MAF_ORH_CNTR "Mass Air Flow out of range high counter" SLONG MC_MAF_ORH_CNTR 0 0 0 0 ECU_ADDRESS 0x3FA074 /end MEASUREMENT
/begin COMPU_METHOD MC_MAF_ORH_CNTR "MAF_ORH_CNTR conversion" RAT_FUNC "%10.0" "Unitless" COEFFS 0 1 0 0 0 1 /end COMPU_METHOD
/begin MEASUREMENT MAF_ORL_CNTR "Mass Air Flow out of range low counter" SLONG MC_MAF_ORL_CNTR 0 0 0 0 ECU_ADDRESS 0x3FA070 /end MEASUREMENT
/begin COMPU_METHOD MC_MAF_ORL_CNTR "MAF_ORL_CNTR conversion" RAT_FUNC "%10.0" "Unitless" COEFFS 0 1 0 0 0 1 /end COMPU_METHOD
/begin MEASUREMENT MAF_RAW "Sampled air mass flow rate, lbm/min" FLOAT32_IEEE MC_MAF_RAW 0 0 0 0 ECU_ADDRESS 0x3FAA58 /end MEASUREMENT
/begin COMPU_METHOD MC_MAF_RAW "MAF_RAW conversion" RAT_FUNC "%10.5" "Unitless" COEFFS 0 1 0 0 0 1 /end COMPU_METHOD
/begin CHARACTERISTIC MAF_REC_INC "MAF fault recovery counter increment value" VALUE 0x565EC SD_SLONG 0 SC_MAF_REC_INC 0 65535 /end CHARACTERISTIC
/begin COMPU_METHOD SC_MAF_REC_INC "MAF_REC_INC conversion" RAT_FUNC "%10.0" "unitless" COEFFS 0 1 0 0 0 1 /end COMPU_METHOD
/begin MEASUREMENT MAF_STATUS "Status of Mass Air Flow high level driver ( 0 = ok )" UBYTE MC_MAF_STATUS 0 0 0 0 ECU_ADDRESS 0x3FAA64 /end MEASUREMENT
/begin COMPU_METHOD MC_MAF_STATUS "MAF_STATUS conversion" RAT_FUNC "%3.0" "Unitless" COEFFS 0 1 0 0 0 1 /end COMPU_METHOD
/begin CHARACTERISTIC MAF_TCREC_SEL "Switch to select MAF filter time constant during fault recovery and during fault occurance before malf is set" VALUE 0x565F8 SD_UBYTE 0 SC_MAF_TCREC_SEL 0 1 /end CHARACTERISTIC
/begin COMPU_METHOD SC_MAF_TCREC_SEL "MAF_TCREC_SEL conversion" RAT_FUNC "%3.0" "unitless" COEFFS 0 1 0 0 0 1 /end COMPU_METHOD
/begin CHARACTERISTIC MAIN_CLOSE "" VALUE 0x56698 SD_FLOAT32_IEEE 0 SC_MAIN_CLOSE 0 65535 /end CHARACTERISTIC
/begin COMPU_METHOD SC_MAIN_CLOSE "MAIN_CLOSE conversion" RAT_FUNC "%10.5" "unitless" COEFFS 0 1 0 0 0 1 /end COMPU_METHOD
/begin CHARACTERISTIC MAIN_DURATION "" VALUE 0x5669C SD_FLOAT32_IEEE 0 SC_MAIN_DURATION 0 65535 /end CHARACTERISTIC
/begin COMPU_METHOD SC_MAIN_DURATION "MAIN_DURATION conversion" RAT_FUNC "%10.5" "unitless" COEFFS 0 1 0 0 0 1 /end COMPU_METHOD
/begin CHARACTERISTIC MAIN_OPEN "" VALUE 0x566A0 SD_FLOAT32_IEEE 0 SC_MAIN_OPEN 0 65535 /end CHARACTERISTIC
/begin COMPU_METHOD SC_MAIN_OPEN "MAIN_OPEN conversion" RAT_FUNC "%10.5" "unitless" COEFFS 0 1 0 0 0 1 /end COMPU_METHOD
/begin CHARACTERISTIC MAP_AD_TC "Manifold pressure filter time constant" VALUE 0x56634 SD_FLOAT32_IEEE 0 SC_MAP_AD_TC 0 64 /end CHARACTERISTIC
/begin COMPU_METHOD SC_MAP_AD_TC "MAP_AD_TC conversion" RAT_FUNC "%10.5" "s" COEFFS 0 1 0 0 0 1 /end COMPU_METHOD
/begin CHARACTERISTIC MAP_DEF "Default FMEM value for manifold pressure" VALUE 0x56620 SD_FLOAT32_IEEE 0 SC_MAP_DEF -40 150 /end CHARACTERISTIC
/begin COMPU_METHOD SC_MAP_DEF "MAP_DEF conversion" RAT_FUNC "%10.5" "kPa" COEFFS 0 1 0 0 0 1 /end COMPU_METHOD
/begin MEASUREMENT MAP_ENG_KPA "MAP engineering Value" FLOAT32_IEEE MC_MAP_ENG_KPA 0 0 0 0 ECU_ADDRESS 0x3FA0B8 /end MEASUREMENT
/begin COMPU_METHOD MC_MAP_ENG_KPA "MAP_ENG_KPA conversion" RAT_FUNC "%10.5" "Unitless" COEFFS 0 1 0 0 0 1 /end COMPU_METHOD
/begin MEASUREMENT MAP_ENG_KPA_OFFS "Engineering value with pdif_map_ref_add" FLOAT32_IEEE MC_MAP_ENG_KPA_OFFS 0 0 0 0 ECU_ADDRESS 0x3FA0B4 /end MEASUREMENT
/begin COMPU_METHOD MC_MAP_ENG_KPA_OFFS "MAP_ENG_KPA_OFFS conversion" RAT_FUNC "%10.5" "Unitless" COEFFS 0 1 0 0 0 1 /end COMPU_METHOD
/begin MEASUREMENT MAP_FIL "Intermittent fault filter for the MAP sensor." UBYTE MC_MAP_FIL 0 0 0 0 ECU_ADDRESS 0x3F9EF9 /end MEASUREMENT
/begin COMPU_METHOD MC_MAP_FIL "MAP_FIL conversion" RAT_FUNC "%3.0" "Unitless" COEFFS 0 1 0 0 0 1 /end COMPU_METHOD
/begin MEASUREMENT MAP_FILT_TIME_CONST "MAP  filter time constant" FLOAT32_IEEE MC_MAP_FILT_TIME_CONST 0 0 0 0 ECU_ADDRESS 0x3FA098 /end MEASUREMENT
/begin COMPU_METHOD MC_MAP_FILT_TIME_CONST "MAP_FILT_TIME_CONST conversion" RAT_FUNC "%10.5" "Unitless" COEFFS 0 1 0 0 0 1 /end COMPU_METHOD
/begin MEASUREMENT MAP_FIL_MAX "HIGHEST VALUE THE FUALT FILTER MAP_FIL SEES" UBYTE MC_MAP_FIL_MAX 0 0 0 0 ECU_ADDRESS 0x3FAED8 /end MEASUREMENT
/begin COMPU_METHOD MC_MAP_FIL_MAX "MAP_FIL_MAX conversion" RAT_FUNC "%3.0" "Unitless" COEFFS 0 1 0 0 0 1 /end COMPU_METHOD
/begin MEASUREMENT MAP_FLT_RECOVERY_CNTR "MAP fault recovery counter" SLONG MC_MAP_FLT_RECOVERY_CNTR 0 0 0 0 ECU_ADDRESS 0x3FA09C /end MEASUREMENT
/begin COMPU_METHOD MC_MAP_FLT_RECOVERY_CNTR "MAP_FLT_RECOVERY_CNTR conversion" RAT_FUNC "%10.0" "Unitless" COEFFS 0 1 0 0 0 1 /end COMPU_METHOD
/begin MEASUREMENT MAP_FLT_RECOVERY_FLG "1-> Indicates MAP fault recovery is occuring" UBYTE MC_MAP_FLT_RECOVERY_FLG 0 0 0 0 ECU_ADDRESS 0x3FA0C0 /end MEASUREMENT
/begin COMPU_METHOD MC_MAP_FLT_RECOVERY_FLG "MAP_FLT_RECOVERY_FLG conversion" RAT_FUNC "%3.0" "Unitless" COEFFS 0 1 0 0 0 1 /end COMPU_METHOD
/begin CHARACTERISTIC MAP_F_DEC "MAP malf failure/update counter decrement value" VALUE 0x56628 SD_SLONG 0 SC_MAP_F_DEC 0 65535 /end CHARACTERISTIC
/begin COMPU_METHOD SC_MAP_F_DEC "MAP_F_DEC conversion" RAT_FUNC "%10.0" "unitless" COEFFS 0 1 0 0 0 1 /end COMPU_METHOD
/begin CHARACTERISTIC MAP_F_INC "MAP ORH/ORL failure counter increment value" VALUE 0x5662C SD_SLONG 0 SC_MAP_F_INC 0 65535 /end CHARACTERISTIC
/begin COMPU_METHOD SC_MAP_F_INC "MAP_F_INC conversion" RAT_FUNC "%10.0" "unitless" COEFFS 0 1 0 0 0 1 /end COMPU_METHOD
/begin MEASUREMENT MAP_F_ORH "Manifold Absolute Pressure out of range high fail" UBYTE MC_MAP_F_ORH 0 0 0 0 ECU_ADDRESS 0x3FA0C6 /end MEASUREMENT
/begin COMPU_METHOD MC_MAP_F_ORH "MAP_F_ORH conversion" RAT_FUNC "%3.0" "Unitless" COEFFS 0 1 0 0 0 1 /end COMPU_METHOD
/begin MEASUREMENT MAP_F_ORL "Manifold Absolute Pressure out of range low fail" UBYTE MC_MAP_F_ORL 0 0 0 0 ECU_ADDRESS 0x3FA0C5 /end MEASUREMENT
/begin COMPU_METHOD MC_MAP_F_ORL "MAP_F_ORL conversion" RAT_FUNC "%3.0" "Unitless" COEFFS 0 1 0 0 0 1 /end COMPU_METHOD
/begin CHARACTERISTIC MAP_HI_VOLTS "MAP sensor over  voltage test  limit" VALUE 0x573AC SD_FLOAT32_IEEE 0 SC_MAP_HI_VOLTS 0 5 /end CHARACTERISTIC
/begin COMPU_METHOD SC_MAP_HI_VOLTS "MAP_HI_VOLTS conversion" RAT_FUNC "%10.5" "V" COEFFS 0 1 0 0 0 1 /end COMPU_METHOD
/begin MEASUREMENT MAP_INT "--" UBYTE MC_MAP_INT 0 0 0 0 ECU_ADDRESS 0x3F9EFA /end MEASUREMENT
/begin COMPU_METHOD MC_MAP_INT "MAP_INT conversion" RAT_FUNC "%3.0" "Unitless" COEFFS 0 1 0 0 0 1 /end COMPU_METHOD
/begin MEASUREMENT MAP_KPA "Manifold Absolute Pressure (in KPA)" FLOAT32_IEEE MC_MAP_KPA 0 0 0 0 ECU_ADDRESS 0x3FA0BC /end MEASUREMENT
/begin COMPU_METHOD MC_MAP_KPA "MAP_KPA conversion" RAT_FUNC "%10.5" "Unitless" COEFFS 0 1 0 0 0 1 /end COMPU_METHOD
/begin CHARACTERISTIC MAP_LO_VOLTS "MAP sensor under voltage test  limit" VALUE 0x573B0 SD_FLOAT32_IEEE 0 SC_MAP_LO_VOLTS 0 5 /end CHARACTERISTIC
/begin COMPU_METHOD SC_MAP_LO_VOLTS "MAP_LO_VOLTS conversion" RAT_FUNC "%10.5" "V" COEFFS 0 1 0 0 0 1 /end COMPU_METHOD
/begin CHARACTERISTIC MAP_LVL_CAL "Fault level for intermittent MAP sensor." VALUE 0x563A4 SD_UBYTE 0 SC_MAP_LVL_CAL 0 255 /end CHARACTERISTIC
/begin COMPU_METHOD SC_MAP_LVL_CAL "MAP_LVL_CAL conversion" RAT_FUNC "%3.0" "LEVEL" COEFFS 0 1 0 0 0 1 /end COMPU_METHOD
/begin MEASUREMENT MAP_MALF_SET "Indicate MAP malf  high or low failure" UBYTE MC_MAP_MALF_SET 0 0 0 0 ECU_ADDRESS 0x3FA0C2 /end MEASUREMENT
/begin COMPU_METHOD MC_MAP_MALF_SET "MAP_MALF_SET conversion" RAT_FUNC "%3.0" "Unitless" COEFFS 0 1 0 0 0 1 /end COMPU_METHOD
/begin MEASUREMENT MAP_ORH_CNTR "Manifold Pressure out of range high counter" SLONG MC_MAP_ORH_CNTR 0 0 0 0 ECU_ADDRESS 0x3FA0AC /end MEASUREMENT
/begin COMPU_METHOD MC_MAP_ORH_CNTR "MAP_ORH_CNTR conversion" RAT_FUNC "%10.0" "Unitless" COEFFS 0 1 0 0 0 1 /end COMPU_METHOD
/begin MEASUREMENT MAP_ORL_CNTR "Manifold Pressure out of range low counter" SLONG MC_MAP_ORL_CNTR 0 0 0 0 ECU_ADDRESS 0x3FA0A8 /end MEASUREMENT
/begin COMPU_METHOD MC_MAP_ORL_CNTR "MAP_ORL_CNTR conversion" RAT_FUNC "%10.0" "Unitless" COEFFS 0 1 0 0 0 1 /end COMPU_METHOD
/begin MEASUREMENT MAP_RAW_KPA "Manifold Pressure, without any FMEM correction, kPA" FLOAT32_IEEE MC_MAP_RAW_KPA 0 0 0 0 ECU_ADDRESS 0x3FA9DC /end MEASUREMENT
/begin COMPU_METHOD MC_MAP_RAW_KPA "MAP_RAW_KPA conversion" RAT_FUNC "%10.5" "Unitless" COEFFS 0 1 0 0 0 1 /end COMPU_METHOD
/begin CHARACTERISTIC MAP_REC_INC "MAP fault recovery counter increment value" VALUE 0x56624 SD_SLONG 0 SC_MAP_REC_INC 0 65535 /end CHARACTERISTIC
/begin COMPU_METHOD SC_MAP_REC_INC "MAP_REC_INC conversion" RAT_FUNC "%10.0" "unitless" COEFFS 0 1 0 0 0 1 /end COMPU_METHOD
/begin MEASUREMENT MAP_STATUS "Status of Manifold Pressure high level driver ( 0 = ok )" UBYTE MC_MAP_STATUS 0 0 0 0 ECU_ADDRESS 0x3FA9E8 /end MEASUREMENT
/begin COMPU_METHOD MC_MAP_STATUS "MAP_STATUS conversion" RAT_FUNC "%3.0" "Unitless" COEFFS 0 1 0 0 0 1 /end COMPU_METHOD
/begin CHARACTERISTIC MAP_TCREC_SEL "Switch to select MAP filter time constant during fault recovery and during fault occurance before malf is set" VALUE 0x56638 SD_UBYTE 0 SC_MAP_TCREC_SEL 0 1 /end CHARACTERISTIC
/begin COMPU_METHOD SC_MAP_TCREC_SEL "MAP_TCREC_SEL conversion" RAT_FUNC "%3.0" "unitless" COEFFS 0 1 0 0 0 1 /end COMPU_METHOD
/begin MEASUREMENT MAP_VOLTAGE "MAP sensor voltage seen at A to D input channel" FLOAT32_IEEE MC_MAP_VOLTAGE 0 0 0 0 ECU_ADDRESS 0x3FA9E0 /end MEASUREMENT
/begin COMPU_METHOD MC_MAP_VOLTAGE "MAP_VOLTAGE conversion" RAT_FUNC "%10.5" "Unitless" COEFFS 0 1 0 0 0 1 /end COMPU_METHOD
/begin MEASUREMENT MAP_VOLTS "MAP sensor voltage seen at A to D input channel" FLOAT32_IEEE MC_MAP_VOLTS 0 0 0 0 ECU_ADDRESS 0x3FA9E4 /end MEASUREMENT
/begin COMPU_METHOD MC_MAP_VOLTS "MAP_VOLTS conversion" RAT_FUNC "%10.5" "Unitless" COEFFS 0 1 0 0 0 1 /end COMPU_METHOD
/begin MEASUREMENT MAT "Manifold Absolute Temperature. (DEGREES C)" FLOAT32_IEEE MC_MAT 0 0 0 0 ECU_ADDRESS 0x3FA0E8 /end MEASUREMENT
/begin COMPU_METHOD MC_MAT "MAT conversion" RAT_FUNC "%10.5" "Unitless" COEFFS 0 1 0 0 0 1 /end COMPU_METHOD
/begin CHARACTERISTIC MAT_AC_OFF "MAT above which cutoff is active" VALUE 0x56260 SD_FLOAT32_IEEE 0 SC_MAT_AC_OFF -110 110 /end CHARACTERISTIC
/begin COMPU_METHOD SC_MAT_AC_OFF "MAT_AC_OFF conversion" RAT_FUNC "%10.5" "degC" COEFFS 0 1 0 0 0 1 /end COMPU_METHOD
/begin CHARACTERISTIC MAT_AD_TC "Manifold temperature filter time constant" VALUE 0x56640 SD_FLOAT32_IEEE 0 SC_MAT_AD_TC 0 64 /end CHARACTERISTIC
/begin COMPU_METHOD SC_MAT_AD_TC "MAT_AD_TC conversion" RAT_FUNC "%10.5" "s" COEFFS 0 1 0 0 0 1 /end COMPU_METHOD
/begin MEASUREMENT MAT_CNTS "Manifold Air Temperature A/D input." SLONG MC_MAT_CNTS 0 0 0 0 ECU_ADDRESS 0x3FA9B4 /end MEASUREMENT
/begin COMPU_METHOD MC_MAT_CNTS "MAT_CNTS conversion" RAT_FUNC "%10.0" "Unitless" COEFFS 0 1 0 0 0 1 /end COMPU_METHOD
/begin CHARACTERISTIC MAT_DEF "Default FMEM value for manifold temperature" VALUE 0x56648 SD_FLOAT32_IEEE 0 SC_MAT_DEF -40 150 /end CHARACTERISTIC
/begin COMPU_METHOD SC_MAT_DEF "MAT_DEF conversion" RAT_FUNC "%10.5" "degC" COEFFS 0 1 0 0 0 1 /end COMPU_METHOD
/begin MEASUREMENT MAT_ENG_C "Engine Coolant Temperature without any FMEM modifications, degrees C" FLOAT32_IEEE MC_MAT_ENG_C 0 0 0 0 ECU_ADDRESS 0x3FA9B8 /end MEASUREMENT
/begin COMPU_METHOD MC_MAT_ENG_C "MAT_ENG_C conversion" RAT_FUNC "%10.5" "Unitless" COEFFS 0 1 0 0 0 1 /end COMPU_METHOD
/begin MEASUREMENT MAT_FILT_TIME_CONST "MAT filter time constant" FLOAT32_IEEE MC_MAT_FILT_TIME_CONST 0 0 0 0 ECU_ADDRESS 0x3FA0E0 /end MEASUREMENT
/begin COMPU_METHOD MC_MAT_FILT_TIME_CONST "MAT_FILT_TIME_CONST conversion" RAT_FUNC "%10.5" "Unitless" COEFFS 0 1 0 0 0 1 /end COMPU_METHOD
/begin MEASUREMENT MAT_FLT_RECOVERY_CNTR "MAT fault recovery counter" SLONG MC_MAT_FLT_RECOVERY_CNTR 0 0 0 0 ECU_ADDRESS 0x3FA0CC /end MEASUREMENT
/begin COMPU_METHOD MC_MAT_FLT_RECOVERY_CNTR "MAT_FLT_RECOVERY_CNTR conversion" RAT_FUNC "%10.0" "Unitless" COEFFS 0 1 0 0 0 1 /end COMPU_METHOD
/begin MEASUREMENT MAT_FLT_RECOVERY_FLG "1-> Indicates MAT fault recovery is occuring" UBYTE MC_MAT_FLT_RECOVERY_FLG 0 0 0 0 ECU_ADDRESS 0x3FA0EC /end MEASUREMENT
/begin COMPU_METHOD MC_MAT_FLT_RECOVERY_FLG "MAT_FLT_RECOVERY_FLG conversion" RAT_FUNC "%3.0" "Unitless" COEFFS 0 1 0 0 0 1 /end COMPU_METHOD
/begin CHARACTERISTIC MAT_F_DEC "MAT malf failure/update counter decrement value" VALUE 0x56670 SD_SLONG 0 SC_MAT_F_DEC 0 65535 /end CHARACTERISTIC
/begin COMPU_METHOD SC_MAT_F_DEC "MAT_F_DEC conversion" RAT_FUNC "%10.0" "unitless" COEFFS 0 1 0 0 0 1 /end COMPU_METHOD
/begin CHARACTERISTIC MAT_F_INC "MAT ORH/ORL failure counter increment value" VALUE 0x56674 SD_SLONG 0 SC_MAT_F_INC 0 65535 /end CHARACTERISTIC
/begin COMPU_METHOD SC_MAT_F_INC "MAT_F_INC conversion" RAT_FUNC "%10.0" "unitless" COEFFS 0 1 0 0 0 1 /end COMPU_METHOD
/begin CHARACTERISTIC MAT_HI_VOLTS "Maximum acceptable voltage for MAT sensor" VALUE 0x5735C SD_FLOAT32_IEEE 0 SC_MAT_HI_VOLTS 0 5 /end CHARACTERISTIC
/begin COMPU_METHOD SC_MAT_HI_VOLTS "MAT_HI_VOLTS conversion" RAT_FUNC "%10.5" "V" COEFFS 0 1 0 0 0 1 /end COMPU_METHOD
/begin CHARACTERISTIC MAT_LO_VOLTS "Minimum acceptable voltage for MAT sensor" VALUE 0x57360 SD_FLOAT32_IEEE 0 SC_MAT_LO_VOLTS 0 5 /end CHARACTERISTIC
/begin COMPU_METHOD SC_MAT_LO_VOLTS "MAT_LO_VOLTS conversion" RAT_FUNC "%10.5" "V" COEFFS 0 1 0 0 0 1 /end COMPU_METHOD
/begin MEASUREMENT MAT_MALF_SET "Indicate MAT malf  high or low failure" UBYTE MC_MAT_MALF_SET 0 0 0 0 ECU_ADDRESS 0x3FA0EE /end MEASUREMENT
/begin COMPU_METHOD MC_MAT_MALF_SET "MAT_MALF_SET conversion" RAT_FUNC "%3.0" "Unitless" COEFFS 0 1 0 0 0 1 /end COMPU_METHOD
/begin MEASUREMENT MAT_ORH_CNTR "Manifold Temperature out of range high counter" SLONG MC_MAT_ORH_CNTR 0 0 0 0 ECU_ADDRESS 0x3FA0DC /end MEASUREMENT
/begin COMPU_METHOD MC_MAT_ORH_CNTR "MAT_ORH_CNTR conversion" RAT_FUNC "%10.0" "Unitless" COEFFS 0 1 0 0 0 1 /end COMPU_METHOD
/begin MEASUREMENT MAT_ORL_CNTR "Manifold Temperature out of range low counter" SLONG MC_MAT_ORL_CNTR 0 0 0 0 ECU_ADDRESS 0x3FA0D8 /end MEASUREMENT
/begin COMPU_METHOD MC_MAT_ORL_CNTR "MAT_ORL_CNTR conversion" RAT_FUNC "%10.0" "Unitless" COEFFS 0 1 0 0 0 1 /end COMPU_METHOD
/begin CHARACTERISTIC MAT_REC_INC "MAT fault recovery counter increment value" VALUE 0x56644 SD_SLONG 0 SC_MAT_REC_INC 0 65535 /end CHARACTERISTIC
/begin COMPU_METHOD SC_MAT_REC_INC "MAT_REC_INC conversion" RAT_FUNC "%10.0" "unitless" COEFFS 0 1 0 0 0 1 /end COMPU_METHOD
/begin MEASUREMENT MAT_STATUS "Status of the manifold temperature high level driver" UBYTE MC_MAT_STATUS 0 0 0 0 ECU_ADDRESS 0x3FA9BC /end MEASUREMENT
/begin COMPU_METHOD MC_MAT_STATUS "MAT_STATUS conversion" RAT_FUNC "%3.0" "Unitless" COEFFS 0 1 0 0 0 1 /end COMPU_METHOD
/begin CHARACTERISTIC MAT_TCREC_SEL "Switch to select MAT filter time constant during fault recovery and during fault occurance before malf is set" VALUE 0x5664C SD_UBYTE 0 SC_MAT_TCREC_SEL 0 1 /end CHARACTERISTIC
/begin COMPU_METHOD SC_MAT_TCREC_SEL "MAT_TCREC_SEL conversion" RAT_FUNC "%3.0" "unitless" COEFFS 0 1 0 0 0 1 /end COMPU_METHOD
/begin MEASUREMENT MAX_BRK_REQ "Engine speed at which maximum possible torque is requested" FLOAT32_IEEE MC_MAX_BRK_REQ 0 0 0 0 ECU_ADDRESS 0x3FAFB0 /end MEASUREMENT
/begin COMPU_METHOD MC_MAX_BRK_REQ "MAX_BRK_REQ conversion" RAT_FUNC "%10.5" "Unitless" COEFFS 0 1 0 0 0 1 /end COMPU_METHOD
/begin MEASUREMENT MED_ALT_BP_MULT "Medium Altitude Barometric Pressure Multiplier." FLOAT32_IEEE MC_MED_ALT_BP_MULT 0 0 0 0 ECU_ADDRESS 0x3F9F58 /end MEASUREMENT
/begin COMPU_METHOD MC_MED_ALT_BP_MULT "MED_ALT_BP_MULT conversion" RAT_FUNC "%10.5" "Unitless" COEFFS 0 1 0 0 0 1 /end COMPU_METHOD
/begin MEASUREMENT MFBLK "Smoke limited mass fuel quantity (mg/stroke)" FLOAT32_IEEE MC_MFBLK 0 0 0 0 ECU_ADDRESS 0x3FA330 /end MEASUREMENT
/begin COMPU_METHOD MC_MFBLK "MFBLK conversion" RAT_FUNC "%10.5" "Unitless" COEFFS 0 1 0 0 0 1 /end COMPU_METHOD
/begin MEASUREMENT MFBLK_AFR "" FLOAT32_IEEE MC_MFBLK_AFR 0 0 0 0 ECU_ADDRESS 0x3FA338 /end MEASUREMENT
/begin COMPU_METHOD MC_MFBLK_AFR "MFBLK_AFR conversion" RAT_FUNC "%10.5" "Unitless" COEFFS 0 1 0 0 0 1 /end COMPU_METHOD
/begin MEASUREMENT MFBLK_MGP "" FLOAT32_IEEE MC_MFBLK_MGP 0 0 0 0 ECU_ADDRESS 0x3FA334 /end MEASUREMENT
/begin COMPU_METHOD MC_MFBLK_MGP "MFBLK_MGP conversion" RAT_FUNC "%10.5" "Unitless" COEFFS 0 1 0 0 0 1 /end COMPU_METHOD
/begin MEASUREMENT MFBLK_PI "" FLOAT32_IEEE MC_MFBLK_PI 0 0 0 0 ECU_ADDRESS 0x3FA348 /end MEASUREMENT
/begin COMPU_METHOD MC_MFBLK_PI "MFBLK_PI conversion" RAT_FUNC "%10.5" "Unitless" COEFFS 0 1 0 0 0 1 /end COMPU_METHOD
/begin MEASUREMENT MFBLK_PI_HI_ALT "" FLOAT32_IEEE MC_MFBLK_PI_HI_ALT 0 0 0 0 ECU_ADDRESS 0x3FA378 /end MEASUREMENT
/begin COMPU_METHOD MC_MFBLK_PI_HI_ALT "MFBLK_PI_HI_ALT conversion" RAT_FUNC "%10.5" "Unitless" COEFFS 0 1 0 0 0 1 /end COMPU_METHOD
/begin MEASUREMENT MFBLK_PI_LO_ALT "" FLOAT32_IEEE MC_MFBLK_PI_LO_ALT 0 0 0 0 ECU_ADDRESS 0x3FA370 /end MEASUREMENT
/begin COMPU_METHOD MC_MFBLK_PI_LO_ALT "MFBLK_PI_LO_ALT conversion" RAT_FUNC "%10.5" "Unitless" COEFFS 0 1 0 0 0 1 /end COMPU_METHOD
/begin MEASUREMENT MFBLK_PI_MED_ALT "" FLOAT32_IEEE MC_MFBLK_PI_MED_ALT 0 0 0 0 ECU_ADDRESS 0x3FA374 /end MEASUREMENT
/begin COMPU_METHOD MC_MFBLK_PI_MED_ALT "MFBLK_PI_MED_ALT conversion" RAT_FUNC "%10.5" "Unitless" COEFFS 0 1 0 0 0 1 /end COMPU_METHOD
/begin CHARACTERISTIC MFBLK_SEL "" VALUE 0x56A20 SD_UBYTE 0 SC_MFBLK_SEL 0 4 /end CHARACTERISTIC
/begin COMPU_METHOD SC_MFBLK_SEL "MFBLK_SEL conversion" RAT_FUNC "%3.0" "unitless" COEFFS 0 1 0 0 0 1 /end COMPU_METHOD
/begin MEASUREMENT MFBLK_SS "" FLOAT32_IEEE MC_MFBLK_SS 0 0 0 0 ECU_ADDRESS 0x3FA34C /end MEASUREMENT
/begin COMPU_METHOD MC_MFBLK_SS "MFBLK_SS conversion" RAT_FUNC "%10.5" "Unitless" COEFFS 0 1 0 0 0 1 /end COMPU_METHOD
/begin MEASUREMENT MFBLK_SS_HI_ALT "" FLOAT32_IEEE MC_MFBLK_SS_HI_ALT 0 0 0 0 ECU_ADDRESS 0x3FA384 /end MEASUREMENT
/begin COMPU_METHOD MC_MFBLK_SS_HI_ALT "MFBLK_SS_HI_ALT conversion" RAT_FUNC "%10.5" "Unitless" COEFFS 0 1 0 0 0 1 /end COMPU_METHOD
/begin MEASUREMENT MFBLK_SS_LO_ALT "" FLOAT32_IEEE MC_MFBLK_SS_LO_ALT 0 0 0 0 ECU_ADDRESS 0x3FA37C /end MEASUREMENT
/begin COMPU_METHOD MC_MFBLK_SS_LO_ALT "MFBLK_SS_LO_ALT conversion" RAT_FUNC "%10.5" "Unitless" COEFFS 0 1 0 0 0 1 /end COMPU_METHOD
/begin MEASUREMENT MFBLK_SS_MED_ALT "" FLOAT32_IEEE MC_MFBLK_SS_MED_ALT 0 0 0 0 ECU_ADDRESS 0x3FA380 /end MEASUREMENT
/begin COMPU_METHOD MC_MFBLK_SS_MED_ALT "MFBLK_SS_MED_ALT conversion" RAT_FUNC "%10.5" "Unitless" COEFFS 0 1 0 0 0 1 /end COMPU_METHOD
/begin MEASUREMENT MFCRANK "Crank Timed Govenor mass fuel (mg/stroke)" FLOAT32_IEEE MC_MFCRANK 0 0 0 0 ECU_ADDRESS 0x3FA29C /end MEASUREMENT
/begin COMPU_METHOD MC_MFCRANK "MFCRANK conversion" RAT_FUNC "%10.5" "Unitless" COEFFS 0 1 0 0 0 1 /end COMPU_METHOD
/begin CHARACTERISTIC MFCRANK_LMX "Maximum timer based fuel adder (mg/stroke)" VALUE 0x56994 SD_FLOAT32_IEEE 0 SC_MFCRANK_LMX 0 160 /end CHARACTERISTIC
/begin COMPU_METHOD SC_MFCRANK_LMX "MFCRANK_LMX conversion" RAT_FUNC "%10.5" "unitless" COEFFS 0 1 0 0 0 1 /end COMPU_METHOD
/begin MEASUREMENT MFDES "Desired mass fuel quantity (mg/stroke)" FLOAT32_IEEE MC_MFDES 0 0 0 0 ECU_ADDRESS 0x3FA3D0 /end MEASUREMENT
/begin COMPU_METHOD MC_MFDES "MFDES conversion" RAT_FUNC "%10.5" "Unitless" COEFFS 0 1 0 0 0 1 /end COMPU_METHOD
/begin MEASUREMENT MFDES_NORM "" FLOAT32_IEEE MC_MFDES_NORM 0 0 0 0 ECU_ADDRESS 0x3FA8F4 /end MEASUREMENT
/begin COMPU_METHOD MC_MFDES_NORM "MFDES_NORM conversion" RAT_FUNC "%10.5" "Unitless" COEFFS 0 1 0 0 0 1 /end COMPU_METHOD
/begin CHARACTERISTIC MFDES_VGT_WARMUP "" VALUE 0x571D4 SD_FLOAT32_IEEE 0 SC_MFDES_VGT_WARMUP 0 100 /end CHARACTERISTIC
/begin COMPU_METHOD SC_MFDES_VGT_WARMUP "MFDES_VGT_WARMUP conversion" RAT_FUNC "%10.5" "unitless" COEFFS 0 1 0 0 0 1 /end COMPU_METHOD
/begin MEASUREMENT MFGOV "Governor mass fuel quantity (mg/stroke)" FLOAT32_IEEE MC_MFGOV 0 0 0 0 ECU_ADDRESS 0x3FA2B4 /end MEASUREMENT
/begin COMPU_METHOD MC_MFGOV "MFGOV conversion" RAT_FUNC "%10.5" "Unitless" COEFFS 0 1 0 0 0 1 /end COMPU_METHOD
/begin MEASUREMENT MFGOV_FF_ADD "Governor Adder for Drv/Neutral engagements" FLOAT32_IEEE MC_MFGOV_FF_ADD 0 0 0 0 ECU_ADDRESS 0x3FA2D0 /end MEASUREMENT
/begin COMPU_METHOD MC_MFGOV_FF_ADD "MFGOV_FF_ADD conversion" RAT_FUNC "%10.5" "Unitless" COEFFS 0 1 0 0 0 1 /end COMPU_METHOD
/begin MEASUREMENT MFGOV_FF_DN "Governor Adder for Drv/Neutral engagements" FLOAT32_IEEE MC_MFGOV_FF_DN 0 0 0 0 ECU_ADDRESS 0x3FA2CC /end MEASUREMENT
/begin COMPU_METHOD MC_MFGOV_FF_DN "MFGOV_FF_DN conversion" RAT_FUNC "%10.5" "Unitless" COEFFS 0 1 0 0 0 1 /end COMPU_METHOD
/begin MEASUREMENT MFGOV_FF_ND "Governor Adder for Neutral/Drv engagements" FLOAT32_IEEE MC_MFGOV_FF_ND 0 0 0 0 ECU_ADDRESS 0x3FA2C8 /end MEASUREMENT
/begin COMPU_METHOD MC_MFGOV_FF_ND "MFGOV_FF_ND conversion" RAT_FUNC "%10.5" "Unitless" COEFFS 0 1 0 0 0 1 /end COMPU_METHOD
/begin MEASUREMENT MFGOV_I "PI governor integral term value (mg/stroke)" FLOAT32_IEEE MC_MFGOV_I 0 0 0 0 ECU_ADDRESS 0x3FA2B0 /end MEASUREMENT
/begin COMPU_METHOD MC_MFGOV_I "MFGOV_I conversion" RAT_FUNC "%10.5" "Unitless" COEFFS 0 1 0 0 0 1 /end COMPU_METHOD
/begin MEASUREMENT MFGOV_P "PI governor proportional term value (mg/stroke)" FLOAT32_IEEE MC_MFGOV_P 0 0 0 0 ECU_ADDRESS 0x3FA2AC /end MEASUREMENT
/begin COMPU_METHOD MC_MFGOV_P "MFGOV_P conversion" RAT_FUNC "%10.5" "Unitless" COEFFS 0 1 0 0 0 1 /end COMPU_METHOD
/begin MEASUREMENT MFGOV_PI "PI governor fuel command (mg/stroke)" FLOAT32_IEEE MC_MFGOV_PI 0 0 0 0 ECU_ADDRESS 0x3FA2A8 /end MEASUREMENT
/begin COMPU_METHOD MC_MFGOV_PI "MFGOV_PI conversion" RAT_FUNC "%10.5" "Unitless" COEFFS 0 1 0 0 0 1 /end COMPU_METHOD
/begin MEASUREMENT MFGOV_TBL "Table gov fuel quantity (mg/stroke)" FLOAT32_IEEE MC_MFGOV_TBL 0 0 0 0 ECU_ADDRESS 0x3FA2A0 /end MEASUREMENT
/begin COMPU_METHOD MC_MFGOV_TBL "MFGOV_TBL conversion" RAT_FUNC "%10.5" "Unitless" COEFFS 0 1 0 0 0 1 /end COMPU_METHOD
/begin MEASUREMENT MFLMX "Mass fuel quantity maximum limit (mg/stroke)" FLOAT32_IEEE MC_MFLMX 0 0 0 0 ECU_ADDRESS 0x3FA3CC /end MEASUREMENT
/begin COMPU_METHOD MC_MFLMX "MFLMX conversion" RAT_FUNC "%10.5" "Unitless" COEFFS 0 1 0 0 0 1 /end COMPU_METHOD
/begin CHARACTERISTIC MFL_MLT_LMN "" VALUE 0x56A18 SD_FLOAT32_IEEE 0 SC_MFL_MLT_LMN 0 200 /end CHARACTERISTIC
/begin COMPU_METHOD SC_MFL_MLT_LMN "MFL_MLT_LMN conversion" RAT_FUNC "%10.5" "unitless" COEFFS 0 1 0 0 0 1 /end COMPU_METHOD
/begin CHARACTERISTIC MFL_MLT_LMX "" VALUE 0x56A14 SD_FLOAT32_IEEE 0 SC_MFL_MLT_LMX 0 200 /end CHARACTERISTIC
/begin COMPU_METHOD SC_MFL_MLT_LMX "MFL_MLT_LMX conversion" RAT_FUNC "%10.5" "unitless" COEFFS 0 1 0 0 0 1 /end COMPU_METHOD
/begin MEASUREMENT MFMFLG "Flag indicating a mass air flow sensor failure" UBYTE MC_MFMFLG 0 0 0 0 ECU_ADDRESS 0x3FA157 /end MEASUREMENT
/begin COMPU_METHOD MC_MFMFLG "MFMFLG conversion" RAT_FUNC "%3.0" "Unitless" COEFFS 0 1 0 0 0 1 /end COMPU_METHOD
/begin MEASUREMENT MFMTQ "Maximum torque limited fuel (mg/stroke)" FLOAT32_IEEE MC_MFMTQ 0 0 0 0 ECU_ADDRESS 0x3FA3C8 /end MEASUREMENT
/begin COMPU_METHOD MC_MFMTQ "MFMTQ conversion" RAT_FUNC "%10.5" "Unitless" COEFFS 0 1 0 0 0 1 /end COMPU_METHOD
/begin CHARACTERISTIC MFMTQ_LMN "Minimum max torque value" VALUE 0x56A1C SD_FLOAT32_IEEE 0 SC_MFMTQ_LMN 0 50 /end CHARACTERISTIC
/begin COMPU_METHOD SC_MFMTQ_LMN "MFMTQ_LMN conversion" RAT_FUNC "%10.5" "unitless" COEFFS 0 1 0 0 0 1 /end COMPU_METHOD
/begin CHARACTERISTIC MFMTQ_LMX "Max torque fuel clipped" VALUE 0x56AB8 SD_FLOAT32_IEEE 0 SC_MFMTQ_LMX 50 127 /end CHARACTERISTIC
/begin COMPU_METHOD SC_MFMTQ_LMX "MFMTQ_LMX conversion" RAT_FUNC "%10.5" "unitless" COEFFS 0 1 0 0 0 1 /end COMPU_METHOD
/begin CHARACTERISTIC MFMTQ_OFST "Maximum torque curve offset" VALUE 0x56A10 SD_FLOAT32_IEEE 0 SC_MFMTQ_OFST -100 100 /end CHARACTERISTIC
/begin COMPU_METHOD SC_MFMTQ_OFST "MFMTQ_OFST conversion" RAT_FUNC "%10.5" "unitless" COEFFS 0 1 0 0 0 1 /end COMPU_METHOD
/begin MEASUREMENT MFMTQ_PI_HI_ALT "" FLOAT32_IEEE MC_MFMTQ_PI_HI_ALT 0 0 0 0 ECU_ADDRESS 0x3FA360 /end MEASUREMENT
/begin COMPU_METHOD MC_MFMTQ_PI_HI_ALT "MFMTQ_PI_HI_ALT conversion" RAT_FUNC "%10.5" "Unitless" COEFFS 0 1 0 0 0 1 /end COMPU_METHOD
/begin MEASUREMENT MFMTQ_PI_LO_ALT "" FLOAT32_IEEE MC_MFMTQ_PI_LO_ALT 0 0 0 0 ECU_ADDRESS 0x3FA358 /end MEASUREMENT
/begin COMPU_METHOD MC_MFMTQ_PI_LO_ALT "MFMTQ_PI_LO_ALT conversion" RAT_FUNC "%10.5" "Unitless" COEFFS 0 1 0 0 0 1 /end COMPU_METHOD
/begin MEASUREMENT MFMTQ_PI_MED_ALT "" FLOAT32_IEEE MC_MFMTQ_PI_MED_ALT 0 0 0 0 ECU_ADDRESS 0x3FA35C /end MEASUREMENT
/begin COMPU_METHOD MC_MFMTQ_PI_MED_ALT "MFMTQ_PI_MED_ALT conversion" RAT_FUNC "%10.5" "Unitless" COEFFS 0 1 0 0 0 1 /end COMPU_METHOD
/begin MEASUREMENT MFMTQ_SS_HI_ALT "" FLOAT32_IEEE MC_MFMTQ_SS_HI_ALT 0 0 0 0 ECU_ADDRESS 0x3FA36C /end MEASUREMENT
/begin COMPU_METHOD MC_MFMTQ_SS_HI_ALT "MFMTQ_SS_HI_ALT conversion" RAT_FUNC "%10.5" "Unitless" COEFFS 0 1 0 0 0 1 /end COMPU_METHOD
/begin MEASUREMENT MFMTQ_SS_LO_ALT "" FLOAT32_IEEE MC_MFMTQ_SS_LO_ALT 0 0 0 0 ECU_ADDRESS 0x3FA364 /end MEASUREMENT
/begin COMPU_METHOD MC_MFMTQ_SS_LO_ALT "MFMTQ_SS_LO_ALT conversion" RAT_FUNC "%10.5" "Unitless" COEFFS 0 1 0 0 0 1 /end COMPU_METHOD
/begin MEASUREMENT MFMTQ_SS_MED_ALT "" FLOAT32_IEEE MC_MFMTQ_SS_MED_ALT 0 0 0 0 ECU_ADDRESS 0x3FA368 /end MEASUREMENT
/begin COMPU_METHOD MC_MFMTQ_SS_MED_ALT "MFMTQ_SS_MED_ALT conversion" RAT_FUNC "%10.5" "Unitless" COEFFS 0 1 0 0 0 1 /end COMPU_METHOD
/begin MEASUREMENT MFREF "Iso mass fuel ref quantity (mg/stroke)" FLOAT32_IEEE MC_MFREF 0 0 0 0 ECU_ADDRESS 0x3FA294 /end MEASUREMENT
/begin COMPU_METHOD MC_MFREF "MFREF conversion" RAT_FUNC "%10.5" "Unitless" COEFFS 0 1 0 0 0 1 /end COMPU_METHOD
/begin MEASUREMENT MF_CLAMP "Crank Timed Govenor mass fuel (mg/stroke)" FLOAT32_IEEE MC_MF_CLAMP 0 0 0 0 ECU_ADDRESS 0x3FA298 /end MEASUREMENT
/begin COMPU_METHOD MC_MF_CLAMP "MF_CLAMP conversion" RAT_FUNC "%10.5" "Unitless" COEFFS 0 1 0 0 0 1 /end COMPU_METHOD
/begin MEASUREMENT MF_FF_DN_TM "Drv/Neutral engagement time" FLOAT32_IEEE MC_MF_FF_DN_TM 0 0 0 0 ECU_ADDRESS 0x3FA2C4 /end MEASUREMENT
/begin COMPU_METHOD MC_MF_FF_DN_TM "MF_FF_DN_TM conversion" RAT_FUNC "%10.5" "Unitless" COEFFS 0 1 0 0 0 1 /end COMPU_METHOD
/begin MEASUREMENT MF_FF_DN_TMR "timer for Drive/Neutral engagement" ULONG MC_MF_FF_DN_TMR 0 0 0 0 ECU_ADDRESS 0x3FA3F4 /end MEASUREMENT
/begin COMPU_METHOD MC_MF_FF_DN_TMR "MF_FF_DN_TMR conversion" RAT_FUNC "%10.0" "Unitless" COEFFS 0 1 0 0 0 1 /end COMPU_METHOD
/begin MEASUREMENT MF_FF_ND_TM "Neutral/Drv engagement time" FLOAT32_IEEE MC_MF_FF_ND_TM 0 0 0 0 ECU_ADDRESS 0x3FA2C0 /end MEASUREMENT
/begin COMPU_METHOD MC_MF_FF_ND_TM "MF_FF_ND_TM conversion" RAT_FUNC "%10.5" "Unitless" COEFFS 0 1 0 0 0 1 /end COMPU_METHOD
/begin MEASUREMENT MF_FF_ND_TMR "timer for Neutral/Drive engagement" ULONG MC_MF_FF_ND_TMR 0 0 0 0 ECU_ADDRESS 0x3FA3F8 /end MEASUREMENT
/begin COMPU_METHOD MC_MF_FF_ND_TMR "MF_FF_ND_TMR conversion" RAT_FUNC "%10.0" "Unitless" COEFFS 0 1 0 0 0 1 /end COMPU_METHOD
/begin MEASUREMENT MGP "Manifold Gage Pressure (in KPA)" FLOAT32_IEEE MC_MGP 0 0 0 0 ECU_ADDRESS 0x3FA0B0 /end MEASUREMENT
/begin COMPU_METHOD MC_MGP "MGP conversion" RAT_FUNC "%10.5" "Unitless" COEFFS 0 1 0 0 0 1 /end COMPU_METHOD
/begin CHARACTERISTIC MILLIM "SWITCH TO CAL IN/OUT THE MIL BULB CHECK UNITLESS" VALUE 0x56345 SD_UBYTE 0 SC_MILLIM 0 1 /end CHARACTERISTIC
/begin COMPU_METHOD SC_MILLIM "MILLIM conversion" RAT_FUNC "%3.0" "unitless" COEFFS 0 1 0 0 0 1 /end COMPU_METHOD
/begin MEASUREMENT MIL_CTRL "MIL light control state encoded register. 0=OFF, 1=ON, 2=FLASHING." UBYTE MC_MIL_CTRL 0 0 0 0 ECU_ADDRESS 0x3F9ED4 /end MEASUREMENT
/begin COMPU_METHOD MC_MIL_CTRL "MIL_CTRL conversion" RAT_FUNC "%3.0" "Unitless" COEFFS 0 1 0 0 0 1 /end COMPU_METHOD
/begin MEASUREMENT MIL_ODO "Distance traveled since MIL is illuminated." UWORD MC_MIL_ODO 0 0 0 0 ECU_ADDRESS 0x3FAEF0 /end MEASUREMENT
/begin COMPU_METHOD MC_MIL_ODO "MIL_ODO conversion" RAT_FUNC "%5.0" "Unitless" COEFFS 0 1 0 0 0 1 /end COMPU_METHOD
/begin CHARACTERISTIC MIL_ODO_SW "Distance traveled since MIL illumination switch." VALUE 0x563EC SD_UBYTE 0 SC_MIL_ODO_SW 0 1 /end CHARACTERISTIC
/begin COMPU_METHOD SC_MIL_ODO_SW "MIL_ODO_SW conversion" RAT_FUNC "%3.0" "unitless" COEFFS 0 1 0 0 0 1 /end COMPU_METHOD
/begin MEASUREMENT MIL_ON "OBDII MIL status flag. (bit 7 of READY_FLAGS; 1 => MIL is on)" UBYTE MC_MIL_ON 0 0 0 0 ECU_ADDRESS 0x3FAEB9 /end MEASUREMENT
/begin COMPU_METHOD MC_MIL_ON "MIL_ON conversion" RAT_FUNC "%3.0" "Unitless" COEFFS 0 1 0 0 0 1 /end COMPU_METHOD
/begin CHARACTERISTIC MIL_SW "MIL enable switch" VALUE 0x56346 SD_UBYTE 0 SC_MIL_SW 0 2 /end CHARACTERISTIC
/begin COMPU_METHOD SC_MIL_SW "MIL_SW conversion" RAT_FUNC "%3.0" "group_of_bits" COEFFS 0 1 0 0 0 1 /end COMPU_METHOD
/begin MEASUREMENT MIN_BRK_REQ "Engine speed at which minimum possible torque is requested" FLOAT32_IEEE MC_MIN_BRK_REQ 0 0 0 0 ECU_ADDRESS 0x3FAFB4 /end MEASUREMENT
/begin COMPU_METHOD MC_MIN_BRK_REQ "MIN_BRK_REQ conversion" RAT_FUNC "%10.5" "Unitless" COEFFS 0 1 0 0 0 1 /end COMPU_METHOD
/begin CHARACTERISTIC MIN_ON_TIM_D "Minimum A/C  on time before cutout logic can reactivate" VALUE 0x56250 SD_FLOAT32_IEEE 0 SC_MIN_ON_TIM_D 0 63.999 /end CHARACTERISTIC
/begin COMPU_METHOD SC_MIN_ON_TIM_D "MIN_ON_TIM_D conversion" RAT_FUNC "%10.5" "s" COEFFS 0 1 0 0 0 1 /end COMPU_METHOD
/begin MEASUREMENT MISFIRING "Misfire status flag. (1 => misfire currently occurring)" UBYTE MC_MISFIRING 0 0 0 0 ECU_ADDRESS 0x3FADD4 /end MEASUREMENT
/begin COMPU_METHOD MC_MISFIRING "MISFIRING conversion" RAT_FUNC "%3.0" "Unitless" COEFFS 0 1 0 0 0 1 /end COMPU_METHOD
/begin MEASUREMENT MIS_ER_ENA "Flag to signal the Misfire test to do engine running on demand test." UBYTE MC_MIS_ER_ENA 0 0 0 0 ECU_ADDRESS 0x3FAB8D /end MEASUREMENT
/begin COMPU_METHOD MC_MIS_ER_ENA "MIS_ER_ENA conversion" RAT_FUNC "%3.0" "Unitless" COEFFS 0 1 0 0 0 1 /end COMPU_METHOD
/begin MEASUREMENT MIS_FCO_FLG "Flag indicating FMEM action is being taken during type A misfire." UBYTE MC_MIS_FCO_FLG 0 0 0 0 ECU_ADDRESS 0x3FADD5 /end MEASUREMENT
/begin COMPU_METHOD MC_MIS_FCO_FLG "MIS_FCO_FLG conversion" RAT_FUNC "%3.0" "Unitless" COEFFS 0 1 0 0 0 1 /end COMPU_METHOD
/begin MEASUREMENT MIS_FMEM "MIS system FMEM flag.  1 -> don't run MIS monitor due to FMEM." UBYTE MC_MIS_FMEM 0 0 0 0 ECU_ADDRESS 0x3F9F00 /end MEASUREMENT
/begin COMPU_METHOD MC_MIS_FMEM "MIS_FMEM conversion" RAT_FUNC "%3.0" "Unitless" COEFFS 0 1 0 0 0 1 /end COMPU_METHOD
/begin MEASUREMENT MIS_MON "obdII misfire test monior complete for trip indication" UBYTE MC_MIS_MON 0 0 0 0 ECU_ADDRESS 0x3FADD6 /end MEASUREMENT
/begin COMPU_METHOD MC_MIS_MON "MIS_MON conversion" RAT_FUNC "%3.0" "Unitless" COEFFS 0 1 0 0 0 1 /end COMPU_METHOD
/begin MEASUREMENT MIS_TST_ENA "OBD-II Misfire Test enable flag. (1 => test enabled)" UBYTE MC_MIS_TST_ENA 0 0 0 0 ECU_ADDRESS 0x3F9EE0 /end MEASUREMENT
/begin COMPU_METHOD MC_MIS_TST_ENA "MIS_TST_ENA conversion" RAT_FUNC "%3.0" "Unitless" COEFFS 0 1 0 0 0 1 /end COMPU_METHOD
/begin MEASUREMENT MODE "HOT MODE" UBYTE MC_MODE 0 0 0 0 ECU_ADDRESS 0x3FA3DF /end MEASUREMENT
/begin COMPU_METHOD MC_MODE "MODE conversion" RAT_FUNC "%3.0" "Unitless" COEFFS 0 1 0 0 0 1 /end COMPU_METHOD
/begin CHARACTERISTIC MODE08MAP_1 "Bit mapped map indicating Mode 08 test ID supported (Top bit = test id 1, bottom bit = test id 8).  (Bit set = test enabled)." VALUE 0x5775F SD_UBYTE 0 SC_MODE08MAP_1 0 255 /end CHARACTERISTIC
/begin COMPU_METHOD SC_MODE08MAP_1 "MODE08MAP_1 conversion" RAT_FUNC "%3.0" "unitless" COEFFS 0 1 0 0 0 1 /end COMPU_METHOD
/begin CHARACTERISTIC MODE08MAP_2 "Bit mapped map indicating Mode 08 test ID supported (Top bit = test id 9, bottom bit = test id 16).  (Bit set = test enabled)." VALUE 0x5775E SD_UBYTE 0 SC_MODE08MAP_2 0 255 /end CHARACTERISTIC
/begin COMPU_METHOD SC_MODE08MAP_2 "MODE08MAP_2 conversion" RAT_FUNC "%3.0" "unitless" COEFFS 0 1 0 0 0 1 /end COMPU_METHOD
/begin CHARACTERISTIC MODE08MAP_3 "Bit mapped map indicating Mode 08 test ID supported (Top bit = test id 17, bottom bit = test id 24).  (Bit set = test enabled)." VALUE 0x5775D SD_UBYTE 0 SC_MODE08MAP_3 0 255 /end CHARACTERISTIC
/begin COMPU_METHOD SC_MODE08MAP_3 "MODE08MAP_3 conversion" RAT_FUNC "%3.0" "unitless" COEFFS 0 1 0 0 0 1 /end COMPU_METHOD
/begin CHARACTERISTIC MODE08MAP_4 "Bit mapped map indicating Mode 08 test ID supported (Top bit = test id 25, bottom bit = test id 32).  (Bit set = test enabled)." VALUE 0x5775C SD_UBYTE 0 SC_MODE08MAP_4 0 255 /end CHARACTERISTIC
/begin COMPU_METHOD SC_MODE08MAP_4 "MODE08MAP_4 conversion" RAT_FUNC "%3.0" "unitless" COEFFS 0 1 0 0 0 1 /end COMPU_METHOD
/begin MEASUREMENT MODE09_CTR "Counter indicating the message number of a multiple message response to a MODE09 request." UBYTE MC_MODE09_CTR 0 0 0 0 ECU_ADDRESS 0x3FAB1A /end MEASUREMENT
/begin COMPU_METHOD MC_MODE09_CTR "MODE09_CTR conversion" RAT_FUNC "%3.0" "Unitless" COEFFS 0 1 0 0 0 1 /end COMPU_METHOD
/begin MEASUREMENT MODE8_DATA1 "Optional data byte sent via Mode 8" UBYTE MC_MODE8_DATA1 0 0 0 0 ECU_ADDRESS 0x3FAB1F /end MEASUREMENT
/begin COMPU_METHOD MC_MODE8_DATA1 "MODE8_DATA1 conversion" RAT_FUNC "%3.0" "Unitless" COEFFS 0 1 0 0 0 1 /end COMPU_METHOD
/begin MEASUREMENT MODE8_DATA2 "Optional data byte sent via Mode 8" UBYTE MC_MODE8_DATA2 0 0 0 0 ECU_ADDRESS 0x3FAB1E /end MEASUREMENT
/begin COMPU_METHOD MC_MODE8_DATA2 "MODE8_DATA2 conversion" RAT_FUNC "%3.0" "Unitless" COEFFS 0 1 0 0 0 1 /end COMPU_METHOD
/begin MEASUREMENT MODE8_DATA3 "Optional data byte sent via Mode 8" UBYTE MC_MODE8_DATA3 0 0 0 0 ECU_ADDRESS 0x3FAB1D /end MEASUREMENT
/begin COMPU_METHOD MC_MODE8_DATA3 "MODE8_DATA3 conversion" RAT_FUNC "%3.0" "Unitless" COEFFS 0 1 0 0 0 1 /end COMPU_METHOD
/begin MEASUREMENT MODE8_DATA4 "Optional data byte sent via Mode 8" UBYTE MC_MODE8_DATA4 0 0 0 0 ECU_ADDRESS 0x3FAB1C /end MEASUREMENT
/begin COMPU_METHOD MC_MODE8_DATA4 "MODE8_DATA4 conversion" RAT_FUNC "%3.0" "Unitless" COEFFS 0 1 0 0 0 1 /end COMPU_METHOD
/begin MEASUREMENT MODE8_DATA5 "Optional data byte sent via Mode 8" UBYTE MC_MODE8_DATA5 0 0 0 0 ECU_ADDRESS 0x3FAB1B /end MEASUREMENT
/begin COMPU_METHOD MC_MODE8_DATA5 "MODE8_DATA5 conversion" RAT_FUNC "%3.0" "Unitless" COEFFS 0 1 0 0 0 1 /end COMPU_METHOD
/begin MEASUREMENT MODE8_TESTID "TEST ID FOR J1979 MODE 8" UBYTE MC_MODE8_TESTID 0 0 0 0 ECU_ADDRESS 0x3FAB20 /end MEASUREMENT
/begin COMPU_METHOD MC_MODE8_TESTID "MODE8_TESTID conversion" RAT_FUNC "%3.0" "Unitless" COEFFS 0 1 0 0 0 1 /end COMPU_METHOD
/begin CHARACTERISTIC MPH_AC_LCH1 "Vehicle speed below which A/C cutout logic is active" VALUE 0x56268 SD_FLOAT32_IEEE 0 SC_MPH_AC_LCH1 0 127 /end CHARACTERISTIC
/begin COMPU_METHOD SC_MPH_AC_LCH1 "MPH_AC_LCH1 conversion" RAT_FUNC "%10.5" "MPH" COEFFS 0 1 0 0 0 1 /end COMPU_METHOD
/begin CHARACTERISTIC MPH_AC_LCH2 "Vehicle speed above which launch A/C cutout logic is deactivated" VALUE 0x56254 SD_FLOAT32_IEEE 0 SC_MPH_AC_LCH2 0 127 /end CHARACTERISTIC
/begin COMPU_METHOD SC_MPH_AC_LCH2 "MPH_AC_LCH2 conversion" RAT_FUNC "%10.5" "MPH" COEFFS 0 1 0 0 0 1 /end COMPU_METHOD
/begin MEASUREMENT MPH_FILT "Filtered vehicle speed in miles per hour" FLOAT32_IEEE MC_MPH_FILT 0 0 0 0 ECU_ADDRESS 0x3FA018 /end MEASUREMENT
/begin COMPU_METHOD MC_MPH_FILT "MPH_FILT conversion" RAT_FUNC "%10.5" "Unitless" COEFFS 0 1 0 0 0 1 /end COMPU_METHOD
/begin MEASUREMENT MPH_VS "Vehicle speed in miles per hour (unfiltered)" FLOAT32_IEEE MC_MPH_VS 0 0 0 0 ECU_ADDRESS 0x3FA01C /end MEASUREMENT
/begin COMPU_METHOD MC_MPH_VS "MPH_VS conversion" RAT_FUNC "%10.5" "Unitless" COEFFS 0 1 0 0 0 1 /end COMPU_METHOD
/begin MEASUREMENT N "Engine speed (RPM)." FLOAT32_IEEE MC_N 0 0 0 0 ECU_ADDRESS 0x3FA058 /end MEASUREMENT
/begin COMPU_METHOD MC_N "N conversion" RAT_FUNC "%10.5" "Unitless" COEFFS 0 1 0 0 0 1 /end COMPU_METHOD
/begin MEASUREMENT NACTMR "TIME AT P.T. OR WOT" FLOAT32_IEEE MC_NACTMR 0 0 0 0 ECU_ADDRESS 0x3FABC0 /end MEASUREMENT
/begin COMPU_METHOD MC_NACTMR "NACTMR conversion" RAT_FUNC "%10.5" "Unitless" COEFFS 0 1 0 0 0 1 /end COMPU_METHOD
/begin MEASUREMENT NBAR "ROLL. AVG. RPM" FLOAT32_IEEE MC_NBAR 0 0 0 0 ECU_ADDRESS 0x3FAC84 /end MEASUREMENT
/begin COMPU_METHOD MC_NBAR "NBAR conversion" RAT_FUNC "%10.5" "Unitless" COEFFS 0 1 0 0 0 1 /end COMPU_METHOD
/begin MEASUREMENT NCOLDIDLE "Output from FNCOLDIDL" FLOAT32_IEEE MC_NCOLDIDLE 0 0 0 0 ECU_ADDRESS 0x3FAF7C /end MEASUREMENT
/begin COMPU_METHOD MC_NCOLDIDLE "NCOLDIDLE conversion" RAT_FUNC "%10.5" "Unitless" COEFFS 0 1 0 0 0 1 /end COMPU_METHOD
/begin MEASUREMENT NCOLD_NLIDLE "Final 'COLD' idle term (RPM)" FLOAT32_IEEE MC_NCOLD_NLIDLE 0 0 0 0 ECU_ADDRESS 0x3FAF80 /end MEASUREMENT
/begin COMPU_METHOD MC_NCOLD_NLIDLE "NCOLD_NLIDLE conversion" RAT_FUNC "%10.5" "Unitless" COEFFS 0 1 0 0 0 1 /end COMPU_METHOD
/begin MEASUREMENT NDES "Desired Engine speed (RPM)" FLOAT32_IEEE MC_NDES 0 0 0 0 ECU_ADDRESS 0x3FAF98 /end MEASUREMENT
/begin COMPU_METHOD MC_NDES "NDES conversion" RAT_FUNC "%10.5" "Unitless" COEFFS 0 1 0 0 0 1 /end COMPU_METHOD
/begin MEASUREMENT NDSFLG "NEUTRAL/DRIVE flag; 1 -> drive." UBYTE MC_NDSFLG 0 0 0 0 ECU_ADDRESS 0x3FA156 /end MEASUREMENT
/begin COMPU_METHOD MC_NDSFLG "NDSFLG conversion" RAT_FUNC "%3.0" "Unitless" COEFFS 0 1 0 0 0 1 /end COMPU_METHOD
/begin MEASUREMENT ND_FF_TMRCTL "Governor 'FF' term for N/D timer flag (1=count)" UBYTE MC_ND_FF_TMRCTL 0 0 0 0 ECU_ADDRESS 0x3FA2EE /end MEASUREMENT
/begin COMPU_METHOD MC_ND_FF_TMRCTL "ND_FF_TMRCTL conversion" RAT_FUNC "%3.0" "Unitless" COEFFS 0 1 0 0 0 1 /end COMPU_METHOD
/begin MEASUREMENT NERR "Engine speed error (RPM)." FLOAT32_IEEE MC_NERR 0 0 0 0 ECU_ADDRESS 0x3FA290 /end MEASUREMENT
/begin COMPU_METHOD MC_NERR "NERR conversion" RAT_FUNC "%10.5" "Unitless" COEFFS 0 1 0 0 0 1 /end COMPU_METHOD
/begin MEASUREMENT NG_ACTIVE "Signal which is used to disable monitors affected by NG fuel." UBYTE MC_NG_ACTIVE 0 0 0 0 ECU_ADDRESS 0x3F9EDD /end MEASUREMENT
/begin COMPU_METHOD MC_NG_ACTIVE "NG_ACTIVE conversion" RAT_FUNC "%3.0" "Unitless" COEFFS 0 1 0 0 0 1 /end COMPU_METHOD
/begin CHARACTERISTIC NG_TST_SW "Mapped byte of sys_NG_SW flag bits in the order(0..7): {cat,ccm,purg,sair,fuel,ego,egr,mis}." VALUE 0x56381 SD_UBYTE 0 SC_NG_TST_SW 0 255 /end CHARACTERISTIC
/begin COMPU_METHOD SC_NG_TST_SW "NG_TST_SW conversion" RAT_FUNC "%3.0" "MAPPED_BYTE" COEFFS 0 1 0 0 0 1 /end COMPU_METHOD
/begin MEASUREMENT NHIDLE "High idle engine speed (RPM)" FLOAT32_IEEE MC_NHIDLE 0 0 0 0 ECU_ADDRESS 0x3FAF8C /end MEASUREMENT
/begin COMPU_METHOD MC_NHIDLE "NHIDLE conversion" RAT_FUNC "%10.5" "Unitless" COEFFS 0 1 0 0 0 1 /end COMPU_METHOD
/begin CHARACTERISTIC NIDES_LMX "Desired Engine speed max limit (RPM)" VALUE 0x56854 SD_FLOAT32_IEEE 0 SC_NIDES_LMX 3000 4000 /end CHARACTERISTIC
/begin COMPU_METHOD SC_NIDES_LMX "NIDES_LMX conversion" RAT_FUNC "%10.5" "RPM" COEFFS 0 1 0 0 0 1 /end COMPU_METHOD
/begin MEASUREMENT NLIDLE "Desired idle speed (rpm)" FLOAT32_IEEE MC_NLIDLE 0 0 0 0 ECU_ADDRESS 0x3FAF88 /end MEASUREMENT
/begin COMPU_METHOD MC_NLIDLE "NLIDLE conversion" RAT_FUNC "%10.5" "Unitless" COEFFS 0 1 0 0 0 1 /end COMPU_METHOD
/begin MEASUREMENT NLIDLE_HICAM "High-cam setpoint for idle speed" FLOAT32_IEEE MC_NLIDLE_HICAM 0 0 0 0 ECU_ADDRESS 0x3FAF84 /end MEASUREMENT
/begin COMPU_METHOD MC_NLIDLE_HICAM "NLIDLE_HICAM conversion" RAT_FUNC "%10.5" "Unitless" COEFFS 0 1 0 0 0 1 /end COMPU_METHOD
/begin MEASUREMENT NLMX "Max engine speed for upshift (RPM)" FLOAT32_IEEE MC_NLMX 0 0 0 0 ECU_ADDRESS 0x3FAF94 /end MEASUREMENT
/begin COMPU_METHOD MC_NLMX "NLMX conversion" RAT_FUNC "%10.5" "Unitless" COEFFS 0 1 0 0 0 1 /end COMPU_METHOD
/begin CHARACTERISTIC NMAX "Maximum engine speed in RPM" VALUE 0x56850 SD_FLOAT32_IEEE 0 SC_NMAX 2600 5000 /end CHARACTERISTIC
/begin COMPU_METHOD SC_NMAX "NMAX conversion" RAT_FUNC "%10.5" "RPM" COEFFS 0 1 0 0 0 1 /end COMPU_METHOD
/begin MEASUREMENT NORM_FN012 "" FLOAT32_IEEE MC_NORM_FN012 0 0 0 0 ECU_ADDRESS 0x3FA3AC /end MEASUREMENT
/begin COMPU_METHOD MC_NORM_FN012 "NORM_FN012 conversion" RAT_FUNC "%10.5" "Unitless" COEFFS 0 1 0 0 0 1 /end COMPU_METHOD
/begin MEASUREMENT NORM_FN012P "" FLOAT32_IEEE MC_NORM_FN012P 0 0 0 0 ECU_ADDRESS 0x3FA3A8 /end MEASUREMENT
/begin COMPU_METHOD MC_NORM_FN012P "NORM_FN012P conversion" RAT_FUNC "%10.5" "Unitless" COEFFS 0 1 0 0 0 1 /end COMPU_METHOD
/begin MEASUREMENT NORM_FN013 "" FLOAT32_IEEE MC_NORM_FN013 0 0 0 0 ECU_ADDRESS 0x3FA470 /end MEASUREMENT
/begin COMPU_METHOD MC_NORM_FN013 "NORM_FN013 conversion" RAT_FUNC "%10.5" "Unitless" COEFFS 0 1 0 0 0 1 /end COMPU_METHOD
/begin MEASUREMENT NORM_FN013P "" FLOAT32_IEEE MC_NORM_FN013P 0 0 0 0 ECU_ADDRESS 0x3FA468 /end MEASUREMENT
/begin COMPU_METHOD MC_NORM_FN013P "NORM_FN013P conversion" RAT_FUNC "%10.5" "Unitless" COEFFS 0 1 0 0 0 1 /end COMPU_METHOD
/begin MEASUREMENT NORM_FN014 "Normalized fn014 value" FLOAT32_IEEE MC_NORM_FN014 0 0 0 0 ECU_ADDRESS 0x3FA3C4 /end MEASUREMENT
/begin COMPU_METHOD MC_NORM_FN014 "NORM_FN014 conversion" RAT_FUNC "%10.5" "Unitless" COEFFS 0 1 0 0 0 1 /end COMPU_METHOD
/begin MEASUREMENT NORM_FN014P "Normalized fn014p value" FLOAT32_IEEE MC_NORM_FN014P 0 0 0 0 ECU_ADDRESS 0x3FA3C0 /end MEASUREMENT
/begin COMPU_METHOD MC_NORM_FN014P "NORM_FN014P conversion" RAT_FUNC "%10.5" "Unitless" COEFFS 0 1 0 0 0 1 /end COMPU_METHOD
/begin MEASUREMENT NORM_FN019 "" FLOAT32_IEEE MC_NORM_FN019 0 0 0 0 ECU_ADDRESS 0x3FA474 /end MEASUREMENT
/begin COMPU_METHOD MC_NORM_FN019 "NORM_FN019 conversion" RAT_FUNC "%10.5" "Unitless" COEFFS 0 1 0 0 0 1 /end COMPU_METHOD
/begin MEASUREMENT NORM_FN019P "" FLOAT32_IEEE MC_NORM_FN019P 0 0 0 0 ECU_ADDRESS 0x3FA46C /end MEASUREMENT
/begin COMPU_METHOD MC_NORM_FN019P "NORM_FN019P conversion" RAT_FUNC "%10.5" "Unitless" COEFFS 0 1 0 0 0 1 /end COMPU_METHOD
/begin MEASUREMENT NORM_FN021 "Normalized fn021 value" FLOAT32_IEEE MC_NORM_FN021 0 0 0 0 ECU_ADDRESS 0x3FA280 /end MEASUREMENT
/begin COMPU_METHOD MC_NORM_FN021 "NORM_FN021 conversion" RAT_FUNC "%10.5" "Unitless" COEFFS 0 1 0 0 0 1 /end COMPU_METHOD
/begin MEASUREMENT NORM_FN021P "Normalized fn021p value" FLOAT32_IEEE MC_NORM_FN021P 0 0 0 0 ECU_ADDRESS 0x3FA288 /end MEASUREMENT
/begin COMPU_METHOD MC_NORM_FN021P "NORM_FN021P conversion" RAT_FUNC "%10.5" "Unitless" COEFFS 0 1 0 0 0 1 /end COMPU_METHOD
/begin MEASUREMENT NORM_FN027 "Normalized value of EOT" FLOAT32_IEEE MC_NORM_FN027 0 0 0 0 ECU_ADDRESS 0x3FA4B0 /end MEASUREMENT
/begin COMPU_METHOD MC_NORM_FN027 "NORM_FN027 conversion" RAT_FUNC "%10.5" "Unitless" COEFFS 0 1 0 0 0 1 /end COMPU_METHOD
/begin MEASUREMENT NORM_FN030 "" FLOAT32_IEEE MC_NORM_FN030 0 0 0 0 ECU_ADDRESS 0x3FA3A4 /end MEASUREMENT
/begin COMPU_METHOD MC_NORM_FN030 "NORM_FN030 conversion" RAT_FUNC "%10.5" "Unitless" COEFFS 0 1 0 0 0 1 /end COMPU_METHOD
/begin MEASUREMENT NORM_FN030P "" FLOAT32_IEEE MC_NORM_FN030P 0 0 0 0 ECU_ADDRESS 0x3FA3A0 /end MEASUREMENT
/begin COMPU_METHOD MC_NORM_FN030P "NORM_FN030P conversion" RAT_FUNC "%10.5" "Unitless" COEFFS 0 1 0 0 0 1 /end COMPU_METHOD
/begin MEASUREMENT NORM_FN032 "" FLOAT32_IEEE MC_NORM_FN032 0 0 0 0 ECU_ADDRESS 0x3FA434 /end MEASUREMENT
/begin COMPU_METHOD MC_NORM_FN032 "NORM_FN032 conversion" RAT_FUNC "%10.5" "Unitless" COEFFS 0 1 0 0 0 1 /end COMPU_METHOD
/begin MEASUREMENT NORM_FN032P "" FLOAT32_IEEE MC_NORM_FN032P 0 0 0 0 ECU_ADDRESS 0x3FA43C /end MEASUREMENT
/begin COMPU_METHOD MC_NORM_FN032P "NORM_FN032P conversion" RAT_FUNC "%10.5" "Unitless" COEFFS 0 1 0 0 0 1 /end COMPU_METHOD
/begin MEASUREMENT NORM_FN033 "" FLOAT32_IEEE MC_NORM_FN033 0 0 0 0 ECU_ADDRESS 0x3FA438 /end MEASUREMENT
/begin COMPU_METHOD MC_NORM_FN033 "NORM_FN033 conversion" RAT_FUNC "%10.5" "Unitless" COEFFS 0 1 0 0 0 1 /end COMPU_METHOD
/begin MEASUREMENT NORM_FN033P "" FLOAT32_IEEE MC_NORM_FN033P 0 0 0 0 ECU_ADDRESS 0x3FA440 /end MEASUREMENT
/begin COMPU_METHOD MC_NORM_FN033P "NORM_FN033P conversion" RAT_FUNC "%10.5" "Unitless" COEFFS 0 1 0 0 0 1 /end COMPU_METHOD
/begin MEASUREMENT NORM_FN035 "Normalized fn035 value" FLOAT32_IEEE MC_NORM_FN035 0 0 0 0 ECU_ADDRESS 0x3FA284 /end MEASUREMENT
/begin COMPU_METHOD MC_NORM_FN035 "NORM_FN035 conversion" RAT_FUNC "%10.5" "Unitless" COEFFS 0 1 0 0 0 1 /end COMPU_METHOD
/begin MEASUREMENT NORM_FN035P "Normalized fn035p value" FLOAT32_IEEE MC_NORM_FN035P 0 0 0 0 ECU_ADDRESS 0x3FA28C /end MEASUREMENT
/begin COMPU_METHOD MC_NORM_FN035P "NORM_FN035P conversion" RAT_FUNC "%10.5" "Unitless" COEFFS 0 1 0 0 0 1 /end COMPU_METHOD
/begin MEASUREMENT NORM_FN038 "Normalized fn038 value" FLOAT32_IEEE MC_NORM_FN038 0 0 0 0 ECU_ADDRESS 0x3FA310 /end MEASUREMENT
/begin COMPU_METHOD MC_NORM_FN038 "NORM_FN038 conversion" RAT_FUNC "%10.5" "Unitless" COEFFS 0 1 0 0 0 1 /end COMPU_METHOD
/begin MEASUREMENT NORM_FN039 "Normalized fn039 value" FLOAT32_IEEE MC_NORM_FN039 0 0 0 0 ECU_ADDRESS 0x3FA314 /end MEASUREMENT
/begin COMPU_METHOD MC_NORM_FN039 "NORM_FN039 conversion" RAT_FUNC "%10.5" "Unitless" COEFFS 0 1 0 0 0 1 /end COMPU_METHOD
/begin MEASUREMENT NORM_FN052 "Normalized fn052 value" FLOAT32_IEEE MC_NORM_FN052 0 0 0 0 ECU_ADDRESS 0x3FA304 /end MEASUREMENT
/begin COMPU_METHOD MC_NORM_FN052 "NORM_FN052 conversion" RAT_FUNC "%10.5" "Unitless" COEFFS 0 1 0 0 0 1 /end COMPU_METHOD
/begin MEASUREMENT NORM_FN053 "Normalized fn053 value" FLOAT32_IEEE MC_NORM_FN053 0 0 0 0 ECU_ADDRESS 0x3FA308 /end MEASUREMENT
/begin COMPU_METHOD MC_NORM_FN053 "NORM_FN053 conversion" RAT_FUNC "%10.5" "Unitless" COEFFS 0 1 0 0 0 1 /end COMPU_METHOD
/begin MEASUREMENT NORM_FN055 "" FLOAT32_IEEE MC_NORM_FN055 0 0 0 0 ECU_ADDRESS 0x3FA458 /end MEASUREMENT
/begin COMPU_METHOD MC_NORM_FN055 "NORM_FN055 conversion" RAT_FUNC "%10.5" "Unitless" COEFFS 0 1 0 0 0 1 /end COMPU_METHOD
/begin MEASUREMENT NORM_FN056 "" FLOAT32_IEEE MC_NORM_FN056 0 0 0 0 ECU_ADDRESS 0x3FA454 /end MEASUREMENT
/begin COMPU_METHOD MC_NORM_FN056 "NORM_FN056 conversion" RAT_FUNC "%10.5" "Unitless" COEFFS 0 1 0 0 0 1 /end COMPU_METHOD
/begin MEASUREMENT NORM_FN057 "" FLOAT32_IEEE MC_NORM_FN057 0 0 0 0 ECU_ADDRESS 0x3FA450 /end MEASUREMENT
/begin COMPU_METHOD MC_NORM_FN057 "NORM_FN057 conversion" RAT_FUNC "%10.5" "Unitless" COEFFS 0 1 0 0 0 1 /end COMPU_METHOD
/begin MEASUREMENT NORM_FN058 "" FLOAT32_IEEE MC_NORM_FN058 0 0 0 0 ECU_ADDRESS 0x3FA44C /end MEASUREMENT
/begin COMPU_METHOD MC_NORM_FN058 "NORM_FN058 conversion" RAT_FUNC "%10.5" "Unitless" COEFFS 0 1 0 0 0 1 /end COMPU_METHOD
/begin MEASUREMENT NORM_FN059 "" FLOAT32_IEEE MC_NORM_FN059 0 0 0 0 ECU_ADDRESS 0x3FA448 /end MEASUREMENT
/begin COMPU_METHOD MC_NORM_FN059 "NORM_FN059 conversion" RAT_FUNC "%10.5" "Unitless" COEFFS 0 1 0 0 0 1 /end COMPU_METHOD
/begin MEASUREMENT NORM_FN060 "" FLOAT32_IEEE MC_NORM_FN060 0 0 0 0 ECU_ADDRESS 0x3FA444 /end MEASUREMENT
/begin COMPU_METHOD MC_NORM_FN060 "NORM_FN060 conversion" RAT_FUNC "%10.5" "Unitless" COEFFS 0 1 0 0 0 1 /end COMPU_METHOD
/begin MEASUREMENT NORM_FN064 "Normalized fn064 value" FLOAT32_IEEE MC_NORM_FN064 0 0 0 0 ECU_ADDRESS 0x3FA2F8 /end MEASUREMENT
/begin COMPU_METHOD MC_NORM_FN064 "NORM_FN064 conversion" RAT_FUNC "%10.5" "Unitless" COEFFS 0 1 0 0 0 1 /end COMPU_METHOD
/begin MEASUREMENT NORM_FN065 "Normalized fn065 value" FLOAT32_IEEE MC_NORM_FN065 0 0 0 0 ECU_ADDRESS 0x3FA2FC /end MEASUREMENT
/begin COMPU_METHOD MC_NORM_FN065 "NORM_FN065 conversion" RAT_FUNC "%10.5" "Unitless" COEFFS 0 1 0 0 0 1 /end COMPU_METHOD
/begin MEASUREMENT NORM_FN090P_AFR "" FLOAT32_IEEE MC_NORM_FN090P_AFR 0 0 0 0 ECU_ADDRESS 0x3FA3B8 /end MEASUREMENT
/begin COMPU_METHOD MC_NORM_FN090P_AFR "NORM_FN090P_AFR conversion" RAT_FUNC "%10.5" "Unitless" COEFFS 0 1 0 0 0 1 /end COMPU_METHOD
/begin MEASUREMENT NORM_FN090_AFR "Normalized fn090_afr value" FLOAT32_IEEE MC_NORM_FN090_AFR 0 0 0 0 ECU_ADDRESS 0x3FA3BC /end MEASUREMENT
/begin COMPU_METHOD MC_NORM_FN090_AFR "NORM_FN090_AFR conversion" RAT_FUNC "%10.5" "Unitless" COEFFS 0 1 0 0 0 1 /end COMPU_METHOD
/begin MEASUREMENT NORM_FN091P_AFR "" FLOAT32_IEEE MC_NORM_FN091P_AFR 0 0 0 0 ECU_ADDRESS 0x3FA3B0 /end MEASUREMENT
/begin COMPU_METHOD MC_NORM_FN091P_AFR "NORM_FN091P_AFR conversion" RAT_FUNC "%10.5" "Unitless" COEFFS 0 1 0 0 0 1 /end COMPU_METHOD
/begin MEASUREMENT NORM_FN091_AFR "Normalized fn091_afr value" FLOAT32_IEEE MC_NORM_FN091_AFR 0 0 0 0 ECU_ADDRESS 0x3FA3B4 /end MEASUREMENT
/begin COMPU_METHOD MC_NORM_FN091_AFR "NORM_FN091_AFR conversion" RAT_FUNC "%10.5" "Unitless" COEFFS 0 1 0 0 0 1 /end COMPU_METHOD
/begin MEASUREMENT NORM_FNMATDS "" FLOAT32_IEEE MC_NORM_FNMATDS 0 0 0 0 ECU_ADDRESS 0x3FA42C /end MEASUREMENT
/begin COMPU_METHOD MC_NORM_FNMATDS "NORM_FNMATDS conversion" RAT_FUNC "%10.5" "Unitless" COEFFS 0 1 0 0 0 1 /end COMPU_METHOD
/begin MEASUREMENT NORM_FNMATP "" FLOAT32_IEEE MC_NORM_FNMATP 0 0 0 0 ECU_ADDRESS 0x3FA428 /end MEASUREMENT
/begin COMPU_METHOD MC_NORM_FNMATP "NORM_FNMATP conversion" RAT_FUNC "%10.5" "Unitless" COEFFS 0 1 0 0 0 1 /end COMPU_METHOD
/begin CHARACTERISTIC NOV_VID_SW "Calibration switch to enable/disable using VID block information for NOV;  0 -> use Cal Cons, 1 -> use VID blcok" VALUE 0x57B44 SD_UBYTE 0 SC_NOV_VID_SW 0 1 /end CHARACTERISTIC
/begin COMPU_METHOD SC_NOV_VID_SW "NOV_VID_SW conversion" RAT_FUNC "%3.0" "unitless" COEFFS 0 1 0 0 0 1 /end COMPU_METHOD
/begin CHARACTERISTIC NO_OF_CYL "Number of cylinders" VALUE 0x56AB4 SD_ULONG 0 SC_NO_OF_CYL 0 8 /end CHARACTERISTIC
/begin COMPU_METHOD SC_NO_OF_CYL "NO_OF_CYL conversion" RAT_FUNC "%10.0" "N/A" COEFFS 0 1 0 0 0 1 /end COMPU_METHOD
/begin CHARACTERISTIC NSTALL "Engine stall speed to re-enter CRANK mode." VALUE 0x5794C SD_FLOAT32_IEEE 0 SC_NSTALL 0 500 /end CHARACTERISTIC
/begin COMPU_METHOD SC_NSTALL "NSTALL conversion" RAT_FUNC "%10.5" "RPM" COEFFS 0 1 0 0 0 1 /end COMPU_METHOD
/begin CHARACTERISTIC NSTRT_TM "Max time w/o CRNK transition until N=0 (ms)" VALUE 0x56AD0 SD_ULONG 0 SC_NSTRT_TM 0 10000 /end CHARACTERISTIC
/begin COMPU_METHOD SC_NSTRT_TM "NSTRT_TM conversion" RAT_FUNC "%10.0" "ms" COEFFS 0 1 0 0 0 1 /end COMPU_METHOD
/begin CHARACTERISTIC NUMCYL_0 "Number of cylinders in the engine. Range is 0-255, although many implementations may support only up to 8 or 10." VALUE 0x3FA998 SD_UBYTE 0 SC_NUMCYL_0 0 255 /end CHARACTERISTIC
/begin COMPU_METHOD SC_NUMCYL_0 "NUMCYL_0 conversion" RAT_FUNC "%3.0" "ENUMERATED" COEFFS 0 1 0 0 0 1 /end COMPU_METHOD
/begin CHARACTERISTIC NUMEGO "Number of HEGO sensors used." VALUE 0x3FB05C SD_UBYTE 0 SC_NUMEGO 1 2 /end CHARACTERISTIC
/begin COMPU_METHOD SC_NUMEGO "NUMEGO conversion" RAT_FUNC "%3.0" "ENUMERATED" COEFFS 0 1 0 0 0 1 /end COMPU_METHOD
/begin MEASUREMENT NUM_CODES "Number of OBD-II fault codes currently stored in memory." UBYTE MC_NUM_CODES 0 0 0 0 ECU_ADDRESS 0x3FAEBD /end MEASUREMENT
/begin COMPU_METHOD MC_NUM_CODES "NUM_CODES conversion" RAT_FUNC "%3.0" "Unitless" COEFFS 0 1 0 0 0 1 /end COMPU_METHOD
/begin MEASUREMENT N_FILT "Filtered Engine speed (RPM)." FLOAT32_IEEE MC_N_FILT 0 0 0 0 ECU_ADDRESS 0x3FA054 /end MEASUREMENT
/begin COMPU_METHOD MC_N_FILT "N_FILT conversion" RAT_FUNC "%10.5" "Unitless" COEFFS 0 1 0 0 0 1 /end COMPU_METHOD
/begin CHARACTERISTIC N_FILT_KF "Engine speed filter gain for N_FILT calculation" VALUE 0x56594 SD_FLOAT32_IEEE 0 SC_N_FILT_KF 0 1 /end CHARACTERISTIC
/begin COMPU_METHOD SC_N_FILT_KF "N_FILT_KF conversion" RAT_FUNC "%10.5" "unitless" COEFFS 0 1 0 0 0 1 /end COMPU_METHOD
/begin MEASUREMENT N_I_SEED "Governor seed value (mg/stroke)" FLOAT32_IEEE MC_N_I_SEED 0 0 0 0 ECU_ADDRESS 0x3FA2BC /end MEASUREMENT
/begin COMPU_METHOD MC_N_I_SEED "N_I_SEED conversion" RAT_FUNC "%10.5" "Unitless" COEFFS 0 1 0 0 0 1 /end COMPU_METHOD
/begin CHARACTERISTIC N_I_SEED_MAX "max engine speed allowed governor reseeding" VALUE 0x5699C SD_FLOAT32_IEEE 0 SC_N_I_SEED_MAX 0 2000 /end CHARACTERISTIC
/begin COMPU_METHOD SC_N_I_SEED_MAX "N_I_SEED_MAX conversion" RAT_FUNC "%10.5" "RPM" COEFFS 0 1 0 0 0 1 /end COMPU_METHOD
/begin CHARACTERISTIC N_I_SEED_MIN "min engine speed allowed governor reseeding" VALUE 0x569A0 SD_FLOAT32_IEEE 0 SC_N_I_SEED_MIN 0 2000 /end CHARACTERISTIC
/begin COMPU_METHOD SC_N_I_SEED_MIN "N_I_SEED_MIN conversion" RAT_FUNC "%10.5" "RPM" COEFFS 0 1 0 0 0 1 /end COMPU_METHOD
/begin MEASUREMENT N_NORM "" FLOAT32_IEEE MC_N_NORM 0 0 0 0 ECU_ADDRESS 0x3FA8F0 /end MEASUREMENT
/begin COMPU_METHOD MC_N_NORM "N_NORM conversion" RAT_FUNC "%10.5" "Unitless" COEFFS 0 1 0 0 0 1 /end COMPU_METHOD
/begin MEASUREMENT N_RAW "Raw engine speed (RPM) from engine position input driver." FLOAT32_IEEE MC_N_RAW 0 0 0 0 ECU_ADDRESS 0x3FA980 /end MEASUREMENT
/begin COMPU_METHOD MC_N_RAW "N_RAW conversion" RAT_FUNC "%10.5" "Unitless" COEFFS 0 1 0 0 0 1 /end COMPU_METHOD
/begin MEASUREMENT N_RDSP_LMX "Road speed limited engine speed (RPM)" FLOAT32_IEEE MC_N_RDSP_LMX 0 0 0 0 ECU_ADDRESS 0x3FAF90 /end MEASUREMENT
/begin COMPU_METHOD MC_N_RDSP_LMX "N_RDSP_LMX conversion" RAT_FUNC "%10.5" "Unitless" COEFFS 0 1 0 0 0 1 /end COMPU_METHOD
/begin CHARACTERISTIC N_VGT_WARMUP "" VALUE 0x571D0 SD_FLOAT32_IEEE 0 SC_N_VGT_WARMUP 0 5000 /end CHARACTERISTIC
/begin COMPU_METHOD SC_N_VGT_WARMUP "N_VGT_WARMUP conversion" RAT_FUNC "%10.5" "unitless" COEFFS 0 1 0 0 0 1 /end COMPU_METHOD
/begin CHARACTERISTIC OBDII_DELAY "Time into run mode before enabling any continuous OBD-II monitor." VALUE 0x5637C SD_UBYTE 0 SC_OBDII_DELAY 0 255 /end CHARACTERISTIC
/begin COMPU_METHOD SC_OBDII_DELAY "OBDII_DELAY conversion" RAT_FUNC "%3.0" "s" COEFFS 0 1 0 0 0 1 /end COMPU_METHOD
/begin MEASUREMENT OBDII_MIL_ON "bit0=cat_mil_on;bit1=ccm_mil_on;bit2=purg_mil_on;bit3=sair_mil_on;bit4=fuel_mil_on;bit5=ego_mil_on;bit6=egr_mil_on;bit7=mis_mil_on" UBYTE MC_OBDII_MIL_ON 0 0 0 0 ECU_ADDRESS 0x3FAEBB /end MEASUREMENT
/begin COMPU_METHOD MC_OBDII_MIL_ON "OBDII_MIL_ON conversion" RAT_FUNC "%3.0" "Unitless" COEFFS 0 1 0 0 0 1 /end COMPU_METHOD
/begin CHARACTERISTIC OBDII_MIL_SW "Mapped byte of sys_MIL_SW flag bits in the order(0..7):{cat,ccm,purg,sair,fuel,ego,egr,mis}." VALUE 0x56348 SD_UBYTE 0 SC_OBDII_MIL_SW 0 255 /end CHARACTERISTIC
/begin COMPU_METHOD SC_OBDII_MIL_SW "OBDII_MIL_SW conversion" RAT_FUNC "%3.0" "group_of_bits" COEFFS 0 1 0 0 0 1 /end COMPU_METHOD
/begin MEASUREMENT OBDII_PARM_RST "1 = OBDII Parameter reset active" UBYTE MC_OBDII_PARM_RST 0 0 0 0 ECU_ADDRESS 0x3FADE4 /end MEASUREMENT
/begin COMPU_METHOD MC_OBDII_PARM_RST "OBDII_PARM_RST conversion" RAT_FUNC "%3.0" "Unitless" COEFFS 0 1 0 0 0 1 /end COMPU_METHOD
/begin MEASUREMENT OBDII_RESET "Flag used to simulate the receipt of an OBD-II scan tool reset message." UBYTE MC_OBDII_RESET 0 0 0 0 ECU_ADDRESS 0x3F9EBA /end MEASUREMENT
/begin COMPU_METHOD MC_OBDII_RESET "OBDII_RESET conversion" RAT_FUNC "%3.0" "Unitless" COEFFS 0 1 0 0 0 1 /end COMPU_METHOD
/begin MEASUREMENT OBDII_STATE "Current state of the obdII sequence controller." UBYTE MC_OBDII_STATE 0 0 0 0 ECU_ADDRESS 0x3F9EDA /end MEASUREMENT
/begin COMPU_METHOD MC_OBDII_STATE "OBDII_STATE conversion" RAT_FUNC "%3.0" "Unitless" COEFFS 0 1 0 0 0 1 /end COMPU_METHOD
/begin CHARACTERISTIC OBDII_TST_SW "Mapped byte of sys_TST_SW flag bits in the order(0..7): {cat,ccm,purg,sair,fuel,ego,egr,mis}." VALUE 0x56380 SD_UBYTE 0 SC_OBDII_TST_SW 0 255 /end CHARACTERISTIC
/begin COMPU_METHOD SC_OBDII_TST_SW "OBDII_TST_SW conversion" RAT_FUNC "%3.0" "MAPPED_BYTE" COEFFS 0 1 0 0 0 1 /end COMPU_METHOD
/begin MEASUREMENT OBDII_WARMUP "FLAG INDICATING ENGINE WARM-UP HAS OCCURED AS DEFINED BY CARB." UBYTE MC_OBDII_WARMUP 0 0 0 0 ECU_ADDRESS 0x3F9EBD /end MEASUREMENT
/begin COMPU_METHOD MC_OBDII_WARMUP "OBDII_WARMUP conversion" RAT_FUNC "%3.0" "Unitless" COEFFS 0 1 0 0 0 1 /end COMPU_METHOD
/begin MEASUREMENT OBD_PARM_RST "OBDII paramter reset signal; 1-> reset parameters." UBYTE MC_OBD_PARM_RST 0 0 0 0 ECU_ADDRESS 0x3F9EDB /end MEASUREMENT
/begin COMPU_METHOD MC_OBD_PARM_RST "OBD_PARM_RST conversion" RAT_FUNC "%3.0" "Unitless" COEFFS 0 1 0 0 0 1 /end COMPU_METHOD
/begin MEASUREMENT OBD_TRIP_RST "1 = An OBD-II trip reset is requested." UBYTE MC_OBD_TRIP_RST 0 0 0 0 ECU_ADDRESS 0x3F9F18 /end MEASUREMENT
/begin COMPU_METHOD MC_OBD_TRIP_RST "OBD_TRIP_RST conversion" RAT_FUNC "%3.0" "Unitless" COEFFS 0 1 0 0 0 1 /end COMPU_METHOD
/begin MEASUREMENT ODU_CODE_CTR "OBDII fault code tables' index indicating the position where the last code was transmitted." UWORD MC_ODU_CODE_CTR 0 0 0 0 ECU_ADDRESS 0x3FAB24 /end MEASUREMENT
/begin COMPU_METHOD MC_ODU_CODE_CTR "ODU_CODE_CTR conversion" RAT_FUNC "%5.0" "Unitless" COEFFS 0 1 0 0 0 1 /end COMPU_METHOD
/begin MEASUREMENT ODU_CODE_RQ "State register indicating which OBDII codes request message is being responded to." UBYTE MC_ODU_CODE_RQ 0 0 0 0 ECU_ADDRESS 0x3FAB26 /end MEASUREMENT
/begin COMPU_METHOD MC_ODU_CODE_RQ "ODU_CODE_RQ conversion" RAT_FUNC "%3.0" "Unitless" COEFFS 0 1 0 0 0 1 /end COMPU_METHOD
/begin MEASUREMENT ODU_KEY "Key value received from ODU to unlock OSC." UWORD MC_ODU_KEY 0 0 0 0 ECU_ADDRESS 0x3FAB30 /end MEASUREMENT
/begin COMPU_METHOD MC_ODU_KEY "ODU_KEY conversion" RAT_FUNC "%5.0" "Unitless" COEFFS 0 1 0 0 0 1 /end COMPU_METHOD
/begin MEASUREMENT ODU_NAR "Node address of diagnostic tester connected to diagnostic link." UBYTE MC_ODU_NAR 0 0 0 0 ECU_ADDRESS 0x3FAB38 /end MEASUREMENT
/begin COMPU_METHOD MC_ODU_NAR "ODU_NAR conversion" RAT_FUNC "%3.0" "Unitless" COEFFS 0 1 0 0 0 1 /end COMPU_METHOD
/begin CHARACTERISTIC ODU_TIMEOUT "Time-out value for certain offboard diagnostic routines." VALUE 0x57738 SD_FLOAT32_IEEE 0 SC_ODU_TIMEOUT 0 31.875 /end CHARACTERISTIC
/begin COMPU_METHOD SC_ODU_TIMEOUT "ODU_TIMEOUT conversion" RAT_FUNC "%10.5" "s" COEFFS 0 1 0 0 0 1 /end COMPU_METHOD
/begin MEASUREMENT ODU_UP_STATE "Flag set when Offboard Unit is actively communicating with the EEC over SCP" UBYTE MC_ODU_UP_STATE 0 0 0 0 ECU_ADDRESS 0x3FAB16 /end MEASUREMENT
/begin COMPU_METHOD MC_ODU_UP_STATE "ODU_UP_STATE conversion" RAT_FUNC "%3.0" "Unitless" COEFFS 0 1 0 0 0 1 /end COMPU_METHOD
/begin MEASUREMENT ODU_UP_TMR "Offboard Diag Unit Activity timer." FLOAT32_IEEE MC_ODU_UP_TMR 0 0 0 0 ECU_ADDRESS 0x3FAB10 /end MEASUREMENT
/begin COMPU_METHOD MC_ODU_UP_TMR "ODU_UP_TMR conversion" RAT_FUNC "%10.5" "Unitless" COEFFS 0 1 0 0 0 1 /end COMPU_METHOD
/begin MEASUREMENT OD_CODE_CNT "Count of total number of on-demand codes currently stored." UBYTE MC_OD_CODE_CNT 0 0 0 0 ECU_ADDRESS 0x3FAEB8 /end MEASUREMENT
/begin COMPU_METHOD MC_OD_CODE_CNT "OD_CODE_CNT conversion" RAT_FUNC "%3.0" "Unitless" COEFFS 0 1 0 0 0 1 /end COMPU_METHOD
/begin MEASUREMENT OL_DRIVE "Open loop due to driving conditions (not FMEM or HOLD related)." UBYTE MC_OL_DRIVE 0 0 0 0 ECU_ADDRESS 0x3FADDE /end MEASUREMENT
/begin COMPU_METHOD MC_OL_DRIVE "OL_DRIVE conversion" RAT_FUNC "%3.0" "Unitless" COEFFS 0 1 0 0 0 1 /end COMPU_METHOD
/begin MEASUREMENT OL_FMEM "Open loop due to detected system fault flag.  1 = open loop ude to FMEM." UBYTE MC_OL_FMEM 0 0 0 0 ECU_ADDRESS 0x3FADDF /end MEASUREMENT
/begin COMPU_METHOD MC_OL_FMEM "OL_FMEM conversion" RAT_FUNC "%3.0" "Unitless" COEFFS 0 1 0 0 0 1 /end COMPU_METHOD
/begin MEASUREMENT OL_HOLD "PRESENT CONDITIONS NOT SATISFIED TO GO CLOSED LOOP FLAG. 1 = HOLD IN OPEN LOOP." UBYTE MC_OL_HOLD 0 0 0 0 ECU_ADDRESS 0x3FADE2 /end MEASUREMENT
/begin COMPU_METHOD MC_OL_HOLD "OL_HOLD conversion" RAT_FUNC "%3.0" "Unitless" COEFFS 0 1 0 0 0 1 /end COMPU_METHOD
/begin MEASUREMENT OPER_RSP_CHK "Flag to signal that it is time to check for operator response (BOO, PSPS, etc)" UBYTE MC_OPER_RSP_CHK 0 0 0 0 ECU_ADDRESS 0x3FAB8C /end MEASUREMENT
/begin COMPU_METHOD MC_OPER_RSP_CHK "OPER_RSP_CHK conversion" RAT_FUNC "%3.0" "Unitless" COEFFS 0 1 0 0 0 1 /end COMPU_METHOD
/begin CHARACTERISTIC OSC_MASK "Key to unlock each OSC channel." VALUE 0x57B50 SD_UBYTE 0 SC_OSC_MASK 135 135 /end CHARACTERISTIC
/begin COMPU_METHOD SC_OSC_MASK "OSC_MASK conversion" RAT_FUNC "%3.0" "NONE" COEFFS 0 1 0 0 0 1 /end COMPU_METHOD
/begin MEASUREMENT OSC_SEED "Randomly generated seed value transmitted to ODU." UBYTE MC_OSC_SEED 0 0 0 0 ECU_ADDRESS 0x3FAB33 /end MEASUREMENT
/begin COMPU_METHOD MC_OSC_SEED "OSC_SEED conversion" RAT_FUNC "%3.0" "Unitless" COEFFS 0 1 0 0 0 1 /end COMPU_METHOD
/begin MEASUREMENT OSC_STATE "Output state control state variable." UBYTE MC_OSC_STATE 0 0 0 0 ECU_ADDRESS 0x3FAB32 /end MEASUREMENT
/begin COMPU_METHOD MC_OSC_STATE "OSC_STATE conversion" RAT_FUNC "%3.0" "Unitless" COEFFS 0 1 0 0 0 1 /end COMPU_METHOD
/begin MEASUREMENT OSM_EDF_OFF "Request for EDF Off from OSM or OTM test" UBYTE MC_OSM_EDF_OFF 0 0 0 0 ECU_ADDRESS 0x3FABA8 /end MEASUREMENT
/begin COMPU_METHOD MC_OSM_EDF_OFF "OSM_EDF_OFF conversion" RAT_FUNC "%3.0" "Unitless" COEFFS 0 1 0 0 0 1 /end COMPU_METHOD
/begin MEASUREMENT OSM_EDF_ON "Request for EDF on from OSM or OTM test" UBYTE MC_OSM_EDF_ON 0 0 0 0 ECU_ADDRESS 0x3FABA7 /end MEASUREMENT
/begin COMPU_METHOD MC_OSM_EDF_ON "OSM_EDF_ON conversion" RAT_FUNC "%3.0" "Unitless" COEFFS 0 1 0 0 0 1 /end COMPU_METHOD
/begin CHARACTERISTIC OSM_EO_DONE "Value of EO_STATUS when OSM on test is complete" VALUE 0x57852 SD_UBYTE 0 SC_OSM_EO_DONE 0 100 /end CHARACTERISTIC
/begin COMPU_METHOD SC_OSM_EO_DONE "OSM_EO_DONE conversion" RAT_FUNC "%3.0" "unitless" COEFFS 0 1 0 0 0 1 /end COMPU_METHOD
/begin MEASUREMENT OSM_EO_OFF "OFF state requested for OSM outputs during engine off on demand test." UBYTE MC_OSM_EO_OFF 0 0 0 0 ECU_ADDRESS 0x3FABA6 /end MEASUREMENT
/begin COMPU_METHOD MC_OSM_EO_OFF "OSM_EO_OFF conversion" RAT_FUNC "%3.0" "Unitless" COEFFS 0 1 0 0 0 1 /end COMPU_METHOD
/begin MEASUREMENT OSM_EO_ON "ON state requested for OSM outputs during engine off on demand test." UBYTE MC_OSM_EO_ON 0 0 0 0 ECU_ADDRESS 0x3FABA5 /end MEASUREMENT
/begin COMPU_METHOD MC_OSM_EO_ON "OSM_EO_ON conversion" RAT_FUNC "%3.0" "Unitless" COEFFS 0 1 0 0 0 1 /end COMPU_METHOD
/begin CHARACTERISTIC OSM_EO_WAIT "Value of EO_STATUS when waiting for OSM test to complete during engine off on demand test" VALUE 0x57851 SD_UBYTE 0 SC_OSM_EO_WAIT 0 100 /end CHARACTERISTIC
/begin COMPU_METHOD SC_OSM_EO_WAIT "OSM_EO_WAIT conversion" RAT_FUNC "%3.0" "unitless" COEFFS 0 1 0 0 0 1 /end COMPU_METHOD
/begin MEASUREMENT OSM_HEDF_OFF "Request for HEDF Off from OSM or OTM test" UBYTE MC_OSM_HEDF_OFF 0 0 0 0 ECU_ADDRESS 0x3FABA4 /end MEASUREMENT
/begin COMPU_METHOD MC_OSM_HEDF_OFF "OSM_HEDF_OFF conversion" RAT_FUNC "%3.0" "Unitless" COEFFS 0 1 0 0 0 1 /end COMPU_METHOD
/begin MEASUREMENT OSM_HEDF_ON "Request for HEDF On from OSM or OTM test" UBYTE MC_OSM_HEDF_ON 0 0 0 0 ECU_ADDRESS 0x3FABA3 /end MEASUREMENT
/begin COMPU_METHOD MC_OSM_HEDF_ON "OSM_HEDF_ON conversion" RAT_FUNC "%3.0" "Unitless" COEFFS 0 1 0 0 0 1 /end COMPU_METHOD
/begin CHARACTERISTIC OTM_MAX_TM "Maximum time in Output Test Mode without changing states" VALUE 0x57860 SD_FLOAT32_IEEE 0 SC_OTM_MAX_TM 0 600 /end CHARACTERISTIC
/begin COMPU_METHOD SC_OTM_MAX_TM "OTM_MAX_TM conversion" RAT_FUNC "%10.5" "s" COEFFS 0 1 0 0 0 1 /end COMPU_METHOD
/begin MEASUREMENT OTM_STATE "Current State of Output Test Mode Controller (Inactive, Off, On, EDF On...)" UBYTE MC_OTM_STATE 0 0 0 0 ECU_ADDRESS 0x3FABA0 /end MEASUREMENT
/begin COMPU_METHOD MC_OTM_STATE "OTM_STATE conversion" RAT_FUNC "%3.0" "Unitless" COEFFS 0 1 0 0 0 1 /end COMPU_METHOD
/begin MEASUREMENT OTM_TIMER "Output Test Mode Time out timer" FLOAT32_IEEE MC_OTM_TIMER 0 0 0 0 ECU_ADDRESS 0x3FAB6C /end MEASUREMENT
/begin COMPU_METHOD MC_OTM_TIMER "OTM_TIMER conversion" RAT_FUNC "%10.5" "Unitless" COEFFS 0 1 0 0 0 1 /end COMPU_METHOD
/begin MEASUREMENT OTM_TST_ENA "Flag to activate the output test mode on demand test." UBYTE MC_OTM_TST_ENA 0 0 0 0 ECU_ADDRESS 0x3F9EEE /end MEASUREMENT
/begin COMPU_METHOD MC_OTM_TST_ENA "OTM_TST_ENA conversion" RAT_FUNC "%3.0" "Unitless" COEFFS 0 1 0 0 0 1 /end COMPU_METHOD
/begin MEASUREMENT OTM_TST_RDY "Flag to signal the OBD-II executive that the output test mode is ready." UBYTE MC_OTM_TST_RDY 0 0 0 0 ECU_ADDRESS 0x3FABA2 /end MEASUREMENT
/begin COMPU_METHOD MC_OTM_TST_RDY "OTM_TST_RDY conversion" RAT_FUNC "%3.0" "Unitless" COEFFS 0 1 0 0 0 1 /end COMPU_METHOD
/begin MEASUREMENT OUTCD_STAT "Outcode Status where a 01h => Outcode stored and a 00h => Outcode not yet stored." UBYTE MC_OUTCD_STAT 0 0 0 0 ECU_ADDRESS 0x3FB042 /end MEASUREMENT
/begin COMPU_METHOD MC_OUTCD_STAT "OUTCD_STAT conversion" RAT_FUNC "%3.0" "Unitless" COEFFS 0 1 0 0 0 1 /end COMPU_METHOD
/begin MEASUREMENT OUTPUT_MODE "Output Test Mode State requested by SCP. (Inactive, Off, On, EDF on ...)" UBYTE MC_OUTPUT_MODE 0 0 0 0 ECU_ADDRESS 0x3FAB5F /end MEASUREMENT
/begin COMPU_METHOD MC_OUTPUT_MODE "OUTPUT_MODE conversion" RAT_FUNC "%3.0" "Unitless" COEFFS 0 1 0 0 0 1 /end COMPU_METHOD
/begin MEASUREMENT OVRBST_MFL_SEL "" UBYTE MC_OVRBST_MFL_SEL 0 0 0 0 ECU_ADDRESS 0x56A21 /end MEASUREMENT
/begin COMPU_METHOD MC_OVRBST_MFL_SEL "OVRBST_MFL_SEL conversion" RAT_FUNC "%3.0" "Unitless" COEFFS 0 1 0 0 0 1 /end COMPU_METHOD
/begin MEASUREMENT P0097MALF "OBD II malfunction flag for mat below min. value" UBYTE MC_P0097MALF 0 0 0 0 ECU_ADDRESS 0x3FA0F1 /end MEASUREMENT
/begin COMPU_METHOD MC_P0097MALF "P0097MALF conversion" RAT_FUNC "%3.0" "Unitless" COEFFS 0 1 0 0 0 1 /end COMPU_METHOD
/begin MEASUREMENT P0097UPDATE "p0097 malf update indication flag" UBYTE MC_P0097UPDATE 0 0 0 0 ECU_ADDRESS 0x3FA0EF /end MEASUREMENT
/begin COMPU_METHOD MC_P0097UPDATE "P0097UPDATE conversion" RAT_FUNC "%3.0" "Unitless" COEFFS 0 1 0 0 0 1 /end COMPU_METHOD
/begin MEASUREMENT P0097UPD_CNTR "MAT low failure update - Counter" SLONG MC_P0097UPD_CNTR 0 0 0 0 ECU_ADDRESS 0x3FA0D0 /end MEASUREMENT
/begin COMPU_METHOD MC_P0097UPD_CNTR "P0097UPD_CNTR conversion" RAT_FUNC "%10.0" "Unitless" COEFFS 0 1 0 0 0 1 /end COMPU_METHOD
/begin MEASUREMENT P0098MALF "OBDII malfunction flag for MAT above max. Cal. value" UBYTE MC_P0098MALF 0 0 0 0 ECU_ADDRESS 0x3FA0F2 /end MEASUREMENT
/begin COMPU_METHOD MC_P0098MALF "P0098MALF conversion" RAT_FUNC "%3.0" "Unitless" COEFFS 0 1 0 0 0 1 /end COMPU_METHOD
/begin MEASUREMENT P0098UPDATE "p0098 malf update indication flag" UBYTE MC_P0098UPDATE 0 0 0 0 ECU_ADDRESS 0x3FA0F0 /end MEASUREMENT
/begin COMPU_METHOD MC_P0098UPDATE "P0098UPDATE conversion" RAT_FUNC "%3.0" "Unitless" COEFFS 0 1 0 0 0 1 /end COMPU_METHOD
/begin MEASUREMENT P0098UPD_CNTR "MAT  high failure update - counter" SLONG MC_P0098UPD_CNTR 0 0 0 0 ECU_ADDRESS 0x3FA0D4 /end MEASUREMENT
/begin COMPU_METHOD MC_P0098UPD_CNTR "P0098UPD_CNTR conversion" RAT_FUNC "%10.0" "Unitless" COEFFS 0 1 0 0 0 1 /end COMPU_METHOD
/begin MEASUREMENT P0102MALF "OBDII malfunction flag for MAF input below minimum acceptable value" UBYTE MC_P0102MALF 0 0 0 0 ECU_ADDRESS 0x3FA095 /end MEASUREMENT
/begin COMPU_METHOD MC_P0102MALF "P0102MALF conversion" RAT_FUNC "%3.0" "Unitless" COEFFS 0 1 0 0 0 1 /end COMPU_METHOD
/begin CHARACTERISTIC P0102SW "0=cal_out; 1=non_mil; 2=mil" VALUE 0x57B4F SD_UBYTE 0 SC_P0102SW 0 255 /end CHARACTERISTIC
/begin COMPU_METHOD SC_P0102SW "P0102SW conversion" RAT_FUNC "%3.0" "Unitless" COEFFS 0 1 0 0 0 1 /end COMPU_METHOD
/begin MEASUREMENT P0102UPDATE "p0102 malf update indication flag" UBYTE MC_P0102UPDATE 0 0 0 0 ECU_ADDRESS 0x3FA091 /end MEASUREMENT
/begin COMPU_METHOD MC_P0102UPDATE "P0102UPDATE conversion" RAT_FUNC "%3.0" "Unitless" COEFFS 0 1 0 0 0 1 /end COMPU_METHOD
/begin MEASUREMENT P0102UPD_CNTR "MAF low failure update - Counter" SLONG MC_P0102UPD_CNTR 0 0 0 0 ECU_ADDRESS 0x3FA068 /end MEASUREMENT
/begin COMPU_METHOD MC_P0102UPD_CNTR "P0102UPD_CNTR conversion" RAT_FUNC "%10.0" "Unitless" COEFFS 0 1 0 0 0 1 /end COMPU_METHOD
/begin MEASUREMENT P0103MALF "OBDII malfunction flag for MAF input above maximum acceptable value" UBYTE MC_P0103MALF 0 0 0 0 ECU_ADDRESS 0x3FA096 /end MEASUREMENT
/begin COMPU_METHOD MC_P0103MALF "P0103MALF conversion" RAT_FUNC "%3.0" "Unitless" COEFFS 0 1 0 0 0 1 /end COMPU_METHOD
/begin CHARACTERISTIC P0103SW "0=cal_out; 1=non_mil; 2=mil" VALUE 0x57B4E SD_UBYTE 0 SC_P0103SW 0 255 /end CHARACTERISTIC
/begin COMPU_METHOD SC_P0103SW "P0103SW conversion" RAT_FUNC "%3.0" "Unitless" COEFFS 0 1 0 0 0 1 /end COMPU_METHOD
/begin MEASUREMENT P0103UPDATE "p0103 malf update indication flag" UBYTE MC_P0103UPDATE 0 0 0 0 ECU_ADDRESS 0x3FA092 /end MEASUREMENT
/begin COMPU_METHOD MC_P0103UPDATE "P0103UPDATE conversion" RAT_FUNC "%3.0" "Unitless" COEFFS 0 1 0 0 0 1 /end COMPU_METHOD
/begin MEASUREMENT P0103UPD_CNTR "MAF  high failure update - counter" SLONG MC_P0103UPD_CNTR 0 0 0 0 ECU_ADDRESS 0x3FA06C /end MEASUREMENT
/begin COMPU_METHOD MC_P0103UPD_CNTR "P0103UPD_CNTR conversion" RAT_FUNC "%10.0" "Unitless" COEFFS 0 1 0 0 0 1 /end COMPU_METHOD
/begin MEASUREMENT P0107MALF "OBD-II malfunction flag for BP low fault" UBYTE MC_P0107MALF 0 0 0 0 ECU_ADDRESS 0x3F9F51 /end MEASUREMENT
/begin COMPU_METHOD MC_P0107MALF "P0107MALF conversion" RAT_FUNC "%3.0" "Unitless" COEFFS 0 1 0 0 0 1 /end COMPU_METHOD
/begin MEASUREMENT P0107UPDATE "p0107 malf update indication flag" UBYTE MC_P0107UPDATE 0 0 0 0 ECU_ADDRESS 0x3F9F4F /end MEASUREMENT
/begin COMPU_METHOD MC_P0107UPDATE "P0107UPDATE conversion" RAT_FUNC "%3.0" "Unitless" COEFFS 0 1 0 0 0 1 /end COMPU_METHOD
/begin MEASUREMENT P0107UPD_CNTR "BP low failure update - Counter" SLONG MC_P0107UPD_CNTR 0 0 0 0 ECU_ADDRESS 0x3F9F30 /end MEASUREMENT
/begin COMPU_METHOD MC_P0107UPD_CNTR "P0107UPD_CNTR conversion" RAT_FUNC "%10.0" "Unitless" COEFFS 0 1 0 0 0 1 /end COMPU_METHOD
/begin MEASUREMENT P0108MALF "OBD-II malfunction flag for BP high fault" UBYTE MC_P0108MALF 0 0 0 0 ECU_ADDRESS 0x3F9F52 /end MEASUREMENT
/begin COMPU_METHOD MC_P0108MALF "P0108MALF conversion" RAT_FUNC "%3.0" "Unitless" COEFFS 0 1 0 0 0 1 /end COMPU_METHOD
/begin MEASUREMENT P0108UPDATE "p0108 malf update indication flag" UBYTE MC_P0108UPDATE 0 0 0 0 ECU_ADDRESS 0x3F9F50 /end MEASUREMENT
/begin COMPU_METHOD MC_P0108UPDATE "P0108UPDATE conversion" RAT_FUNC "%3.0" "Unitless" COEFFS 0 1 0 0 0 1 /end COMPU_METHOD
/begin MEASUREMENT P0108UPD_CNTR "BP high failure update - counter" SLONG MC_P0108UPD_CNTR 0 0 0 0 ECU_ADDRESS 0x3F9F34 /end MEASUREMENT
/begin COMPU_METHOD MC_P0108UPD_CNTR "P0108UPD_CNTR conversion" RAT_FUNC "%10.0" "Unitless" COEFFS 0 1 0 0 0 1 /end COMPU_METHOD
/begin CHARACTERISTIC P0109SW "0=cal_out; 1=non_mil; 2=mil" VALUE 0x563A1 SD_UBYTE 0 SC_P0109SW 0 255 /end CHARACTERISTIC
/begin COMPU_METHOD SC_P0109SW "P0109SW conversion" RAT_FUNC "%3.0" "Unitless" COEFFS 0 1 0 0 0 1 /end COMPU_METHOD
/begin MEASUREMENT P0112MALF "OBD II malfunction flag for IAT below min. value" UBYTE MC_P0112MALF 0 0 0 0 ECU_ADDRESS 0x3FA1E7 /end MEASUREMENT
/begin COMPU_METHOD MC_P0112MALF "P0112MALF conversion" RAT_FUNC "%3.0" "Unitless" COEFFS 0 1 0 0 0 1 /end COMPU_METHOD
/begin MEASUREMENT P0112UPDATE "p0112 malf update indication flag" UBYTE MC_P0112UPDATE 0 0 0 0 ECU_ADDRESS 0x3FA1E3 /end MEASUREMENT
/begin COMPU_METHOD MC_P0112UPDATE "P0112UPDATE conversion" RAT_FUNC "%3.0" "Unitless" COEFFS 0 1 0 0 0 1 /end COMPU_METHOD
/begin MEASUREMENT P0112UPD_CNTR "IAT low failure update - Counter" SLONG MC_P0112UPD_CNTR 0 0 0 0 ECU_ADDRESS 0x3FA1C4 /end MEASUREMENT
/begin COMPU_METHOD MC_P0112UPD_CNTR "P0112UPD_CNTR conversion" RAT_FUNC "%10.0" "Unitless" COEFFS 0 1 0 0 0 1 /end COMPU_METHOD
/begin MEASUREMENT P0113MALF "OBDII malfunction flag for IAT above max. Cal. value" UBYTE MC_P0113MALF 0 0 0 0 ECU_ADDRESS 0x3FA1E8 /end MEASUREMENT
/begin COMPU_METHOD MC_P0113MALF "P0113MALF conversion" RAT_FUNC "%3.0" "Unitless" COEFFS 0 1 0 0 0 1 /end COMPU_METHOD
/begin MEASUREMENT P0113UPDATE "p0113 malf update indication flag" UBYTE MC_P0113UPDATE 0 0 0 0 ECU_ADDRESS 0x3FA1E4 /end MEASUREMENT
/begin COMPU_METHOD MC_P0113UPDATE "P0113UPDATE conversion" RAT_FUNC "%3.0" "Unitless" COEFFS 0 1 0 0 0 1 /end COMPU_METHOD
/begin MEASUREMENT P0113UPD_CNTR "IAT high failure update - counter" SLONG MC_P0113UPD_CNTR 0 0 0 0 ECU_ADDRESS 0x3FA1C8 /end MEASUREMENT
/begin COMPU_METHOD MC_P0113UPD_CNTR "P0113UPD_CNTR conversion" RAT_FUNC "%10.0" "Unitless" COEFFS 0 1 0 0 0 1 /end COMPU_METHOD
/begin MEASUREMENT P0117MALF "OBDII malfunction flag for ect below the minimum cal value." UBYTE MC_P0117MALF 0 0 0 0 ECU_ADDRESS 0x3F9FE4 /end MEASUREMENT
/begin COMPU_METHOD MC_P0117MALF "P0117MALF conversion" RAT_FUNC "%3.0" "Unitless" COEFFS 0 1 0 0 0 1 /end COMPU_METHOD
/begin MEASUREMENT P0117UPDATE "p0117malf update flag." UBYTE MC_P0117UPDATE 0 0 0 0 ECU_ADDRESS 0x3F9FE0 /end MEASUREMENT
/begin COMPU_METHOD MC_P0117UPDATE "P0117UPDATE conversion" RAT_FUNC "%3.0" "Unitless" COEFFS 0 1 0 0 0 1 /end COMPU_METHOD
/begin MEASUREMENT P0117UPD_CNTR "p0117 malf update counetr" SLONG MC_P0117UPD_CNTR 0 0 0 0 ECU_ADDRESS 0x3F9FC0 /end MEASUREMENT
/begin COMPU_METHOD MC_P0117UPD_CNTR "P0117UPD_CNTR conversion" RAT_FUNC "%10.0" "Unitless" COEFFS 0 1 0 0 0 1 /end COMPU_METHOD
/begin MEASUREMENT P0118MALF "OBDII malfunction flag for ect above max calibration value" UBYTE MC_P0118MALF 0 0 0 0 ECU_ADDRESS 0x3F9FE5 /end MEASUREMENT
/begin COMPU_METHOD MC_P0118MALF "P0118MALF conversion" RAT_FUNC "%3.0" "Unitless" COEFFS 0 1 0 0 0 1 /end COMPU_METHOD
/begin MEASUREMENT P0118UPDATE "p0118 malfunction update  flag" UBYTE MC_P0118UPDATE 0 0 0 0 ECU_ADDRESS 0x3F9FE1 /end MEASUREMENT
/begin COMPU_METHOD MC_P0118UPDATE "P0118UPDATE conversion" RAT_FUNC "%3.0" "Unitless" COEFFS 0 1 0 0 0 1 /end COMPU_METHOD
/begin MEASUREMENT P0118UPD_CNTR "ect high failure update counter" SLONG MC_P0118UPD_CNTR 0 0 0 0 ECU_ADDRESS 0x3F9FC4 /end MEASUREMENT
/begin COMPU_METHOD MC_P0118UPD_CNTR "P0118UPD_CNTR conversion" RAT_FUNC "%10.0" "Unitless" COEFFS 0 1 0 0 0 1 /end COMPU_METHOD
/begin MEASUREMENT P0196MALF "threshold monitor cold malfunction flag" UBYTE MC_P0196MALF 0 0 0 0 ECU_ADDRESS 0x3F9F99 /end MEASUREMENT
/begin COMPU_METHOD MC_P0196MALF "P0196MALF conversion" RAT_FUNC "%3.0" "Unitless" COEFFS 0 1 0 0 0 1 /end COMPU_METHOD
/begin MEASUREMENT P0196UPDATE "threshold monitor update flag" UBYTE MC_P0196UPDATE 0 0 0 0 ECU_ADDRESS 0x3F9F9B /end MEASUREMENT
/begin COMPU_METHOD MC_P0196UPDATE "P0196UPDATE conversion" RAT_FUNC "%3.0" "Unitless" COEFFS 0 1 0 0 0 1 /end COMPU_METHOD
/begin MEASUREMENT P0197MALF "OBDII malfunction flag for eot below minimum cal value" UBYTE MC_P0197MALF 0 0 0 0 ECU_ADDRESS 0x3F9FA4 /end MEASUREMENT
/begin COMPU_METHOD MC_P0197MALF "P0197MALF conversion" RAT_FUNC "%3.0" "Unitless" COEFFS 0 1 0 0 0 1 /end COMPU_METHOD
/begin MEASUREMENT P0197UPDATE "p0197 malf update flag" UBYTE MC_P0197UPDATE 0 0 0 0 ECU_ADDRESS 0x3F9FA0 /end MEASUREMENT
/begin COMPU_METHOD MC_P0197UPDATE "P0197UPDATE conversion" RAT_FUNC "%3.0" "Unitless" COEFFS 0 1 0 0 0 1 /end COMPU_METHOD
/begin MEASUREMENT P0197UPD_CNTR "p0197 malf update counter" SLONG MC_P0197UPD_CNTR 0 0 0 0 ECU_ADDRESS 0x3F9F7C /end MEASUREMENT
/begin COMPU_METHOD MC_P0197UPD_CNTR "P0197UPD_CNTR conversion" RAT_FUNC "%10.0" "Unitless" COEFFS 0 1 0 0 0 1 /end COMPU_METHOD
/begin MEASUREMENT P0198MALF "OBDII malfunction flag for eot above maximum cal value" UBYTE MC_P0198MALF 0 0 0 0 ECU_ADDRESS 0x3F9FA5 /end MEASUREMENT
/begin COMPU_METHOD MC_P0198MALF "P0198MALF conversion" RAT_FUNC "%3.0" "Unitless" COEFFS 0 1 0 0 0 1 /end COMPU_METHOD
/begin MEASUREMENT P0198UPDATE "p00198 malf update flag" UBYTE MC_P0198UPDATE 0 0 0 0 ECU_ADDRESS 0x3F9FA1 /end MEASUREMENT
/begin COMPU_METHOD MC_P0198UPDATE "P0198UPDATE conversion" RAT_FUNC "%3.0" "Unitless" COEFFS 0 1 0 0 0 1 /end COMPU_METHOD
/begin MEASUREMENT P0198UPD_CNTR "eot high, failure update counter" SLONG MC_P0198UPD_CNTR 0 0 0 0 ECU_ADDRESS 0x3F9F80 /end MEASUREMENT
/begin COMPU_METHOD MC_P0198UPD_CNTR "P0198UPD_CNTR conversion" RAT_FUNC "%10.0" "Unitless" COEFFS 0 1 0 0 0 1 /end COMPU_METHOD
/begin MEASUREMENT P0237MALF "OBDII malfunction flag for MAP input below minimum acceptable value" UBYTE MC_P0237MALF 0 0 0 0 ECU_ADDRESS 0x3FA0C7 /end MEASUREMENT
/begin COMPU_METHOD MC_P0237MALF "P0237MALF conversion" RAT_FUNC "%3.0" "Unitless" COEFFS 0 1 0 0 0 1 /end COMPU_METHOD
/begin MEASUREMENT P0237UPDATE "p0237 malf update indication flag" UBYTE MC_P0237UPDATE 0 0 0 0 ECU_ADDRESS 0x3FA0C3 /end MEASUREMENT
/begin COMPU_METHOD MC_P0237UPDATE "P0237UPDATE conversion" RAT_FUNC "%3.0" "Unitless" COEFFS 0 1 0 0 0 1 /end COMPU_METHOD
/begin MEASUREMENT P0237UPD_CNTR "MAP Sensor low failure update - Counter" SLONG MC_P0237UPD_CNTR 0 0 0 0 ECU_ADDRESS 0x3FA0A0 /end MEASUREMENT
/begin COMPU_METHOD MC_P0237UPD_CNTR "P0237UPD_CNTR conversion" RAT_FUNC "%10.0" "Unitless" COEFFS 0 1 0 0 0 1 /end COMPU_METHOD
/begin MEASUREMENT P0238MALF "OBDII malfunction flag for MAP input above maximum acceptable value" UBYTE MC_P0238MALF 0 0 0 0 ECU_ADDRESS 0x3FA0C8 /end MEASUREMENT
/begin COMPU_METHOD MC_P0238MALF "P0238MALF conversion" RAT_FUNC "%3.0" "Unitless" COEFFS 0 1 0 0 0 1 /end COMPU_METHOD
/begin MEASUREMENT P0238UPDATE "p0238 malf update indication flag" UBYTE MC_P0238UPDATE 0 0 0 0 ECU_ADDRESS 0x3FA0C4 /end MEASUREMENT
/begin COMPU_METHOD MC_P0238UPDATE "P0238UPDATE conversion" RAT_FUNC "%3.0" "Unitless" COEFFS 0 1 0 0 0 1 /end COMPU_METHOD
/begin MEASUREMENT P0238UPD_CNTR "MAP Sensor  high failure update - counter" SLONG MC_P0238UPD_CNTR 0 0 0 0 ECU_ADDRESS 0x3FA0A4 /end MEASUREMENT
/begin COMPU_METHOD MC_P0238UPD_CNTR "P0238UPD_CNTR conversion" RAT_FUNC "%10.0" "Unitless" COEFFS 0 1 0 0 0 1 /end COMPU_METHOD
/begin MEASUREMENT P0298MALF "threshold monitor hot malfunction flag" UBYTE MC_P0298MALF 0 0 0 0 ECU_ADDRESS 0x3F9F98 /end MEASUREMENT
/begin COMPU_METHOD MC_P0298MALF "P0298MALF conversion" RAT_FUNC "%3.0" "Unitless" COEFFS 0 1 0 0 0 1 /end COMPU_METHOD
/begin MEASUREMENT P0298UPDATE "threshold monitor update flag" UBYTE MC_P0298UPDATE 0 0 0 0 ECU_ADDRESS 0x3F9F9A /end MEASUREMENT
/begin COMPU_METHOD MC_P0298UPDATE "P0298UPDATE conversion" RAT_FUNC "%3.0" "Unitless" COEFFS 0 1 0 0 0 1 /end COMPU_METHOD
/begin MEASUREMENT P0405MALF "OBD II malfunction flag for egrp below min. value" UBYTE MC_P0405MALF 0 0 0 0 ECU_ADDRESS 0x3FA00B /end MEASUREMENT
/begin COMPU_METHOD MC_P0405MALF "P0405MALF conversion" RAT_FUNC "%3.0" "Unitless" COEFFS 0 1 0 0 0 1 /end COMPU_METHOD
/begin MEASUREMENT P0405UPDATE "p0405 malf update indication flag" UBYTE MC_P0405UPDATE 0 0 0 0 ECU_ADDRESS 0x3FA007 /end MEASUREMENT
/begin COMPU_METHOD MC_P0405UPDATE "P0405UPDATE conversion" RAT_FUNC "%3.0" "Unitless" COEFFS 0 1 0 0 0 1 /end COMPU_METHOD
/begin MEASUREMENT P0405UPD_CNTR "EGRP low failure update - Counter" SLONG MC_P0405UPD_CNTR 0 0 0 0 ECU_ADDRESS 0x3F9FF0 /end MEASUREMENT
/begin COMPU_METHOD MC_P0405UPD_CNTR "P0405UPD_CNTR conversion" RAT_FUNC "%10.0" "Unitless" COEFFS 0 1 0 0 0 1 /end COMPU_METHOD
/begin MEASUREMENT P0406MALF "OBDII malfunction flag for EGRP above max. Cal. value" UBYTE MC_P0406MALF 0 0 0 0 ECU_ADDRESS 0x3FA00C /end MEASUREMENT
/begin COMPU_METHOD MC_P0406MALF "P0406MALF conversion" RAT_FUNC "%3.0" "Unitless" COEFFS 0 1 0 0 0 1 /end COMPU_METHOD
/begin MEASUREMENT P0406UPDATE "p0406 malf update indication flag" UBYTE MC_P0406UPDATE 0 0 0 0 ECU_ADDRESS 0x3FA008 /end MEASUREMENT
/begin COMPU_METHOD MC_P0406UPDATE "P0406UPDATE conversion" RAT_FUNC "%3.0" "Unitless" COEFFS 0 1 0 0 0 1 /end COMPU_METHOD
/begin MEASUREMENT P0406UPD_CNTR "EGRP  high failure update - counter" SLONG MC_P0406UPD_CNTR 0 0 0 0 ECU_ADDRESS 0x3F9FF4 /end MEASUREMENT
/begin COMPU_METHOD MC_P0406UPD_CNTR "P0406UPD_CNTR conversion" RAT_FUNC "%10.0" "Unitless" COEFFS 0 1 0 0 0 1 /end COMPU_METHOD
/begin MEASUREMENT P0407MALF "OBD II malfunction flag for ithp below min. value" UBYTE MC_P0407MALF 0 0 0 0 ECU_ADDRESS 0x3FA244 /end MEASUREMENT
/begin COMPU_METHOD MC_P0407MALF "P0407MALF conversion" RAT_FUNC "%3.0" "Unitless" COEFFS 0 1 0 0 0 1 /end COMPU_METHOD
/begin MEASUREMENT P0407UPDATE "p0407 malf update indication flag" UBYTE MC_P0407UPDATE 0 0 0 0 ECU_ADDRESS 0x3FA240 /end MEASUREMENT
/begin COMPU_METHOD MC_P0407UPDATE "P0407UPDATE conversion" RAT_FUNC "%3.0" "Unitless" COEFFS 0 1 0 0 0 1 /end COMPU_METHOD
/begin MEASUREMENT P0407UPD_CNTR "ITHP low failure update - Counter" SLONG MC_P0407UPD_CNTR 0 0 0 0 ECU_ADDRESS 0x3FA220 /end MEASUREMENT
/begin COMPU_METHOD MC_P0407UPD_CNTR "P0407UPD_CNTR conversion" RAT_FUNC "%10.0" "Unitless" COEFFS 0 1 0 0 0 1 /end COMPU_METHOD
/begin MEASUREMENT P0408MALF "OBDII malfunction flag for ITHP above max. Cal. value" UBYTE MC_P0408MALF 0 0 0 0 ECU_ADDRESS 0x3FA245 /end MEASUREMENT
/begin COMPU_METHOD MC_P0408MALF "P0408MALF conversion" RAT_FUNC "%3.0" "Unitless" COEFFS 0 1 0 0 0 1 /end COMPU_METHOD
/begin MEASUREMENT P0408UPDATE "p0408 malf update indication flag" UBYTE MC_P0408UPDATE 0 0 0 0 ECU_ADDRESS 0x3FA241 /end MEASUREMENT
/begin COMPU_METHOD MC_P0408UPDATE "P0408UPDATE conversion" RAT_FUNC "%3.0" "Unitless" COEFFS 0 1 0 0 0 1 /end COMPU_METHOD
/begin MEASUREMENT P0408UPD_CNTR "ITHP high failure update - counter" SLONG MC_P0408UPD_CNTR 0 0 0 0 ECU_ADDRESS 0x3FA224 /end MEASUREMENT
/begin COMPU_METHOD MC_P0408UPD_CNTR "P0408UPD_CNTR conversion" RAT_FUNC "%10.0" "Unitless" COEFFS 0 1 0 0 0 1 /end COMPU_METHOD
/begin MEASUREMENT P0472MALF "OBD II malfunction flag for EBP  above max cal value" UBYTE MC_P0472MALF 0 0 0 0 ECU_ADDRESS 0x3FA217 /end MEASUREMENT
/begin COMPU_METHOD MC_P0472MALF "P0472MALF conversion" RAT_FUNC "%3.0" "Unitless" COEFFS 0 1 0 0 0 1 /end COMPU_METHOD
/begin MEASUREMENT P0472UPDATE "p0472 malf update flag" UBYTE MC_P0472UPDATE 0 0 0 0 ECU_ADDRESS 0x3FA213 /end MEASUREMENT
/begin COMPU_METHOD MC_P0472UPDATE "P0472UPDATE conversion" RAT_FUNC "%3.0" "Unitless" COEFFS 0 1 0 0 0 1 /end COMPU_METHOD
/begin MEASUREMENT P0472UPD_CNTR "System voltage low failure update counter" SLONG MC_P0472UPD_CNTR 0 0 0 0 ECU_ADDRESS 0x3FA1EC /end MEASUREMENT
/begin COMPU_METHOD MC_P0472UPD_CNTR "P0472UPD_CNTR conversion" RAT_FUNC "%10.0" "Unitless" COEFFS 0 1 0 0 0 1 /end COMPU_METHOD
/begin MEASUREMENT P0473MALF "" UBYTE MC_P0473MALF 0 0 0 0 ECU_ADDRESS 0x3FA218 /end MEASUREMENT
/begin COMPU_METHOD MC_P0473MALF "P0473MALF conversion" RAT_FUNC "%3.0" "Unitless" COEFFS 0 1 0 0 0 1 /end COMPU_METHOD
/begin MEASUREMENT P0473UPDATE " p0473 malf update flag" UBYTE MC_P0473UPDATE 0 0 0 0 ECU_ADDRESS 0x3FA214 /end MEASUREMENT
/begin COMPU_METHOD MC_P0473UPDATE "P0473UPDATE conversion" RAT_FUNC "%3.0" "Unitless" COEFFS 0 1 0 0 0 1 /end COMPU_METHOD
/begin MEASUREMENT P0473UPD_CNTR "System voltage high failure update counter" SLONG MC_P0473UPD_CNTR 0 0 0 0 ECU_ADDRESS 0x3FA1F0 /end MEASUREMENT
/begin COMPU_METHOD MC_P0473UPD_CNTR "P0473UPD_CNTR conversion" RAT_FUNC "%10.0" "Unitless" COEFFS 0 1 0 0 0 1 /end COMPU_METHOD
/begin CHARACTERISTIC P0505SW "0=cal_out; 1=non_mil; 2=mil" VALUE 0x57825 SD_UBYTE 0 SC_P0505SW 0 255 /end CHARACTERISTIC
/begin COMPU_METHOD SC_P0505SW "P0505SW conversion" RAT_FUNC "%3.0" "Unitless" COEFFS 0 1 0 0 0 1 /end COMPU_METHOD
/begin MEASUREMENT P0562MALF "OBD II malfunction flag for system voltage below min. value" UBYTE MC_P0562MALF 0 0 0 0 ECU_ADDRESS 0x3FA269 /end MEASUREMENT
/begin COMPU_METHOD MC_P0562MALF "P0562MALF conversion" RAT_FUNC "%3.0" "Unitless" COEFFS 0 1 0 0 0 1 /end COMPU_METHOD
/begin MEASUREMENT P0562UPDATE "p0562 malf update indication flag" UBYTE MC_P0562UPDATE 0 0 0 0 ECU_ADDRESS 0x3FA267 /end MEASUREMENT
/begin COMPU_METHOD MC_P0562UPDATE "P0562UPDATE conversion" RAT_FUNC "%3.0" "Unitless" COEFFS 0 1 0 0 0 1 /end COMPU_METHOD
/begin MEASUREMENT P0562UPD_CNTR "System voltage low failure update - Counter" SLONG MC_P0562UPD_CNTR 0 0 0 0 ECU_ADDRESS 0x3FA25C /end MEASUREMENT
/begin COMPU_METHOD MC_P0562UPD_CNTR "P0562UPD_CNTR conversion" RAT_FUNC "%10.0" "Unitless" COEFFS 0 1 0 0 0 1 /end COMPU_METHOD
/begin MEASUREMENT P0563MALF "OBDII malfunction flag for System voltage above max. Cal. value" UBYTE MC_P0563MALF 0 0 0 0 ECU_ADDRESS 0x3FA26A /end MEASUREMENT
/begin COMPU_METHOD MC_P0563MALF "P0563MALF conversion" RAT_FUNC "%3.0" "Unitless" COEFFS 0 1 0 0 0 1 /end COMPU_METHOD
/begin MEASUREMENT P0563UPDATE "p0563 malf update indication flag" UBYTE MC_P0563UPDATE 0 0 0 0 ECU_ADDRESS 0x3FA268 /end MEASUREMENT
/begin COMPU_METHOD MC_P0563UPDATE "P0563UPDATE conversion" RAT_FUNC "%3.0" "Unitless" COEFFS 0 1 0 0 0 1 /end COMPU_METHOD
/begin MEASUREMENT P0563UPD_CNTR "System voltage  high failure update - counter" SLONG MC_P0563UPD_CNTR 0 0 0 0 ECU_ADDRESS 0x3FA260 /end MEASUREMENT
/begin COMPU_METHOD MC_P0563UPD_CNTR "P0563UPD_CNTR conversion" RAT_FUNC "%10.0" "Unitless" COEFFS 0 1 0 0 0 1 /end COMPU_METHOD
/begin CHARACTERISTIC P0603SW "0=cal_out; 1=non_mil; 2=mil" VALUE 0x575C1 SD_UBYTE 0 SC_P0603SW 0 255 /end CHARACTERISTIC
/begin COMPU_METHOD SC_P0603SW "P0603SW conversion" RAT_FUNC "%3.0" "Unitless" COEFFS 0 1 0 0 0 1 /end COMPU_METHOD
/begin CHARACTERISTIC P0605SW "0=cal_out; 1=non_mil; 2=mil" VALUE 0x575C0 SD_UBYTE 0 SC_P0605SW 0 255 /end CHARACTERISTIC
/begin COMPU_METHOD SC_P0605SW "P0605SW conversion" RAT_FUNC "%3.0" "Unitless" COEFFS 0 1 0 0 0 1 /end COMPU_METHOD
/begin MEASUREMENT P1 "Multiplicative adaptive parameter for throttle flow model" FLOAT32_IEEE MC_P1 0 0 0 0 ECU_ADDRESS 0x3FA110 /end MEASUREMENT
/begin COMPU_METHOD MC_P1 "P1 conversion" RAT_FUNC "%10.5" "Unitless" COEFFS 0 1 0 0 0 1 /end COMPU_METHOD
/begin CHARACTERISTIC P1000SW "0=cal_out; 1=non_mil; 2=mil" VALUE 0x563B4 SD_UBYTE 0 SC_P1000SW 0 255 /end CHARACTERISTIC
/begin COMPU_METHOD SC_P1000SW "P1000SW conversion" RAT_FUNC "%3.0" "Unitless" COEFFS 0 1 0 0 0 1 /end COMPU_METHOD
/begin CHARACTERISTIC P1001SW "0=cal_out; 1=non_mil; 2=mil" VALUE 0x57824 SD_UBYTE 0 SC_P1001SW 0 255 /end CHARACTERISTIC
/begin COMPU_METHOD SC_P1001SW "P1001SW conversion" RAT_FUNC "%3.0" "Unitless" COEFFS 0 1 0 0 0 1 /end COMPU_METHOD
/begin CHARACTERISTIC P1100SW "0=cal_out; 1=non_mil; 2=mil" VALUE 0x563A0 SD_UBYTE 0 SC_P1100SW 0 255 /end CHARACTERISTIC
/begin COMPU_METHOD SC_P1100SW "P1100SW conversion" RAT_FUNC "%3.0" "Unitless" COEFFS 0 1 0 0 0 1 /end COMPU_METHOD
/begin CHARACTERISTIC P1112SW "0=cal_out; 1=non_mil; 2=mil" VALUE 0x5639F SD_UBYTE 0 SC_P1112SW 0 255 /end CHARACTERISTIC
/begin COMPU_METHOD SC_P1112SW "P1112SW conversion" RAT_FUNC "%3.0" "Unitless" COEFFS 0 1 0 0 0 1 /end COMPU_METHOD
/begin CHARACTERISTIC P1117SW "0=cal_out; 1=non_mil; 2=mil" VALUE 0x5639E SD_UBYTE 0 SC_P1117SW 0 255 /end CHARACTERISTIC
/begin COMPU_METHOD SC_P1117SW "P1117SW conversion" RAT_FUNC "%3.0" "Unitless" COEFFS 0 1 0 0 0 1 /end COMPU_METHOD
/begin CHARACTERISTIC P1125SW "0=cal_out; 1=non_mil; 2=mil" VALUE 0x5639D SD_UBYTE 0 SC_P1125SW 0 255 /end CHARACTERISTIC
/begin COMPU_METHOD SC_P1125SW "P1125SW conversion" RAT_FUNC "%3.0" "Unitless" COEFFS 0 1 0 0 0 1 /end COMPU_METHOD
/begin CHARACTERISTIC P1131SW "0=cal_out; 1=non_mil; 2=mil" VALUE 0x57B4C SD_UBYTE 0 SC_P1131SW 0 255 /end CHARACTERISTIC
/begin COMPU_METHOD SC_P1131SW "P1131SW conversion" RAT_FUNC "%3.0" "Unitless" COEFFS 0 1 0 0 0 1 /end COMPU_METHOD
/begin CHARACTERISTIC P1132SW "0=cal_out; 1=non_mil; 2=mil" VALUE 0x57B4B SD_UBYTE 0 SC_P1132SW 0 255 /end CHARACTERISTIC
/begin COMPU_METHOD SC_P1132SW "P1132SW conversion" RAT_FUNC "%3.0" "Unitless" COEFFS 0 1 0 0 0 1 /end COMPU_METHOD
/begin CHARACTERISTIC P1137SW "0=cal_out; 1=non_mil; 2=mil" VALUE 0x57B48 SD_UBYTE 0 SC_P1137SW 0 255 /end CHARACTERISTIC
/begin COMPU_METHOD SC_P1137SW "P1137SW conversion" RAT_FUNC "%3.0" "Unitless" COEFFS 0 1 0 0 0 1 /end COMPU_METHOD
/begin CHARACTERISTIC P1138SW "0=cal_out; 1=non_mil; 2=mil" VALUE 0x57B47 SD_UBYTE 0 SC_P1138SW 0 255 /end CHARACTERISTIC
/begin COMPU_METHOD SC_P1138SW "P1138SW conversion" RAT_FUNC "%3.0" "Unitless" COEFFS 0 1 0 0 0 1 /end COMPU_METHOD
/begin CHARACTERISTIC P1151SW "0=cal_out; 1=non_mil; 2=mil" VALUE 0x57B4A SD_UBYTE 0 SC_P1151SW 0 255 /end CHARACTERISTIC
/begin COMPU_METHOD SC_P1151SW "P1151SW conversion" RAT_FUNC "%3.0" "Unitless" COEFFS 0 1 0 0 0 1 /end COMPU_METHOD
/begin CHARACTERISTIC P1152SW "0=cal_out; 1=non_mil; 2=mil" VALUE 0x57B49 SD_UBYTE 0 SC_P1152SW 0 255 /end CHARACTERISTIC
/begin COMPU_METHOD SC_P1152SW "P1152SW conversion" RAT_FUNC "%3.0" "Unitless" COEFFS 0 1 0 0 0 1 /end COMPU_METHOD
/begin CHARACTERISTIC P1157SW "0=cal_out; 1=non_mil; 2=mil" VALUE 0x57B46 SD_UBYTE 0 SC_P1157SW 0 255 /end CHARACTERISTIC
/begin COMPU_METHOD SC_P1157SW "P1157SW conversion" RAT_FUNC "%3.0" "Unitless" COEFFS 0 1 0 0 0 1 /end COMPU_METHOD
/begin CHARACTERISTIC P1158SW "0=cal_out; 1=non_mil; 2=mil" VALUE 0x57B45 SD_UBYTE 0 SC_P1158SW 0 255 /end CHARACTERISTIC
/begin COMPU_METHOD SC_P1158SW "P1158SW conversion" RAT_FUNC "%3.0" "Unitless" COEFFS 0 1 0 0 0 1 /end COMPU_METHOD
/begin MEASUREMENT P1210MALF "malfunction flag" UBYTE MC_P1210MALF 0 0 0 0 ECU_ADDRESS 0x3FA041 /end MEASUREMENT
/begin COMPU_METHOD MC_P1210MALF "P1210MALF conversion" RAT_FUNC "%3.0" "Unitless" COEFFS 0 1 0 0 0 1 /end COMPU_METHOD
/begin MEASUREMENT P1211MALF "malfunction flag" UBYTE MC_P1211MALF 0 0 0 0 ECU_ADDRESS 0x3FA040 /end MEASUREMENT
/begin COMPU_METHOD MC_P1211MALF "P1211MALF conversion" RAT_FUNC "%3.0" "Unitless" COEFFS 0 1 0 0 0 1 /end COMPU_METHOD
/begin MEASUREMENT P1280MALF "OBDII malfunction flag for icp below min cal value" UBYTE MC_P1280MALF 0 0 0 0 ECU_ADDRESS 0x3FA048 /end MEASUREMENT
/begin COMPU_METHOD MC_P1280MALF "P1280MALF conversion" RAT_FUNC "%3.0" "Unitless" COEFFS 0 1 0 0 0 1 /end COMPU_METHOD
/begin MEASUREMENT P1280UPDATE "p1280 malfunction update flag" UBYTE MC_P1280UPDATE 0 0 0 0 ECU_ADDRESS 0x3FA046 /end MEASUREMENT
/begin COMPU_METHOD MC_P1280UPDATE "P1280UPDATE conversion" RAT_FUNC "%3.0" "Unitless" COEFFS 0 1 0 0 0 1 /end COMPU_METHOD
/begin MEASUREMENT P1280UPD_CNTR "icp low failure update counetr" SLONG MC_P1280UPD_CNTR 0 0 0 0 ECU_ADDRESS 0x3FA028 /end MEASUREMENT
/begin COMPU_METHOD MC_P1280UPD_CNTR "P1280UPD_CNTR conversion" RAT_FUNC "%10.0" "Unitless" COEFFS 0 1 0 0 0 1 /end COMPU_METHOD
/begin MEASUREMENT P1281MALF "OBDII malfunction flag for icp above max calibration value" UBYTE MC_P1281MALF 0 0 0 0 ECU_ADDRESS 0x3FA047 /end MEASUREMENT
/begin COMPU_METHOD MC_P1281MALF "P1281MALF conversion" RAT_FUNC "%3.0" "Unitless" COEFFS 0 1 0 0 0 1 /end COMPU_METHOD
/begin MEASUREMENT P1281UPDATE "p01281 mafunction update flag" UBYTE MC_P1281UPDATE 0 0 0 0 ECU_ADDRESS 0x3FA045 /end MEASUREMENT
/begin COMPU_METHOD MC_P1281UPDATE "P1281UPDATE conversion" RAT_FUNC "%3.0" "Unitless" COEFFS 0 1 0 0 0 1 /end COMPU_METHOD
/begin MEASUREMENT P1281UPD_CNTR "icp high failure update counter" SLONG MC_P1281UPD_CNTR 0 0 0 0 ECU_ADDRESS 0x3FA024 /end MEASUREMENT
/begin COMPU_METHOD MC_P1281UPD_CNTR "P1281UPD_CNTR conversion" RAT_FUNC "%10.0" "Unitless" COEFFS 0 1 0 0 0 1 /end COMPU_METHOD
/begin CHARACTERISTIC P1500SW "0=cal_out; 1=non_mil; 2=mil" VALUE 0x5639C SD_UBYTE 0 SC_P1500SW 0 255 /end CHARACTERISTIC
/begin COMPU_METHOD SC_P1500SW "P1500SW conversion" RAT_FUNC "%3.0" "Unitless" COEFFS 0 1 0 0 0 1 /end COMPU_METHOD
/begin CHARACTERISTIC P1501SW "0=cal_out; 1=non_mil; 2=mil" VALUE 0x57826 SD_UBYTE 0 SC_P1501SW 0 255 /end CHARACTERISTIC
/begin COMPU_METHOD SC_P1501SW "P1501SW conversion" RAT_FUNC "%3.0" "Unitless" COEFFS 0 1 0 0 0 1 /end COMPU_METHOD
/begin CHARACTERISTIC P1633SW "0=cal_out; 1=non_mil; 2=mil" VALUE 0x575B8 SD_UBYTE 0 SC_P1633SW 0 255 /end CHARACTERISTIC
/begin COMPU_METHOD SC_P1633SW "P1633SW conversion" RAT_FUNC "%3.0" "Unitless" COEFFS 0 1 0 0 0 1 /end COMPU_METHOD
/begin CHARACTERISTIC P1705SW "0=cal_out; 1=non_mil; 2=mil" VALUE 0x57B4D SD_UBYTE 0 SC_P1705SW 0 255 /end CHARACTERISTIC
/begin COMPU_METHOD SC_P1705SW "P1705SW conversion" RAT_FUNC "%3.0" "Unitless" COEFFS 0 1 0 0 0 1 /end COMPU_METHOD
/begin MEASUREMENT P1P2FMFLG "PPS SENSOR COMPARISON TEST FAILURE" UBYTE MC_P1P2FMFLG 0 0 0 0 ECU_ADDRESS 0x3FA1B4 /end MEASUREMENT
/begin COMPU_METHOD MC_P1P2FMFLG "P1P2FMFLG conversion" RAT_FUNC "%3.0" "Unitless" COEFFS 0 1 0 0 0 1 /end COMPU_METHOD
/begin MEASUREMENT P1P2_CNT "PEDAL COMPARISON FAILURE COUNTER" UBYTE MC_P1P2_CNT 0 0 0 0 ECU_ADDRESS 0x3FA1B9 /end MEASUREMENT
/begin COMPU_METHOD MC_P1P2_CNT "P1P2_CNT conversion" RAT_FUNC "%3.0" "Unitless" COEFFS 0 1 0 0 0 1 /end COMPU_METHOD
/begin MEASUREMENT P1P3FMFLG "PPS SENSOR COMPARISON TEST FAILURE" UBYTE MC_P1P3FMFLG 0 0 0 0 ECU_ADDRESS 0x3FA1B3 /end MEASUREMENT
/begin COMPU_METHOD MC_P1P3FMFLG "P1P3FMFLG conversion" RAT_FUNC "%3.0" "Unitless" COEFFS 0 1 0 0 0 1 /end COMPU_METHOD
/begin MEASUREMENT P1P3_CNT "PEDAL COMPARISON FAILURE COUNTER" UBYTE MC_P1P3_CNT 0 0 0 0 ECU_ADDRESS 0x3FA1B8 /end MEASUREMENT
/begin COMPU_METHOD MC_P1P3_CNT "P1P3_CNT conversion" RAT_FUNC "%3.0" "Unitless" COEFFS 0 1 0 0 0 1 /end COMPU_METHOD
/begin MEASUREMENT P2 "Additive adaptive parameter for throttle flow model" FLOAT32_IEEE MC_P2 0 0 0 0 ECU_ADDRESS 0x3FA10C /end MEASUREMENT
/begin COMPU_METHOD MC_P2 "P2 conversion" RAT_FUNC "%10.5" "Unitless" COEFFS 0 1 0 0 0 1 /end COMPU_METHOD
/begin MEASUREMENT P2P3FMFLG "PPS SENSOR COMPARISON TEST FAILURE" UBYTE MC_P2P3FMFLG 0 0 0 0 ECU_ADDRESS 0x3FA1B2 /end MEASUREMENT
/begin COMPU_METHOD MC_P2P3FMFLG "P2P3FMFLG conversion" RAT_FUNC "%3.0" "Unitless" COEFFS 0 1 0 0 0 1 /end COMPU_METHOD
/begin MEASUREMENT P2P3SCFMFLG "PPS SENSOR COMPARISON TEST FAILURE for short circuit between sensors 2 and 3" UBYTE MC_P2P3SCFMFLG 0 0 0 0 ECU_ADDRESS 0x3FA1B1 /end MEASUREMENT
/begin COMPU_METHOD MC_P2P3SCFMFLG "P2P3SCFMFLG conversion" RAT_FUNC "%3.0" "Unitless" COEFFS 0 1 0 0 0 1 /end COMPU_METHOD
/begin MEASUREMENT P2P3_CNT "PEDAL COMPARISON FAILURE COUNTER" UBYTE MC_P2P3_CNT 0 0 0 0 ECU_ADDRESS 0x3FA1B7 /end MEASUREMENT
/begin COMPU_METHOD MC_P2P3_CNT "P2P3_CNT conversion" RAT_FUNC "%3.0" "Unitless" COEFFS 0 1 0 0 0 1 /end COMPU_METHOD
/begin MEASUREMENT P2P3_SCCNT "PEDAL COMPARISON FAILURE COUNTER for short circuit between sensors 2-3" UBYTE MC_P2P3_SCCNT 0 0 0 0 ECU_ADDRESS 0x3FA1B6 /end MEASUREMENT
/begin COMPU_METHOD MC_P2P3_SCCNT "P2P3_SCCNT conversion" RAT_FUNC "%3.0" "Unitless" COEFFS 0 1 0 0 0 1 /end COMPU_METHOD
/begin CHARACTERISTIC PAPMAX_VLTS[0] "High limits for eletronic throttle accelerator pedal inputs, voltage" VALUE 0x53508 SD_FLOAT32_IEEE 0 SC_PAPMAX_VLTS 0 5 /end CHARACTERISTIC
/begin COMPU_METHOD SC_PAPMAX_VLTS "PAPMAX_VLTS conversion" RAT_FUNC "%10.5" "V" COEFFS 0 1 0 0 0 1 /end COMPU_METHOD
/begin CHARACTERISTIC PAPMAX_VLTS[1] "High limits for eletronic throttle accelerator pedal inputs, voltage" VALUE 0x5350C SD_FLOAT32_IEEE 0 SC_PAPMAX_VLTS 0 5 /end CHARACTERISTIC
/begin CHARACTERISTIC PAPMAX_VLTS[2] "High limits for eletronic throttle accelerator pedal inputs, voltage" VALUE 0x53510 SD_FLOAT32_IEEE 0 SC_PAPMAX_VLTS 0 5 /end CHARACTERISTIC
/begin CHARACTERISTIC PAPMIN_VLTS[0] "Low limits for eletronic throttle accelerator pedal inputs, voltage" VALUE 0x534FC SD_FLOAT32_IEEE 0 SC_PAPMIN_VLTS 0 5 /end CHARACTERISTIC
/begin COMPU_METHOD SC_PAPMIN_VLTS "PAPMIN_VLTS conversion" RAT_FUNC "%10.5" "V" COEFFS 0 1 0 0 0 1 /end COMPU_METHOD
/begin CHARACTERISTIC PAPMIN_VLTS[1] "Low limits for eletronic throttle accelerator pedal inputs, voltage" VALUE 0x53500 SD_FLOAT32_IEEE 0 SC_PAPMIN_VLTS 0 5 /end CHARACTERISTIC
/begin CHARACTERISTIC PAPMIN_VLTS[2] "Low limits for eletronic throttle accelerator pedal inputs, voltage" VALUE 0x53504 SD_FLOAT32_IEEE 0 SC_PAPMIN_VLTS 0 5 /end CHARACTERISTIC
/begin MEASUREMENT PATS_ACC "Secure access method for ANTI-THEFT.  0 -> coded, 1 -> timed." UBYTE MC_PATS_ACC 0 0 0 0 ECU_ADDRESS 0x3FB03E /end MEASUREMENT
/begin COMPU_METHOD MC_PATS_ACC "PATS_ACC conversion" RAT_FUNC "%3.0" "Unitless" COEFFS 0 1 0 0 0 1 /end COMPU_METHOD
/begin MEASUREMENT PATS_ACTIVE "PATS Operation Status, 1- PATS S/W Running, 0 - PATS  S/W Not Running" UBYTE MC_PATS_ACTIVE 0 0 0 0 ECU_ADDRESS 0x3FADB8 /end MEASUREMENT
/begin COMPU_METHOD MC_PATS_ACTIVE "PATS_ACTIVE conversion" RAT_FUNC "%3.0" "Unitless" COEFFS 0 1 0 0 0 1 /end COMPU_METHOD
/begin MEASUREMENT PBA "parking brake applied indicator flag, 1 - brake applied" UBYTE MC_PBA 0 0 0 0 ECU_ADDRESS 0x3FA9FB /end MEASUREMENT
/begin COMPU_METHOD MC_PBA "PBA conversion" RAT_FUNC "%3.0" "Unitless" COEFFS 0 1 0 0 0 1 /end COMPU_METHOD
/begin MEASUREMENT PCF_AC "Filtered ROC of pedal for A/C control finctions." FLOAT32_IEEE MC_PCF_AC 0 0 0 0 ECU_ADDRESS 0x3F9E7C /end MEASUREMENT
/begin COMPU_METHOD MC_PCF_AC "PCF_AC conversion" RAT_FUNC "%10.5" "Unitless" COEFFS 0 1 0 0 0 1 /end COMPU_METHOD
/begin CHARACTERISTIC PCLCH_AC "Time constant for pcf_ac" VALUE 0x56274 SD_FLOAT32_IEEE 0 SC_PCLCH_AC 0 63.999 /end CHARACTERISTIC
/begin COMPU_METHOD SC_PCLCH_AC "PCLCH_AC conversion" RAT_FUNC "%10.5" "unitless" COEFFS 0 1 0 0 0 1 /end COMPU_METHOD
/begin MEASUREMENT PCM_RST_CNT "Counter used to delay a diagnostic tester's request for PCM Reset to allow respnse message to be sent." UBYTE MC_PCM_RST_CNT 0 0 0 0 ECU_ADDRESS 0x3FAB5E /end MEASUREMENT
/begin COMPU_METHOD MC_PCM_RST_CNT "PCM_RST_CNT conversion" RAT_FUNC "%3.0" "Unitless" COEFFS 0 1 0 0 0 1 /end COMPU_METHOD
/begin MEASUREMENT PCT_LOAD "Percent inferred load based on mapped engine behavior at ESTP" FLOAT32_IEEE MC_PCT_LOAD 0 0 0 0 ECU_ADDRESS 0x3FAC90 /end MEASUREMENT
/begin COMPU_METHOD MC_PCT_LOAD "PCT_LOAD conversion" RAT_FUNC "%10.5" "Unitless" COEFFS 0 1 0 0 0 1 /end COMPU_METHOD
/begin MEASUREMENT PDIF_BP_REF_ADD "BP offset value" FLOAT32_IEEE MC_PDIF_BP_REF_ADD 0 0 0 0 ECU_ADDRESS 0x3FAD54 /end MEASUREMENT
/begin COMPU_METHOD MC_PDIF_BP_REF_ADD "PDIF_BP_REF_ADD conversion" RAT_FUNC "%10.5" "Unitless" COEFFS 0 1 0 0 0 1 /end COMPU_METHOD
/begin MEASUREMENT PDIF_EBP_REF_ADD "Differential referance term" FLOAT32_IEEE MC_PDIF_EBP_REF_ADD 0 0 0 0 ECU_ADDRESS 0x3FAD58 /end MEASUREMENT
/begin COMPU_METHOD MC_PDIF_EBP_REF_ADD "PDIF_EBP_REF_ADD conversion" RAT_FUNC "%10.5" "Unitless" COEFFS 0 1 0 0 0 1 /end COMPU_METHOD
/begin MEASUREMENT PDIF_MAP_REF_ADD "Differential MAP reference term" FLOAT32_IEEE MC_PDIF_MAP_REF_ADD 0 0 0 0 ECU_ADDRESS 0x3FAD5C /end MEASUREMENT
/begin COMPU_METHOD MC_PDIF_MAP_REF_ADD "PDIF_MAP_REF_ADD conversion" RAT_FUNC "%10.5" "Unitless" COEFFS 0 1 0 0 0 1 /end COMPU_METHOD
/begin MEASUREMENT PDL "PRNDL Position - from A to D conversion" UBYTE MC_PDL 0 0 0 0 ECU_ADDRESS 0x3FAF6A /end MEASUREMENT
/begin COMPU_METHOD MC_PDL "PDL conversion" RAT_FUNC "%3.0" "Unitless" COEFFS 0 1 0 0 0 1 /end COMPU_METHOD
/begin MEASUREMENT PDL_ERROR "Flag indicating PRNDL Position Error (1 = Failed)" UBYTE MC_PDL_ERROR 0 0 0 0 ECU_ADDRESS 0x3FB025 /end MEASUREMENT
/begin COMPU_METHOD MC_PDL_ERROR "PDL_ERROR conversion" RAT_FUNC "%3.0" "Unitless" COEFFS 0 1 0 0 0 1 /end COMPU_METHOD
/begin MEASUREMENT PFMFLG "PPS SENSORS HAVE ALL FAILED" UBYTE MC_PFMFLG 0 0 0 0 ECU_ADDRESS 0x3FA1B0 /end MEASUREMENT
/begin COMPU_METHOD MC_PFMFLG "PFMFLG conversion" RAT_FUNC "%3.0" "Unitless" COEFFS 0 1 0 0 0 1 /end COMPU_METHOD
/begin MEASUREMENT PGM_TEMP_BYP "Purge Monitor temperature bypass flag; 1 -> bypass monitor." UBYTE MC_PGM_TEMP_BYP 0 0 0 0 ECU_ADDRESS 0x3FADBE /end MEASUREMENT
/begin COMPU_METHOD MC_PGM_TEMP_BYP "PGM_TEMP_BYP conversion" RAT_FUNC "%3.0" "Unitless" COEFFS 0 1 0 0 0 1 /end COMPU_METHOD
/begin MEASUREMENT PHFMFLG_A[0] "ARRAY OF PEDAL POSITION HIGH FAILURE FLAGS" UBYTE MC_PHFMFLG_A 0 0 0 1 ECU_ADDRESS 0x3FA1A8 /end MEASUREMENT
/begin COMPU_METHOD MC_PHFMFLG_A "PHFMFLG_A conversion" RAT_FUNC "%3.0" "Unitless" COEFFS 0 1 0 0 0 1 /end COMPU_METHOD
/begin MEASUREMENT PHFMFLG_A[1] "ARRAY OF PEDAL POSITION HIGH FAILURE FLAGS" UBYTE MC_PHFMFLG_A 0 0 0 1 ECU_ADDRESS 0x3FA1A9 /end MEASUREMENT
/begin MEASUREMENT PHFMFLG_A[2] "ARRAY OF PEDAL POSITION HIGH FAILURE FLAGS" UBYTE MC_PHFMFLG_A 0 0 0 1 ECU_ADDRESS 0x3FA1AA /end MEASUREMENT
/begin MEASUREMENT PHFM_CNT_A[0] "COUNTER OF PEDAL POSITION HIGH FAILURES" UBYTE MC_PHFM_CNT_A 0 0 0 255 ECU_ADDRESS 0x3FA1A5 /end MEASUREMENT
/begin COMPU_METHOD MC_PHFM_CNT_A "PHFM_CNT_A conversion" RAT_FUNC "%3.0" "Unitless" COEFFS 0 1 0 0 0 1 /end COMPU_METHOD
/begin MEASUREMENT PHFM_CNT_A[1] "COUNTER OF PEDAL POSITION HIGH FAILURES" UBYTE MC_PHFM_CNT_A 0 0 0 255 ECU_ADDRESS 0x3FA1A6 /end MEASUREMENT
/begin MEASUREMENT PHFM_CNT_A[2] "COUNTER OF PEDAL POSITION HIGH FAILURES" UBYTE MC_PHFM_CNT_A 0 0 0 255 ECU_ADDRESS 0x3FA1A7 /end MEASUREMENT
/begin CHARACTERISTIC PHFM_INC "VARIABLE  TO INCREMENT THE  PEDAL HIGH FAILURE COUNTER BY" VALUE 0x56772 SD_UBYTE 0 SC_PHFM_INC 8 255 /end CHARACTERISTIC
/begin COMPU_METHOD SC_PHFM_INC "PHFM_INC conversion" RAT_FUNC "%3.0" "Unitless" COEFFS 0 1 0 0 0 1 /end COMPU_METHOD
/begin CHARACTERISTIC PHFM_LVL "NUMBER OF PEDAL HIGH FAILURE COUNTS FOR FLAG TO SET" VALUE 0x56771 SD_UBYTE 0 SC_PHFM_LVL 0 254 /end CHARACTERISTIC
/begin COMPU_METHOD SC_PHFM_LVL "PHFM_LVL conversion" RAT_FUNC "%3.0" "Unitless" COEFFS 0 1 0 0 0 1 /end COMPU_METHOD
/begin CHARACTERISTIC PIDMAP_1 "J1979 map of supported PIDs for numbers $01-$16." VALUE 0x5633A SD_UWORD 0 SC_PIDMAP_1 0 65535 /end CHARACTERISTIC
/begin COMPU_METHOD SC_PIDMAP_1 "PIDMAP_1 conversion" RAT_FUNC "%5.0" "NONE" COEFFS 0 1 0 0 0 1 /end COMPU_METHOD
/begin CHARACTERISTIC PIDMAP_2 "J1979 map of supported PIDs for numbers $17-$20." VALUE 0x56338 SD_UWORD 0 SC_PIDMAP_2 0 65535 /end CHARACTERISTIC
/begin COMPU_METHOD SC_PIDMAP_2 "PIDMAP_2 conversion" RAT_FUNC "%5.0" "NONE" COEFFS 0 1 0 0 0 1 /end COMPU_METHOD
/begin CHARACTERISTIC PIDMAP_3 "J1979 map of supported PIDs for mode 01 PIDs 01-16." VALUE 0x56336 SD_UWORD 0 SC_PIDMAP_3 0 65535 /end CHARACTERISTIC
/begin COMPU_METHOD SC_PIDMAP_3 "PIDMAP_3 conversion" RAT_FUNC "%5.0" "UNITLESS" COEFFS 0 1 0 0 0 1 /end COMPU_METHOD
/begin CHARACTERISTIC PIDMAP_4 "J1979 map of supported PIDs for mode 01, PIDs 17-20" VALUE 0x56334 SD_UWORD 0 SC_PIDMAP_4 0 65535 /end CHARACTERISTIC
/begin COMPU_METHOD SC_PIDMAP_4 "PIDMAP_4 conversion" RAT_FUNC "%5.0" "UNITLESS" COEFFS 0 1 0 0 0 1 /end COMPU_METHOD
/begin MEASUREMENT PID_10020_D "Data for J1979 Mode $01 PID $20" ULONG MC_PID_10020_D 0 0 0 0 ECU_ADDRESS 0x3F9F24 /end MEASUREMENT
/begin COMPU_METHOD MC_PID_10020_D "PID_10020_D conversion" RAT_FUNC "%10.0" "Unitless" COEFFS 0 1 0 0 0 1 /end COMPU_METHOD
/begin MEASUREMENT PID_20004_D "Freeze frame engine load*255, for SAE J1979 Mode $02 PID $04" UBYTE MC_PID_20004_D 0 0 0 0 ECU_ADDRESS 0x3FAEB1 /end MEASUREMENT
/begin COMPU_METHOD MC_PID_20004_D "PID_20004_D conversion" RAT_FUNC "%3.0" "Unitless" COEFFS 0 1 0 0 0 1 /end COMPU_METHOD
/begin MEASUREMENT PID_2000A_D "J1979 Mode$02 PID number ^0A, Fuel pressure as indicated by the fuel pressure sensor at the time the freeze frame data was collecte" UBYTE MC_PID_2000A_D 0 0 0 0 ECU_ADDRESS 0x3FADBD /end MEASUREMENT
/begin COMPU_METHOD MC_PID_2000A_D "PID_2000A_D conversion" RAT_FUNC "%3.0" "Unitless" COEFFS 0 1 0 0 0 1 /end COMPU_METHOD
/begin CHARACTERISTIC PID_30921_D "This is a J2190 PID assignment for ^0921, it contains the address of alc_strt_kam. (4 byte address)" VALUE 0x3FADA0 SD_UWORD 0 SC_PID_30921_D 0 -256 /end CHARACTERISTIC
/begin COMPU_METHOD SC_PID_30921_D "PID_30921_D conversion" RAT_FUNC "%5.0" "pointer" COEFFS 0 1 0 0 0 1 /end COMPU_METHOD
/begin CHARACTERISTIC PID_30922_D "Starting address of adaptive fuel table 1" VALUE 0x3FAC54 SD_ULONG 0 SC_PID_30922_D 0 -256 /end CHARACTERISTIC
/begin COMPU_METHOD SC_PID_30922_D "PID_30922_D conversion" RAT_FUNC "%10.0" "unitless" COEFFS 0 1 0 0 0 1 /end COMPU_METHOD
/begin MEASUREMENT PID_30923_D "PID parameter loaded with cell ct, row ct and idle cell switch info on ADPT table 1" UWORD MC_PID_30923_D 0 0 0 0 ECU_ADDRESS 0x3FAD9E /end MEASUREMENT
/begin COMPU_METHOD MC_PID_30923_D "PID_30923_D conversion" RAT_FUNC "%5.0" "Unitless" COEFFS 0 1 0 0 0 1 /end COMPU_METHOD
/begin CHARACTERISTIC PID_30924_D "Starting Address of Adaptive Fuel Table Bank 2" VALUE 0x3FAC50 SD_ULONG 0 SC_PID_30924_D 0 -256 /end CHARACTERISTIC
/begin COMPU_METHOD SC_PID_30924_D "PID_30924_D conversion" RAT_FUNC "%10.0" "unitless" COEFFS 0 1 0 0 0 1 /end COMPU_METHOD
/begin MEASUREMENT PID_30925_D "PID Parameter loaded with cell ct, row ct and idle cell switch info for ADPT table 2" UWORD MC_PID_30925_D 0 0 0 0 ECU_ADDRESS 0x3FAD9C /end MEASUREMENT
/begin COMPU_METHOD MC_PID_30925_D "PID_30925_D conversion" RAT_FUNC "%5.0" "Unitless" COEFFS 0 1 0 0 0 1 /end COMPU_METHOD
/begin MEASUREMENT PID_30944_D "Address of start of PCM generated vehicle speed VID block ranges." ULONG MC_PID_30944_D 0 0 0 0 ECU_ADDRESS 0x3FAC4C /end MEASUREMENT
/begin COMPU_METHOD MC_PID_30944_D "PID_30944_D conversion" RAT_FUNC "%10.0" "Unitless" COEFFS 0 1 0 0 0 1 /end COMPU_METHOD
/begin MEASUREMENT PID_31100_D "4 bytes of data for double word SCP J2190 PID number 1100. Contains location (3 bytes)  and format (1 byte)  of Software ID block." ULONG MC_PID_31100_D 0 0 0 0 ECU_ADDRESS 0x3FAC48 /end MEASUREMENT
/begin COMPU_METHOD MC_PID_31100_D "PID_31100_D conversion" RAT_FUNC "%10.0" "Unitless" COEFFS 0 1 0 0 0 1 /end COMPU_METHOD
/begin MEASUREMENT PID_316FC_D "Freeze Frame value of  VBATT." FLOAT32_IEEE MC_PID_316FC_D 0 0 0 0 ECU_ADDRESS 0x3FAEA0 /end MEASUREMENT
/begin COMPU_METHOD MC_PID_316FC_D "PID_316FC_D conversion" RAT_FUNC "%10.5" "Unitless" COEFFS 0 1 0 0 0 1 /end COMPU_METHOD
/begin MEASUREMENT PID_3C115_D "Data for single byte SCP J2190 PID number C115, Security Access Status for  PATS (Passive Anti-Theft System)." UBYTE MC_PID_3C115_D 0 0 0 0 ECU_ADDRESS 0x3FADBA /end MEASUREMENT
/begin COMPU_METHOD MC_PID_3C115_D "PID_3C115_D conversion" RAT_FUNC "%3.0" "Unitless" COEFFS 0 1 0 0 0 1 /end COMPU_METHOD
/begin MEASUREMENT PID_3C116_D "4 bytes of data for double word SCP J2190 PID number C116, Request Outcode for PATS (Passive Anti-Theft System)." ULONG MC_PID_3C116_D 0 0 0 0 ECU_ADDRESS 0x3FAC44 /end MEASUREMENT
/begin COMPU_METHOD MC_PID_3C116_D "PID_3C116_D conversion" RAT_FUNC "%10.0" "Unitless" COEFFS 0 1 0 0 0 1 /end COMPU_METHOD
/begin MEASUREMENT PID_3C117_D "4 bytes of data for double word SCP J2190 PID number C117, Parameter Status for PATS (Passive Anti-Theft System)." ULONG MC_PID_3C117_D 0 0 0 0 ECU_ADDRESS 0x3FAC40 /end MEASUREMENT
/begin COMPU_METHOD MC_PID_3C117_D "PID_3C117_D conversion" RAT_FUNC "%10.0" "Unitless" COEFFS 0 1 0 0 0 1 /end COMPU_METHOD
/begin MEASUREMENT PID_3C124_D "Data for single byte SCP J2190 PID number C124, Passive Anti-Theft System (PATS) Status." UBYTE MC_PID_3C124_D 0 0 0 0 ECU_ADDRESS 0x3FADB9 /end MEASUREMENT
/begin COMPU_METHOD MC_PID_3C124_D "PID_3C124_D conversion" RAT_FUNC "%3.0" "Unitless" COEFFS 0 1 0 0 0 1 /end COMPU_METHOD
/begin CHARACTERISTIC PILOT_CLOSE "" VALUE 0x566A4 SD_FLOAT32_IEEE 0 SC_PILOT_CLOSE 0 65535 /end CHARACTERISTIC
/begin COMPU_METHOD SC_PILOT_CLOSE "PILOT_CLOSE conversion" RAT_FUNC "%10.5" "unitless" COEFFS 0 1 0 0 0 1 /end COMPU_METHOD
/begin CHARACTERISTIC PILOT_DURATION "" VALUE 0x566A8 SD_FLOAT32_IEEE 0 SC_PILOT_DURATION 0 65535 /end CHARACTERISTIC
/begin COMPU_METHOD SC_PILOT_DURATION "PILOT_DURATION conversion" RAT_FUNC "%10.5" "unitless" COEFFS 0 1 0 0 0 1 /end COMPU_METHOD
/begin CHARACTERISTIC PILOT_OPEN "" VALUE 0x566AC SD_FLOAT32_IEEE 0 SC_PILOT_OPEN 0 65535 /end CHARACTERISTIC
/begin COMPU_METHOD SC_PILOT_OPEN "PILOT_OPEN conversion" RAT_FUNC "%10.5" "unitless" COEFFS 0 1 0 0 0 1 /end COMPU_METHOD
/begin MEASUREMENT PLFMFLG_A[0] "ARRAY OF PEDAL POSITION  LOW FAILURE FLAGS" UBYTE MC_PLFMFLG_A 0 0 0 1 ECU_ADDRESS 0x3FA1A2 /end MEASUREMENT
/begin COMPU_METHOD MC_PLFMFLG_A "PLFMFLG_A conversion" RAT_FUNC "%3.0" "Unitless" COEFFS 0 1 0 0 0 1 /end COMPU_METHOD
/begin MEASUREMENT PLFMFLG_A[1] "ARRAY OF PEDAL POSITION  LOW FAILURE FLAGS" UBYTE MC_PLFMFLG_A 0 0 0 1 ECU_ADDRESS 0x3FA1A3 /end MEASUREMENT
/begin MEASUREMENT PLFMFLG_A[2] "ARRAY OF PEDAL POSITION  LOW FAILURE FLAGS" UBYTE MC_PLFMFLG_A 0 0 0 1 ECU_ADDRESS 0x3FA1A4 /end MEASUREMENT
/begin MEASUREMENT PLFM_CNT_A[0] "COUNTER OF PEDAL POSITION LOW FAILURES" UBYTE MC_PLFM_CNT_A 0 0 0 255 ECU_ADDRESS 0x3FA19F /end MEASUREMENT
/begin COMPU_METHOD MC_PLFM_CNT_A "PLFM_CNT_A conversion" RAT_FUNC "%3.0" "Unitless" COEFFS 0 1 0 0 0 1 /end COMPU_METHOD
/begin MEASUREMENT PLFM_CNT_A[1] "COUNTER OF PEDAL POSITION LOW FAILURES" UBYTE MC_PLFM_CNT_A 0 0 0 255 ECU_ADDRESS 0x3FA1A0 /end MEASUREMENT
/begin MEASUREMENT PLFM_CNT_A[2] "COUNTER OF PEDAL POSITION LOW FAILURES" UBYTE MC_PLFM_CNT_A 0 0 0 255 ECU_ADDRESS 0x3FA1A1 /end MEASUREMENT
/begin CHARACTERISTIC PLFM_INC "VARIABLE  TO INCREMENT THE  PEDAL LOW FAILURE COUNTER BY" VALUE 0x56770 SD_UBYTE 0 SC_PLFM_INC 8 255 /end CHARACTERISTIC
/begin COMPU_METHOD SC_PLFM_INC "PLFM_INC conversion" RAT_FUNC "%3.0" "Unitless" COEFFS 0 1 0 0 0 1 /end COMPU_METHOD
/begin CHARACTERISTIC PLFM_LVL "NUMBER OF PEDAL LOW FAILURE COUNTS FOR FLAG TO SET" VALUE 0x5676F SD_UBYTE 0 SC_PLFM_LVL 0 254 /end CHARACTERISTIC
/begin COMPU_METHOD SC_PLFM_LVL "PLFM_LVL conversion" RAT_FUNC "%3.0" "Unitless" COEFFS 0 1 0 0 0 1 /end COMPU_METHOD
/begin CHARACTERISTIC PNPM_INC "VARIABLE  TO INCREMENT THE  PEDAL COMPARE FAILURE COUNTER BY" VALUE 0x5676E SD_UBYTE 0 SC_PNPM_INC 8 255 /end CHARACTERISTIC
/begin COMPU_METHOD SC_PNPM_INC "PNPM_INC conversion" RAT_FUNC "%3.0" "Unitless" COEFFS 0 1 0 0 0 1 /end COMPU_METHOD
/begin RECORD_LAYOUT SD_UBYTE FNC_VALUES 1 UBYTE ROW_DIR DIRECT /end RECORD_LAYOUT
/begin RECORD_LAYOUT SD_UWORD FNC_VALUES 1 UWORD ROW_DIR DIRECT /end RECORD_LAYOUT
/begin RECORD_LAYOUT SD_ULONG FNC_VALUES 1 ULONG ROW_DIR DIRECT /end RECORD_LAYOUT
/begin RECORD_LAYOUT SD_SLONG FNC_VALUES 1 SLONG ROW_DIR DIRECT /end RECORD_LAYOUT
/begin RECORD_LAYOUT SD_FLOAT32_IEEE FNC_VALUES 1 FLOAT32_IEEE ROW_DIR DIRECT /end RECORD_LAYOUT
/end MODULE
/end PROJECT
