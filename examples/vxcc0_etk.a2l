/begin PROJECT DPU-2XX "Visteon Diesel"
/begin HEADER " " VERSION "1" PROJECT_NO Global /end HEADER
/begin MODULE ENGINE "International Engine Controller"
/begin MOD_COMMON " " BYTE_ORDER MSB_FIRST /end MOD_COMMON
/begin MEASUREMENT EBP_STATUS "Status of Exhaust Back Pressure sensor,  0 = no error" UBYTE MC_EBP_STATUS 0 0 0 0 ECU_ADDRESS 0x3F99E4 /end MEASUREMENT
/begin COMPU_METHOD MC_EBP_STATUS "EBP_STATUS conversion" RAT_FUNC "%3.0" "Unitless" COEFFS 0 1 0 0 0 1 /end COMPU_METHOD
/begin CHARACTERISTIC EBP_TCREC_SEL "Switch to select EBP filter constant" VALUE 0x5D5DC SD_UBYTE 0 SC_EBP_TCREC_SEL 0 1 /end CHARACTERISTIC
/begin COMPU_METHOD SC_EBP_TCREC_SEL "EBP_TCREC_SEL conversion" RAT_FUNC "%3.0" "unitless" COEFFS 0 1 0 0 0 1 /end COMPU_METHOD
/begin CHARACTERISTIC EBP_VMAX "Exhaust Back Pressure out of range high limit" VALUE 0x5C788 SD_FLOAT32_IEEE 0 SC_EBP_VMAX 0 5 /end CHARACTERISTIC
/begin COMPU_METHOD SC_EBP_VMAX "EBP_VMAX conversion" RAT_FUNC "%10.5" "V" COEFFS 0 1 0 0 0 1 /end COMPU_METHOD
/begin CHARACTERISTIC EBP_VMIN "Exhaust Back Pressure out of range low limit" VALUE 0x5C78C SD_FLOAT32_IEEE 0 SC_EBP_VMIN 0 5 /end CHARACTERISTIC
/begin COMPU_METHOD SC_EBP_VMIN "EBP_VMIN conversion" RAT_FUNC "%10.5" "V" COEFFS 0 1 0 0 0 1 /end COMPU_METHOD
/begin MEASUREMENT EBP_VOLTAGE "Exhaust Back Pressure sensor voltage" FLOAT32_IEEE MC_EBP_VOLTAGE 0 0 0 0 ECU_ADDRESS 0x3F99D8 /end MEASUREMENT
/begin COMPU_METHOD MC_EBP_VOLTAGE "EBP_VOLTAGE conversion" RAT_FUNC "%10.5" "Unitless" COEFFS 0 1 0 0 0 1 /end COMPU_METHOD
/begin CHARACTERISTIC EBP_XS_TM "Run mode excessive ebp timer value" VALUE 0x5D5A8 SD_FLOAT32_IEEE 0 SC_EBP_XS_TM 0 524288 /end CHARACTERISTIC
/begin COMPU_METHOD SC_EBP_XS_TM "EBP_XS_TM conversion" RAT_FUNC "%10.5" "s" COEFFS 0 1 0 0 0 1 /end COMPU_METHOD
/begin MEASUREMENT EBP_XS_TMR "Run mode, Excessive EBP FMEM timer" FLOAT32_IEEE MC_EBP_XS_TMR 0 0 0 0 ECU_ADDRESS 0x3FA380 /end MEASUREMENT
/begin COMPU_METHOD MC_EBP_XS_TMR "EBP_XS_TMR conversion" RAT_FUNC "%10.5" "Unitless" COEFFS 0 1 0 0 0 1 /end COMPU_METHOD
/begin MEASUREMENT EBP_XS_UPDATE_TMR "Run mode, Excessive EBP FMEM malf update timer" FLOAT32_IEEE MC_EBP_XS_UPDATE_TMR 0 0 0 0 ECU_ADDRESS 0x3FA37C /end MEASUREMENT
/begin COMPU_METHOD MC_EBP_XS_UPDATE_TMR "EBP_XS_UPDATE_TMR conversion" RAT_FUNC "%10.5" "Unitless" COEFFS 0 1 0 0 0 1 /end COMPU_METHOD
/begin MEASUREMENT ECM_PDL "PRNDL Position for cluster" UBYTE MC_ECM_PDL 0 0 0 0 ECU_ADDRESS 0x3FA2A7 /end MEASUREMENT
/begin COMPU_METHOD MC_ECM_PDL "ECM_PDL conversion" RAT_FUNC "%3.0" "Unitless" COEFFS 0 1 0 0 0 1 /end COMPU_METHOD
/begin MEASUREMENT ECT "Engine coolant temperature, deg F." FLOAT32_IEEE MC_ECT 0 0 0 0 ECU_ADDRESS 0x3FA280 /end MEASUREMENT
/begin COMPU_METHOD MC_ECT "ECT conversion" RAT_FUNC "%10.5" "Unitless" COEFFS 0 1 0 0 0 1 /end COMPU_METHOD
/begin CHARACTERISTIC ECTRAT_DEL "Engine coolant temperature rational delay" VALUE 0x5D000 SD_FLOAT32_IEEE 0 SC_ECTRAT_DEL -4096 4095.88 /end CHARACTERISTIC
/begin COMPU_METHOD SC_ECTRAT_DEL "ECTRAT_DEL conversion" RAT_FUNC "%10.5" "degC" COEFFS 0 1 0 0 0 1 /end COMPU_METHOD
/begin CHARACTERISTIC ECTRAT_DELTM "Engine coolant temperature rational delay timer" VALUE 0x5CFFC SD_FLOAT32_IEEE 0 SC_ECTRAT_DELTM -4096 4095.88 /end CHARACTERISTIC
/begin COMPU_METHOD SC_ECTRAT_DELTM "ECTRAT_DELTM conversion" RAT_FUNC "%10.5" "degC" COEFFS 0 1 0 0 0 1 /end COMPU_METHOD
/begin CHARACTERISTIC ECT_AD_TC "Engine coolant temperature filter time constant" VALUE 0x5D028 SD_FLOAT32_IEEE 0 SC_ECT_AD_TC 0 64 /end CHARACTERISTIC
/begin COMPU_METHOD SC_ECT_AD_TC "ECT_AD_TC conversion" RAT_FUNC "%10.5" "s" COEFFS 0 1 0 0 0 1 /end COMPU_METHOD
/begin CHARACTERISTIC ECT_AD_TC_NSTRT "Engine coolant temperature filter time constant" VALUE 0x5D024 SD_FLOAT32_IEEE 0 SC_ECT_AD_TC_NSTRT 0 64 /end CHARACTERISTIC
/begin COMPU_METHOD SC_ECT_AD_TC_NSTRT "ECT_AD_TC_NSTRT conversion" RAT_FUNC "%10.5" "s" COEFFS 0 1 0 0 0 1 /end COMPU_METHOD
/begin MEASUREMENT ECT_C "Engine coolant temperature. (DEGREES C)" FLOAT32_IEEE MC_ECT_C 0 0 0 0 ECU_ADDRESS 0x3F9F88 /end MEASUREMENT
/begin COMPU_METHOD MC_ECT_C "ECT_C conversion" RAT_FUNC "%10.5" "Unitless" COEFFS 0 1 0 0 0 1 /end COMPU_METHOD
/begin MEASUREMENT ECT_CNTS "Engine Coolant Temperature, input from A/D." SLONG MC_ECT_CNTS 0 0 0 0 ECU_ADDRESS 0x3F98C0 /end MEASUREMENT
/begin COMPU_METHOD MC_ECT_CNTS "ECT_CNTS conversion" RAT_FUNC "%10.0" "Unitless" COEFFS 0 1 0 0 0 1 /end COMPU_METHOD
/begin MEASUREMENT ECT_CNT_LMC "ect cold fault counter limit" SLONG MC_ECT_CNT_LMC 0 0 0 0 ECU_ADDRESS 0x3F9F54 /end MEASUREMENT
/begin COMPU_METHOD MC_ECT_CNT_LMC "ECT_CNT_LMC conversion" RAT_FUNC "%10.0" "Unitless" COEFFS 0 1 0 0 0 1 /end COMPU_METHOD
/begin MEASUREMENT ECT_CNT_LMH "ect hot fault counter limit" SLONG MC_ECT_CNT_LMH 0 0 0 0 ECU_ADDRESS 0x3F9F50 /end MEASUREMENT
/begin COMPU_METHOD MC_ECT_CNT_LMH "ECT_CNT_LMH conversion" RAT_FUNC "%10.0" "Unitless" COEFFS 0 1 0 0 0 1 /end COMPU_METHOD
/begin MEASUREMENT ECT_COLD_CNT "Threshold monitor cold counter" SLONG MC_ECT_COLD_CNT 0 0 0 0 ECU_ADDRESS 0x3F9F64 /end MEASUREMENT
/begin COMPU_METHOD MC_ECT_COLD_CNT "ECT_COLD_CNT conversion" RAT_FUNC "%10.0" "Unitless" COEFFS 0 1 0 0 0 1 /end COMPU_METHOD
/begin CHARACTERISTIC ECT_COLD_LMN "" VALUE 0x5D008 SD_FLOAT32_IEEE 0 SC_ECT_COLD_LMN -4096 4095.88 /end CHARACTERISTIC
/begin COMPU_METHOD SC_ECT_COLD_LMN "ECT_COLD_LMN conversion" RAT_FUNC "%10.5" "degC" COEFFS 0 1 0 0 0 1 /end COMPU_METHOD
/begin CHARACTERISTIC ECT_COLD_MFDES "" VALUE 0x5D00C SD_FLOAT32_IEEE 0 SC_ECT_COLD_MFDES -2048 2.04794 /end CHARACTERISTIC
/begin COMPU_METHOD SC_ECT_COLD_MFDES "ECT_COLD_MFDES conversion" RAT_FUNC "%10.5" "unitless" COEFFS 0 1 0 0 0 1 /end COMPU_METHOD
/begin CHARACTERISTIC ECT_COLD_N "ect cold engine speed calibration" VALUE 0x5D010 SD_FLOAT32_IEEE 0 SC_ECT_COLD_N 0 16387.3 /end CHARACTERISTIC
/begin COMPU_METHOD SC_ECT_COLD_N "ECT_COLD_N conversion" RAT_FUNC "%10.5" "RPM" COEFFS 0 1 0 0 0 1 /end COMPU_METHOD
/begin MEASUREMENT ECT_C_THLD "ect threshold flag" UBYTE MC_ECT_C_THLD 0 0 0 0 ECU_ADDRESS 0x3F9F91 /end MEASUREMENT
/begin COMPU_METHOD MC_ECT_C_THLD "ECT_C_THLD conversion" RAT_FUNC "%3.0" "Unitless" COEFFS 0 1 0 0 0 1 /end COMPU_METHOD
/begin CHARACTERISTIC ECT_DEF "Default FMEM value for engine coolant temp" VALUE 0x5D02C SD_FLOAT32_IEEE 0 SC_ECT_DEF -20 150 /end CHARACTERISTIC
/begin COMPU_METHOD SC_ECT_DEF "ECT_DEF conversion" RAT_FUNC "%10.5" "degC" COEFFS 0 1 0 0 0 1 /end COMPU_METHOD
/begin MEASUREMENT ECT_ENG "Engine Coolant Temperature without any FMEM modifications." FLOAT32_IEEE MC_ECT_ENG 0 0 0 0 ECU_ADDRESS 0x3F9B34 /end MEASUREMENT
/begin COMPU_METHOD MC_ECT_ENG "ECT_ENG conversion" RAT_FUNC "%10.5" "Unitless" COEFFS 0 1 0 0 0 1 /end COMPU_METHOD
/begin MEASUREMENT ECT_ENG_C "Engine Coolant Temperature without any FMEM modifications, degrees C" FLOAT32_IEEE MC_ECT_ENG_C 0 0 0 0 ECU_ADDRESS 0x3F98C8 /end MEASUREMENT
/begin COMPU_METHOD MC_ECT_ENG_C "ECT_ENG_C conversion" RAT_FUNC "%10.5" "Unitless" COEFFS 0 1 0 0 0 1 /end COMPU_METHOD
/begin CHARACTERISTIC ECT_ENG_C_TC "Engine coolant engineering value filter time constant" VALUE 0x5C548 SD_FLOAT32_IEEE 0 SC_ECT_ENG_C_TC 0 64 /end CHARACTERISTIC
/begin COMPU_METHOD SC_ECT_ENG_C_TC "ECT_ENG_C_TC conversion" RAT_FUNC "%10.5" "s" COEFFS 0 1 0 0 0 1 /end COMPU_METHOD
/begin MEASUREMENT ECT_ENG_UNFILT "Engine Coolant Temperature without filtering, degrees C" FLOAT32_IEEE MC_ECT_ENG_UNFILT 0 0 0 0 ECU_ADDRESS 0x3F98C4 /end MEASUREMENT
/begin COMPU_METHOD MC_ECT_ENG_UNFILT "ECT_ENG_UNFILT conversion" RAT_FUNC "%10.5" "Unitless" COEFFS 0 1 0 0 0 1 /end COMPU_METHOD
/begin MEASUREMENT ECT_F "Engine coolant temperature. (DEGREES F)" FLOAT32_IEEE MC_ECT_F 0 0 0 0 ECU_ADDRESS 0x3F9F84 /end MEASUREMENT
/begin COMPU_METHOD MC_ECT_F "ECT_F conversion" RAT_FUNC "%10.5" "Unitless" COEFFS 0 1 0 0 0 1 /end COMPU_METHOD
/begin MEASUREMENT ECT_FIL "Intermittent fault filter for the ECT semsor." UBYTE MC_ECT_FIL 0 0 0 0 ECU_ADDRESS 0x3F9E55 /end MEASUREMENT
/begin COMPU_METHOD MC_ECT_FIL "ECT_FIL conversion" RAT_FUNC "%3.0" "Unitless" COEFFS 0 1 0 0 0 1 /end COMPU_METHOD
/begin MEASUREMENT ECT_FILT_TIME_CONST "ect filter time const" FLOAT32_IEEE MC_ECT_FILT_TIME_CONST 0 0 0 0 ECU_ADDRESS 0x3F9F80 /end MEASUREMENT
/begin COMPU_METHOD MC_ECT_FILT_TIME_CONST "ECT_FILT_TIME_CONST conversion" RAT_FUNC "%10.5" "Unitless" COEFFS 0 1 0 0 0 1 /end COMPU_METHOD
/begin MEASUREMENT ECT_FIL_MAX "HIGHEST VALUE THE FAULT FILTER ECT_FIL ACHIEVES." UBYTE MC_ECT_FIL_MAX 0 0 0 0 ECU_ADDRESS 0x3FCD00 /end MEASUREMENT
/begin COMPU_METHOD MC_ECT_FIL_MAX "ECT_FIL_MAX conversion" RAT_FUNC "%3.0" "Unitless" COEFFS 0 1 0 0 0 1 /end COMPU_METHOD
/begin MEASUREMENT ECT_FLT_RECOVERY_CNTR "ect fault recovery counter" SLONG MC_ECT_FLT_RECOVERY_CNTR 0 0 0 0 ECU_ADDRESS 0x3F9F6C /end MEASUREMENT
/begin COMPU_METHOD MC_ECT_FLT_RECOVERY_CNTR "ECT_FLT_RECOVERY_CNTR conversion" RAT_FUNC "%10.0" "Unitless" COEFFS 0 1 0 0 0 1 /end COMPU_METHOD
/begin MEASUREMENT ECT_FLT_RECOVERY_FLG "ect fault recovery flag" UBYTE MC_ECT_FLT_RECOVERY_FLG 0 0 0 0 ECU_ADDRESS 0x3F9F92 /end MEASUREMENT
/begin COMPU_METHOD MC_ECT_FLT_RECOVERY_FLG "ECT_FLT_RECOVERY_FLG conversion" RAT_FUNC "%3.0" "Unitless" COEFFS 0 1 0 0 0 1 /end COMPU_METHOD
/begin CHARACTERISTIC ECT_F_DEC "ECT ORH/ORL failure counter decrement value" VALUE 0x5D084 SD_SLONG 0 SC_ECT_F_DEC 0 65535 /end CHARACTERISTIC
/begin COMPU_METHOD SC_ECT_F_DEC "ECT_F_DEC conversion" RAT_FUNC "%10.0" "unitless" COEFFS 0 1 0 0 0 1 /end COMPU_METHOD
/begin CHARACTERISTIC ECT_F_INC "ECT ORH/ORL failure counter increment value" VALUE 0x5D088 SD_SLONG 0 SC_ECT_F_INC 0 65535 /end CHARACTERISTIC
/begin COMPU_METHOD SC_ECT_F_INC "ECT_F_INC conversion" RAT_FUNC "%10.0" "unitless" COEFFS 0 1 0 0 0 1 /end COMPU_METHOD
/begin MEASUREMENT ECT_F_ORH "Engine Coolant Temperature out of range high fail" UBYTE MC_ECT_F_ORH 0 0 0 0 ECU_ADDRESS 0x3F9F98 /end MEASUREMENT
/begin COMPU_METHOD MC_ECT_F_ORH "ECT_F_ORH conversion" RAT_FUNC "%3.0" "Unitless" COEFFS 0 1 0 0 0 1 /end COMPU_METHOD
/begin MEASUREMENT ECT_F_ORL "Engine Coolant Temperature out of range low fail" UBYTE MC_ECT_F_ORL 0 0 0 0 ECU_ADDRESS 0x3F9F97 /end MEASUREMENT
/begin COMPU_METHOD MC_ECT_F_ORL "ECT_F_ORL conversion" RAT_FUNC "%3.0" "Unitless" COEFFS 0 1 0 0 0 1 /end COMPU_METHOD
/begin MEASUREMENT ECT_HELD "previous cycle engine coolant temperature. (DEGREES C)" FLOAT32_IEEE MC_ECT_HELD 0 0 0 0 ECU_ADDRESS 0x3F9F4C /end MEASUREMENT
/begin COMPU_METHOD MC_ECT_HELD "ECT_HELD conversion" RAT_FUNC "%10.5" "Unitless" COEFFS 0 1 0 0 0 1 /end COMPU_METHOD
/begin CHARACTERISTIC ECT_HI_VOLTS "Maximum acceptable voltage for ECT sensor" VALUE 0x5C550 SD_FLOAT32_IEEE 0 SC_ECT_HI_VOLTS 0 5 /end CHARACTERISTIC
/begin COMPU_METHOD SC_ECT_HI_VOLTS "ECT_HI_VOLTS conversion" RAT_FUNC "%10.5" "V" COEFFS 0 1 0 0 0 1 /end COMPU_METHOD
/begin MEASUREMENT ECT_HOT_CNT "Threshold monitor hot counter" SLONG MC_ECT_HOT_CNT 0 0 0 0 ECU_ADDRESS 0x3F9F68 /end MEASUREMENT
/begin COMPU_METHOD MC_ECT_HOT_CNT "ECT_HOT_CNT conversion" RAT_FUNC "%10.0" "Unitless" COEFFS 0 1 0 0 0 1 /end COMPU_METHOD
/begin CHARACTERISTIC ECT_HOT_LMN "" VALUE 0x5D004 SD_FLOAT32_IEEE 0 SC_ECT_HOT_LMN -4096 4095.88 /end CHARACTERISTIC
/begin COMPU_METHOD SC_ECT_HOT_LMN "ECT_HOT_LMN conversion" RAT_FUNC "%10.5" "degC" COEFFS 0 1 0 0 0 1 /end COMPU_METHOD
/begin CHARACTERISTIC ECT_HOT_MFDES "Hot mfdes calibration." VALUE 0x5D014 SD_FLOAT32_IEEE 0 SC_ECT_HOT_MFDES -2048 2047.94 /end CHARACTERISTIC
/begin COMPU_METHOD SC_ECT_HOT_MFDES "ECT_HOT_MFDES conversion" RAT_FUNC "%10.5" "unitless" COEFFS 0 1 0 0 0 1 /end COMPU_METHOD
/begin CHARACTERISTIC ECT_HOT_N "Hot engine speed calibration" VALUE 0x5D018 SD_FLOAT32_IEEE 0 SC_ECT_HOT_N 0 16387.5 /end CHARACTERISTIC
/begin COMPU_METHOD SC_ECT_HOT_N "ECT_HOT_N conversion" RAT_FUNC "%10.5" "RPM" COEFFS 0 1 0 0 0 1 /end COMPU_METHOD
/begin MEASUREMENT ECT_INT "Flag set when intermittent is detected on ECT sensor." UBYTE MC_ECT_INT 0 0 0 0 ECU_ADDRESS 0x3F9E54 /end MEASUREMENT
/begin COMPU_METHOD MC_ECT_INT "ECT_INT conversion" RAT_FUNC "%3.0" "Unitless" COEFFS 0 1 0 0 0 1 /end COMPU_METHOD
/begin CHARACTERISTIC ECT_LO_VOLTS "Minimum acceptable voltage for ECT sensor" VALUE 0x5C54C SD_FLOAT32_IEEE 0 SC_ECT_LO_VOLTS 0 5 /end CHARACTERISTIC
/begin COMPU_METHOD SC_ECT_LO_VOLTS "ECT_LO_VOLTS conversion" RAT_FUNC "%10.5" "V" COEFFS 0 1 0 0 0 1 /end COMPU_METHOD
/begin CHARACTERISTIC ECT_LVL "Fault level for intermittent ECT sensor." VALUE 0x5CE56 SD_UBYTE 0 SC_ECT_LVL 0 255 /end CHARACTERISTIC
/begin COMPU_METHOD SC_ECT_LVL "ECT_LVL conversion" RAT_FUNC "%3.0" "LEVEL" COEFFS 0 1 0 0 0 1 /end COMPU_METHOD
/begin MEASUREMENT ECT_MALF_SET "Indicate ect malf high or low failure." UBYTE MC_ECT_MALF_SET 0 0 0 0 ECU_ADDRESS 0x3F9F94 /end MEASUREMENT
/begin COMPU_METHOD MC_ECT_MALF_SET "ECT_MALF_SET conversion" RAT_FUNC "%3.0" "Unitless" COEFFS 0 1 0 0 0 1 /end COMPU_METHOD
/begin MEASUREMENT ECT_ORH_CNTR "Engine Coolant Temp out of range high counter" SLONG MC_ECT_ORH_CNTR 0 0 0 0 ECU_ADDRESS 0x3F9F7C /end MEASUREMENT
/begin COMPU_METHOD MC_ECT_ORH_CNTR "ECT_ORH_CNTR conversion" RAT_FUNC "%10.0" "Unitless" COEFFS 0 1 0 0 0 1 /end COMPU_METHOD
/begin MEASUREMENT ECT_ORL_CNTR "Engine Coolant Temp out of range low counter" SLONG MC_ECT_ORL_CNTR 0 0 0 0 ECU_ADDRESS 0x3F9F78 /end MEASUREMENT
/begin COMPU_METHOD MC_ECT_ORL_CNTR "ECT_ORL_CNTR conversion" RAT_FUNC "%10.0" "Unitless" COEFFS 0 1 0 0 0 1 /end COMPU_METHOD
/begin CHARACTERISTIC ECT_REC_INC "" VALUE 0x5D020 SD_SLONG 0 SC_ECT_REC_INC 0 65334 /end CHARACTERISTIC
/begin COMPU_METHOD SC_ECT_REC_INC "ECT_REC_INC conversion" RAT_FUNC "%10.0" "unitless" COEFFS 0 1 0 0 0 1 /end COMPU_METHOD
/begin CHARACTERISTIC ECT_SNS_HP "ECT hardware present switch; 0 -> no ECT, 1 -> ECT sensor present." VALUE 0x5CB2D SD_UBYTE 0 SC_ECT_SNS_HP 0 1 /end CHARACTERISTIC
/begin COMPU_METHOD SC_ECT_SNS_HP "ECT_SNS_HP conversion" RAT_FUNC "%3.0" "UNITLESS" COEFFS 0 1 0 0 0 1 /end COMPU_METHOD
/begin MEASUREMENT ECT_STATUS "Status of Engine Coolant Temperature high level driver ( 0 = ok )" UBYTE MC_ECT_STATUS 0 0 0 0 ECU_ADDRESS 0x3F98CC /end MEASUREMENT
/begin COMPU_METHOD MC_ECT_STATUS "ECT_STATUS conversion" RAT_FUNC "%3.0" "Unitless" COEFFS 0 1 0 0 0 1 /end COMPU_METHOD
/begin CHARACTERISTIC ECT_TCREC_SEL "" VALUE 0x5D030 SD_UBYTE 0 SC_ECT_TCREC_SEL 0 1 /end CHARACTERISTIC
/begin COMPU_METHOD SC_ECT_TCREC_SEL "ECT_TCREC_SEL conversion" RAT_FUNC "%3.0" "unitless" COEFFS 0 1 0 0 0 1 /end COMPU_METHOD
/begin MEASUREMENT ECT_THLD_TMR "threshold monitor timer counter" FLOAT32_IEEE MC_ECT_THLD_TMR 0 0 0 0 ECU_ADDRESS 0x3F9F5C /end MEASUREMENT
/begin COMPU_METHOD MC_ECT_THLD_TMR "ECT_THLD_TMR conversion" RAT_FUNC "%10.5" "Unitless" COEFFS 0 1 0 0 0 1 /end COMPU_METHOD
/begin MEASUREMENT ECT_THLD_TST_TM "" FLOAT32_IEEE MC_ECT_THLD_TST_TM 0 0 0 0 ECU_ADDRESS 0x3F9F58 /end MEASUREMENT
/begin COMPU_METHOD MC_ECT_THLD_TST_TM "ECT_THLD_TST_TM conversion" RAT_FUNC "%10.5" "Unitless" COEFFS 0 1 0 0 0 1 /end COMPU_METHOD
/begin MEASUREMENT ECT_UPDOWN_CNTR "threshold monitor updown counter" SLONG MC_ECT_UPDOWN_CNTR 0 0 0 0 ECU_ADDRESS 0x3F9F60 /end MEASUREMENT
/begin COMPU_METHOD MC_ECT_UPDOWN_CNTR "ECT_UPDOWN_CNTR conversion" RAT_FUNC "%10.0" "Unitless" COEFFS 0 1 0 0 0 1 /end COMPU_METHOD
/begin CHARACTERISTIC ECT_WARM "Temperature above which the engine is considered warm for the purposes of OBDII similar conditions." VALUE 0x5CE44 SD_UBYTE 0 SC_ECT_WARM 0 254 /end CHARACTERISTIC
/begin COMPU_METHOD SC_ECT_WARM "ECT_WARM conversion" RAT_FUNC "%3.0" "DEGREES" COEFFS 0 1 0 0 0 1 /end COMPU_METHOD
/begin CHARACTERISTIC ECU_EO_DONE "VAlue of EO_STATUS when ECU test is complete (engine off on demand test sequence)" VALUE 0x5F0E4 SD_UBYTE 0 SC_ECU_EO_DONE 0 100 /end CHARACTERISTIC
/begin COMPU_METHOD SC_ECU_EO_DONE "ECU_EO_DONE conversion" RAT_FUNC "%3.0" "unitless" COEFFS 0 1 0 0 0 1 /end COMPU_METHOD
/begin CHARACTERISTIC ECU_EO_INIT "Value of EO_STATUS to signal for ECU test (Instruction, KAM, RAM, ROM)" VALUE 0x5F0E5 SD_UBYTE 0 SC_ECU_EO_INIT 0 100 /end CHARACTERISTIC
/begin COMPU_METHOD SC_ECU_EO_INIT "ECU_EO_INIT conversion" RAT_FUNC "%3.0" "unitless" COEFFS 0 1 0 0 0 1 /end COMPU_METHOD
/begin MEASUREMENT EDF_DELTA_SEC "EDF loop timer" FLOAT32_IEEE MC_EDF_DELTA_SEC 0 0 0 0 ECU_ADDRESS 0x3FB1EC /end MEASUREMENT
/begin COMPU_METHOD MC_EDF_DELTA_SEC "EDF_DELTA_SEC conversion" RAT_FUNC "%10.5" "Unitless" COEFFS 0 1 0 0 0 1 /end COMPU_METHOD
/begin MEASUREMENT EDF_PPM "Airflow increment required when electro-drive speed fan is on." FLOAT32_IEEE MC_EDF_PPM 0 0 0 0 ECU_ADDRESS 0x3FB224 /end MEASUREMENT
/begin COMPU_METHOD MC_EDF_PPM "EDF_PPM conversion" RAT_FUNC "%10.5" "Unitless" COEFFS 0 1 0 0 0 1 /end COMPU_METHOD
/begin MEASUREMENT EGC_MFL_MULT "EGC overboost smoke limiter multiplier" FLOAT32_IEEE MC_EGC_MFL_MULT 0 0 0 0 ECU_ADDRESS 0x3FA808 /end MEASUREMENT
/begin COMPU_METHOD MC_EGC_MFL_MULT "EGC_MFL_MULT conversion" RAT_FUNC "%10.5" "Unitless" COEFFS 0 1 0 0 0 1 /end COMPU_METHOD
/begin MEASUREMENT EGO_COUNT "Count of the number of complete ego tests since KAM reset." UBYTE MC_EGO_COUNT 0 0 0 0 ECU_ADDRESS 0x3FCD0A /end MEASUREMENT
/begin COMPU_METHOD MC_EGO_COUNT "EGO_COUNT conversion" RAT_FUNC "%3.0" "Unitless" COEFFS 0 1 0 0 0 1 /end COMPU_METHOD
/begin CHARACTERISTIC EGO_DEL_TM "Time delay between succesive runs of the EGO monitor." VALUE 0x5CE2F SD_UBYTE 0 SC_EGO_DEL_TM 0 127 /end CHARACTERISTIC
/begin COMPU_METHOD SC_EGO_DEL_TM "EGO_DEL_TM conversion" RAT_FUNC "%3.0" "s" COEFFS 0 1 0 0 0 1 /end COMPU_METHOD
/begin MEASUREMENT EGO_DEL_TMR "Time since abort of the EGO monitor." FLOAT32_IEEE MC_EGO_DEL_TMR 0 0 0 0 ECU_ADDRESS 0x3F9E6C /end MEASUREMENT
/begin COMPU_METHOD MC_EGO_DEL_TMR "EGO_DEL_TMR conversion" RAT_FUNC "%10.5" "Unitless" COEFFS 0 1 0 0 0 1 /end COMPU_METHOD
/begin MEASUREMENT EGO_FMEM "EGO system FMEM flag.  1 -> don't run EGO monitor due to FMEM." UBYTE MC_EGO_FMEM 0 0 0 0 ECU_ADDRESS 0x3F9E5B /end MEASUREMENT
/begin COMPU_METHOD MC_EGO_FMEM "EGO_FMEM conversion" RAT_FUNC "%3.0" "Unitless" COEFFS 0 1 0 0 0 1 /end COMPU_METHOD
/begin MEASUREMENT EGO_MON "OBDII monitor flag for EGO system; 1=> all fuel faults been monitored since power-up" UBYTE MC_EGO_MON 0 0 0 0 ECU_ADDRESS 0x3F9CD9 /end MEASUREMENT
/begin COMPU_METHOD MC_EGO_MON "EGO_MON conversion" RAT_FUNC "%3.0" "Unitless" COEFFS 0 1 0 0 0 1 /end COMPU_METHOD
/begin MEASUREMENT EGO_TST_ENA "OBD-II EGO Test enable flag. (1 => test enabled)" UBYTE MC_EGO_TST_ENA 0 0 0 0 ECU_ADDRESS 0x3F9E3A /end MEASUREMENT
/begin COMPU_METHOD MC_EGO_TST_ENA "EGO_TST_ENA conversion" RAT_FUNC "%3.0" "Unitless" COEFFS 0 1 0 0 0 1 /end COMPU_METHOD
/begin MEASUREMENT EGO_TST_RDY "EGO test ready flag; 1 ->  all  local  conditions have been met; ready to run EGO test." UBYTE MC_EGO_TST_RDY 0 0 0 0 ECU_ADDRESS 0x3F9CD6 /end MEASUREMENT
/begin COMPU_METHOD MC_EGO_TST_RDY "EGO_TST_RDY conversion" RAT_FUNC "%3.0" "Unitless" COEFFS 0 1 0 0 0 1 /end COMPU_METHOD
/begin CHARACTERISTIC EGRAM_F_DEC "" VALUE 0x5D6A4 SD_SLONG 0 SC_EGRAM_F_DEC 0 65535 /end CHARACTERISTIC
/begin COMPU_METHOD SC_EGRAM_F_DEC "EGRAM_F_DEC conversion" RAT_FUNC "%10.0" "unitless" COEFFS 0 1 0 0 0 1 /end COMPU_METHOD
/begin CHARACTERISTIC EGRAM_F_INC "" VALUE 0x5D6A0 SD_SLONG 0 SC_EGRAM_F_INC 0 65535 /end CHARACTERISTIC
/begin COMPU_METHOD SC_EGRAM_F_INC "EGRAM_F_INC conversion" RAT_FUNC "%10.0" "unitless" COEFFS 0 1 0 0 0 1 /end COMPU_METHOD
/begin MEASUREMENT EGRAM_ORH_CNTR "" SLONG MC_EGRAM_ORH_CNTR 0 0 0 0 ECU_ADDRESS 0x3FA46C /end MEASUREMENT
/begin COMPU_METHOD MC_EGRAM_ORH_CNTR "EGRAM_ORH_CNTR conversion" RAT_FUNC "%10.0" "Unitless" COEFFS 0 1 0 0 0 1 /end COMPU_METHOD
/begin MEASUREMENT EGRAM_STATUS "" UBYTE MC_EGRAM_STATUS 0 0 0 0 ECU_ADDRESS 0x3F9CEF /end MEASUREMENT
/begin COMPU_METHOD MC_EGRAM_STATUS "EGRAM_STATUS conversion" RAT_FUNC "%3.0" "Unitless" COEFFS 0 1 0 0 0 1 /end COMPU_METHOD
/begin CHARACTERISTIC EGRC_AFR_KF "EGR Close time constant  for  AFR  based transient compensator" VALUE 0x5E5CC SD_FLOAT32_IEEE 0 SC_EGRC_AFR_KF 0 5 /end CHARACTERISTIC
/begin COMPU_METHOD SC_EGRC_AFR_KF "EGRC_AFR_KF conversion" RAT_FUNC "%10.5" "s" COEFFS 0 1 0 0 0 1 /end COMPU_METHOD
/begin CHARACTERISTIC EGRC_AFR_PPS_KF "EGR close time constant for pps by AFR based transient compensation" VALUE 0x5E580 SD_FLOAT32_IEEE 0 SC_EGRC_AFR_PPS_KF 0 5 /end CHARACTERISTIC
/begin COMPU_METHOD SC_EGRC_AFR_PPS_KF "EGRC_AFR_PPS_KF conversion" RAT_FUNC "%10.5" "s" COEFFS 0 1 0 0 0 1 /end COMPU_METHOD
/begin MEASUREMENT EGRDP_SS_ERR_FLG "" UBYTE MC_EGRDP_SS_ERR_FLG 0 0 0 0 ECU_ADDRESS 0x3F9FCE /end MEASUREMENT
/begin COMPU_METHOD MC_EGRDP_SS_ERR_FLG "EGRDP_SS_ERR_FLG conversion" RAT_FUNC "%3.0" "Unitless" COEFFS 0 1 0 0 0 1 /end COMPU_METHOD
/begin CHARACTERISTIC EGRF_ERR_LMN "Minimum limit check for egr_flw_err" VALUE 0x5E5C8 SD_FLOAT32_IEEE 0 SC_EGRF_ERR_LMN -10000 0 /end CHARACTERISTIC
/begin COMPU_METHOD SC_EGRF_ERR_LMN "EGRF_ERR_LMN conversion" RAT_FUNC "%10.5" "unitless" COEFFS 0 1 0 0 0 1 /end COMPU_METHOD
/begin CHARACTERISTIC EGRF_ERR_LMX "Maximum limit check for egr_flw_err" VALUE 0x5E5C4 SD_FLOAT32_IEEE 0 SC_EGRF_ERR_LMX 0 10000 /end CHARACTERISTIC
/begin COMPU_METHOD SC_EGRF_ERR_LMX "EGRF_ERR_LMX conversion" RAT_FUNC "%10.5" "unitless" COEFFS 0 1 0 0 0 1 /end COMPU_METHOD
/begin CHARACTERISTIC EGRF_ERR_OBD "Steady state flow error threshold, OBD" VALUE 0x5E5C0 SD_FLOAT32_IEEE 0 SC_EGRF_ERR_OBD 0 100 /end CHARACTERISTIC
/begin COMPU_METHOD SC_EGRF_ERR_OBD "EGRF_ERR_OBD conversion" RAT_FUNC "%10.5" "g/s" COEFFS 0 1 0 0 0 1 /end COMPU_METHOD
/begin CHARACTERISTIC EGRF_ERR_SS "Steady state flow error threshold, failure management" VALUE 0x5E5BC SD_FLOAT32_IEEE 0 SC_EGRF_ERR_SS 0 500 /end CHARACTERISTIC
/begin COMPU_METHOD SC_EGRF_ERR_SS "EGRF_ERR_SS conversion" RAT_FUNC "%10.5" "g/s" COEFFS 0 1 0 0 0 1 /end COMPU_METHOD
/begin MEASUREMENT EGRF_F_OBD "EGR  flow steady state error flag for OBD" UBYTE MC_EGRF_F_OBD 0 0 0 0 ECU_ADDRESS 0x3FAE17 /end MEASUREMENT
/begin COMPU_METHOD MC_EGRF_F_OBD "EGRF_F_OBD conversion" RAT_FUNC "%3.0" "Unitless" COEFFS 0 1 0 0 0 1 /end COMPU_METHOD
/begin MEASUREMENT EGRF_F_SS "EGR flow steady state error flag" UBYTE MC_EGRF_F_SS 0 0 0 0 ECU_ADDRESS 0x3FAE16 /end MEASUREMENT
/begin COMPU_METHOD MC_EGRF_F_SS "EGRF_F_SS conversion" RAT_FUNC "%3.0" "Unitless" COEFFS 0 1 0 0 0 1 /end COMPU_METHOD
/begin CHARACTERISTIC EGRF_OBD_DT "Steady state flow error detection time, OBD" VALUE 0x5E5B8 SD_FLOAT32_IEEE 0 SC_EGRF_OBD_DT 0 600 /end CHARACTERISTIC
/begin COMPU_METHOD SC_EGRF_OBD_DT "EGRF_OBD_DT conversion" RAT_FUNC "%10.5" "s" COEFFS 0 1 0 0 0 1 /end COMPU_METHOD
/begin MEASUREMENT EGRF_OBD_DTR "Detection timer for OBDII MAF rate failure diagnostics" FLOAT32_IEEE MC_EGRF_OBD_DTR 0 0 0 0 ECU_ADDRESS 0x3FADC4 /end MEASUREMENT
/begin COMPU_METHOD MC_EGRF_OBD_DTR "EGRF_OBD_DTR conversion" RAT_FUNC "%10.5" "Unitless" COEFFS 0 1 0 0 0 1 /end COMPU_METHOD
/begin CHARACTERISTIC EGRF_OBD_RT "Steady state flow error recovery time, OBD" VALUE 0x5E5B4 SD_FLOAT32_IEEE 0 SC_EGRF_OBD_RT 0 600 /end CHARACTERISTIC
/begin COMPU_METHOD SC_EGRF_OBD_RT "EGRF_OBD_RT conversion" RAT_FUNC "%10.5" "s" COEFFS 0 1 0 0 0 1 /end COMPU_METHOD
/begin MEASUREMENT EGRF_OBD_RTR "Recovery timer for OBDII MAF rate failure diagnostics" FLOAT32_IEEE MC_EGRF_OBD_RTR 0 0 0 0 ECU_ADDRESS 0x3FADC0 /end MEASUREMENT
/begin COMPU_METHOD MC_EGRF_OBD_RTR "EGRF_OBD_RTR conversion" RAT_FUNC "%10.5" "Unitless" COEFFS 0 1 0 0 0 1 /end COMPU_METHOD
/begin CHARACTERISTIC EGRF_SS_DT "Steady state flow error detection time, failure management" VALUE 0x5E5B0 SD_FLOAT32_IEEE 0 SC_EGRF_SS_DT 0 600 /end CHARACTERISTIC
/begin COMPU_METHOD SC_EGRF_SS_DT "EGRF_SS_DT conversion" RAT_FUNC "%10.5" "s" COEFFS 0 1 0 0 0 1 /end COMPU_METHOD
/begin MEASUREMENT EGRF_SS_DTR "Detection timer for steady state MAF rate failure diagnostics" FLOAT32_IEEE MC_EGRF_SS_DTR 0 0 0 0 ECU_ADDRESS 0x3FADBC /end MEASUREMENT
/begin COMPU_METHOD MC_EGRF_SS_DTR "EGRF_SS_DTR conversion" RAT_FUNC "%10.5" "Unitless" COEFFS 0 1 0 0 0 1 /end COMPU_METHOD
/begin CHARACTERISTIC EGRF_SS_RT "Steady state flow error recovery time, failure management" VALUE 0x5E5AC SD_FLOAT32_IEEE 0 SC_EGRF_SS_RT 0 600 /end CHARACTERISTIC
/begin COMPU_METHOD SC_EGRF_SS_RT "EGRF_SS_RT conversion" RAT_FUNC "%10.5" "s" COEFFS 0 1 0 0 0 1 /end COMPU_METHOD
/begin MEASUREMENT EGRF_SS_RTR "Recovery timer for steady state MAF rate failure diagnostics" FLOAT32_IEEE MC_EGRF_SS_RTR 0 0 0 0 ECU_ADDRESS 0x3FADB8 /end MEASUREMENT
/begin COMPU_METHOD MC_EGRF_SS_RTR "EGRF_SS_RTR conversion" RAT_FUNC "%10.5" "Unitless" COEFFS 0 1 0 0 0 1 /end COMPU_METHOD
/begin MEASUREMENT EGRMNT_EC1_ACTV "" UBYTE MC_EGRMNT_EC1_ACTV 0 0 0 0 ECU_ADDRESS 0x3FAFF3 /end MEASUREMENT
/begin COMPU_METHOD MC_EGRMNT_EC1_ACTV "EGRMNT_EC1_ACTV conversion" RAT_FUNC "%3.0" "Unitless" COEFFS 0 1 0 0 0 1 /end COMPU_METHOD
/begin CHARACTERISTIC EGRMNT_EC1_TM "" VALUE 0x5E850 SD_FLOAT32_IEEE 0 SC_EGRMNT_EC1_TM 0 500 /end CHARACTERISTIC
/begin COMPU_METHOD SC_EGRMNT_EC1_TM "EGRMNT_EC1_TM conversion" RAT_FUNC "%10.5" "s" COEFFS 0 1 0 0 0 1 /end COMPU_METHOD
/begin MEASUREMENT EGRMNT_EC1_TMR "" FLOAT32_IEEE MC_EGRMNT_EC1_TMR 0 0 0 0 ECU_ADDRESS 0x3FAF6C /end MEASUREMENT
/begin COMPU_METHOD MC_EGRMNT_EC1_TMR "EGRMNT_EC1_TMR conversion" RAT_FUNC "%10.5" "Unitless" COEFFS 0 1 0 0 0 1 /end COMPU_METHOD
/begin MEASUREMENT EGRMNT_EC2_ACTV "" UBYTE MC_EGRMNT_EC2_ACTV 0 0 0 0 ECU_ADDRESS 0x3FAFF2 /end MEASUREMENT
/begin COMPU_METHOD MC_EGRMNT_EC2_ACTV "EGRMNT_EC2_ACTV conversion" RAT_FUNC "%3.0" "Unitless" COEFFS 0 1 0 0 0 1 /end COMPU_METHOD
/begin CHARACTERISTIC EGRMNT_EC2_TM "" VALUE 0x5E84C SD_FLOAT32_IEEE 0 SC_EGRMNT_EC2_TM 0 500 /end CHARACTERISTIC
/begin COMPU_METHOD SC_EGRMNT_EC2_TM "EGRMNT_EC2_TM conversion" RAT_FUNC "%10.5" "s" COEFFS 0 1 0 0 0 1 /end COMPU_METHOD
/begin MEASUREMENT EGRMNT_EC2_TMR "" FLOAT32_IEEE MC_EGRMNT_EC2_TMR 0 0 0 0 ECU_ADDRESS 0x3FAF68 /end MEASUREMENT
/begin COMPU_METHOD MC_EGRMNT_EC2_TMR "EGRMNT_EC2_TMR conversion" RAT_FUNC "%10.5" "Unitless" COEFFS 0 1 0 0 0 1 /end COMPU_METHOD
/begin MEASUREMENT EGRMNT_EGRPCT "" FLOAT32_IEEE MC_EGRMNT_EGRPCT 0 0 0 0 ECU_ADDRESS 0x3FAF64 /end MEASUREMENT
/begin COMPU_METHOD MC_EGRMNT_EGRPCT "EGRMNT_EGRPCT conversion" RAT_FUNC "%10.5" "Unitless" COEFFS 0 1 0 0 0 1 /end COMPU_METHOD
/begin CHARACTERISTIC EGRMNT_MF_MAX1 "" VALUE 0x5E848 SD_FLOAT32_IEEE 0 SC_EGRMNT_MF_MAX1 0 500 /end CHARACTERISTIC
/begin COMPU_METHOD SC_EGRMNT_MF_MAX1 "EGRMNT_MF_MAX1 conversion" RAT_FUNC "%10.5" "g/s" COEFFS 0 1 0 0 0 1 /end COMPU_METHOD
/begin CHARACTERISTIC EGRMNT_MF_MAX2 "" VALUE 0x5E844 SD_FLOAT32_IEEE 0 SC_EGRMNT_MF_MAX2 0 500 /end CHARACTERISTIC
/begin COMPU_METHOD SC_EGRMNT_MF_MAX2 "EGRMNT_MF_MAX2 conversion" RAT_FUNC "%10.5" "g/s" COEFFS 0 1 0 0 0 1 /end COMPU_METHOD
/begin CHARACTERISTIC EGRMNT_MF_MIN1 "" VALUE 0x5E840 SD_FLOAT32_IEEE 0 SC_EGRMNT_MF_MIN1 0 500 /end CHARACTERISTIC
/begin COMPU_METHOD SC_EGRMNT_MF_MIN1 "EGRMNT_MF_MIN1 conversion" RAT_FUNC "%10.5" "g/s" COEFFS 0 1 0 0 0 1 /end COMPU_METHOD
/begin CHARACTERISTIC EGRMNT_MF_MIN2 "" VALUE 0x5E83C SD_FLOAT32_IEEE 0 SC_EGRMNT_MF_MIN2 0 500 /end CHARACTERISTIC
/begin COMPU_METHOD SC_EGRMNT_MF_MIN2 "EGRMNT_MF_MIN2 conversion" RAT_FUNC "%10.5" "g/s" COEFFS 0 1 0 0 0 1 /end COMPU_METHOD
/begin CHARACTERISTIC EGRMNT_N_MAX1 "" VALUE 0x5E838 SD_FLOAT32_IEEE 0 SC_EGRMNT_N_MAX1 0 6000 /end CHARACTERISTIC
/begin COMPU_METHOD SC_EGRMNT_N_MAX1 "EGRMNT_N_MAX1 conversion" RAT_FUNC "%10.5" "RPM" COEFFS 0 1 0 0 0 1 /end COMPU_METHOD
/begin CHARACTERISTIC EGRMNT_N_MAX2 "" VALUE 0x5E834 SD_FLOAT32_IEEE 0 SC_EGRMNT_N_MAX2 0 6000 /end CHARACTERISTIC
/begin COMPU_METHOD SC_EGRMNT_N_MAX2 "EGRMNT_N_MAX2 conversion" RAT_FUNC "%10.5" "RPM" COEFFS 0 1 0 0 0 1 /end COMPU_METHOD
/begin CHARACTERISTIC EGRMNT_N_MIN1 "" VALUE 0x5E830 SD_FLOAT32_IEEE 0 SC_EGRMNT_N_MIN1 0 6000 /end CHARACTERISTIC
/begin COMPU_METHOD SC_EGRMNT_N_MIN1 "EGRMNT_N_MIN1 conversion" RAT_FUNC "%10.5" "RPM" COEFFS 0 1 0 0 0 1 /end COMPU_METHOD
/begin CHARACTERISTIC EGRMNT_N_MIN2 "" VALUE 0x5E82C SD_FLOAT32_IEEE 0 SC_EGRMNT_N_MIN2 0 6000 /end CHARACTERISTIC
/begin COMPU_METHOD SC_EGRMNT_N_MIN2 "EGRMNT_N_MIN2 conversion" RAT_FUNC "%10.5" "RPM" COEFFS 0 1 0 0 0 1 /end COMPU_METHOD
/begin CHARACTERISTIC EGRMNT_PCT_ACT "" VALUE 0x5E828 SD_FLOAT32_IEEE 0 SC_EGRMNT_PCT_ACT 0 1 /end CHARACTERISTIC
/begin COMPU_METHOD SC_EGRMNT_PCT_ACT "EGRMNT_PCT_ACT conversion" RAT_FUNC "%10.5" "RPM" COEFFS 0 1 0 0 0 1 /end COMPU_METHOD
/begin MEASUREMENT EGRMNT_PCT_LMN "" FLOAT32_IEEE MC_EGRMNT_PCT_LMN 0 0 0 0 ECU_ADDRESS 0x3FAF60 /end MEASUREMENT
/begin COMPU_METHOD MC_EGRMNT_PCT_LMN "EGRMNT_PCT_LMN conversion" RAT_FUNC "%10.5" "Unitless" COEFFS 0 1 0 0 0 1 /end COMPU_METHOD
/begin MEASUREMENT EGRMNT_PCT_LMX "" FLOAT32_IEEE MC_EGRMNT_PCT_LMX 0 0 0 0 ECU_ADDRESS 0x3FAF5C /end MEASUREMENT
/begin COMPU_METHOD MC_EGRMNT_PCT_LMX "EGRMNT_PCT_LMX conversion" RAT_FUNC "%10.5" "Unitless" COEFFS 0 1 0 0 0 1 /end COMPU_METHOD
/begin CHARACTERISTIC EGRMNT_TP_OPEN "" VALUE 0x5E824 SD_FLOAT32_IEEE 0 SC_EGRMNT_TP_OPEN 0 1 /end CHARACTERISTIC
/begin COMPU_METHOD SC_EGRMNT_TP_OPEN "EGRMNT_TP_OPEN conversion" RAT_FUNC "%10.5" "%" COEFFS 0 1 0 0 0 1 /end COMPU_METHOD
/begin CHARACTERISTIC EGRO_AFR_KF "EGR Open time constant for AFR based transient compensator" VALUE 0x5E5A8 SD_FLOAT32_IEEE 0 SC_EGRO_AFR_KF 0 5 /end CHARACTERISTIC
/begin COMPU_METHOD SC_EGRO_AFR_KF "EGRO_AFR_KF conversion" RAT_FUNC "%10.5" "s" COEFFS 0 1 0 0 0 1 /end COMPU_METHOD
/begin CHARACTERISTIC EGRO_AFR_PPS_KF "EGR open time constantfor pps  by AFR based transient compensation" VALUE 0x5E57C SD_FLOAT32_IEEE 0 SC_EGRO_AFR_PPS_KF 0 5 /end CHARACTERISTIC
/begin COMPU_METHOD SC_EGRO_AFR_PPS_KF "EGRO_AFR_PPS_KF conversion" RAT_FUNC "%10.5" "s" COEFFS 0 1 0 0 0 1 /end COMPU_METHOD
/begin MEASUREMENT EGRP "EGR Valve position" FLOAT32_IEEE MC_EGRP 0 0 0 0 ECU_ADDRESS 0x3F9FC4 /end MEASUREMENT
/begin COMPU_METHOD MC_EGRP "EGRP conversion" RAT_FUNC "%10.5" "Unitless" COEFFS 0 1 0 0 0 1 /end COMPU_METHOD
/begin MEASUREMENT EGRP_ADC "" FLOAT32_IEEE MC_EGRP_ADC 0 0 0 0 ECU_ADDRESS 0x3F999C /end MEASUREMENT
/begin COMPU_METHOD MC_EGRP_ADC "EGRP_ADC conversion" RAT_FUNC "%10.5" "Unitless" COEFFS 0 1 0 0 0 1 /end COMPU_METHOD
/begin MEASUREMENT EGRP_ADC_COR "EGRP normalized, zero corrected ADC value, in 0-1023 count scale." FLOAT32_IEEE MC_EGRP_ADC_COR 0 0 0 0 ECU_ADDRESS 0x3F9998 /end MEASUREMENT
/begin COMPU_METHOD MC_EGRP_ADC_COR "EGRP_ADC_COR conversion" RAT_FUNC "%10.5" "Unitless" COEFFS 0 1 0 0 0 1 /end COMPU_METHOD
/begin CHARACTERISTIC EGRP_AD_TC "EGR Position filter time constant" VALUE 0x5D08C SD_FLOAT32_IEEE 0 SC_EGRP_AD_TC 0 64 /end CHARACTERISTIC
/begin COMPU_METHOD SC_EGRP_AD_TC "EGRP_AD_TC conversion" RAT_FUNC "%10.5" "s" COEFFS 0 1 0 0 0 1 /end COMPU_METHOD
/begin CHARACTERISTIC EGRP_CAL "Calibration mode valve position desired input" VALUE 0x5E5A4 SD_FLOAT32_IEEE 0 SC_EGRP_CAL 0 1 /end CHARACTERISTIC
/begin COMPU_METHOD SC_EGRP_CAL "EGRP_CAL conversion" RAT_FUNC "%10.5" "%" COEFFS 0 1 0 0 0 1 /end COMPU_METHOD
/begin MEASUREMENT EGRP_CLS_ADC "" FLOAT32_IEEE MC_EGRP_CLS_ADC 0 0 0 0 ECU_ADDRESS 0x3FCC70 /end MEASUREMENT
/begin COMPU_METHOD MC_EGRP_CLS_ADC "EGRP_CLS_ADC conversion" RAT_FUNC "%10.5" "Unitless" COEFFS 0 1 0 0 0 1 /end COMPU_METHOD
/begin CHARACTERISTIC EGRP_DEF "EGR Valve position default value" VALUE 0x5D098 SD_FLOAT32_IEEE 0 SC_EGRP_DEF 0 1 /end CHARACTERISTIC
/begin COMPU_METHOD SC_EGRP_DEF "EGRP_DEF conversion" RAT_FUNC "%10.5" "%" COEFFS 0 1 0 0 0 1 /end COMPU_METHOD
/begin MEASUREMENT EGRP_DES "MAF rate based PI loop Desired valve position" FLOAT32_IEEE MC_EGRP_DES 0 0 0 0 ECU_ADDRESS 0x3FADB4 /end MEASUREMENT
/begin COMPU_METHOD MC_EGRP_DES "EGRP_DES conversion" RAT_FUNC "%10.5" "Unitless" COEFFS 0 1 0 0 0 1 /end COMPU_METHOD
/begin MEASUREMENT EGRP_ENG "EGR Valve position engineer unit." FLOAT32_IEEE MC_EGRP_ENG 0 0 0 0 ECU_ADDRESS 0x3F9994 /end MEASUREMENT
/begin COMPU_METHOD MC_EGRP_ENG "EGRP_ENG conversion" RAT_FUNC "%10.5" "Unitless" COEFFS 0 1 0 0 0 1 /end COMPU_METHOD
/begin MEASUREMENT EGRP_ERR "EGR position error" FLOAT32_IEEE MC_EGRP_ERR 0 0 0 0 ECU_ADDRESS 0x3FADB0 /end MEASUREMENT
/begin COMPU_METHOD MC_EGRP_ERR "EGRP_ERR conversion" RAT_FUNC "%10.5" "Unitless" COEFFS 0 1 0 0 0 1 /end COMPU_METHOD
/begin CHARACTERISTIC EGRP_ERR_LMN "Minimum limit check for egrp_err" VALUE 0x5E5A0 SD_FLOAT32_IEEE 0 SC_EGRP_ERR_LMN -10 10 /end CHARACTERISTIC
/begin COMPU_METHOD SC_EGRP_ERR_LMN "EGRP_ERR_LMN conversion" RAT_FUNC "%10.5" "unitless" COEFFS 0 1 0 0 0 1 /end COMPU_METHOD
/begin CHARACTERISTIC EGRP_ERR_LMX "Maximum limit check for egrp_err" VALUE 0x5E59C SD_FLOAT32_IEEE 0 SC_EGRP_ERR_LMX 0 10 /end CHARACTERISTIC
/begin COMPU_METHOD SC_EGRP_ERR_LMX "EGRP_ERR_LMX conversion" RAT_FUNC "%10.5" "unitless" COEFFS 0 1 0 0 0 1 /end COMPU_METHOD
/begin CHARACTERISTIC EGRP_ERR_OBD "Position error based steady state detection threshold for OBD" VALUE 0x5E598 SD_FLOAT32_IEEE 0 SC_EGRP_ERR_OBD 0 1 /end CHARACTERISTIC
/begin COMPU_METHOD SC_EGRP_ERR_OBD "EGRP_ERR_OBD conversion" RAT_FUNC "%10.5" "%" COEFFS 0 1 0 0 0 1 /end COMPU_METHOD
/begin CHARACTERISTIC EGRP_ERR_SS "Position error based steady state detection" VALUE 0x5E594 SD_FLOAT32_IEEE 0 SC_EGRP_ERR_SS 0 1 /end CHARACTERISTIC
/begin COMPU_METHOD SC_EGRP_ERR_SS "EGRP_ERR_SS conversion" RAT_FUNC "%10.5" "%" COEFFS 0 1 0 0 0 1 /end COMPU_METHOD
/begin MEASUREMENT EGRP_FILT_TIME_CONST "EGRP filter time constant" FLOAT32_IEEE MC_EGRP_FILT_TIME_CONST 0 0 0 0 ECU_ADDRESS 0x3F9FAC /end MEASUREMENT
/begin COMPU_METHOD MC_EGRP_FILT_TIME_CONST "EGRP_FILT_TIME_CONST conversion" RAT_FUNC "%10.5" "Unitless" COEFFS 0 1 0 0 0 1 /end COMPU_METHOD
/begin MEASUREMENT EGRP_FLT_RECOVERY_CNTR "EGRP fault recovery counter" SLONG MC_EGRP_FLT_RECOVERY_CNTR 0 0 0 0 ECU_ADDRESS 0x3F9FB0 /end MEASUREMENT
/begin COMPU_METHOD MC_EGRP_FLT_RECOVERY_CNTR "EGRP_FLT_RECOVERY_CNTR conversion" RAT_FUNC "%10.0" "Unitless" COEFFS 0 1 0 0 0 1 /end COMPU_METHOD
/begin MEASUREMENT EGRP_FLT_RECOVERY_FLG "1-> Indicates EGRP fault recovery is occuring" UBYTE MC_EGRP_FLT_RECOVERY_FLG 0 0 0 0 ECU_ADDRESS 0x3F9FC8 /end MEASUREMENT
/begin COMPU_METHOD MC_EGRP_FLT_RECOVERY_FLG "EGRP_FLT_RECOVERY_FLG conversion" RAT_FUNC "%3.0" "Unitless" COEFFS 0 1 0 0 0 1 /end COMPU_METHOD
/begin CHARACTERISTIC EGRP_F_DEC "EGRP malf failure/update counter decrement value" VALUE 0x5D0C4 SD_SLONG 0 SC_EGRP_F_DEC 0 65535 /end CHARACTERISTIC
/begin COMPU_METHOD SC_EGRP_F_DEC "EGRP_F_DEC conversion" RAT_FUNC "%10.0" "unitless" COEFFS 0 1 0 0 0 1 /end COMPU_METHOD
/begin CHARACTERISTIC EGRP_F_INC "EGRP ORH/ORL failure counter increment value" VALUE 0x5D0C8 SD_SLONG 0 SC_EGRP_F_INC 0 65535 /end CHARACTERISTIC
/begin COMPU_METHOD SC_EGRP_F_INC "EGRP_F_INC conversion" RAT_FUNC "%10.0" "unitless" COEFFS 0 1 0 0 0 1 /end COMPU_METHOD
/begin MEASUREMENT EGRP_F_ORH "EGRP out of range high fault" UBYTE MC_EGRP_F_ORH 0 0 0 0 ECU_ADDRESS 0x3F9FD0 /end MEASUREMENT
/begin COMPU_METHOD MC_EGRP_F_ORH "EGRP_F_ORH conversion" RAT_FUNC "%3.0" "Unitless" COEFFS 0 1 0 0 0 1 /end COMPU_METHOD
/begin MEASUREMENT EGRP_F_ORL "EGRP out  of range low fault" UBYTE MC_EGRP_F_ORL 0 0 0 0 ECU_ADDRESS 0x3F9FCF /end MEASUREMENT
/begin COMPU_METHOD MC_EGRP_F_ORL "EGRP_F_ORL conversion" RAT_FUNC "%3.0" "Unitless" COEFFS 0 1 0 0 0 1 /end COMPU_METHOD
/begin MEASUREMENT EGRP_F_SS "EGR valve position Steady state error flag" UBYTE MC_EGRP_F_SS 0 0 0 0 ECU_ADDRESS 0x3FAE15 /end MEASUREMENT
/begin COMPU_METHOD MC_EGRP_F_SS "EGRP_F_SS conversion" RAT_FUNC "%3.0" "Unitless" COEFFS 0 1 0 0 0 1 /end COMPU_METHOD
/begin CHARACTERISTIC EGRP_HI_ER "Egr out-of-range high in counts" VALUE 0x5C6CC SD_FLOAT32_IEEE 0 SC_EGRP_HI_ER 0 1023 /end CHARACTERISTIC
/begin COMPU_METHOD SC_EGRP_HI_ER "EGRP_HI_ER conversion" RAT_FUNC "%10.5" "ADct" COEFFS 0 1 0 0 0 1 /end COMPU_METHOD
/begin CHARACTERISTIC EGRP_KI "EGRP integral gain term" VALUE 0x5E590 SD_FLOAT32_IEEE 0 SC_EGRP_KI 0 30 /end CHARACTERISTIC
/begin COMPU_METHOD SC_EGRP_KI "EGRP_KI conversion" RAT_FUNC "%10.5" "unitless" COEFFS 0 1 0 0 0 1 /end COMPU_METHOD
/begin CHARACTERISTIC EGRP_KP "proportional gain term" VALUE 0x5E58C SD_FLOAT32_IEEE 0 SC_EGRP_KP 0 30 /end CHARACTERISTIC
/begin COMPU_METHOD SC_EGRP_KP "EGRP_KP conversion" RAT_FUNC "%10.5" "unitless" COEFFS 0 1 0 0 0 1 /end COMPU_METHOD
/begin CHARACTERISTIC EGRP_LO_ER "EGRP out-of-range low in counts" VALUE 0x5C6C8 SD_FLOAT32_IEEE 0 SC_EGRP_LO_ER 0 1023 /end CHARACTERISTIC
/begin COMPU_METHOD SC_EGRP_LO_ER "EGRP_LO_ER conversion" RAT_FUNC "%10.5" "ADct" COEFFS 0 1 0 0 0 1 /end COMPU_METHOD
/begin MEASUREMENT EGRP_MALF_SET "Indicate EGRP malf  high or low failure" UBYTE MC_EGRP_MALF_SET 0 0 0 0 ECU_ADDRESS 0x3F9FCA /end MEASUREMENT
/begin COMPU_METHOD MC_EGRP_MALF_SET "EGRP_MALF_SET conversion" RAT_FUNC "%3.0" "Unitless" COEFFS 0 1 0 0 0 1 /end COMPU_METHOD
/begin CHARACTERISTIC EGRP_MAX_ADC "Maximum EGR A/D conversion voltage." VALUE 0x5C6C4 SD_FLOAT32_IEEE 0 SC_EGRP_MAX_ADC 0 1024 /end CHARACTERISTIC
/begin COMPU_METHOD SC_EGRP_MAX_ADC "EGRP_MAX_ADC conversion" RAT_FUNC "%10.5" "V" COEFFS 0 1 0 0 0 1 /end COMPU_METHOD
/begin CHARACTERISTIC EGRP_MAX_COR "EGR input maximum corrected voltage" VALUE 0x5C6C0 SD_FLOAT32_IEEE 0 SC_EGRP_MAX_COR 0 1023 /end CHARACTERISTIC
/begin COMPU_METHOD SC_EGRP_MAX_COR "EGRP_MAX_COR conversion" RAT_FUNC "%10.5" "unitless" COEFFS 0 1 0 0 0 1 /end COMPU_METHOD
/begin CHARACTERISTIC EGRP_MIN_COR "" VALUE 0x5C6BC SD_FLOAT32_IEEE 0 SC_EGRP_MIN_COR 0 1023 /end CHARACTERISTIC
/begin COMPU_METHOD SC_EGRP_MIN_COR "EGRP_MIN_COR conversion" RAT_FUNC "%10.5" "unitless" COEFFS 0 1 0 0 0 1 /end COMPU_METHOD
/begin MEASUREMENT EGRP_ORH_CNTR "EGRP out of range high counter" SLONG MC_EGRP_ORH_CNTR 0 0 0 0 ECU_ADDRESS 0x3F9FC0 /end MEASUREMENT
/begin COMPU_METHOD MC_EGRP_ORH_CNTR "EGRP_ORH_CNTR conversion" RAT_FUNC "%10.0" "Unitless" COEFFS 0 1 0 0 0 1 /end COMPU_METHOD
/begin MEASUREMENT EGRP_ORL_CNTR "EGRP out of range low counter" SLONG MC_EGRP_ORL_CNTR 0 0 0 0 ECU_ADDRESS 0x3F9FBC /end MEASUREMENT
/begin COMPU_METHOD MC_EGRP_ORL_CNTR "EGRP_ORL_CNTR conversion" RAT_FUNC "%10.0" "Unitless" COEFFS 0 1 0 0 0 1 /end COMPU_METHOD
/begin MEASUREMENT EGRP_RAW "Raw A/D value for EGR valve position" FLOAT32_IEEE MC_EGRP_RAW 0 0 0 0 ECU_ADDRESS 0x3F9990 /end MEASUREMENT
/begin COMPU_METHOD MC_EGRP_RAW "EGRP_RAW conversion" RAT_FUNC "%10.5" "Unitless" COEFFS 0 1 0 0 0 1 /end COMPU_METHOD
/begin CHARACTERISTIC EGRP_REC_INC "EGRP fault recovery counter increment value" VALUE 0x5D094 SD_SLONG 0 SC_EGRP_REC_INC 0 65535 /end CHARACTERISTIC
/begin COMPU_METHOD SC_EGRP_REC_INC "EGRP_REC_INC conversion" RAT_FUNC "%10.0" "unitless" COEFFS 0 1 0 0 0 1 /end COMPU_METHOD
/begin CHARACTERISTIC EGRP_SS_DT "Detection time threshold for detection, failure diagnostics" VALUE 0x5E588 SD_FLOAT32_IEEE 0 SC_EGRP_SS_DT 0 600 /end CHARACTERISTIC
/begin COMPU_METHOD SC_EGRP_SS_DT "EGRP_SS_DT conversion" RAT_FUNC "%10.5" "s" COEFFS 0 1 0 0 0 1 /end COMPU_METHOD
/begin MEASUREMENT EGRP_SS_DTR "" FLOAT32_IEEE MC_EGRP_SS_DTR 0 0 0 0 ECU_ADDRESS 0x3FADAC /end MEASUREMENT
/begin COMPU_METHOD MC_EGRP_SS_DTR "EGRP_SS_DTR conversion" RAT_FUNC "%10.5" "Unitless" COEFFS 0 1 0 0 0 1 /end COMPU_METHOD
/begin CHARACTERISTIC EGRP_SS_RT "Recovery time threshold for detection, failure diagnostics" VALUE 0x5E584 SD_FLOAT32_IEEE 0 SC_EGRP_SS_RT 0 600 /end CHARACTERISTIC
/begin COMPU_METHOD SC_EGRP_SS_RT "EGRP_SS_RT conversion" RAT_FUNC "%10.5" "s" COEFFS 0 1 0 0 0 1 /end COMPU_METHOD
/begin MEASUREMENT EGRP_SS_RTR "" FLOAT32_IEEE MC_EGRP_SS_RTR 0 0 0 0 ECU_ADDRESS 0x3FADA8 /end MEASUREMENT
/begin COMPU_METHOD MC_EGRP_SS_RTR "EGRP_SS_RTR conversion" RAT_FUNC "%10.5" "Unitless" COEFFS 0 1 0 0 0 1 /end COMPU_METHOD
/begin MEASUREMENT EGRP_STATUS "EGR Valve position status" UBYTE MC_EGRP_STATUS 0 0 0 0 ECU_ADDRESS 0x3F99A3 /end MEASUREMENT
/begin COMPU_METHOD MC_EGRP_STATUS "EGRP_STATUS conversion" RAT_FUNC "%3.0" "Unitless" COEFFS 0 1 0 0 0 1 /end COMPU_METHOD
/begin CHARACTERISTIC EGRP_TCREC_SEL "Switch to select EGRP filter time constant during fault recovery and during fault occurance before malf is set" VALUE 0x5D09C SD_UBYTE 0 SC_EGRP_TCREC_SEL 0 1 /end CHARACTERISTIC
/begin COMPU_METHOD SC_EGRP_TCREC_SEL "EGRP_TCREC_SEL conversion" RAT_FUNC "%3.0" "unitless" COEFFS 0 1 0 0 0 1 /end COMPU_METHOD
/begin MEASUREMENT EGRP_VOLTS "" FLOAT32_IEEE MC_EGRP_VOLTS 0 0 0 0 ECU_ADDRESS 0x3F998C /end MEASUREMENT
/begin COMPU_METHOD MC_EGRP_VOLTS "EGRP_VOLTS conversion" RAT_FUNC "%10.5" "Unitless" COEFFS 0 1 0 0 0 1 /end COMPU_METHOD
/begin CHARACTERISTIC EGRTPZ_F_DEC "" VALUE 0x5C80C SD_SLONG 0 SC_EGRTPZ_F_DEC 0 65535 /end CHARACTERISTIC
/begin COMPU_METHOD SC_EGRTPZ_F_DEC "EGRTPZ_F_DEC conversion" RAT_FUNC "%10.0" "unitless" COEFFS 0 1 0 0 0 1 /end COMPU_METHOD
/begin CHARACTERISTIC EGRTPZ_F_INC "" VALUE 0x5C808 SD_SLONG 0 SC_EGRTPZ_F_INC 0 65535 /end CHARACTERISTIC
/begin COMPU_METHOD SC_EGRTPZ_F_INC "EGRTPZ_F_INC conversion" RAT_FUNC "%10.0" "unitless" COEFFS 0 1 0 0 0 1 /end COMPU_METHOD
/begin MEASUREMENT EGRTPZ_F_LRNOPN "" UBYTE MC_EGRTPZ_F_LRNOPN 0 0 0 0 ECU_ADDRESS 0x3F9A46 /end MEASUREMENT
/begin COMPU_METHOD MC_EGRTPZ_F_LRNOPN "EGRTPZ_F_LRNOPN conversion" RAT_FUNC "%3.0" "Unitless" COEFFS 0 1 0 0 0 1 /end COMPU_METHOD
/begin CHARACTERISTIC EGRZ_DTY_MIN "" VALUE 0x5C6B8 SD_FLOAT32_IEEE 0 SC_EGRZ_DTY_MIN 0 1 /end CHARACTERISTIC
/begin COMPU_METHOD SC_EGRZ_DTY_MIN "EGRZ_DTY_MIN conversion" RAT_FUNC "%10.5" "unitless" COEFFS 0 1 0 0 0 1 /end COMPU_METHOD
/begin MEASUREMENT EGRZ_EGRSP_C "" UBYTE MC_EGRZ_EGRSP_C 0 0 0 0 ECU_ADDRESS 0x3F99A2 /end MEASUREMENT
/begin COMPU_METHOD MC_EGRZ_EGRSP_C "EGRZ_EGRSP_C conversion" RAT_FUNC "%3.0" "Unitless" COEFFS 0 1 0 0 0 1 /end COMPU_METHOD
/begin CHARACTERISTIC EGRZ_MFDES_MAX "" VALUE 0x5C6B4 SD_FLOAT32_IEEE 0 SC_EGRZ_MFDES_MAX 0 350 /end CHARACTERISTIC
/begin COMPU_METHOD SC_EGRZ_MFDES_MAX "EGRZ_MFDES_MAX conversion" RAT_FUNC "%10.5" "unitless" COEFFS 0 1 0 0 0 1 /end COMPU_METHOD
/begin CHARACTERISTIC EGRZ_N_MAX "" VALUE 0x5C6B0 SD_FLOAT32_IEEE 0 SC_EGRZ_N_MAX 0 5000 /end CHARACTERISTIC
/begin COMPU_METHOD SC_EGRZ_N_MAX "EGRZ_N_MAX conversion" RAT_FUNC "%10.5" "unitless" COEFFS 0 1 0 0 0 1 /end COMPU_METHOD
/begin MEASUREMENT EGRZ_SAMPLE "" UBYTE MC_EGRZ_SAMPLE 0 0 0 0 ECU_ADDRESS 0x3F99A1 /end MEASUREMENT
/begin COMPU_METHOD MC_EGRZ_SAMPLE "EGRZ_SAMPLE conversion" RAT_FUNC "%3.0" "Unitless" COEFFS 0 1 0 0 0 1 /end COMPU_METHOD
/begin MEASUREMENT EGRZ_STL_FLG "" UBYTE MC_EGRZ_STL_FLG 0 0 0 0 ECU_ADDRESS 0x3F99A0 /end MEASUREMENT
/begin COMPU_METHOD MC_EGRZ_STL_FLG "EGRZ_STL_FLG conversion" RAT_FUNC "%3.0" "Unitless" COEFFS 0 1 0 0 0 1 /end COMPU_METHOD
/begin CHARACTERISTIC EGRZ_STL_TM "Power on delay for EGR zeroing logic." VALUE 0x5C6AC SD_FLOAT32_IEEE 0 SC_EGRZ_STL_TM 0 100 /end CHARACTERISTIC
/begin COMPU_METHOD SC_EGRZ_STL_TM "EGRZ_STL_TM conversion" RAT_FUNC "%10.5" "s" COEFFS 0 1 0 0 0 1 /end COMPU_METHOD
/begin MEASUREMENT EGRZ_STL_TMR "" FLOAT32_IEEE MC_EGRZ_STL_TMR 0 0 0 0 ECU_ADDRESS 0x3F9988 /end MEASUREMENT
/begin COMPU_METHOD MC_EGRZ_STL_TMR "EGRZ_STL_TMR conversion" RAT_FUNC "%10.5" "Unitless" COEFFS 0 1 0 0 0 1 /end COMPU_METHOD
/begin MEASUREMENT EGR_AFR_KF "First Order Filter time constant (sec)" FLOAT32_IEEE MC_EGR_AFR_KF 0 0 0 0 ECU_ADDRESS 0x3FAE04 /end MEASUREMENT
/begin COMPU_METHOD MC_EGR_AFR_KF "EGR_AFR_KF conversion" RAT_FUNC "%10.5" "Unitless" COEFFS 0 1 0 0 0 1 /end COMPU_METHOD
/begin MEASUREMENT EGR_AFR_MLT "Multiplier that modifies MAF setpoint for transient management" FLOAT32_IEEE MC_EGR_AFR_MLT 0 0 0 0 ECU_ADDRESS 0x3FAE00 /end MEASUREMENT
/begin COMPU_METHOD MC_EGR_AFR_MLT "EGR_AFR_MLT conversion" RAT_FUNC "%10.5" "Unitless" COEFFS 0 1 0 0 0 1 /end COMPU_METHOD
/begin MEASUREMENT EGR_AFR_PPS_KF "First  order filter constant" FLOAT32_IEEE MC_EGR_AFR_PPS_KF 0 0 0 0 ECU_ADDRESS 0x3FADFC /end MEASUREMENT
/begin COMPU_METHOD MC_EGR_AFR_PPS_KF "EGR_AFR_PPS_KF conversion" RAT_FUNC "%10.5" "Unitless" COEFFS 0 1 0 0 0 1 /end COMPU_METHOD
/begin MEASUREMENT EGR_COLD_MULT "" FLOAT32_IEEE MC_EGR_COLD_MULT 0 0 0 0 ECU_ADDRESS 0x3FAD08 /end MEASUREMENT
/begin COMPU_METHOD MC_EGR_COLD_MULT "EGR_COLD_MULT conversion" RAT_FUNC "%10.5" "Unitless" COEFFS 0 1 0 0 0 1 /end COMPU_METHOD
/begin MEASUREMENT EGR_COND_MULT "" FLOAT32_IEEE MC_EGR_COND_MULT 0 0 0 0 ECU_ADDRESS 0x3FAD04 /end MEASUREMENT
/begin COMPU_METHOD MC_EGR_COND_MULT "EGR_COND_MULT conversion" RAT_FUNC "%10.5" "Unitless" COEFFS 0 1 0 0 0 1 /end COMPU_METHOD
/begin MEASUREMENT EGR_COND_MULT_ROC "" FLOAT32_IEEE MC_EGR_COND_MULT_ROC 0 0 0 0 ECU_ADDRESS 0x3FAD00 /end MEASUREMENT
/begin COMPU_METHOD MC_EGR_COND_MULT_ROC "EGR_COND_MULT_ROC conversion" RAT_FUNC "%10.5" "Unitless" COEFFS 0 1 0 0 0 1 /end COMPU_METHOD
/begin MEASUREMENT EGR_COUNT "Count of the number of complete egr tests since KAM reset." UBYTE MC_EGR_COUNT 0 0 0 0 ECU_ADDRESS 0x3FCD0B /end MEASUREMENT
/begin COMPU_METHOD MC_EGR_COUNT "EGR_COUNT conversion" RAT_FUNC "%3.0" "Unitless" COEFFS 0 1 0 0 0 1 /end COMPU_METHOD
/begin MEASUREMENT EGR_DTY "EGR Valve duty cycle" FLOAT32_IEEE MC_EGR_DTY 0 0 0 0 ECU_ADDRESS 0x3FACFC /end MEASUREMENT
/begin COMPU_METHOD MC_EGR_DTY "EGR_DTY conversion" RAT_FUNC "%10.5" "Unitless" COEFFS 0 1 0 0 0 1 /end COMPU_METHOD
/begin CHARACTERISTIC EGR_DTY_CAL "Calibration mode manual duty input" VALUE 0x5E604 SD_FLOAT32_IEEE 0 SC_EGR_DTY_CAL 0 1 /end CHARACTERISTIC
/begin COMPU_METHOD SC_EGR_DTY_CAL "EGR_DTY_CAL conversion" RAT_FUNC "%10.5" "unitless" COEFFS 0 1 0 0 0 1 /end COMPU_METHOD
/begin CHARACTERISTIC EGR_DTY_DEF "default value of egr_dty for egr_f setting" VALUE 0x5E600 SD_FLOAT32_IEEE 0 SC_EGR_DTY_DEF 0 1 /end CHARACTERISTIC
/begin COMPU_METHOD SC_EGR_DTY_DEF "EGR_DTY_DEF conversion" RAT_FUNC "%10.5" "unitless" COEFFS 0 1 0 0 0 1 /end COMPU_METHOD
/begin CHARACTERISTIC EGR_DTY_LMN "Minimum limit for valve duty cycle" VALUE 0x5E5FC SD_FLOAT32_IEEE 0 SC_EGR_DTY_LMN 0 1 /end CHARACTERISTIC
/begin COMPU_METHOD SC_EGR_DTY_LMN "EGR_DTY_LMN conversion" RAT_FUNC "%10.5" "g/s" COEFFS 0 1 0 0 0 1 /end COMPU_METHOD
/begin CHARACTERISTIC EGR_DTY_LMX "Maximum limit for valve duty cycle" VALUE 0x5E5F8 SD_FLOAT32_IEEE 0 SC_EGR_DTY_LMX 0 1 /end CHARACTERISTIC
/begin COMPU_METHOD SC_EGR_DTY_LMX "EGR_DTY_LMX conversion" RAT_FUNC "%10.5" "g/s" COEFFS 0 1 0 0 0 1 /end COMPU_METHOD
/begin MEASUREMENT EGR_DUTY "" FLOAT32_IEEE MC_EGR_DUTY 0 0 0 0 ECU_ADDRESS 0x3FADF8 /end MEASUREMENT
/begin COMPU_METHOD MC_EGR_DUTY "EGR_DUTY conversion" RAT_FUNC "%10.5" "Unitless" COEFFS 0 1 0 0 0 1 /end COMPU_METHOD
/begin CHARACTERISTIC EGR_DUTY_CLOSED "" VALUE 0x5E4E0 SD_FLOAT32_IEEE 0 SC_EGR_DUTY_CLOSED 0 1 /end CHARACTERISTIC
/begin COMPU_METHOD SC_EGR_DUTY_CLOSED "EGR_DUTY_CLOSED conversion" RAT_FUNC "%10.5" "unitless" COEFFS 0 1 0 0 0 1 /end COMPU_METHOD
/begin CHARACTERISTIC EGR_DUTY_OPEN "" VALUE 0x5E4DC SD_FLOAT32_IEEE 0 SC_EGR_DUTY_OPEN 0 1 /end CHARACTERISTIC
/begin COMPU_METHOD SC_EGR_DUTY_OPEN "EGR_DUTY_OPEN conversion" RAT_FUNC "%10.5" "unitless" COEFFS 0 1 0 0 0 1 /end COMPU_METHOD
/begin CHARACTERISTIC EGR_EOTECT_MIN "" VALUE 0x5E4D8 SD_FLOAT32_IEEE 0 SC_EGR_EOTECT_MIN -50 200 /end CHARACTERISTIC
/begin COMPU_METHOD SC_EGR_EOTECT_MIN "EGR_EOTECT_MIN conversion" RAT_FUNC "%10.5" "degC" COEFFS 0 1 0 0 0 1 /end COMPU_METHOD
/begin CHARACTERISTIC EGR_EOT_EN "Cold Engine oil temperature above which to enable EGR" VALUE 0x5E5F4 SD_FLOAT32_IEEE 0 SC_EGR_EOT_EN -100 200 /end CHARACTERISTIC
/begin COMPU_METHOD SC_EGR_EOT_EN "EGR_EOT_EN conversion" RAT_FUNC "%10.5" "degC" COEFFS 0 1 0 0 0 1 /end COMPU_METHOD
/begin MEASUREMENT EGR_FMEM "EGR system FMEM flag.  1 -> don't run EGR monitor due to FMEM." UBYTE MC_EGR_FMEM 0 0 0 0 ECU_ADDRESS 0x3F9E5A /end MEASUREMENT
/begin COMPU_METHOD MC_EGR_FMEM "EGR_FMEM conversion" RAT_FUNC "%3.0" "Unitless" COEFFS 0 1 0 0 0 1 /end COMPU_METHOD
/begin MEASUREMENT EGR_I_DTY "EGR integral term duty cycle" FLOAT32_IEEE MC_EGR_I_DTY 0 0 0 0 ECU_ADDRESS 0x3FADF4 /end MEASUREMENT
/begin COMPU_METHOD MC_EGR_I_DTY "EGR_I_DTY conversion" RAT_FUNC "%10.5" "Unitless" COEFFS 0 1 0 0 0 1 /end COMPU_METHOD
/begin MEASUREMENT EGR_I_VPD "Integral part of EGR duty cycle" FLOAT32_IEEE MC_EGR_I_VPD 0 0 0 0 ECU_ADDRESS 0x3FADF0 /end MEASUREMENT
/begin COMPU_METHOD MC_EGR_I_VPD "EGR_I_VPD conversion" RAT_FUNC "%10.5" "Unitless" COEFFS 0 1 0 0 0 1 /end COMPU_METHOD
/begin CHARACTERISTIC EGR_KOER_HI "MAF Desired high setpoint for EGR Control KOER Diagnostics" VALUE 0x5E5F0 SD_FLOAT32_IEEE 0 SC_EGR_KOER_HI 0 100 /end CHARACTERISTIC
/begin COMPU_METHOD SC_EGR_KOER_HI "EGR_KOER_HI conversion" RAT_FUNC "%10.5" "g/s" COEFFS 0 1 0 0 0 1 /end COMPU_METHOD
/begin CHARACTERISTIC EGR_KOER_LO "MAF Desired low setpoint for EGR Control KOER Diagnostics" VALUE 0x5E5EC SD_FLOAT32_IEEE 0 SC_EGR_KOER_LO 0 100 /end CHARACTERISTIC
/begin COMPU_METHOD SC_EGR_KOER_LO "EGR_KOER_LO conversion" RAT_FUNC "%10.5" "g/s" COEFFS 0 1 0 0 0 1 /end COMPU_METHOD
/begin CHARACTERISTIC EGR_KOER_OFF "MAF Desired off setpoint  for EGR Control  KOER Diagnostics" VALUE 0x5E5E8 SD_FLOAT32_IEEE 0 SC_EGR_KOER_OFF 0 100 /end CHARACTERISTIC
/begin COMPU_METHOD SC_EGR_KOER_OFF "EGR_KOER_OFF conversion" RAT_FUNC "%10.5" "g/s" COEFFS 0 1 0 0 0 1 /end COMPU_METHOD
/begin CHARACTERISTIC EGR_MAF_CAL "Calibration mode manual MAF setpoint input" VALUE 0x5E5E4 SD_FLOAT32_IEEE 0 SC_EGR_MAF_CAL 0 2000 /end CHARACTERISTIC
/begin COMPU_METHOD SC_EGR_MAF_CAL "EGR_MAF_CAL conversion" RAT_FUNC "%10.5" "g/s" COEFFS 0 1 0 0 0 1 /end COMPU_METHOD
/begin MEASUREMENT EGR_MAF_DES "Desired MAF setpoint after saturation block" FLOAT32_IEEE MC_EGR_MAF_DES 0 0 0 0 ECU_ADDRESS 0x3FADE4 /end MEASUREMENT
/begin COMPU_METHOD MC_EGR_MAF_DES "EGR_MAF_DES conversion" RAT_FUNC "%10.5" "Unitless" COEFFS 0 1 0 0 0 1 /end COMPU_METHOD
/begin MEASUREMENT EGR_MAF_ERR "MAF error calculated by actual MAF sensor - setpoint" FLOAT32_IEEE MC_EGR_MAF_ERR 0 0 0 0 ECU_ADDRESS 0x3FADE0 /end MEASUREMENT
/begin COMPU_METHOD MC_EGR_MAF_ERR "EGR_MAF_ERR conversion" RAT_FUNC "%10.5" "Unitless" COEFFS 0 1 0 0 0 1 /end COMPU_METHOD
/begin CHARACTERISTIC EGR_MAF_LMN "Minimum limit for MAF desired" VALUE 0x5E5E0 SD_FLOAT32_IEEE 0 SC_EGR_MAF_LMN 0 100 /end CHARACTERISTIC
/begin COMPU_METHOD SC_EGR_MAF_LMN "EGR_MAF_LMN conversion" RAT_FUNC "%10.5" "g/s" COEFFS 0 1 0 0 0 1 /end COMPU_METHOD
/begin CHARACTERISTIC EGR_MAF_LMX "Maximum limit for MAF desired" VALUE 0x5E5DC SD_FLOAT32_IEEE 0 SC_EGR_MAF_LMX 0 2000 /end CHARACTERISTIC
/begin COMPU_METHOD SC_EGR_MAF_LMX "EGR_MAF_LMX conversion" RAT_FUNC "%10.5" "g/s" COEFFS 0 1 0 0 0 1 /end COMPU_METHOD
/begin MEASUREMENT EGR_MAF_SP "MAF desired setpoint after thermal and transient compensation" FLOAT32_IEEE MC_EGR_MAF_SP 0 0 0 0 ECU_ADDRESS 0x3FADDC /end MEASUREMENT
/begin COMPU_METHOD MC_EGR_MAF_SP "EGR_MAF_SP conversion" RAT_FUNC "%10.5" "Unitless" COEFFS 0 1 0 0 0 1 /end COMPU_METHOD
/begin CHARACTERISTIC EGR_MAT_MIN "" VALUE 0x5E4D4 SD_FLOAT32_IEEE 0 SC_EGR_MAT_MIN -50 200 /end CHARACTERISTIC
/begin COMPU_METHOD SC_EGR_MAT_MIN "EGR_MAT_MIN conversion" RAT_FUNC "%10.5" "degC" COEFFS 0 1 0 0 0 1 /end COMPU_METHOD
/begin MEASUREMENT EGR_MNT_RDY "" UBYTE MC_EGR_MNT_RDY 0 0 0 0 ECU_ADDRESS 0x3FAFF4 /end MEASUREMENT
/begin COMPU_METHOD MC_EGR_MNT_RDY "EGR_MNT_RDY conversion" RAT_FUNC "%3.0" "Unitless" COEFFS 0 1 0 0 0 1 /end COMPU_METHOD
/begin CHARACTERISTIC EGR_MNT_RDY_BYPASS "" VALUE 0x5E85C SD_UBYTE 0 SC_EGR_MNT_RDY_BYPASS 0 1 /end CHARACTERISTIC
/begin COMPU_METHOD SC_EGR_MNT_RDY_BYPASS "EGR_MNT_RDY_BYPASS conversion" RAT_FUNC "%3.0" "unitless" COEFFS 0 1 0 0 0 1 /end COMPU_METHOD
/begin CHARACTERISTIC EGR_MNT_RDY_TM "" VALUE 0x5E854 SD_FLOAT32_IEEE 0 SC_EGR_MNT_RDY_TM 0 30000 /end CHARACTERISTIC
/begin COMPU_METHOD SC_EGR_MNT_RDY_TM "EGR_MNT_RDY_TM conversion" RAT_FUNC "%10.5" "s" COEFFS 0 1 0 0 0 1 /end COMPU_METHOD
/begin MEASUREMENT EGR_MNT_RDY_TMR "Timer for the EGR monitor to finish, so the egr_mon to set." FLOAT32_IEEE MC_EGR_MNT_RDY_TMR 0 0 0 0 ECU_ADDRESS 0x3FAF70 /end MEASUREMENT
/begin COMPU_METHOD MC_EGR_MNT_RDY_TMR "EGR_MNT_RDY_TMR conversion" RAT_FUNC "%10.5" "Unitless" COEFFS 0 1 0 0 0 1 /end COMPU_METHOD
/begin MEASUREMENT EGR_MON "OBDII monitor flag for EGR system; 1=> all EGR faults been monitored since power-up" UBYTE MC_EGR_MON 0 0 0 0 ECU_ADDRESS 0x3FAFF1 /end MEASUREMENT
/begin COMPU_METHOD MC_EGR_MON "EGR_MON conversion" RAT_FUNC "%3.0" "Unitless" COEFFS 0 1 0 0 0 1 /end COMPU_METHOD
/begin MEASUREMENT EGR_MON_KAM "KAM version of OBDII monitor flag for EGR system; 1=> all EGR faults been monitored since power-up" UBYTE MC_EGR_MON_KAM 0 0 0 0 ECU_ADDRESS 0x3FCF70 /end MEASUREMENT
/begin COMPU_METHOD MC_EGR_MON_KAM "EGR_MON_KAM conversion" RAT_FUNC "%3.0" "Unitless" COEFFS 0 1 0 0 0 1 /end COMPU_METHOD
/begin CHARACTERISTIC EGR_MSTR_3WAY_SEL "" VALUE 0x5E60C SD_UBYTE 0 SC_EGR_MSTR_3WAY_SEL 0 2 /end CHARACTERISTIC
/begin COMPU_METHOD SC_EGR_MSTR_3WAY_SEL "EGR_MSTR_3WAY_SEL conversion" RAT_FUNC "%3.0" "unitless" COEFFS 0 1 0 0 0 1 /end COMPU_METHOD
/begin CHARACTERISTIC EGR_MSTR_SEL "" VALUE 0x5E60B SD_UBYTE 0 SC_EGR_MSTR_SEL 0 1 /end CHARACTERISTIC
/begin COMPU_METHOD SC_EGR_MSTR_SEL "EGR_MSTR_SEL conversion" RAT_FUNC "%3.0" "unitless" COEFFS 0 1 0 0 0 1 /end COMPU_METHOD
/begin CHARACTERISTIC EGR_OSC_CHANNEL "IOC channel assignment" VALUE 0x5E613 SD_UBYTE 0 SC_EGR_OSC_CHANNEL 0 255 /end CHARACTERISTIC
/begin COMPU_METHOD SC_EGR_OSC_CHANNEL "EGR_OSC_CHANNEL conversion" RAT_FUNC "%3.0" "unitless" COEFFS 0 1 0 0 0 1 /end COMPU_METHOD
/begin CHARACTERISTIC EGR_PERIOD_OUT "" VALUE 0x5C3BC SD_FLOAT32_IEEE 0 SC_EGR_PERIOD_OUT 100 2e+06 /end CHARACTERISTIC
/begin COMPU_METHOD SC_EGR_PERIOD_OUT "EGR_PERIOD_OUT conversion" RAT_FUNC "%10.5" "us" COEFFS 0 1 0 0 0 1 /end COMPU_METHOD
/begin MEASUREMENT EGR_PPS_DIF "Difference of actual PPS minus filtered PPS" FLOAT32_IEEE MC_EGR_PPS_DIF 0 0 0 0 ECU_ADDRESS 0x3FADD0 /end MEASUREMENT
/begin COMPU_METHOD MC_EGR_PPS_DIF "EGR_PPS_DIF conversion" RAT_FUNC "%10.5" "Unitless" COEFFS 0 1 0 0 0 1 /end COMPU_METHOD
/begin MEASUREMENT EGR_PPS_FOF "Output of First Order Filter of PPS signal" FLOAT32_IEEE MC_EGR_PPS_FOF 0 0 0 0 ECU_ADDRESS 0x3FADCC /end MEASUREMENT
/begin COMPU_METHOD MC_EGR_PPS_FOF "EGR_PPS_FOF conversion" RAT_FUNC "%10.5" "Unitless" COEFFS 0 1 0 0 0 1 /end COMPU_METHOD
/begin CHARACTERISTIC EGR_PPS_KF "EGR time constant for PPS based transient compensator" VALUE 0x5E5D8 SD_FLOAT32_IEEE 0 SC_EGR_PPS_KF 0 5 /end CHARACTERISTIC
/begin COMPU_METHOD SC_EGR_PPS_KF "EGR_PPS_KF conversion" RAT_FUNC "%10.5" "s" COEFFS 0 1 0 0 0 1 /end COMPU_METHOD
/begin MEASUREMENT EGR_PPS_MLT "MAF  setpoint   based on PPS Trasient multiplier" FLOAT32_IEEE MC_EGR_PPS_MLT 0 0 0 0 ECU_ADDRESS 0x3FADC8 /end MEASUREMENT
/begin COMPU_METHOD MC_EGR_PPS_MLT "EGR_PPS_MLT conversion" RAT_FUNC "%10.5" "Unitless" COEFFS 0 1 0 0 0 1 /end COMPU_METHOD
/begin CHARACTERISTIC EGR_PULSE_TM "" VALUE 0x5E4D0 SD_FLOAT32_IEEE 0 SC_EGR_PULSE_TM 0 100000 /end CHARACTERISTIC
/begin COMPU_METHOD SC_EGR_PULSE_TM "EGR_PULSE_TM conversion" RAT_FUNC "%10.5" "s" COEFFS 0 1 0 0 0 1 /end COMPU_METHOD
/begin MEASUREMENT EGR_P_DTY "EGR proportional term duty cycle" FLOAT32_IEEE MC_EGR_P_DTY 0 0 0 0 ECU_ADDRESS 0x3FADD8 /end MEASUREMENT
/begin COMPU_METHOD MC_EGR_P_DTY "EGR_P_DTY conversion" RAT_FUNC "%10.5" "Unitless" COEFFS 0 1 0 0 0 1 /end COMPU_METHOD
/begin MEASUREMENT EGR_P_VPD "Proportional part of EGR duty cycle" FLOAT32_IEEE MC_EGR_P_VPD 0 0 0 0 ECU_ADDRESS 0x3FADD4 /end MEASUREMENT
/begin COMPU_METHOD MC_EGR_P_VPD "EGR_P_VPD conversion" RAT_FUNC "%10.5" "Unitless" COEFFS 0 1 0 0 0 1 /end COMPU_METHOD
/begin CHARACTERISTIC EGR_SEL "EGR mode selection" VALUE 0x5E612 SD_UBYTE 0 SC_EGR_SEL 0 3 /end CHARACTERISTIC
/begin COMPU_METHOD SC_EGR_SEL "EGR_SEL conversion" RAT_FUNC "%3.0" "unitless" COEFFS 0 1 0 0 0 1 /end COMPU_METHOD
/begin MEASUREMENT EGR_SENSOR_FAULT "" UBYTE MC_EGR_SENSOR_FAULT 0 0 0 0 ECU_ADDRESS 0x3FAE14 /end MEASUREMENT
/begin COMPU_METHOD MC_EGR_SENSOR_FAULT "EGR_SENSOR_FAULT conversion" RAT_FUNC "%3.0" "Unitless" COEFFS 0 1 0 0 0 1 /end COMPU_METHOD
/begin MEASUREMENT EGR_SLIDE_BAR "IOC slide bar limiter" FLOAT32_IEEE MC_EGR_SLIDE_BAR 0 0 0 0 ECU_ADDRESS 0x3FB514 /end MEASUREMENT
/begin COMPU_METHOD MC_EGR_SLIDE_BAR "EGR_SLIDE_BAR conversion" RAT_FUNC "%10.5" "Unitless" COEFFS 0 1 0 0 0 1 /end COMPU_METHOD
/begin MEASUREMENT EGR_TST_ENA "OBD-II EGR Test enable flag. (1 => test enabled)" UBYTE MC_EGR_TST_ENA 0 0 0 0 ECU_ADDRESS 0x3F9E39 /end MEASUREMENT
/begin COMPU_METHOD MC_EGR_TST_ENA "EGR_TST_ENA conversion" RAT_FUNC "%3.0" "Unitless" COEFFS 0 1 0 0 0 1 /end COMPU_METHOD
/begin MEASUREMENT EGR_TST_RDY "EGR test ready flag; 1 ->  all  local  conditions have been met; ready to run EGR test." UBYTE MC_EGR_TST_RDY 0 0 0 0 ECU_ADDRESS 0x3F9CD7 /end MEASUREMENT
/begin COMPU_METHOD MC_EGR_TST_RDY "EGR_TST_RDY conversion" RAT_FUNC "%3.0" "Unitless" COEFFS 0 1 0 0 0 1 /end COMPU_METHOD
/begin MEASUREMENT EGR_V6_KI "" FLOAT32_IEEE MC_EGR_V6_KI 0 0 0 0 ECU_ADDRESS 0x3FADEC /end MEASUREMENT
/begin COMPU_METHOD MC_EGR_V6_KI "EGR_V6_KI conversion" RAT_FUNC "%10.5" "Unitless" COEFFS 0 1 0 0 0 1 /end COMPU_METHOD
/begin MEASUREMENT EGR_V6_KP "" FLOAT32_IEEE MC_EGR_V6_KP 0 0 0 0 ECU_ADDRESS 0x3FADE8 /end MEASUREMENT
/begin COMPU_METHOD MC_EGR_V6_KP "EGR_V6_KP conversion" RAT_FUNC "%10.5" "Unitless" COEFFS 0 1 0 0 0 1 /end COMPU_METHOD
/begin CHARACTERISTIC EGR_VLV_EN "" VALUE 0x5E60A SD_UBYTE 0 SC_EGR_VLV_EN 0 1 /end CHARACTERISTIC
/begin COMPU_METHOD SC_EGR_VLV_EN "EGR_VLV_EN conversion" RAT_FUNC "%3.0" "g/cm3" COEFFS 0 1 0 0 0 1 /end COMPU_METHOD
/begin MEASUREMENT EGR_VLV_EX "" UBYTE MC_EGR_VLV_EX 0 0 0 0 ECU_ADDRESS 0x3FAE11 /end MEASUREMENT
/begin COMPU_METHOD MC_EGR_VLV_EX "EGR_VLV_EX conversion" RAT_FUNC "%3.0" "Unitless" COEFFS 0 1 0 0 0 1 /end COMPU_METHOD
/begin CHARACTERISTIC EGR_VLV_EX_EOTECT_MIN "" VALUE 0x5E4CC SD_FLOAT32_IEEE 0 SC_EGR_VLV_EX_EOTECT_MIN -50 200 /end CHARACTERISTIC
/begin COMPU_METHOD SC_EGR_VLV_EX_EOTECT_MIN "EGR_VLV_EX_EOTECT_MIN conversion" RAT_FUNC "%10.5" "degC" COEFFS 0 1 0 0 0 1 /end COMPU_METHOD
/begin CHARACTERISTIC EGR_VLV_EX_MAT_MIN "" VALUE 0x5E4C8 SD_FLOAT32_IEEE 0 SC_EGR_VLV_EX_MAT_MIN -50 200 /end CHARACTERISTIC
/begin COMPU_METHOD SC_EGR_VLV_EX_MAT_MIN "EGR_VLV_EX_MAT_MIN conversion" RAT_FUNC "%10.5" "degC" COEFFS 0 1 0 0 0 1 /end COMPU_METHOD
/begin CHARACTERISTIC EGR_VLV_EX_MFDES_LMN "" VALUE 0x5E4C4 SD_FLOAT32_IEEE 0 SC_EGR_VLV_EX_MFDES_LMN 0 350 /end CHARACTERISTIC
/begin COMPU_METHOD SC_EGR_VLV_EX_MFDES_LMN "EGR_VLV_EX_MFDES_LMN conversion" RAT_FUNC "%10.5" "g/cm3" COEFFS 0 1 0 0 0 1 /end COMPU_METHOD
/begin CHARACTERISTIC EGR_VLV_EX_MFDES_LMX "" VALUE 0x5E4C0 SD_FLOAT32_IEEE 0 SC_EGR_VLV_EX_MFDES_LMX 0 350 /end CHARACTERISTIC
/begin COMPU_METHOD SC_EGR_VLV_EX_MFDES_LMX "EGR_VLV_EX_MFDES_LMX conversion" RAT_FUNC "%10.5" "g/cm3" COEFFS 0 1 0 0 0 1 /end COMPU_METHOD
/begin CHARACTERISTIC EGR_VLV_EX_N_LMN "" VALUE 0x5E4BC SD_FLOAT32_IEEE 0 SC_EGR_VLV_EX_N_LMN 0 6000 /end CHARACTERISTIC
/begin COMPU_METHOD SC_EGR_VLV_EX_N_LMN "EGR_VLV_EX_N_LMN conversion" RAT_FUNC "%10.5" "RPM" COEFFS 0 1 0 0 0 1 /end COMPU_METHOD
/begin CHARACTERISTIC EGR_VLV_EX_N_LMX "" VALUE 0x5E4B8 SD_FLOAT32_IEEE 0 SC_EGR_VLV_EX_N_LMX 0 6000 /end CHARACTERISTIC
/begin COMPU_METHOD SC_EGR_VLV_EX_N_LMX "EGR_VLV_EX_N_LMX conversion" RAT_FUNC "%10.5" "RPM" COEFFS 0 1 0 0 0 1 /end COMPU_METHOD
/begin MEASUREMENT EGR_VLV_EX_TIMER "" FLOAT32_IEEE MC_EGR_VLV_EX_TIMER 0 0 0 0 ECU_ADDRESS 0x3FACF8 /end MEASUREMENT
/begin COMPU_METHOD MC_EGR_VLV_EX_TIMER "EGR_VLV_EX_TIMER conversion" RAT_FUNC "%10.5" "Unitless" COEFFS 0 1 0 0 0 1 /end COMPU_METHOD
/begin MEASUREMENT EGR_VLV_EX_TMR "" FLOAT32_IEEE MC_EGR_VLV_EX_TMR 0 0 0 0 ECU_ADDRESS 0x3FACF4 /end MEASUREMENT
/begin COMPU_METHOD MC_EGR_VLV_EX_TMR "EGR_VLV_EX_TMR conversion" RAT_FUNC "%10.5" "Unitless" COEFFS 0 1 0 0 0 1 /end COMPU_METHOD
/begin CHARACTERISTIC EGR_VLV_EX_TM_MAX "" VALUE 0x5E4B4 SD_FLOAT32_IEEE 0 SC_EGR_VLV_EX_TM_MAX 0 100000 /end CHARACTERISTIC
/begin COMPU_METHOD SC_EGR_VLV_EX_TM_MAX "EGR_VLV_EX_TM_MAX conversion" RAT_FUNC "%10.5" "s" COEFFS 0 1 0 0 0 1 /end COMPU_METHOD
/begin CHARACTERISTIC EGR_VLV_EX_TM_MIN "" VALUE 0x5E4B0 SD_FLOAT32_IEEE 0 SC_EGR_VLV_EX_TM_MIN 0 100000 /end CHARACTERISTIC
/begin COMPU_METHOD SC_EGR_VLV_EX_TM_MIN "EGR_VLV_EX_TM_MIN conversion" RAT_FUNC "%10.5" "s" COEFFS 0 1 0 0 0 1 /end COMPU_METHOD
/begin CHARACTERISTIC EGR_VLV_OPN_STL_TM "" VALUE 0x5E4AC SD_FLOAT32_IEEE 0 SC_EGR_VLV_OPN_STL_TM 0 100000 /end CHARACTERISTIC
/begin COMPU_METHOD SC_EGR_VLV_OPN_STL_TM "EGR_VLV_OPN_STL_TM conversion" RAT_FUNC "%10.5" "s" COEFFS 0 1 0 0 0 1 /end COMPU_METHOD
/begin CHARACTERISTIC EGR_VPD_LMN "Minimum egr_flw_err for enable egr_i_vpd" VALUE 0x5E5D4 SD_FLOAT32_IEEE 0 SC_EGR_VPD_LMN -1 1 /end CHARACTERISTIC
/begin COMPU_METHOD SC_EGR_VPD_LMN "EGR_VPD_LMN conversion" RAT_FUNC "%10.5" "unitless" COEFFS 0 1 0 0 0 1 /end COMPU_METHOD
/begin CHARACTERISTIC EGR_VPD_LMX "Max egr_flw_err for enable egr_i_vpd" VALUE 0x5E5D0 SD_FLOAT32_IEEE 0 SC_EGR_VPD_LMX 0 1 /end CHARACTERISTIC
/begin COMPU_METHOD SC_EGR_VPD_LMX "EGR_VPD_LMX conversion" RAT_FUNC "%10.5" "unitless" COEFFS 0 1 0 0 0 1 /end COMPU_METHOD
/begin MEASUREMENT ENC_CHKSUM "Four byte Encrypted Checksum for Mode 9" ULONG MC_ENC_CHKSUM 0 0 0 0 ECU_ADDRESS 0x3FB620 /end MEASUREMENT
/begin COMPU_METHOD MC_ENC_CHKSUM "ENC_CHKSUM conversion" RAT_FUNC "%10.0" "Unitless" COEFFS 0 1 0 0 0 1 /end COMPU_METHOD
/begin MEASUREMENT ENGINE_SPEED "Engine speed (RPM)." FLOAT32_IEEE MC_ENGINE_SPEED 0 0 0 0 ECU_ADDRESS 0x3FA27C /end MEASUREMENT
/begin COMPU_METHOD MC_ENGINE_SPEED "ENGINE_SPEED conversion" RAT_FUNC "%10.5" "Unitless" COEFFS 0 1 0 0 0 1 /end COMPU_METHOD
/begin MEASUREMENT ENGINE_TYPE "" UBYTE MC_ENGINE_TYPE 0 0 0 0 ECU_ADDRESS 0x3FB6B8 /end MEASUREMENT
/begin COMPU_METHOD MC_ENGINE_TYPE "ENGINE_TYPE conversion" RAT_FUNC "%3.0" "Unitless" COEFFS 0 1 0 0 0 1 /end COMPU_METHOD
/begin CHARACTERISTIC ENG_CONFIG_1 "Calibration of Engine Cylinders and Valves for SCP. CAl as (NUMCYL * 8) + (Number of Valves per cyl)" VALUE 0x5EF95 SD_UBYTE 0 SC_ENG_CONFIG_1 0 255 /end CHARACTERISTIC
/begin COMPU_METHOD SC_ENG_CONFIG_1 "ENG_CONFIG_1 conversion" RAT_FUNC "%3.0" "UNITLESS" COEFFS 0 1 0 0 0 1 /end COMPU_METHOD
/begin CHARACTERISTIC ENG_CONFIG_2 "Calibration of Air induction and Fuel Type/Delivery for SCP.  Cal as (Ref SCP_MSG_CONTROL module)." VALUE 0x5EF94 SD_UBYTE 0 SC_ENG_CONFIG_2 0 255 /end CHARACTERISTIC
/begin COMPU_METHOD SC_ENG_CONFIG_2 "ENG_CONFIG_2 conversion" RAT_FUNC "%3.0" "UNITLESS" COEFFS 0 1 0 0 0 1 /end COMPU_METHOD
/begin MEASUREMENT ENG_MISF_OCC "Engine misfire occurred" UBYTE MC_ENG_MISF_OCC 0 0 0 0 ECU_ADDRESS 0x3FA2C1 /end MEASUREMENT
/begin COMPU_METHOD MC_ENG_MISF_OCC "ENG_MISF_OCC conversion" RAT_FUNC "%3.0" "Unitless" COEFFS 0 1 0 0 0 1 /end COMPU_METHOD
/begin MEASUREMENT ENG_OFF_HRES "High Res engine off time.  From H/W timer." FLOAT32_IEEE MC_ENG_OFF_HRES 0 0 0 0 ECU_ADDRESS 0x3FB600 /end MEASUREMENT
/begin COMPU_METHOD MC_ENG_OFF_HRES "ENG_OFF_HRES conversion" RAT_FUNC "%10.5" "Unitless" COEFFS 0 1 0 0 0 1 /end COMPU_METHOD
/begin CHARACTERISTIC ENG_OFF_OVRD "Flag  override of engine off timer calculation" VALUE 0x5F2D4 SD_UBYTE 0 SC_ENG_OFF_OVRD 0 1 /end CHARACTERISTIC
/begin COMPU_METHOD SC_ENG_OFF_OVRD "ENG_OFF_OVRD conversion" RAT_FUNC "%3.0" "flag" COEFFS 0 1 0 0 0 1 /end COMPU_METHOD
/begin MEASUREMENT ENG_OFF_TMR "Elapsed time of the most recent EEC module key-off powered-down period." FLOAT32_IEEE MC_ENG_OFF_TMR 0 0 0 0 ECU_ADDRESS 0x3FB604 /end MEASUREMENT
/begin COMPU_METHOD MC_ENG_OFF_TMR "ENG_OFF_TMR conversion" RAT_FUNC "%10.5" "Unitless" COEFFS 0 1 0 0 0 1 /end COMPU_METHOD
/begin CHARACTERISTIC ENG_OFF_VAL "Engine off timer calibratable override value" VALUE 0x5F2D0 SD_FLOAT32_IEEE 0 SC_ENG_OFF_VAL 0 1680 /end CHARACTERISTIC
/begin COMPU_METHOD SC_ENG_OFF_VAL "ENG_OFF_VAL conversion" RAT_FUNC "%10.5" "min" COEFFS 0 1 0 0 0 1 /end COMPU_METHOD
/begin MEASUREMENT ENG_STALLED "Flag set to one when the engine has stalled (TSLPIP > TSTALL, 800 msec)." UBYTE MC_ENG_STALLED 0 0 0 0 ECU_ADDRESS 0x3FA8B4 /end MEASUREMENT
/begin COMPU_METHOD MC_ENG_STALLED "ENG_STALLED conversion" RAT_FUNC "%3.0" "Unitless" COEFFS 0 1 0 0 0 1 /end COMPU_METHOD
/begin MEASUREMENT ENG_TQ_QUALITY "Engine Torque Quality" UBYTE MC_ENG_TQ_QUALITY 0 0 0 0 ECU_ADDRESS 0x3FA2A6 /end MEASUREMENT
/begin COMPU_METHOD MC_ENG_TQ_QUALITY "ENG_TQ_QUALITY conversion" RAT_FUNC "%3.0" "Unitless" COEFFS 0 1 0 0 0 1 /end COMPU_METHOD
/begin MEASUREMENT EOTCORR_NORM "" FLOAT32_IEEE MC_EOTCORR_NORM 0 0 0 0 ECU_ADDRESS 0x3F9908 /end MEASUREMENT
/begin COMPU_METHOD MC_EOTCORR_NORM "EOTCORR_NORM conversion" RAT_FUNC "%10.5" "Unitless" COEFFS 0 1 0 0 0 1 /end COMPU_METHOD
/begin MEASUREMENT EOTICPCORR "" FLOAT32_IEEE MC_EOTICPCORR 0 0 0 0 ECU_ADDRESS 0x3F9904 /end MEASUREMENT
/begin COMPU_METHOD MC_EOTICPCORR "EOTICPCORR conversion" RAT_FUNC "%10.5" "Unitless" COEFFS 0 1 0 0 0 1 /end COMPU_METHOD
/begin CHARACTERISTIC EOTRAT_DEL "Engine oil temperature rational delay" VALUE 0x5CF60 SD_FLOAT32_IEEE 0 SC_EOTRAT_DEL -8192 8191 /end CHARACTERISTIC
/begin COMPU_METHOD SC_EOTRAT_DEL "EOTRAT_DEL conversion" RAT_FUNC "%10.5" "degC" COEFFS 0 1 0 0 0 1 /end COMPU_METHOD
/begin CHARACTERISTIC EOTRAT_DELTM "Engine oil temperature rational delay timer" VALUE 0x5CF5C SD_FLOAT32_IEEE 0 SC_EOTRAT_DELTM -8192 8191 /end CHARACTERISTIC
/begin COMPU_METHOD SC_EOTRAT_DELTM "EOTRAT_DELTM conversion" RAT_FUNC "%10.5" "degC" COEFFS 0 1 0 0 0 1 /end COMPU_METHOD
/begin CHARACTERISTIC EOT_AD_TC "Engine oil temperature filter time constant" VALUE 0x5CF88 SD_FLOAT32_IEEE 0 SC_EOT_AD_TC 0 64 /end CHARACTERISTIC
/begin COMPU_METHOD SC_EOT_AD_TC "EOT_AD_TC conversion" RAT_FUNC "%10.5" "s" COEFFS 0 1 0 0 0 1 /end COMPU_METHOD
/begin CHARACTERISTIC EOT_AD_TC_NSTRT "Engine oil temperature filter time constant" VALUE 0x5CF84 SD_FLOAT32_IEEE 0 SC_EOT_AD_TC_NSTRT 0 64 /end CHARACTERISTIC
/begin COMPU_METHOD SC_EOT_AD_TC_NSTRT "EOT_AD_TC_NSTRT conversion" RAT_FUNC "%10.5" "s" COEFFS 0 1 0 0 0 1 /end COMPU_METHOD
/begin MEASUREMENT EOT_C "Engine oil temperature. (DEGREES C)" FLOAT32_IEEE MC_EOT_C 0 0 0 0 ECU_ADDRESS 0x3F9F2C /end MEASUREMENT
/begin COMPU_METHOD MC_EOT_C "EOT_C conversion" RAT_FUNC "%10.5" "Unitless" COEFFS 0 1 0 0 0 1 /end COMPU_METHOD
/begin MEASUREMENT EOT_CNTS "Engine Oil Temperature A/D input." SLONG MC_EOT_CNTS 0 0 0 0 ECU_ADDRESS 0x3F98D8 /end MEASUREMENT
/begin COMPU_METHOD MC_EOT_CNTS "EOT_CNTS conversion" RAT_FUNC "%10.0" "Unitless" COEFFS 0 1 0 0 0 1 /end COMPU_METHOD
/begin MEASUREMENT EOT_CNT_LMC "eot cold fault counter limit" SLONG MC_EOT_CNT_LMC 0 0 0 0 ECU_ADDRESS 0x3F9EF8 /end MEASUREMENT
/begin COMPU_METHOD MC_EOT_CNT_LMC "EOT_CNT_LMC conversion" RAT_FUNC "%10.0" "Unitless" COEFFS 0 1 0 0 0 1 /end COMPU_METHOD
/begin MEASUREMENT EOT_CNT_LMH "eot hot fault counter limit" SLONG MC_EOT_CNT_LMH 0 0 0 0 ECU_ADDRESS 0x3F9EF4 /end MEASUREMENT
/begin COMPU_METHOD MC_EOT_CNT_LMH "EOT_CNT_LMH conversion" RAT_FUNC "%10.0" "Unitless" COEFFS 0 1 0 0 0 1 /end COMPU_METHOD
/begin MEASUREMENT EOT_COLD "EOT cold flag." UBYTE MC_EOT_COLD 0 0 0 0 ECU_ADDRESS 0x3FA53B /end MEASUREMENT
/begin COMPU_METHOD MC_EOT_COLD "EOT_COLD conversion" RAT_FUNC "%3.0" "Unitless" COEFFS 0 1 0 0 0 1 /end COMPU_METHOD
/begin MEASUREMENT EOT_COLD_CNT "threshold monitor cold counter" SLONG MC_EOT_COLD_CNT 0 0 0 0 ECU_ADDRESS 0x3F9F08 /end MEASUREMENT
/begin COMPU_METHOD MC_EOT_COLD_CNT "EOT_COLD_CNT conversion" RAT_FUNC "%10.0" "Unitless" COEFFS 0 1 0 0 0 1 /end COMPU_METHOD
/begin CHARACTERISTIC EOT_COLD_DEF "Default value for Engine Oil Temperature" VALUE 0x5CFE4 SD_FLOAT32_IEEE 0 SC_EOT_COLD_DEF -40 50 /end CHARACTERISTIC
/begin COMPU_METHOD SC_EOT_COLD_DEF "EOT_COLD_DEF conversion" RAT_FUNC "%10.5" "degC" COEFFS 0 1 0 0 0 1 /end COMPU_METHOD
/begin CHARACTERISTIC EOT_COLD_LMN "threshold monitor cold temperature limit" VALUE 0x5CF68 SD_FLOAT32_IEEE 0 SC_EOT_COLD_LMN -8192 8191 /end CHARACTERISTIC
/begin COMPU_METHOD SC_EOT_COLD_LMN "EOT_COLD_LMN conversion" RAT_FUNC "%10.5" "degC" COEFFS 0 1 0 0 0 1 /end COMPU_METHOD
/begin CHARACTERISTIC EOT_COLD_MFDES "cold desired mass fuel threshold value" VALUE 0x5CF6C SD_FLOAT32_IEEE 0 SC_EOT_COLD_MFDES -2048 2047.94 /end CHARACTERISTIC
/begin COMPU_METHOD SC_EOT_COLD_MFDES "EOT_COLD_MFDES conversion" RAT_FUNC "%10.5" "g/s" COEFFS 0 1 0 0 0 1 /end COMPU_METHOD
/begin CHARACTERISTIC EOT_COLD_N "cold engine speed threshold value" VALUE 0x5CF70 SD_FLOAT32_IEEE 0 SC_EOT_COLD_N 0 16383.8 /end CHARACTERISTIC
/begin COMPU_METHOD SC_EOT_COLD_N "EOT_COLD_N conversion" RAT_FUNC "%10.5" "RPM" COEFFS 0 1 0 0 0 1 /end COMPU_METHOD
/begin MEASUREMENT EOT_C_PID "Engine oil temperature for pid. (DEGREES C)" FLOAT32_IEEE MC_EOT_C_PID 0 0 0 0 ECU_ADDRESS 0x3F9EEC /end MEASUREMENT
/begin COMPU_METHOD MC_EOT_C_PID "EOT_C_PID conversion" RAT_FUNC "%10.5" "Unitless" COEFFS 0 1 0 0 0 1 /end COMPU_METHOD
/begin MEASUREMENT EOT_C_THLD "eot threshold flag" UBYTE MC_EOT_C_THLD 0 0 0 0 ECU_ADDRESS 0x3F9F34 /end MEASUREMENT
/begin COMPU_METHOD MC_EOT_C_THLD "EOT_C_THLD conversion" RAT_FUNC "%3.0" "Unitless" COEFFS 0 1 0 0 0 1 /end COMPU_METHOD
/begin MEASUREMENT EOT_ENG_C "Engine Oil Temperature without FMEM substitutions, degree C" FLOAT32_IEEE MC_EOT_ENG_C 0 0 0 0 ECU_ADDRESS 0x3F98D0 /end MEASUREMENT
/begin COMPU_METHOD MC_EOT_ENG_C "EOT_ENG_C conversion" RAT_FUNC "%10.5" "Unitless" COEFFS 0 1 0 0 0 1 /end COMPU_METHOD
/begin CHARACTERISTIC EOT_ENG_C_TC "Engine oil engineering value filter time constant" VALUE 0x5C570 SD_FLOAT32_IEEE 0 SC_EOT_ENG_C_TC 0 64 /end CHARACTERISTIC
/begin COMPU_METHOD SC_EOT_ENG_C_TC "EOT_ENG_C_TC conversion" RAT_FUNC "%10.5" "s" COEFFS 0 1 0 0 0 1 /end COMPU_METHOD
/begin CHARACTERISTIC EOT_FAST_ENA "Engine oil temperature. (DEGREES C)" VALUE 0x5DBB4 SD_FLOAT32_IEEE 0 SC_EOT_FAST_ENA -40 150 /end CHARACTERISTIC
/begin COMPU_METHOD SC_EOT_FAST_ENA "EOT_FAST_ENA conversion" RAT_FUNC "%10.5" "degC" COEFFS 0 1 0 0 0 1 /end COMPU_METHOD
/begin MEASUREMENT EOT_FILT_TIME_CONST "eot filter time constant" FLOAT32_IEEE MC_EOT_FILT_TIME_CONST 0 0 0 0 ECU_ADDRESS 0x3F9F24 /end MEASUREMENT
/begin COMPU_METHOD MC_EOT_FILT_TIME_CONST "EOT_FILT_TIME_CONST conversion" RAT_FUNC "%10.5" "Unitless" COEFFS 0 1 0 0 0 1 /end COMPU_METHOD
/begin MEASUREMENT EOT_FLT_RECOVERY_CNTR "eot fault recovery counter" SLONG MC_EOT_FLT_RECOVERY_CNTR 0 0 0 0 ECU_ADDRESS 0x3F9F10 /end MEASUREMENT
/begin COMPU_METHOD MC_EOT_FLT_RECOVERY_CNTR "EOT_FLT_RECOVERY_CNTR conversion" RAT_FUNC "%10.0" "Unitless" COEFFS 0 1 0 0 0 1 /end COMPU_METHOD
/begin MEASUREMENT EOT_FLT_RECOVERY_FLG "eot fault recovery flag" UBYTE MC_EOT_FLT_RECOVERY_FLG 0 0 0 0 ECU_ADDRESS 0x3F9F35 /end MEASUREMENT
/begin COMPU_METHOD MC_EOT_FLT_RECOVERY_FLG "EOT_FLT_RECOVERY_FLG conversion" RAT_FUNC "%3.0" "Unitless" COEFFS 0 1 0 0 0 1 /end COMPU_METHOD
/begin MEASUREMENT EOT_FMFLG "Engine oil temperature failure mode flag, set to one if EOT_HP is zero." UBYTE MC_EOT_FMFLG 0 0 0 0 ECU_ADDRESS 0x3F9F3E /end MEASUREMENT
/begin COMPU_METHOD MC_EOT_FMFLG "EOT_FMFLG conversion" RAT_FUNC "%3.0" "Unitless" COEFFS 0 1 0 0 0 1 /end COMPU_METHOD
/begin CHARACTERISTIC EOT_F_DEC "EOT ORH/ORL failure counter decrement value" VALUE 0x5CFE8 SD_SLONG 0 SC_EOT_F_DEC 0 65535 /end CHARACTERISTIC
/begin COMPU_METHOD SC_EOT_F_DEC "EOT_F_DEC conversion" RAT_FUNC "%10.0" "unitless" COEFFS 0 1 0 0 0 1 /end COMPU_METHOD
/begin CHARACTERISTIC EOT_F_INC "EOT ORH/ORL failure counter increment value" VALUE 0x5CFEC SD_SLONG 0 SC_EOT_F_INC 0 65535 /end CHARACTERISTIC
/begin COMPU_METHOD SC_EOT_F_INC "EOT_F_INC conversion" RAT_FUNC "%10.0" "unitless" COEFFS 0 1 0 0 0 1 /end COMPU_METHOD
/begin MEASUREMENT EOT_F_ORH "Engine Oil Temperature out of range high fail" UBYTE MC_EOT_F_ORH 0 0 0 0 ECU_ADDRESS 0x3F9F3B /end MEASUREMENT
/begin COMPU_METHOD MC_EOT_F_ORH "EOT_F_ORH conversion" RAT_FUNC "%3.0" "Unitless" COEFFS 0 1 0 0 0 1 /end COMPU_METHOD
/begin MEASUREMENT EOT_F_ORL "Engine Oil Temperature out of range low fail" UBYTE MC_EOT_F_ORL 0 0 0 0 ECU_ADDRESS 0x3F9F3A /end MEASUREMENT
/begin COMPU_METHOD MC_EOT_F_ORL "EOT_F_ORL conversion" RAT_FUNC "%3.0" "Unitless" COEFFS 0 1 0 0 0 1 /end COMPU_METHOD
/begin MEASUREMENT EOT_HELD "previous cycle engine oil temperature. (DEGREES C)" FLOAT32_IEEE MC_EOT_HELD 0 0 0 0 ECU_ADDRESS 0x3F9EF0 /end MEASUREMENT
/begin COMPU_METHOD MC_EOT_HELD "EOT_HELD conversion" RAT_FUNC "%10.5" "Unitless" COEFFS 0 1 0 0 0 1 /end COMPU_METHOD
/begin CHARACTERISTIC EOT_HI_VOLTS "Maximum acceptable voltage for EOT sensor" VALUE 0x5C578 SD_FLOAT32_IEEE 0 SC_EOT_HI_VOLTS 0 5 /end CHARACTERISTIC
/begin COMPU_METHOD SC_EOT_HI_VOLTS "EOT_HI_VOLTS conversion" RAT_FUNC "%10.5" "V" COEFFS 0 1 0 0 0 1 /end COMPU_METHOD
/begin MEASUREMENT EOT_HOT_CNT "threshold monitor hot counter" SLONG MC_EOT_HOT_CNT 0 0 0 0 ECU_ADDRESS 0x3F9F0C /end MEASUREMENT
/begin COMPU_METHOD MC_EOT_HOT_CNT "EOT_HOT_CNT conversion" RAT_FUNC "%10.0" "Unitless" COEFFS 0 1 0 0 0 1 /end COMPU_METHOD
/begin CHARACTERISTIC EOT_HOT_LMN "threshold monitr hot count limit" VALUE 0x5CF64 SD_FLOAT32_IEEE 0 SC_EOT_HOT_LMN -8192 8191 /end CHARACTERISTIC
/begin COMPU_METHOD SC_EOT_HOT_LMN "EOT_HOT_LMN conversion" RAT_FUNC "%10.5" "degC" COEFFS 0 1 0 0 0 1 /end COMPU_METHOD
/begin CHARACTERISTIC EOT_HOT_MFDES "hot, desired massfuel  threshold value" VALUE 0x5CF74 SD_FLOAT32_IEEE 0 SC_EOT_HOT_MFDES -2048 2047.94 /end CHARACTERISTIC
/begin COMPU_METHOD SC_EOT_HOT_MFDES "EOT_HOT_MFDES conversion" RAT_FUNC "%10.5" "g/s" COEFFS 0 1 0 0 0 1 /end COMPU_METHOD
/begin CHARACTERISTIC EOT_HOT_N "hot engine speed threshold value" VALUE 0x5CF78 SD_FLOAT32_IEEE 0 SC_EOT_HOT_N 0 16383.8 /end CHARACTERISTIC
/begin COMPU_METHOD SC_EOT_HOT_N "EOT_HOT_N conversion" RAT_FUNC "%10.5" "RPM" COEFFS 0 1 0 0 0 1 /end COMPU_METHOD
/begin MEASUREMENT EOT_INC "EO EOT/MAT fault increment register." UBYTE MC_EOT_INC 0 0 0 0 ECU_ADDRESS 0x3FA539 /end MEASUREMENT
/begin COMPU_METHOD MC_EOT_INC "EOT_INC conversion" RAT_FUNC "%3.0" "Unitless" COEFFS 0 1 0 0 0 1 /end COMPU_METHOD
/begin MEASUREMENT EOT_INDEX "" UBYTE MC_EOT_INDEX 0 0 0 0 ECU_ADDRESS 0x3FB5B2 /end MEASUREMENT
/begin COMPU_METHOD MC_EOT_INDEX "EOT_INDEX conversion" RAT_FUNC "%3.0" "Unitless" COEFFS 0 1 0 0 0 1 /end COMPU_METHOD
/begin CHARACTERISTIC EOT_KAM_PU_TM "Putmr timer limit calibration for eot filtering." VALUE 0x5CF58 SD_FLOAT32_IEEE 0 SC_EOT_KAM_PU_TM 0 63.999 /end CHARACTERISTIC
/begin COMPU_METHOD SC_EOT_KAM_PU_TM "EOT_KAM_PU_TM conversion" RAT_FUNC "%10.5" "s" COEFFS 0 1 0 0 0 1 /end COMPU_METHOD
/begin CHARACTERISTIC EOT_KICK_MAX "Maximum EOT allowed for cold idle kicker" VALUE 0x5D98C SD_FLOAT32_IEEE 0 SC_EOT_KICK_MAX -40 150 /end CHARACTERISTIC
/begin COMPU_METHOD SC_EOT_KICK_MAX "EOT_KICK_MAX conversion" RAT_FUNC "%10.5" "degC" COEFFS 0 1 0 0 0 1 /end COMPU_METHOD
/begin CHARACTERISTIC EOT_LONG_SOAK_TM "Stored elapsed time of the most recent EEC module key-off powered-down period limit for eot filter time constant switching." VALUE 0x5CF54 SD_FLOAT32_IEEE 0 SC_EOT_LONG_SOAK_TM 0 1680 /end CHARACTERISTIC
/begin COMPU_METHOD SC_EOT_LONG_SOAK_TM "EOT_LONG_SOAK_TM conversion" RAT_FUNC "%10.5" "MINUTES" COEFFS 0 1 0 0 0 1 /end COMPU_METHOD
/begin CHARACTERISTIC EOT_LO_VOLTS "Minimum acceptable voltage for EOT sensor" VALUE 0x5C574 SD_FLOAT32_IEEE 0 SC_EOT_LO_VOLTS 0 5 /end CHARACTERISTIC
/begin COMPU_METHOD SC_EOT_LO_VOLTS "EOT_LO_VOLTS conversion" RAT_FUNC "%10.5" "V" COEFFS 0 1 0 0 0 1 /end COMPU_METHOD
/begin MEASUREMENT EOT_MALF_SET "indicate eot malf high or low failure" UBYTE MC_EOT_MALF_SET 0 0 0 0 ECU_ADDRESS 0x3F9F37 /end MEASUREMENT
/begin COMPU_METHOD MC_EOT_MALF_SET "EOT_MALF_SET conversion" RAT_FUNC "%3.0" "Unitless" COEFFS 0 1 0 0 0 1 /end COMPU_METHOD
/begin MEASUREMENT EOT_MAT_FLT "EO EOT/MAT fault status flag." UBYTE MC_EOT_MAT_FLT 0 0 0 0 ECU_ADDRESS 0x3FA538 /end MEASUREMENT
/begin COMPU_METHOD MC_EOT_MAT_FLT "EOT_MAT_FLT conversion" RAT_FUNC "%3.0" "Unitless" COEFFS 0 1 0 0 0 1 /end COMPU_METHOD
/begin MEASUREMENT EOT_ORH_CNTR "Engine Oil Temp out of range high counter" SLONG MC_EOT_ORH_CNTR 0 0 0 0 ECU_ADDRESS 0x3F9F20 /end MEASUREMENT
/begin COMPU_METHOD MC_EOT_ORH_CNTR "EOT_ORH_CNTR conversion" RAT_FUNC "%10.0" "Unitless" COEFFS 0 1 0 0 0 1 /end COMPU_METHOD
/begin MEASUREMENT EOT_ORL_CNTR "Engine Oil Temp out of range low counter" SLONG MC_EOT_ORL_CNTR 0 0 0 0 ECU_ADDRESS 0x3F9F1C /end MEASUREMENT
/begin COMPU_METHOD MC_EOT_ORL_CNTR "EOT_ORL_CNTR conversion" RAT_FUNC "%10.0" "Unitless" COEFFS 0 1 0 0 0 1 /end COMPU_METHOD
/begin CHARACTERISTIC EOT_REC_INC "EOT recovery counter increment value" VALUE 0x5CF80 SD_SLONG 0 SC_EOT_REC_INC 0 65535 /end CHARACTERISTIC
/begin COMPU_METHOD SC_EOT_REC_INC "EOT_REC_INC conversion" RAT_FUNC "%10.0" "unitless" COEFFS 0 1 0 0 0 1 /end COMPU_METHOD
/begin MEASUREMENT EOT_STATUS "Status of Engine Oil Temperature sensor,  0 = no error" UBYTE MC_EOT_STATUS 0 0 0 0 ECU_ADDRESS 0x3F98DC /end MEASUREMENT
/begin COMPU_METHOD MC_EOT_STATUS "EOT_STATUS conversion" RAT_FUNC "%3.0" "Unitless" COEFFS 0 1 0 0 0 1 /end COMPU_METHOD
/begin CHARACTERISTIC EOT_TCREC_SEL "switch to select EOT filter constant" VALUE 0x5CF8C SD_UBYTE 0 SC_EOT_TCREC_SEL 0 1 /end CHARACTERISTIC
/begin COMPU_METHOD SC_EOT_TCREC_SEL "EOT_TCREC_SEL conversion" RAT_FUNC "%3.0" "unitless" COEFFS 0 1 0 0 0 1 /end COMPU_METHOD
/begin MEASUREMENT EOT_THLD_TMR "threshold monitor timer counter" FLOAT32_IEEE MC_EOT_THLD_TMR 0 0 0 0 ECU_ADDRESS 0x3F9F00 /end MEASUREMENT
/begin COMPU_METHOD MC_EOT_THLD_TMR "EOT_THLD_TMR conversion" RAT_FUNC "%10.5" "Unitless" COEFFS 0 1 0 0 0 1 /end COMPU_METHOD
/begin MEASUREMENT EOT_THLD_TST_TM "threshold monitor counter limit" FLOAT32_IEEE MC_EOT_THLD_TST_TM 0 0 0 0 ECU_ADDRESS 0x3F9EFC /end MEASUREMENT
/begin COMPU_METHOD MC_EOT_THLD_TST_TM "EOT_THLD_TST_TM conversion" RAT_FUNC "%10.5" "Unitless" COEFFS 0 1 0 0 0 1 /end COMPU_METHOD
/begin MEASUREMENT EOT_UPDOWN_CNTR "eot updown counter" SLONG MC_EOT_UPDOWN_CNTR 0 0 0 0 ECU_ADDRESS 0x3F9F04 /end MEASUREMENT
/begin COMPU_METHOD MC_EOT_UPDOWN_CNTR "EOT_UPDOWN_CNTR conversion" RAT_FUNC "%10.0" "Unitless" COEFFS 0 1 0 0 0 1 /end COMPU_METHOD
/begin MEASUREMENT EOT_VLTS "Engine Oil Temperature sensor voltage" FLOAT32_IEEE MC_EOT_VLTS 0 0 0 0 ECU_ADDRESS 0x3F98D4 /end MEASUREMENT
/begin COMPU_METHOD MC_EOT_VLTS "EOT_VLTS conversion" RAT_FUNC "%10.5" "Unitless" COEFFS 0 1 0 0 0 1 /end COMPU_METHOD
/begin MEASUREMENT EOT_WARM "EOT warm flag." UBYTE MC_EOT_WARM 0 0 0 0 ECU_ADDRESS 0x3FA53A /end MEASUREMENT
/begin COMPU_METHOD MC_EOT_WARM "EOT_WARM conversion" RAT_FUNC "%3.0" "Unitless" COEFFS 0 1 0 0 0 1 /end COMPU_METHOD
/begin CHARACTERISTIC EOT_WARM_DEF "Default FMEM value for warm engine oil temp" VALUE 0x5CFF0 SD_FLOAT32_IEEE 0 SC_EOT_WARM_DEF 60 150 /end CHARACTERISTIC
/begin COMPU_METHOD SC_EOT_WARM_DEF "EOT_WARM_DEF conversion" RAT_FUNC "%10.5" "degC" COEFFS 0 1 0 0 0 1 /end COMPU_METHOD
/begin CHARACTERISTIC EO_ABORT_TM "KOEO  abort test  dwell time" VALUE 0x5F258 SD_FLOAT32_IEEE 0 SC_EO_ABORT_TM 0 120 /end CHARACTERISTIC
/begin COMPU_METHOD SC_EO_ABORT_TM "EO_ABORT_TM conversion" RAT_FUNC "%10.5" "s" COEFFS 0 1 0 0 0 1 /end COMPU_METHOD
/begin CHARACTERISTIC EO_ACCROFF_TM "KOEO  ac clutch coil off  dwell time" VALUE 0x5F210 SD_FLOAT32_IEEE 0 SC_EO_ACCROFF_TM 0 120 /end CHARACTERISTIC
/begin COMPU_METHOD SC_EO_ACCROFF_TM "EO_ACCROFF_TM conversion" RAT_FUNC "%10.5" "s" COEFFS 0 1 0 0 0 1 /end COMPU_METHOD
/begin CHARACTERISTIC EO_ACCRON_TM "KOEO  ac clutch coil on  dwell time" VALUE 0x5F214 SD_FLOAT32_IEEE 0 SC_EO_ACCRON_TM 0 120 /end CHARACTERISTIC
/begin COMPU_METHOD SC_EO_ACCRON_TM "EO_ACCRON_TM conversion" RAT_FUNC "%10.5" "s" COEFFS 0 1 0 0 0 1 /end COMPU_METHOD
/begin MEASUREMENT EO_ACTIVE "Flag set when engine off on demand test is active" UBYTE MC_EO_ACTIVE 0 0 0 0 ECU_ADDRESS 0x3FB50F /end MEASUREMENT
/begin COMPU_METHOD MC_EO_ACTIVE "EO_ACTIVE conversion" RAT_FUNC "%3.0" "Unitless" COEFFS 0 1 0 0 0 1 /end COMPU_METHOD
/begin CHARACTERISTIC EO_ALLOFF_TM "KOEO  all outputs off dwell time" VALUE 0x5F260 SD_FLOAT32_IEEE 0 SC_EO_ALLOFF_TM 0 120 /end CHARACTERISTIC
/begin COMPU_METHOD SC_EO_ALLOFF_TM "EO_ALLOFF_TM conversion" RAT_FUNC "%10.5" "s" COEFFS 0 1 0 0 0 1 /end COMPU_METHOD
/begin CHARACTERISTIC EO_ALLON_TM "KOEO  all outputs on dwell time" VALUE 0x5F25C SD_FLOAT32_IEEE 0 SC_EO_ALLON_TM 0 120 /end CHARACTERISTIC
/begin COMPU_METHOD SC_EO_ALLON_TM "EO_ALLON_TM conversion" RAT_FUNC "%10.5" "s" COEFFS 0 1 0 0 0 1 /end COMPU_METHOD
/begin CHARACTERISTIC EO_BUZZABORT_TM "KOEO  FICM buzz test abort dwell time" VALUE 0x5F1A4 SD_FLOAT32_IEEE 0 SC_EO_BUZZABORT_TM 0 120 /end CHARACTERISTIC
/begin COMPU_METHOD SC_EO_BUZZABORT_TM "EO_BUZZABORT_TM conversion" RAT_FUNC "%10.5" "s" COEFFS 0 1 0 0 0 1 /end COMPU_METHOD
/begin CHARACTERISTIC EO_BUZZCLEAN_TM "KOEO  FICM buzz test cleanup dwell time" VALUE 0x5F1A8 SD_FLOAT32_IEEE 0 SC_EO_BUZZCLEAN_TM 0 120 /end CHARACTERISTIC
/begin COMPU_METHOD SC_EO_BUZZCLEAN_TM "EO_BUZZCLEAN_TM conversion" RAT_FUNC "%10.5" "s" COEFFS 0 1 0 0 0 1 /end COMPU_METHOD
/begin CHARACTERISTIC EO_BUZZCODES_TM "KOEO  FICM buzz test code retrieve dwell time" VALUE 0x5F1AC SD_FLOAT32_IEEE 0 SC_EO_BUZZCODES_TM 0 120 /end CHARACTERISTIC
/begin COMPU_METHOD SC_EO_BUZZCODES_TM "EO_BUZZCODES_TM conversion" RAT_FUNC "%10.5" "s" COEFFS 0 1 0 0 0 1 /end COMPU_METHOD
/begin CHARACTERISTIC EO_BUZZEND_TM "KOEO  FICM buzz test end dwell time" VALUE 0x5F1A0 SD_FLOAT32_IEEE 0 SC_EO_BUZZEND_TM 0 120 /end CHARACTERISTIC
/begin COMPU_METHOD SC_EO_BUZZEND_TM "EO_BUZZEND_TM conversion" RAT_FUNC "%10.5" "s" COEFFS 0 1 0 0 0 1 /end COMPU_METHOD
/begin CHARACTERISTIC EO_BUZZINIT_TM "KOEO  FICM buzz test init dwell time" VALUE 0x5F1B4 SD_FLOAT32_IEEE 0 SC_EO_BUZZINIT_TM 0 120 /end CHARACTERISTIC
/begin COMPU_METHOD SC_EO_BUZZINIT_TM "EO_BUZZINIT_TM conversion" RAT_FUNC "%10.5" "s" COEFFS 0 1 0 0 0 1 /end COMPU_METHOD
/begin CHARACTERISTIC EO_BUZZRUN_TM "KOEO  FICM buzz test run dwell time" VALUE 0x5F1B0 SD_FLOAT32_IEEE 0 SC_EO_BUZZRUN_TM 0 120 /end CHARACTERISTIC
/begin COMPU_METHOD SC_EO_BUZZRUN_TM "EO_BUZZRUN_TM conversion" RAT_FUNC "%10.5" "s" COEFFS 0 1 0 0 0 1 /end COMPU_METHOD
/begin MEASUREMENT EO_BUZZ_TST_RDY "Flag that signals OBD-II executive that the engine off buzz test is able to run" UBYTE MC_EO_BUZZ_TST_RDY 0 0 0 0 ECU_ADDRESS 0x3FB50C /end MEASUREMENT
/begin COMPU_METHOD MC_EO_BUZZ_TST_RDY "EO_BUZZ_TST_RDY conversion" RAT_FUNC "%3.0" "Unitless" COEFFS 0 1 0 0 0 1 /end COMPU_METHOD
/begin CHARACTERISTIC EO_CCM_DLY "Delay time for CCM and OSM off state during engine off on demand test" VALUE 0x5F0D0 SD_FLOAT32_IEEE 0 SC_EO_CCM_DLY 0 31 /end CHARACTERISTIC
/begin COMPU_METHOD SC_EO_CCM_DLY "EO_CCM_DLY conversion" RAT_FUNC "%10.5" "s" COEFFS 0 1 0 0 0 1 /end COMPU_METHOD
/begin MEASUREMENT EO_CONDTS "Conditions necessary to run KOEO test, 1 = conditions not met" UBYTE MC_EO_CONDTS 0 0 0 0 ECU_ADDRESS 0x3FB5CA /end MEASUREMENT
/begin COMPU_METHOD MC_EO_CONDTS "EO_CONDTS conversion" RAT_FUNC "%3.0" "Unitless" COEFFS 0 1 0 0 0 1 /end COMPU_METHOD
/begin CHARACTERISTIC EO_DOLOFF_TM "KOEO data output link off dwell time" VALUE 0x5F1F8 SD_FLOAT32_IEEE 0 SC_EO_DOLOFF_TM 0 120 /end CHARACTERISTIC
/begin COMPU_METHOD SC_EO_DOLOFF_TM "EO_DOLOFF_TM conversion" RAT_FUNC "%10.5" "s" COEFFS 0 1 0 0 0 1 /end COMPU_METHOD
/begin CHARACTERISTIC EO_DOLON_TM "KOEO data output link on dwell time" VALUE 0x5F1FC SD_FLOAT32_IEEE 0 SC_EO_DOLON_TM 0 120 /end CHARACTERISTIC
/begin COMPU_METHOD SC_EO_DOLON_TM "EO_DOLON_TM conversion" RAT_FUNC "%10.5" "s" COEFFS 0 1 0 0 0 1 /end COMPU_METHOD
/begin CHARACTERISTIC EO_DONE "Value of EO_STATUS when engine off on demand t est is complete" VALUE 0x5F0E1 SD_UBYTE 0 SC_EO_DONE 0 100 /end CHARACTERISTIC
/begin COMPU_METHOD SC_EO_DONE "EO_DONE conversion" RAT_FUNC "%3.0" "unitless" COEFFS 0 1 0 0 0 1 /end COMPU_METHOD
/begin CHARACTERISTIC EO_EGRCLOSE_TM "KOEO  egr valve close dwell time" VALUE 0x5F24C SD_FLOAT32_IEEE 0 SC_EO_EGRCLOSE_TM 0 120 /end CHARACTERISTIC
/begin COMPU_METHOD SC_EO_EGRCLOSE_TM "EO_EGRCLOSE_TM conversion" RAT_FUNC "%10.5" "s" COEFFS 0 1 0 0 0 1 /end COMPU_METHOD
/begin CHARACTERISTIC EO_EGRDTYALLOFF "" VALUE 0x5E560 SD_FLOAT32_IEEE 0 SC_EO_EGRDTYALLOFF 0 1 /end CHARACTERISTIC
/begin COMPU_METHOD SC_EO_EGRDTYALLOFF "EO_EGRDTYALLOFF conversion" RAT_FUNC "%10.5" "unitless" COEFFS 0 1 0 0 0 1 /end COMPU_METHOD
/begin CHARACTERISTIC EO_EGRDTYALLON "" VALUE 0x5E55C SD_FLOAT32_IEEE 0 SC_EO_EGRDTYALLON 0 1 /end CHARACTERISTIC
/begin COMPU_METHOD SC_EO_EGRDTYALLON "EO_EGRDTYALLON conversion" RAT_FUNC "%10.5" "unitless" COEFFS 0 1 0 0 0 1 /end COMPU_METHOD
/begin CHARACTERISTIC EO_EGRDTYOFF "" VALUE 0x5E558 SD_FLOAT32_IEEE 0 SC_EO_EGRDTYOFF 0 1 /end CHARACTERISTIC
/begin COMPU_METHOD SC_EO_EGRDTYOFF "EO_EGRDTYOFF conversion" RAT_FUNC "%10.5" "unitless" COEFFS 0 1 0 0 0 1 /end COMPU_METHOD
/begin CHARACTERISTIC EO_EGRDTYON "" VALUE 0x5E554 SD_FLOAT32_IEEE 0 SC_EO_EGRDTYON 0 1 /end CHARACTERISTIC
/begin COMPU_METHOD SC_EO_EGRDTYON "EO_EGRDTYON conversion" RAT_FUNC "%10.5" "unitless" COEFFS 0 1 0 0 0 1 /end COMPU_METHOD
/begin CHARACTERISTIC EO_EGROPEN_TM "KOEO  egr valve open dwell time" VALUE 0x5F248 SD_FLOAT32_IEEE 0 SC_EO_EGROPEN_TM 0 120 /end CHARACTERISTIC
/begin COMPU_METHOD SC_EO_EGROPEN_TM "EO_EGROPEN_TM conversion" RAT_FUNC "%10.5" "s" COEFFS 0 1 0 0 0 1 /end COMPU_METHOD
/begin CHARACTERISTIC EO_EGRVCOFF_TM "KOEO  egr valve off dwell time" VALUE 0x5F238 SD_FLOAT32_IEEE 0 SC_EO_EGRVCOFF_TM 0 120 /end CHARACTERISTIC
/begin COMPU_METHOD SC_EO_EGRVCOFF_TM "EO_EGRVCOFF_TM conversion" RAT_FUNC "%10.5" "s" COEFFS 0 1 0 0 0 1 /end COMPU_METHOD
/begin CHARACTERISTIC EO_EGRVCON_TM "KOEO  egr valve on dwell time" VALUE 0x5F23C SD_FLOAT32_IEEE 0 SC_EO_EGRVCON_TM 0 120 /end CHARACTERISTIC
/begin COMPU_METHOD SC_EO_EGRVCON_TM "EO_EGRVCON_TM conversion" RAT_FUNC "%10.5" "s" COEFFS 0 1 0 0 0 1 /end COMPU_METHOD
/begin CHARACTERISTIC EO_END_TM "KOEO on demand EO test ended dwell time" VALUE 0x5F264 SD_FLOAT32_IEEE 0 SC_EO_END_TM 0 120 /end CHARACTERISTIC
/begin COMPU_METHOD SC_EO_END_TM "EO_END_TM conversion" RAT_FUNC "%10.5" "s" COEFFS 0 1 0 0 0 1 /end COMPU_METHOD
/begin CHARACTERISTIC EO_EOTMAT_RAT_DIFF_TM "EO eot/mat rationale test timer limit calibration" VALUE 0x5D748 SD_FLOAT32_IEEE 0 SC_EO_EOTMAT_RAT_DIFF_TM 0 50000 /end CHARACTERISTIC
/begin COMPU_METHOD SC_EO_EOTMAT_RAT_DIFF_TM "EO_EOTMAT_RAT_DIFF_TM conversion" RAT_FUNC "%10.5" "unitless" COEFFS 0 1 0 0 0 1 /end COMPU_METHOD
/begin MEASUREMENT EO_EOTMAT_RAT_DIFF_TMR "EO eot/mat rationale test update timer" FLOAT32_IEEE MC_EO_EOTMAT_RAT_DIFF_TMR 0 0 0 0 ECU_ADDRESS 0x3FA52C /end MEASUREMENT
/begin COMPU_METHOD MC_EO_EOTMAT_RAT_DIFF_TMR "EO_EOTMAT_RAT_DIFF_TMR conversion" RAT_FUNC "%10.5" "Unitless" COEFFS 0 1 0 0 0 1 /end COMPU_METHOD
/begin CHARACTERISTIC EO_FCVOFF_TM "KOEO  fan clutch off  dwell time" VALUE 0x5F230 SD_FLOAT32_IEEE 0 SC_EO_FCVOFF_TM 0 120 /end CHARACTERISTIC
/begin COMPU_METHOD SC_EO_FCVOFF_TM "EO_FCVOFF_TM conversion" RAT_FUNC "%10.5" "s" COEFFS 0 1 0 0 0 1 /end COMPU_METHOD
/begin CHARACTERISTIC EO_FCVON_TM "KOEO  fan clutch on  dwell time" VALUE 0x5F234 SD_FLOAT32_IEEE 0 SC_EO_FCVON_TM 0 120 /end CHARACTERISTIC
/begin COMPU_METHOD SC_EO_FCVON_TM "EO_FCVON_TM conversion" RAT_FUNC "%10.5" "s" COEFFS 0 1 0 0 0 1 /end COMPU_METHOD
/begin CHARACTERISTIC EO_FPCOFF_TM "KOEO fuel pump relay off  dwell time" VALUE 0x5F1F0 SD_FLOAT32_IEEE 0 SC_EO_FPCOFF_TM 0 120 /end CHARACTERISTIC
/begin COMPU_METHOD SC_EO_FPCOFF_TM "EO_FPCOFF_TM conversion" RAT_FUNC "%10.5" "s" COEFFS 0 1 0 0 0 1 /end COMPU_METHOD
/begin CHARACTERISTIC EO_FPCON_TM "KOEO fuel pump relay on  dwell time" VALUE 0x5F1F4 SD_FLOAT32_IEEE 0 SC_EO_FPCON_TM 0 120 /end CHARACTERISTIC
/begin COMPU_METHOD SC_EO_FPCON_TM "EO_FPCON_TM conversion" RAT_FUNC "%10.5" "s" COEFFS 0 1 0 0 0 1 /end COMPU_METHOD
/begin CHARACTERISTIC EO_GEN1MOFF_TM "KOEO  primary generator/alternator I-line off  dwell time" VALUE 0x5F1C8 SD_FLOAT32_IEEE 0 SC_EO_GEN1MOFF_TM 0 120 /end CHARACTERISTIC
/begin COMPU_METHOD SC_EO_GEN1MOFF_TM "EO_GEN1MOFF_TM conversion" RAT_FUNC "%10.5" "s" COEFFS 0 1 0 0 0 1 /end COMPU_METHOD
/begin CHARACTERISTIC EO_GEN1MON_TM "KOEO  primary generator/alternator I-line on  dwell time" VALUE 0x5F1CC SD_FLOAT32_IEEE 0 SC_EO_GEN1MON_TM 0 120 /end CHARACTERISTIC
/begin COMPU_METHOD SC_EO_GEN1MON_TM "EO_GEN1MON_TM conversion" RAT_FUNC "%10.5" "s" COEFFS 0 1 0 0 0 1 /end COMPU_METHOD
/begin CHARACTERISTIC EO_GEN2ILOFF_TM "KOEO  primary&secondary generator(battery) indicator lamp off  dwell time" VALUE 0x5F1B8 SD_FLOAT32_IEEE 0 SC_EO_GEN2ILOFF_TM 0 120 /end CHARACTERISTIC
/begin COMPU_METHOD SC_EO_GEN2ILOFF_TM "EO_GEN2ILOFF_TM conversion" RAT_FUNC "%10.5" "s" COEFFS 0 1 0 0 0 1 /end COMPU_METHOD
/begin CHARACTERISTIC EO_GEN2ILON_TM "KOEO  primary&secondary generator(battery) indicator lamp on  dwell time" VALUE 0x5F1BC SD_FLOAT32_IEEE 0 SC_EO_GEN2ILON_TM 0 120 /end CHARACTERISTIC
/begin COMPU_METHOD SC_EO_GEN2ILON_TM "EO_GEN2ILON_TM conversion" RAT_FUNC "%10.5" "s" COEFFS 0 1 0 0 0 1 /end COMPU_METHOD
/begin CHARACTERISTIC EO_GEN2MOFF_TM "KOEO  secondary generator/alternator I-line off  dwell time" VALUE 0x5F1C0 SD_FLOAT32_IEEE 0 SC_EO_GEN2MOFF_TM 0 120 /end CHARACTERISTIC
/begin COMPU_METHOD SC_EO_GEN2MOFF_TM "EO_GEN2MOFF_TM conversion" RAT_FUNC "%10.5" "s" COEFFS 0 1 0 0 0 1 /end COMPU_METHOD
/begin CHARACTERISTIC EO_GEN2MON_TM "KOEO  secondary generator/alternator I-line on  dwell time" VALUE 0x5F1C4 SD_FLOAT32_IEEE 0 SC_EO_GEN2MON_TM 0 120 /end CHARACTERISTIC
/begin COMPU_METHOD SC_EO_GEN2MON_TM "EO_GEN2MON_TM conversion" RAT_FUNC "%10.5" "s" COEFFS 0 1 0 0 0 1 /end COMPU_METHOD
/begin CHARACTERISTIC EO_GPEOFF_TM "KOEO  glow plug enable off dwell time" VALUE 0x5F218 SD_FLOAT32_IEEE 0 SC_EO_GPEOFF_TM 0 120 /end CHARACTERISTIC
/begin COMPU_METHOD SC_EO_GPEOFF_TM "EO_GPEOFF_TM conversion" RAT_FUNC "%10.5" "s" COEFFS 0 1 0 0 0 1 /end COMPU_METHOD
/begin CHARACTERISTIC EO_GPEON_TM "KOEO  glow plug enable on dwell time" VALUE 0x5F21C SD_FLOAT32_IEEE 0 SC_EO_GPEON_TM 0 120 /end CHARACTERISTIC
/begin COMPU_METHOD SC_EO_GPEON_TM "EO_GPEON_TM conversion" RAT_FUNC "%10.5" "s" COEFFS 0 1 0 0 0 1 /end COMPU_METHOD
/begin CHARACTERISTIC EO_GPILOFF_TM "KOEO glow plug indicator lamp off  dwell time" VALUE 0x5F1D0 SD_FLOAT32_IEEE 0 SC_EO_GPILOFF_TM 0 120 /end CHARACTERISTIC
/begin COMPU_METHOD SC_EO_GPILOFF_TM "EO_GPILOFF_TM conversion" RAT_FUNC "%10.5" "s" COEFFS 0 1 0 0 0 1 /end COMPU_METHOD
/begin CHARACTERISTIC EO_GPILON_TM "KOEO glow plug indicator lamp on  dwell time" VALUE 0x5F1D4 SD_FLOAT32_IEEE 0 SC_EO_GPILON_TM 0 120 /end CHARACTERISTIC
/begin COMPU_METHOD SC_EO_GPILON_TM "EO_GPILON_TM conversion" RAT_FUNC "%10.5" "s" COEFFS 0 1 0 0 0 1 /end COMPU_METHOD
/begin CHARACTERISTIC EO_IATMAT_PU_TM "EO iat/mat rationale test putmr limit calibration" VALUE 0x5D764 SD_FLOAT32_IEEE 0 SC_EO_IATMAT_PU_TM 0 63.999 /end CHARACTERISTIC
/begin COMPU_METHOD SC_EO_IATMAT_PU_TM "EO_IATMAT_PU_TM conversion" RAT_FUNC "%10.5" "s" COEFFS 0 1 0 0 0 1 /end COMPU_METHOD
/begin CHARACTERISTIC EO_IATMAT_RAT_DIFF_MAX "EO iat/mat difference limit calibration" VALUE 0x5D75C SD_FLOAT32_IEEE 0 SC_EO_IATMAT_RAT_DIFF_MAX -4096 4095.88 /end CHARACTERISTIC
/begin COMPU_METHOD SC_EO_IATMAT_RAT_DIFF_MAX "EO_IATMAT_RAT_DIFF_MAX conversion" RAT_FUNC "%10.5" "degC" COEFFS 0 1 0 0 0 1 /end COMPU_METHOD
/begin CHARACTERISTIC EO_IATMAT_RAT_DIFF_TM "EO iat/mat rationale test timer limit calibration" VALUE 0x5D768 SD_FLOAT32_IEEE 0 SC_EO_IATMAT_RAT_DIFF_TM 0 50000 /end CHARACTERISTIC
/begin COMPU_METHOD SC_EO_IATMAT_RAT_DIFF_TM "EO_IATMAT_RAT_DIFF_TM conversion" RAT_FUNC "%10.5" "unitless" COEFFS 0 1 0 0 0 1 /end COMPU_METHOD
/begin CHARACTERISTIC EO_IATMAT_RAT_TIM "EO iat/mat engine off timer limit calibration" VALUE 0x5D760 SD_FLOAT32_IEEE 0 SC_EO_IATMAT_RAT_TIM 0 1680 /end CHARACTERISTIC
/begin COMPU_METHOD SC_EO_IATMAT_RAT_TIM "EO_IATMAT_RAT_TIM conversion" RAT_FUNC "%10.5" "min" COEFFS 0 1 0 0 0 1 /end COMPU_METHOD
/begin CHARACTERISTIC EO_ICPDTYALLOFF "KOEO duty setup" VALUE 0x5E044 SD_FLOAT32_IEEE 0 SC_EO_ICPDTYALLOFF 0 1 /end CHARACTERISTIC
/begin COMPU_METHOD SC_EO_ICPDTYALLOFF "EO_ICPDTYALLOFF conversion" RAT_FUNC "%10.5" "unitless" COEFFS 0 1 0 0 0 1 /end COMPU_METHOD
/begin CHARACTERISTIC EO_ICPDTYALLON "KOEO duty setup" VALUE 0x5E040 SD_FLOAT32_IEEE 0 SC_EO_ICPDTYALLON 0 1 /end CHARACTERISTIC
/begin COMPU_METHOD SC_EO_ICPDTYALLON "EO_ICPDTYALLON conversion" RAT_FUNC "%10.5" "unitless" COEFFS 0 1 0 0 0 1 /end COMPU_METHOD
/begin CHARACTERISTIC EO_ICPDTY_OFF "KOEO duty setup" VALUE 0x5E04C SD_FLOAT32_IEEE 0 SC_EO_ICPDTY_OFF 0 1 /end CHARACTERISTIC
/begin COMPU_METHOD SC_EO_ICPDTY_OFF "EO_ICPDTY_OFF conversion" RAT_FUNC "%10.5" "unitless" COEFFS 0 1 0 0 0 1 /end COMPU_METHOD
/begin CHARACTERISTIC EO_ICPDTY_ON "KOEO duty setup" VALUE 0x5E048 SD_FLOAT32_IEEE 0 SC_EO_ICPDTY_ON 0 1 /end CHARACTERISTIC
/begin COMPU_METHOD SC_EO_ICPDTY_ON "EO_ICPDTY_ON conversion" RAT_FUNC "%10.5" "unitless" COEFFS 0 1 0 0 0 1 /end COMPU_METHOD
/begin CHARACTERISTIC EO_INACTIVE "Value of ER_STATUS when engine off pn demand test is complete" VALUE 0x5F0E6 SD_UBYTE 0 SC_EO_INACTIVE 0 100 /end CHARACTERISTIC
/begin COMPU_METHOD SC_EO_INACTIVE "EO_INACTIVE conversion" RAT_FUNC "%3.0" "unitless" COEFFS 0 1 0 0 0 1 /end COMPU_METHOD
/begin CHARACTERISTIC EO_INIT_TM "KOEO on demand EO init dwell time" VALUE 0x5F268 SD_FLOAT32_IEEE 0 SC_EO_INIT_TM 0 120 /end CHARACTERISTIC
/begin COMPU_METHOD SC_EO_INIT_TM "EO_INIT_TM conversion" RAT_FUNC "%10.5" "s" COEFFS 0 1 0 0 0 1 /end COMPU_METHOD
/begin CHARACTERISTIC EO_IPROFF_TM "KOEO injector pressure regulator off  dwell time" VALUE 0x5F1E0 SD_FLOAT32_IEEE 0 SC_EO_IPROFF_TM 0 120 /end CHARACTERISTIC
/begin COMPU_METHOD SC_EO_IPROFF_TM "EO_IPROFF_TM conversion" RAT_FUNC "%10.5" "s" COEFFS 0 1 0 0 0 1 /end COMPU_METHOD
/begin CHARACTERISTIC EO_IPRON_TM "KOEO injector pressure regulator on  dwell time" VALUE 0x5F1E4 SD_FLOAT32_IEEE 0 SC_EO_IPRON_TM 0 120 /end CHARACTERISTIC
/begin COMPU_METHOD SC_EO_IPRON_TM "EO_IPRON_TM conversion" RAT_FUNC "%10.5" "s" COEFFS 0 1 0 0 0 1 /end COMPU_METHOD
/begin CHARACTERISTIC EO_ITHCLOSE_TM "KOEO  intake throttle close dwell time" VALUE 0x5F254 SD_FLOAT32_IEEE 0 SC_EO_ITHCLOSE_TM 0 120 /end CHARACTERISTIC
/begin COMPU_METHOD SC_EO_ITHCLOSE_TM "EO_ITHCLOSE_TM conversion" RAT_FUNC "%10.5" "s" COEFFS 0 1 0 0 0 1 /end COMPU_METHOD
/begin CHARACTERISTIC EO_ITHDTYALLOFF "" VALUE 0x5E4A0 SD_FLOAT32_IEEE 0 SC_EO_ITHDTYALLOFF -1 1 /end CHARACTERISTIC
/begin COMPU_METHOD SC_EO_ITHDTYALLOFF "EO_ITHDTYALLOFF conversion" RAT_FUNC "%10.5" "unitless" COEFFS 0 1 0 0 0 1 /end COMPU_METHOD
/begin CHARACTERISTIC EO_ITHDTYALLON "" VALUE 0x5E49C SD_FLOAT32_IEEE 0 SC_EO_ITHDTYALLON -1 1 /end CHARACTERISTIC
/begin COMPU_METHOD SC_EO_ITHDTYALLON "EO_ITHDTYALLON conversion" RAT_FUNC "%10.5" "unitless" COEFFS 0 1 0 0 0 1 /end COMPU_METHOD
/begin CHARACTERISTIC EO_ITHDTYOFF "" VALUE 0x5E498 SD_FLOAT32_IEEE 0 SC_EO_ITHDTYOFF -1 1 /end CHARACTERISTIC
/begin COMPU_METHOD SC_EO_ITHDTYOFF "EO_ITHDTYOFF conversion" RAT_FUNC "%10.5" "unitless" COEFFS 0 1 0 0 0 1 /end COMPU_METHOD
/begin CHARACTERISTIC EO_ITHDTYON "" VALUE 0x5E494 SD_FLOAT32_IEEE 0 SC_EO_ITHDTYON -1 1 /end CHARACTERISTIC
/begin COMPU_METHOD SC_EO_ITHDTYON "EO_ITHDTYON conversion" RAT_FUNC "%10.5" "unitless" COEFFS 0 1 0 0 0 1 /end COMPU_METHOD
/begin CHARACTERISTIC EO_ITHOPEN_TM "KOEO  intake throttle open dwell time" VALUE 0x5F250 SD_FLOAT32_IEEE 0 SC_EO_ITHOPEN_TM 0 120 /end CHARACTERISTIC
/begin COMPU_METHOD SC_EO_ITHOPEN_TM "EO_ITHOPEN_TM conversion" RAT_FUNC "%10.5" "s" COEFFS 0 1 0 0 0 1 /end COMPU_METHOD
/begin CHARACTERISTIC EO_MILOFF_TM "KOEO mil lamp off  dwell time" VALUE 0x5F220 SD_FLOAT32_IEEE 0 SC_EO_MILOFF_TM 0 120 /end CHARACTERISTIC
/begin COMPU_METHOD SC_EO_MILOFF_TM "EO_MILOFF_TM conversion" RAT_FUNC "%10.5" "s" COEFFS 0 1 0 0 0 1 /end COMPU_METHOD
/begin CHARACTERISTIC EO_MILON_TM "KOEO mil lamp on  dwell time" VALUE 0x5F224 SD_FLOAT32_IEEE 0 SC_EO_MILON_TM 0 120 /end CHARACTERISTIC
/begin COMPU_METHOD SC_EO_MILON_TM "EO_MILON_TM conversion" RAT_FUNC "%10.5" "s" COEFFS 0 1 0 0 0 1 /end COMPU_METHOD
/begin MEASUREMENT EO_MODE "" UBYTE MC_EO_MODE 0 0 0 0 ECU_ADDRESS 0x3FB510 /end MEASUREMENT
/begin COMPU_METHOD MC_EO_MODE "EO_MODE conversion" RAT_FUNC "%3.0" "Unitless" COEFFS 0 1 0 0 0 1 /end COMPU_METHOD
/begin MEASUREMENT EO_MON "Flag indicating the engine off on-demand test is complete." UBYTE MC_EO_MON 0 0 0 0 ECU_ADDRESS 0x3FB50E /end MEASUREMENT
/begin COMPU_METHOD MC_EO_MON "EO_MON conversion" RAT_FUNC "%3.0" "Unitless" COEFFS 0 1 0 0 0 1 /end COMPU_METHOD
/begin CHARACTERISTIC EO_OSM_DLY "Delay time for OSM on state during engine off on demand test" VALUE 0x5F0CC SD_FLOAT32_IEEE 0 SC_EO_OSM_DLY 0 31 /end CHARACTERISTIC
/begin COMPU_METHOD SC_EO_OSM_DLY "EO_OSM_DLY conversion" RAT_FUNC "%10.5" "s" COEFFS 0 1 0 0 0 1 /end COMPU_METHOD
/begin CHARACTERISTIC EO_SCILOFF_TM "KOEO speed control indicator lamp off  dwell time" VALUE 0x5F1E8 SD_FLOAT32_IEEE 0 SC_EO_SCILOFF_TM 0 120 /end CHARACTERISTIC
/begin COMPU_METHOD SC_EO_SCILOFF_TM "EO_SCILOFF_TM conversion" RAT_FUNC "%10.5" "s" COEFFS 0 1 0 0 0 1 /end COMPU_METHOD
/begin CHARACTERISTIC EO_SCILON_TM "KOEO speed control indicator lamp on  dwell time" VALUE 0x5F1EC SD_FLOAT32_IEEE 0 SC_EO_SCILON_TM 0 120 /end CHARACTERISTIC
/begin COMPU_METHOD SC_EO_SCILON_TM "EO_SCILON_TM conversion" RAT_FUNC "%10.5" "s" COEFFS 0 1 0 0 0 1 /end COMPU_METHOD
/begin MEASUREMENT EO_STATUS "State pointer that indicates current state of engine off on demand test sequence" UBYTE MC_EO_STATUS 0 0 0 0 ECU_ADDRESS 0x3FB511 /end MEASUREMENT
/begin COMPU_METHOD MC_EO_STATUS "EO_STATUS conversion" RAT_FUNC "%3.0" "Unitless" COEFFS 0 1 0 0 0 1 /end COMPU_METHOD
/begin CHARACTERISTIC EO_TPODTYALLOFF "KOEO duty setup" VALUE 0x5D520 SD_FLOAT32_IEEE 0 SC_EO_TPODTYALLOFF 0 1 /end CHARACTERISTIC
/begin COMPU_METHOD SC_EO_TPODTYALLOFF "EO_TPODTYALLOFF conversion" RAT_FUNC "%10.5" "unitless" COEFFS 0 1 0 0 0 1 /end COMPU_METHOD
/begin CHARACTERISTIC EO_TPODTYALLON "KOEO duty setup" VALUE 0x5D51C SD_FLOAT32_IEEE 0 SC_EO_TPODTYALLON 0 1 /end CHARACTERISTIC
/begin COMPU_METHOD SC_EO_TPODTYALLON "EO_TPODTYALLON conversion" RAT_FUNC "%10.5" "unitless" COEFFS 0 1 0 0 0 1 /end COMPU_METHOD
/begin CHARACTERISTIC EO_TPODTY_OFF "KOEO duty setup" VALUE 0x5D518 SD_FLOAT32_IEEE 0 SC_EO_TPODTY_OFF 0 1 /end CHARACTERISTIC
/begin COMPU_METHOD SC_EO_TPODTY_OFF "EO_TPODTY_OFF conversion" RAT_FUNC "%10.5" "unitless" COEFFS 0 1 0 0 0 1 /end COMPU_METHOD
/begin CHARACTERISTIC EO_TPODTY_ON "KOEO duty setup" VALUE 0x5D514 SD_FLOAT32_IEEE 0 SC_EO_TPODTY_ON 0 1 /end CHARACTERISTIC
/begin COMPU_METHOD SC_EO_TPODTY_ON "EO_TPODTY_ON conversion" RAT_FUNC "%10.5" "unitless" COEFFS 0 1 0 0 0 1 /end COMPU_METHOD
/begin CHARACTERISTIC EO_TPO_OFF_TM "KOEO  trans pedal out off  dwell time" VALUE 0x5F208 SD_FLOAT32_IEEE 0 SC_EO_TPO_OFF_TM 0 120 /end CHARACTERISTIC
/begin COMPU_METHOD SC_EO_TPO_OFF_TM "EO_TPO_OFF_TM conversion" RAT_FUNC "%10.5" "s" COEFFS 0 1 0 0 0 1 /end COMPU_METHOD
/begin CHARACTERISTIC EO_TPO_ON_TM "KOEO  trans pedal out on  dwell time" VALUE 0x5F20C SD_FLOAT32_IEEE 0 SC_EO_TPO_ON_TM 0 120 /end CHARACTERISTIC
/begin COMPU_METHOD SC_EO_TPO_ON_TM "EO_TPO_ON_TM conversion" RAT_FUNC "%10.5" "s" COEFFS 0 1 0 0 0 1 /end COMPU_METHOD
/begin MEASUREMENT EO_TST_ENA "Flag to activate engine off on demand test" UBYTE MC_EO_TST_ENA 0 0 0 0 ECU_ADDRESS 0x3F9E47 /end MEASUREMENT
/begin COMPU_METHOD MC_EO_TST_ENA "EO_TST_ENA conversion" RAT_FUNC "%3.0" "Unitless" COEFFS 0 1 0 0 0 1 /end COMPU_METHOD
/begin MEASUREMENT EO_TST_RDY "Flag that signals OBD-II executive that the engine off test is able to run" UBYTE MC_EO_TST_RDY 0 0 0 0 ECU_ADDRESS 0x3FB50D /end MEASUREMENT
/begin COMPU_METHOD MC_EO_TST_RDY "EO_TST_RDY conversion" RAT_FUNC "%3.0" "Unitless" COEFFS 0 1 0 0 0 1 /end COMPU_METHOD
/begin CHARACTERISTIC EO_VGTDTYALLOFF "KOEO VGT duty" VALUE 0x5E9C8 SD_FLOAT32_IEEE 0 SC_EO_VGTDTYALLOFF 0 1 /end CHARACTERISTIC
/begin COMPU_METHOD SC_EO_VGTDTYALLOFF "EO_VGTDTYALLOFF conversion" RAT_FUNC "%10.5" "unitless" COEFFS 0 1 0 0 0 1 /end COMPU_METHOD
/begin CHARACTERISTIC EO_VGTDTYALLON "KOEO VGT duty" VALUE 0x5E9C4 SD_FLOAT32_IEEE 0 SC_EO_VGTDTYALLON 0 1 /end CHARACTERISTIC
/begin COMPU_METHOD SC_EO_VGTDTYALLON "EO_VGTDTYALLON conversion" RAT_FUNC "%10.5" "unitless" COEFFS 0 1 0 0 0 1 /end COMPU_METHOD
/begin CHARACTERISTIC EO_VGTDTY_OFF "KOEO VGT duty" VALUE 0x5E9D0 SD_FLOAT32_IEEE 0 SC_EO_VGTDTY_OFF 0 1 /end CHARACTERISTIC
/begin COMPU_METHOD SC_EO_VGTDTY_OFF "EO_VGTDTY_OFF conversion" RAT_FUNC "%10.5" "unitless" COEFFS 0 1 0 0 0 1 /end COMPU_METHOD
/begin CHARACTERISTIC EO_VGTDTY_ON "KOEO VGT duty" VALUE 0x5E9CC SD_FLOAT32_IEEE 0 SC_EO_VGTDTY_ON 0 1 /end CHARACTERISTIC
/begin COMPU_METHOD SC_EO_VGTDTY_ON "EO_VGTDTY_ON conversion" RAT_FUNC "%10.5" "unitless" COEFFS 0 1 0 0 0 1 /end COMPU_METHOD
/begin CHARACTERISTIC EO_VGTHOFF_TM "" VALUE 0x5F228 SD_FLOAT32_IEEE 0 SC_EO_VGTHOFF_TM 0 50 /end CHARACTERISTIC
/begin COMPU_METHOD SC_EO_VGTHOFF_TM "EO_VGTHOFF_TM conversion" RAT_FUNC "%10.5" "s" COEFFS 0 1 0 0 0 1 /end COMPU_METHOD
/begin CHARACTERISTIC EO_VGTHON_TM "" VALUE 0x5F22C SD_FLOAT32_IEEE 0 SC_EO_VGTHON_TM 0 50 /end CHARACTERISTIC
/begin COMPU_METHOD SC_EO_VGTHON_TM "EO_VGTHON_TM conversion" RAT_FUNC "%10.5" "s" COEFFS 0 1 0 0 0 1 /end COMPU_METHOD
/begin CHARACTERISTIC EO_VGTOFF_TM "KOEO  variable geometry turbo off dwell time" VALUE 0x5F240 SD_FLOAT32_IEEE 0 SC_EO_VGTOFF_TM 0 120 /end CHARACTERISTIC
/begin COMPU_METHOD SC_EO_VGTOFF_TM "EO_VGTOFF_TM conversion" RAT_FUNC "%10.5" "s" COEFFS 0 1 0 0 0 1 /end COMPU_METHOD
/begin CHARACTERISTIC EO_VGTON_TM "KOEO  variable geometry turbo on dwell time" VALUE 0x5F244 SD_FLOAT32_IEEE 0 SC_EO_VGTON_TM 0 120 /end CHARACTERISTIC
/begin COMPU_METHOD SC_EO_VGTON_TM "EO_VGTON_TM conversion" RAT_FUNC "%10.5" "s" COEFFS 0 1 0 0 0 1 /end COMPU_METHOD
/begin CHARACTERISTIC EO_VSO_OFF_TM "KOEO vehicle speed out off dwell time" VALUE 0x5F200 SD_FLOAT32_IEEE 0 SC_EO_VSO_OFF_TM 0 120 /end CHARACTERISTIC
/begin COMPU_METHOD SC_EO_VSO_OFF_TM "EO_VSO_OFF_TM conversion" RAT_FUNC "%10.5" "s" COEFFS 0 1 0 0 0 1 /end COMPU_METHOD
/begin CHARACTERISTIC EO_VSO_ON_TM "KOEO vehicle speed out on dwell time" VALUE 0x5F204 SD_FLOAT32_IEEE 0 SC_EO_VSO_ON_TM 0 120 /end CHARACTERISTIC
/begin COMPU_METHOD SC_EO_VSO_ON_TM "EO_VSO_ON_TM conversion" RAT_FUNC "%10.5" "s" COEFFS 0 1 0 0 0 1 /end COMPU_METHOD
/begin CHARACTERISTIC EO_WIFOFF_TM "KOEO water in fuel lamp off  dwell time" VALUE 0x5F1D8 SD_FLOAT32_IEEE 0 SC_EO_WIFOFF_TM 0 120 /end CHARACTERISTIC
/begin COMPU_METHOD SC_EO_WIFOFF_TM "EO_WIFOFF_TM conversion" RAT_FUNC "%10.5" "s" COEFFS 0 1 0 0 0 1 /end COMPU_METHOD
/begin CHARACTERISTIC EO_WIFON_TM "KOEO water in fuel lamp on  dwell time" VALUE 0x5F1DC SD_FLOAT32_IEEE 0 SC_EO_WIFON_TM 0 120 /end CHARACTERISTIC
/begin COMPU_METHOD SC_EO_WIFON_TM "EO_WIFON_TM conversion" RAT_FUNC "%10.5" "s" COEFFS 0 1 0 0 0 1 /end COMPU_METHOD
/begin MEASUREMENT EPOS_STATUS "Status of Cylinder Position high level driver ( 0 = ok )" UBYTE MC_EPOS_STATUS 0 0 0 0 ECU_ADDRESS 0x3F9891 /end MEASUREMENT
/begin COMPU_METHOD MC_EPOS_STATUS "EPOS_STATUS conversion" RAT_FUNC "%3.0" "Unitless" COEFFS 0 1 0 0 0 1 /end COMPU_METHOD
/begin MEASUREMENT ERROR_CODE "" ULONG MC_ERROR_CODE 0 0 0 0 ECU_ADDRESS 0x3FB524 /end MEASUREMENT
/begin COMPU_METHOD MC_ERROR_CODE "ERROR_CODE conversion" RAT_FUNC "%10.0" "Unitless" COEFFS 0 1 0 0 0 1 /end COMPU_METHOD
/begin CHARACTERISTIC ERSTD_EBPG_VGTHI "KOER EBPG thresh hold" VALUE 0x5D0B8 SD_FLOAT32_IEEE 0 SC_ERSTD_EBPG_VGTHI 0 100000 /end CHARACTERISTIC
/begin COMPU_METHOD SC_ERSTD_EBPG_VGTHI "ERSTD_EBPG_VGTHI conversion" RAT_FUNC "%10.5" "kPa" COEFFS 0 1 0 0 0 1 /end COMPU_METHOD
/begin CHARACTERISTIC ERSTD_EBPG_VGTLO "KOER EBPG thresh hold" VALUE 0x5D0B4 SD_FLOAT32_IEEE 0 SC_ERSTD_EBPG_VGTLO 0 100000 /end CHARACTERISTIC
/begin COMPU_METHOD SC_ERSTD_EBPG_VGTLO "ERSTD_EBPG_VGTLO conversion" RAT_FUNC "%10.5" "kPa" COEFFS 0 1 0 0 0 1 /end COMPU_METHOD
/begin CHARACTERISTIC ERSTD_EBPG_VGTMID "KOER EBPG thresh hold" VALUE 0x5D0B0 SD_FLOAT32_IEEE 0 SC_ERSTD_EBPG_VGTMID 0 100000 /end CHARACTERISTIC
/begin COMPU_METHOD SC_ERSTD_EBPG_VGTMID "ERSTD_EBPG_VGTMID conversion" RAT_FUNC "%10.5" "kPa" COEFFS 0 1 0 0 0 1 /end COMPU_METHOD
/begin CHARACTERISTIC ERSTD_VGTHI "KOER EBPG thresh hold" VALUE 0x5F104 SD_FLOAT32_IEEE 0 SC_ERSTD_VGTHI 0 100000 /end CHARACTERISTIC
/begin COMPU_METHOD SC_ERSTD_VGTHI "ERSTD_VGTHI conversion" RAT_FUNC "%10.5" "kPa" COEFFS 0 1 0 0 0 1 /end COMPU_METHOD
/begin CHARACTERISTIC ERSTD_VGTLO "KOER EBPG thresh hold" VALUE 0x5F100 SD_FLOAT32_IEEE 0 SC_ERSTD_VGTLO 0 100000 /end CHARACTERISTIC
/begin COMPU_METHOD SC_ERSTD_VGTLO "ERSTD_VGTLO conversion" RAT_FUNC "%10.5" "kPa" COEFFS 0 1 0 0 0 1 /end COMPU_METHOD
/begin CHARACTERISTIC ERSTD_VGTMID "KOER mode EBPG limit for fault detection" VALUE 0x5F0FC SD_FLOAT32_IEEE 0 SC_ERSTD_VGTMID 0 1e+06 /end CHARACTERISTIC
/begin COMPU_METHOD SC_ERSTD_VGTMID "ERSTD_VGTMID conversion" RAT_FUNC "%10.5" "kPa" COEFFS 0 1 0 0 0 1 /end COMPU_METHOD
/begin MEASUREMENT ER_ACTIVE "flag set when engine running on demand test is active" UBYTE MC_ER_ACTIVE 0 0 0 0 ECU_ADDRESS 0x3FB504 /end MEASUREMENT
/begin COMPU_METHOD MC_ER_ACTIVE "ER_ACTIVE conversion" RAT_FUNC "%3.0" "Unitless" COEFFS 0 1 0 0 0 1 /end COMPU_METHOD
/begin CHARACTERISTIC ER_CCT_TM_0 "" VALUE 0x5F174 SD_FLOAT32_IEEE 0 SC_ER_CCT_TM_0 0 200000 /end CHARACTERISTIC
/begin COMPU_METHOD SC_ER_CCT_TM_0 "ER_CCT_TM_0 conversion" RAT_FUNC "%10.5" "unitless" COEFFS 0 1 0 0 0 1 /end COMPU_METHOD
/begin CHARACTERISTIC ER_CCT_TM_1 "" VALUE 0x5F170 SD_FLOAT32_IEEE 0 SC_ER_CCT_TM_1 0 200000 /end CHARACTERISTIC
/begin COMPU_METHOD SC_ER_CCT_TM_1 "ER_CCT_TM_1 conversion" RAT_FUNC "%10.5" "unitless" COEFFS 0 1 0 0 0 1 /end COMPU_METHOD
/begin CHARACTERISTIC ER_CCT_TM_2 "" VALUE 0x5F16C SD_FLOAT32_IEEE 0 SC_ER_CCT_TM_2 0 200000 /end CHARACTERISTIC
/begin COMPU_METHOD SC_ER_CCT_TM_2 "ER_CCT_TM_2 conversion" RAT_FUNC "%10.5" "unitless" COEFFS 0 1 0 0 0 1 /end COMPU_METHOD
/begin CHARACTERISTIC ER_CLEANUP "Value of ER_STATUS when ""cleanup"" portion of engine running test is in progress" VALUE 0x5F0BB SD_UBYTE 0 SC_ER_CLEANUP 0 100 /end CHARACTERISTIC
/begin COMPU_METHOD SC_ER_CLEANUP "ER_CLEANUP conversion" RAT_FUNC "%3.0" "unitless" COEFFS 0 1 0 0 0 1 /end COMPU_METHOD
/begin MEASUREMENT ER_CONDTS "Conditions necessary to run KOER test, 1 = conditions not met" UBYTE MC_ER_CONDTS 0 0 0 0 ECU_ADDRESS 0x3FB503 /end MEASUREMENT
/begin COMPU_METHOD MC_ER_CONDTS "ER_CONDTS conversion" RAT_FUNC "%3.0" "Unitless" COEFFS 0 1 0 0 0 1 /end COMPU_METHOD
/begin CHARACTERISTIC ER_DITDES_EGR "Desired engine timing degrees (Crank Deg/BTDC), KOER mode" VALUE 0x5DDF8 SD_FLOAT32_IEEE 0 SC_ER_DITDES_EGR -512 511.9 /end CHARACTERISTIC
/begin COMPU_METHOD SC_ER_DITDES_EGR "ER_DITDES_EGR conversion" RAT_FUNC "%10.5" "deg" COEFFS 0 1 0 0 0 1 /end COMPU_METHOD
/begin CHARACTERISTIC ER_DITDES_ICP "Desired engine timing degrees (Crank Deg/BTDC), KOER mode" VALUE 0x5DDF4 SD_FLOAT32_IEEE 0 SC_ER_DITDES_ICP -512 511.9 /end CHARACTERISTIC
/begin COMPU_METHOD SC_ER_DITDES_ICP "ER_DITDES_ICP conversion" RAT_FUNC "%10.5" "deg" COEFFS 0 1 0 0 0 1 /end COMPU_METHOD
/begin CHARACTERISTIC ER_DITDES_VGT "Desired engine timing degrees (Crank Deg/BTDC), KOER mode" VALUE 0x5DDF0 SD_FLOAT32_IEEE 0 SC_ER_DITDES_VGT -512 511.9 /end CHARACTERISTIC
/begin COMPU_METHOD SC_ER_DITDES_VGT "ER_DITDES_VGT conversion" RAT_FUNC "%10.5" "deg" COEFFS 0 1 0 0 0 1 /end COMPU_METHOD
/begin CHARACTERISTIC ER_DONE "Value of ER_STATUS when engine running test is complete" VALUE 0x5F0BA SD_UBYTE 0 SC_ER_DONE 0 100 /end CHARACTERISTIC
/begin COMPU_METHOD SC_ER_DONE "ER_DONE conversion" RAT_FUNC "%3.0" "unitless" COEFFS 0 1 0 0 0 1 /end COMPU_METHOD
/begin CHARACTERISTIC ER_EGR_DTY_HI "EGR KOER HI duty cycle" VALUE 0x5E578 SD_FLOAT32_IEEE 0 SC_ER_EGR_DTY_HI 0 1 /end CHARACTERISTIC
/begin COMPU_METHOD SC_ER_EGR_DTY_HI "ER_EGR_DTY_HI conversion" RAT_FUNC "%10.5" "unitless" COEFFS 0 1 0 0 0 1 /end COMPU_METHOD
/begin CHARACTERISTIC ER_EGR_DTY_LO "" VALUE 0x5E574 SD_FLOAT32_IEEE 0 SC_ER_EGR_DTY_LO 0 1 /end CHARACTERISTIC
/begin COMPU_METHOD SC_ER_EGR_DTY_LO "ER_EGR_DTY_LO conversion" RAT_FUNC "%10.5" "unitless" COEFFS 0 1 0 0 0 1 /end COMPU_METHOD
/begin CHARACTERISTIC ER_EGR_HI_TM "Time to run EGR high test in KOER mode" VALUE 0x5F168 SD_FLOAT32_IEEE 0 SC_ER_EGR_HI_TM 0 1000 /end CHARACTERISTIC
/begin COMPU_METHOD SC_ER_EGR_HI_TM "ER_EGR_HI_TM conversion" RAT_FUNC "%10.5" "s" COEFFS 0 1 0 0 0 1 /end COMPU_METHOD
/begin CHARACTERISTIC ER_EGR_LO_TM "Time to run EGR low test in KOER mode" VALUE 0x5F164 SD_FLOAT32_IEEE 0 SC_ER_EGR_LO_TM 0 1000 /end CHARACTERISTIC
/begin COMPU_METHOD SC_ER_EGR_LO_TM "ER_EGR_LO_TM conversion" RAT_FUNC "%10.5" "s" COEFFS 0 1 0 0 0 1 /end COMPU_METHOD
/begin CHARACTERISTIC ER_EOT_MAX "" VALUE 0x5F160 SD_FLOAT32_IEEE 0 SC_ER_EOT_MAX -50 300 /end CHARACTERISTIC
/begin COMPU_METHOD SC_ER_EOT_MAX "ER_EOT_MAX conversion" RAT_FUNC "%10.5" "degC" COEFFS 0 1 0 0 0 1 /end COMPU_METHOD
/begin CHARACTERISTIC ER_EOT_MIN "" VALUE 0x5F15C SD_FLOAT32_IEEE 0 SC_ER_EOT_MIN -50 300 /end CHARACTERISTIC
/begin COMPU_METHOD SC_ER_EOT_MIN "ER_EOT_MIN conversion" RAT_FUNC "%10.5" "degC" COEFFS 0 1 0 0 0 1 /end COMPU_METHOD
/begin CHARACTERISTIC ER_FN103KP "KOER mode governor KP" CURVE 0x4541C FD_FLOAT32_IEEE 0 FCY_ER_FN103KP 0 2 /begin AXIS_DESCR STD_AXIS NERR FCX_ER_FN103KP 10 -5500 5500 /end AXIS_DESCR /end CHARACTERISTIC
/begin COMPU_METHOD FCX_ER_FN103KP "ER_FN103KP X-axis conversion" RAT_FUNC "%10.5" "RPM" COEFFS 0 1 0 0 0 1 /end COMPU_METHOD
/begin COMPU_METHOD FCY_ER_FN103KP "ER_FN103KP Y-axis conversion" RAT_FUNC "%10.5" "unitless" COEFFS 0 1 0 0 0 1 /end COMPU_METHOD
/begin MEASUREMENT ER_FUL_REQ "Flag to signal fuel system to set lambse to KOER_LQM_DSD" UBYTE MC_ER_FUL_REQ 0 0 0 0 ECU_ADDRESS 0x3FB502 /end MEASUREMENT
/begin COMPU_METHOD MC_ER_FUL_REQ "ER_FUL_REQ conversion" RAT_FUNC "%3.0" "Unitless" COEFFS 0 1 0 0 0 1 /end COMPU_METHOD
/begin CHARACTERISTIC ER_GLOW_TM_0 "" VALUE 0x5F158 SD_FLOAT32_IEEE 0 SC_ER_GLOW_TM_0 0 200000 /end CHARACTERISTIC
/begin COMPU_METHOD SC_ER_GLOW_TM_0 "ER_GLOW_TM_0 conversion" RAT_FUNC "%10.5" "s" COEFFS 0 1 0 0 0 1 /end COMPU_METHOD
/begin CHARACTERISTIC ER_GLOW_TM_1 "" VALUE 0x5F154 SD_FLOAT32_IEEE 0 SC_ER_GLOW_TM_1 0 200000 /end CHARACTERISTIC
/begin COMPU_METHOD SC_ER_GLOW_TM_1 "ER_GLOW_TM_1 conversion" RAT_FUNC "%10.5" "s" COEFFS 0 1 0 0 0 1 /end COMPU_METHOD
/begin CHARACTERISTIC ER_GLOW_TM_2 "" VALUE 0x5F150 SD_FLOAT32_IEEE 0 SC_ER_GLOW_TM_2 0 200000 /end CHARACTERISTIC
/begin COMPU_METHOD SC_ER_GLOW_TM_2 "ER_GLOW_TM_2 conversion" RAT_FUNC "%10.5" "s" COEFFS 0 1 0 0 0 1 /end COMPU_METHOD
/begin CHARACTERISTIC ER_GOV_KI_ICP "KOER mode governer KI gain" VALUE 0x5DBF4 SD_FLOAT32_IEEE 0 SC_ER_GOV_KI_ICP 0 2 /end CHARACTERISTIC
/begin COMPU_METHOD SC_ER_GOV_KI_ICP "ER_GOV_KI_ICP conversion" RAT_FUNC "%10.5" "unitless" COEFFS 0 1 0 0 0 1 /end COMPU_METHOD
/begin CHARACTERISTIC ER_GOV_KI_VGT "KOER mode governer KI gain" VALUE 0x5DBF0 SD_FLOAT32_IEEE 0 SC_ER_GOV_KI_VGT 0 2 /end CHARACTERISTIC
/begin COMPU_METHOD SC_ER_GOV_KI_VGT "ER_GOV_KI_VGT conversion" RAT_FUNC "%10.5" "unitless" COEFFS 0 1 0 0 0 1 /end COMPU_METHOD
/begin CHARACTERISTIC ER_GPCEOT "Key on engine running EOT (Glow Plug) cal" VALUE 0x5E1F8 SD_FLOAT32_IEEE 0 SC_ER_GPCEOT -40 1000 /end CHARACTERISTIC
/begin COMPU_METHOD SC_ER_GPCEOT "ER_GPCEOT conversion" RAT_FUNC "%10.5" "degC" COEFFS 0 1 0 0 0 1 /end COMPU_METHOD
/begin CHARACTERISTIC ER_HI_RPM "Base value for RPM requested during engine running on demand test" VALUE 0x5F0A0 SD_FLOAT32_IEEE 0 SC_ER_HI_RPM 0 2040 /end CHARACTERISTIC
/begin COMPU_METHOD SC_ER_HI_RPM "ER_HI_RPM conversion" RAT_FUNC "%10.5" "RPM" COEFFS 0 1 0 0 0 1 /end COMPU_METHOD
/begin CHARACTERISTIC ER_ICP_DES_HI "KOER Calibration value, for ICP high." VALUE 0x5E03C SD_FLOAT32_IEEE 0 SC_ER_ICP_DES_HI 0 100000 /end CHARACTERISTIC
/begin COMPU_METHOD SC_ER_ICP_DES_HI "ER_ICP_DES_HI conversion" RAT_FUNC "%10.5" "unitless" COEFFS 0 1 0 0 0 1 /end COMPU_METHOD
/begin CHARACTERISTIC ER_ICP_DES_LO "KOER Calibration value, for ICP low." VALUE 0x5E038 SD_FLOAT32_IEEE 0 SC_ER_ICP_DES_LO 0 100000 /end CHARACTERISTIC
/begin COMPU_METHOD SC_ER_ICP_DES_LO "ER_ICP_DES_LO conversion" RAT_FUNC "%10.5" "unitless" COEFFS 0 1 0 0 0 1 /end COMPU_METHOD
/begin CHARACTERISTIC ER_ICP_HI_TM "Time to run ICP high test in KOER mode" VALUE 0x5F14C SD_FLOAT32_IEEE 0 SC_ER_ICP_HI_TM 0 1000 /end CHARACTERISTIC
/begin COMPU_METHOD SC_ER_ICP_HI_TM "ER_ICP_HI_TM conversion" RAT_FUNC "%10.5" "s" COEFFS 0 1 0 0 0 1 /end COMPU_METHOD
/begin CHARACTERISTIC ER_ICP_LO_TM "Time to run ICP low test in KOER mode" VALUE 0x5F148 SD_FLOAT32_IEEE 0 SC_ER_ICP_LO_TM 0 1000 /end CHARACTERISTIC
/begin COMPU_METHOD SC_ER_ICP_LO_TM "ER_ICP_LO_TM conversion" RAT_FUNC "%10.5" "s" COEFFS 0 1 0 0 0 1 /end COMPU_METHOD
/begin CHARACTERISTIC ER_ICP_SS_ERR_MN "KOER mode ICP fault timer limit." VALUE 0x5D230 SD_FLOAT32_IEEE 0 SC_ER_ICP_SS_ERR_MN -128 128 /end CHARACTERISTIC
/begin COMPU_METHOD SC_ER_ICP_SS_ERR_MN "ER_ICP_SS_ERR_MN conversion" RAT_FUNC "%10.5" "s" COEFFS 0 1 0 0 0 1 /end COMPU_METHOD
/begin CHARACTERISTIC ER_ICP_SS_ERR_MX "KOER mode ICP fault timer limit." VALUE 0x5D228 SD_FLOAT32_IEEE 0 SC_ER_ICP_SS_ERR_MX 0 1e+06 /end CHARACTERISTIC
/begin COMPU_METHOD SC_ER_ICP_SS_ERR_MX "ER_ICP_SS_ERR_MX conversion" RAT_FUNC "%10.5" "s" COEFFS 0 1 0 0 0 1 /end COMPU_METHOD
/begin CHARACTERISTIC ER_ICP_SS_TM_LN "KOER mode ICP fault timer limit." VALUE 0x5D22C SD_FLOAT32_IEEE 0 SC_ER_ICP_SS_TM_LN 0 1e+06 /end CHARACTERISTIC
/begin COMPU_METHOD SC_ER_ICP_SS_TM_LN "ER_ICP_SS_TM_LN conversion" RAT_FUNC "%10.5" "s" COEFFS 0 1 0 0 0 1 /end COMPU_METHOD
/begin CHARACTERISTIC ER_ICP_SS_TM_LX "KOER mode ICP fault timer limit." VALUE 0x5D224 SD_FLOAT32_IEEE 0 SC_ER_ICP_SS_TM_LX 0 1e+06 /end CHARACTERISTIC
/begin COMPU_METHOD SC_ER_ICP_SS_TM_LX "ER_ICP_SS_TM_LX conversion" RAT_FUNC "%10.5" "s" COEFFS 0 1 0 0 0 1 /end COMPU_METHOD
/begin CHARACTERISTIC ER_INACTIVE "VAlue for state ER_STATUS when engine runnint test is not active." VALUE 0x5F0C3 SD_UBYTE 0 SC_ER_INACTIVE 0 100 /end CHARACTERISTIC
/begin COMPU_METHOD SC_ER_INACTIVE "ER_INACTIVE conversion" RAT_FUNC "%3.0" "unitless" COEFFS 0 1 0 0 0 1 /end COMPU_METHOD
/begin CHARACTERISTIC ER_INIT "Value for state of ER_STATUS when engine running test first inits." VALUE 0x5F0C2 SD_UBYTE 0 SC_ER_INIT 0 100 /end CHARACTERISTIC
/begin COMPU_METHOD SC_ER_INIT "ER_INIT conversion" RAT_FUNC "%3.0" "unitless" COEFFS 0 1 0 0 0 1 /end COMPU_METHOD
/begin MEASUREMENT ER_ISC_HLD "Flag to signal Idle Speed Control to hold ISC solenoid at current duty cycle." UBYTE MC_ER_ISC_HLD 0 0 0 0 ECU_ADDRESS 0x3FB501 /end MEASUREMENT
/begin COMPU_METHOD MC_ER_ISC_HLD "ER_ISC_HLD conversion" RAT_FUNC "%3.0" "Unitless" COEFFS 0 1 0 0 0 1 /end COMPU_METHOD
/begin MEASUREMENT ER_ISC_REQ "Flag to request ER_RPM from ISC system" UBYTE MC_ER_ISC_REQ 0 0 0 0 ECU_ADDRESS 0x3FB500 /end MEASUREMENT
/begin COMPU_METHOD MC_ER_ISC_REQ "ER_ISC_REQ conversion" RAT_FUNC "%3.0" "Unitless" COEFFS 0 1 0 0 0 1 /end COMPU_METHOD
/begin CHARACTERISTIC ER_IVPWR_MIN "" VALUE 0x5F144 SD_FLOAT32_IEEE 0 SC_ER_IVPWR_MIN 0 20 /end CHARACTERISTIC
/begin COMPU_METHOD SC_ER_IVPWR_MIN "ER_IVPWR_MIN conversion" RAT_FUNC "%10.5" "V" COEFFS 0 1 0 0 0 1 /end COMPU_METHOD
/begin MEASUREMENT ER_MODE "" UBYTE MC_ER_MODE 0 0 0 0 ECU_ADDRESS 0x3FB506 /end MEASUREMENT
/begin COMPU_METHOD MC_ER_MODE "ER_MODE conversion" RAT_FUNC "%3.0" "Unitless" COEFFS 0 1 0 0 0 1 /end COMPU_METHOD
/begin MEASUREMENT ER_MON "Flag indicating the engine running on demand test is complete." UBYTE MC_ER_MON 0 0 0 0 ECU_ADDRESS 0x3FB4FF /end MEASUREMENT
/begin COMPU_METHOD MC_ER_MON "ER_MON conversion" RAT_FUNC "%3.0" "Unitless" COEFFS 0 1 0 0 0 1 /end COMPU_METHOD
/begin CHARACTERISTIC ER_MPH_MAX "" VALUE 0x5F140 SD_FLOAT32_IEEE 0 SC_ER_MPH_MAX 0 150 /end CHARACTERISTIC
/begin COMPU_METHOD SC_ER_MPH_MAX "ER_MPH_MAX conversion" RAT_FUNC "%10.5" "MPH" COEFFS 0 1 0 0 0 1 /end COMPU_METHOD
/begin CHARACTERISTIC ER_NDES_EGR "KOER Calibration value for engine speed setpoint." VALUE 0x5DA14 SD_FLOAT32_IEEE 0 SC_ER_NDES_EGR 0 4095.88 /end CHARACTERISTIC
/begin COMPU_METHOD SC_ER_NDES_EGR "ER_NDES_EGR conversion" RAT_FUNC "%10.5" "unitless" COEFFS 0 1 0 0 0 1 /end COMPU_METHOD
/begin CHARACTERISTIC ER_NDES_ICP "KOER Calibration value for engine speed setpoint." VALUE 0x5DA10 SD_FLOAT32_IEEE 0 SC_ER_NDES_ICP 0 4095.88 /end CHARACTERISTIC
/begin COMPU_METHOD SC_ER_NDES_ICP "ER_NDES_ICP conversion" RAT_FUNC "%10.5" "unitless" COEFFS 0 1 0 0 0 1 /end COMPU_METHOD
/begin CHARACTERISTIC ER_NDES_VGT "KOER Calibration value for engine speed setpoint." VALUE 0x5DA0C SD_FLOAT32_IEEE 0 SC_ER_NDES_VGT 0 4095.88 /end CHARACTERISTIC
/begin COMPU_METHOD SC_ER_NDES_VGT "ER_NDES_VGT conversion" RAT_FUNC "%10.5" "unitless" COEFFS 0 1 0 0 0 1 /end COMPU_METHOD
/begin CHARACTERISTIC ER_N_MAX "" VALUE 0x5F13C SD_FLOAT32_IEEE 0 SC_ER_N_MAX 0 5500 /end CHARACTERISTIC
/begin COMPU_METHOD SC_ER_N_MAX "ER_N_MAX conversion" RAT_FUNC "%10.5" "RPM" COEFFS 0 1 0 0 0 1 /end COMPU_METHOD
/begin CHARACTERISTIC ER_N_MIN "" VALUE 0x5F138 SD_FLOAT32_IEEE 0 SC_ER_N_MIN 0 5500 /end CHARACTERISTIC
/begin COMPU_METHOD SC_ER_N_MIN "ER_N_MIN conversion" RAT_FUNC "%10.5" "RPM" COEFFS 0 1 0 0 0 1 /end COMPU_METHOD
/begin CHARACTERISTIC ER_PPS_MAX "" VALUE 0x5F134 SD_FLOAT32_IEEE 0 SC_ER_PPS_MAX 0 1024 /end CHARACTERISTIC
/begin COMPU_METHOD SC_ER_PPS_MAX "ER_PPS_MAX conversion" RAT_FUNC "%10.5" "unitless" COEFFS 0 1 0 0 0 1 /end COMPU_METHOD
/begin MEASUREMENT ER_RPM "Register that contains RPM value requested during engine running self test" FLOAT32_IEEE MC_ER_RPM 0 0 0 0 ECU_ADDRESS 0x3FB4F4 /end MEASUREMENT
/begin COMPU_METHOD MC_ER_RPM "ER_RPM conversion" RAT_FUNC "%10.5" "Unitless" COEFFS 0 1 0 0 0 1 /end COMPU_METHOD
/begin MEASUREMENT ER_SPARK "Required value of SAF during on demand self test." FLOAT32_IEEE MC_ER_SPARK 0 0 0 0 ECU_ADDRESS 0x3FB4F0 /end MEASUREMENT
/begin COMPU_METHOD MC_ER_SPARK "ER_SPARK conversion" RAT_FUNC "%10.5" "Unitless" COEFFS 0 1 0 0 0 1 /end COMPU_METHOD
/begin CHARACTERISTIC ER_SPARK_BAS "BAse value for Spark advance during engine running on demand tes" VALUE 0x5F098 SD_FLOAT32_IEEE 0 SC_ER_SPARK_BAS 0 60 /end CHARACTERISTIC
/begin COMPU_METHOD SC_ER_SPARK_BAS "ER_SPARK_BAS conversion" RAT_FUNC "%10.5" "DEGREES" COEFFS 0 1 0 0 0 1 /end COMPU_METHOD
/begin MEASUREMENT ER_SPK_REQ "Flag to request ER_SPARK from spark strategy during engine running on demand test" UBYTE MC_ER_SPK_REQ 0 0 0 0 ECU_ADDRESS 0x3FB4FE /end MEASUREMENT
/begin COMPU_METHOD MC_ER_SPK_REQ "ER_SPK_REQ conversion" RAT_FUNC "%3.0" "Unitless" COEFFS 0 1 0 0 0 1 /end COMPU_METHOD
/begin MEASUREMENT ER_STATUS "State pointer that indicated current state of engine running on demand test" UBYTE MC_ER_STATUS 0 0 0 0 ECU_ADDRESS 0x3FB505 /end MEASUREMENT
/begin COMPU_METHOD MC_ER_STATUS "ER_STATUS conversion" RAT_FUNC "%3.0" "Unitless" COEFFS 0 1 0 0 0 1 /end COMPU_METHOD
/begin CHARACTERISTIC ER_TM "Time for engine to stable when entering KOER mode." VALUE 0x5F130 SD_FLOAT32_IEEE 0 SC_ER_TM 0 1000 /end CHARACTERISTIC
/begin COMPU_METHOD SC_ER_TM "ER_TM conversion" RAT_FUNC "%10.5" "s" COEFFS 0 1 0 0 0 1 /end COMPU_METHOD
/begin CHARACTERISTIC ER_TM_11 "Time for engine to stable when entering KOER mode." VALUE 0x5F118 SD_FLOAT32_IEEE 0 SC_ER_TM_11 0 1000 /end CHARACTERISTIC
/begin COMPU_METHOD SC_ER_TM_11 "ER_TM_11 conversion" RAT_FUNC "%10.5" "s" COEFFS 0 1 0 0 0 1 /end COMPU_METHOD
/begin CHARACTERISTIC ER_TM_13 "Time for engine to stable when entering KOER mode." VALUE 0x5F114 SD_FLOAT32_IEEE 0 SC_ER_TM_13 0 1000 /end CHARACTERISTIC
/begin COMPU_METHOD SC_ER_TM_13 "ER_TM_13 conversion" RAT_FUNC "%10.5" "s" COEFFS 0 1 0 0 0 1 /end COMPU_METHOD
/begin CHARACTERISTIC ER_TM_3 "Time for engine to stable when entering KOER mode." VALUE 0x5F12C SD_FLOAT32_IEEE 0 SC_ER_TM_3 0 1000 /end CHARACTERISTIC
/begin COMPU_METHOD SC_ER_TM_3 "ER_TM_3 conversion" RAT_FUNC "%10.5" "s" COEFFS 0 1 0 0 0 1 /end COMPU_METHOD
/begin CHARACTERISTIC ER_TM_5 "Time for engine to stable when entering KOER mode." VALUE 0x5F128 SD_FLOAT32_IEEE 0 SC_ER_TM_5 0 1000 /end CHARACTERISTIC
/begin COMPU_METHOD SC_ER_TM_5 "ER_TM_5 conversion" RAT_FUNC "%10.5" "s" COEFFS 0 1 0 0 0 1 /end COMPU_METHOD
/begin CHARACTERISTIC ER_TM_7 "Time for engine to stable when entering KOER mode." VALUE 0x5F124 SD_FLOAT32_IEEE 0 SC_ER_TM_7 0 1000 /end CHARACTERISTIC
/begin COMPU_METHOD SC_ER_TM_7 "ER_TM_7 conversion" RAT_FUNC "%10.5" "s" COEFFS 0 1 0 0 0 1 /end COMPU_METHOD
/begin CHARACTERISTIC ER_TM_8 "Time for engine to stable when entering KOER mode." VALUE 0x5F120 SD_FLOAT32_IEEE 0 SC_ER_TM_8 0 1000 /end CHARACTERISTIC
/begin COMPU_METHOD SC_ER_TM_8 "ER_TM_8 conversion" RAT_FUNC "%10.5" "s" COEFFS 0 1 0 0 0 1 /end COMPU_METHOD
/begin CHARACTERISTIC ER_TM_9 "Time for engine to stable when entering KOER mode." VALUE 0x5F11C SD_FLOAT32_IEEE 0 SC_ER_TM_9 0 1000 /end CHARACTERISTIC
/begin COMPU_METHOD SC_ER_TM_9 "ER_TM_9 conversion" RAT_FUNC "%10.5" "s" COEFFS 0 1 0 0 0 1 /end COMPU_METHOD
/begin MEASUREMENT ER_TST_ENA "Flag to signal engine running on demand test to run" UBYTE MC_ER_TST_ENA 0 0 0 0 ECU_ADDRESS 0x3F9E48 /end MEASUREMENT
/begin COMPU_METHOD MC_ER_TST_ENA "ER_TST_ENA conversion" RAT_FUNC "%3.0" "Unitless" COEFFS 0 1 0 0 0 1 /end COMPU_METHOD
/begin MEASUREMENT ER_TST_RDY "Flag to signal OBD-II executive that the engine running on demand test is able to run" UBYTE MC_ER_TST_RDY 0 0 0 0 ECU_ADDRESS 0x3FB4FD /end MEASUREMENT
/begin COMPU_METHOD MC_ER_TST_RDY "ER_TST_RDY conversion" RAT_FUNC "%3.0" "Unitless" COEFFS 0 1 0 0 0 1 /end COMPU_METHOD
/begin CHARACTERISTIC ER_VBAT_DELTA "" VALUE 0x5F110 SD_FLOAT32_IEEE 0 SC_ER_VBAT_DELTA 0 20000 /end CHARACTERISTIC
/begin COMPU_METHOD SC_ER_VBAT_DELTA "ER_VBAT_DELTA conversion" RAT_FUNC "%10.5" "unitless" COEFFS 0 1 0 0 0 1 /end COMPU_METHOD
/begin CHARACTERISTIC ER_VGT_DES_LO "KOER step calibration value" VALUE 0x5E9C0 SD_FLOAT32_IEEE 0 SC_ER_VGT_DES_LO 0 1 /end CHARACTERISTIC
/begin COMPU_METHOD SC_ER_VGT_DES_LO "ER_VGT_DES_LO conversion" RAT_FUNC "%10.5" "unitless" COEFFS 0 1 0 0 0 1 /end COMPU_METHOD
/begin CHARACTERISTIC ER_VGT_DTY_EGR "KOER step calibration value" VALUE 0x5E9BC SD_FLOAT32_IEEE 0 SC_ER_VGT_DTY_EGR 0 1 /end CHARACTERISTIC
/begin COMPU_METHOD SC_ER_VGT_DTY_EGR "ER_VGT_DTY_EGR conversion" RAT_FUNC "%10.5" "unitless" COEFFS 0 1 0 0 0 1 /end COMPU_METHOD
/begin CHARACTERISTIC ER_VGT_DTY_HI "KOER step calibration value" VALUE 0x5E9B8 SD_FLOAT32_IEEE 0 SC_ER_VGT_DTY_HI 0 1 /end CHARACTERISTIC
/begin COMPU_METHOD SC_ER_VGT_DTY_HI "ER_VGT_DTY_HI conversion" RAT_FUNC "%10.5" "unitless" COEFFS 0 1 0 0 0 1 /end COMPU_METHOD
/begin CHARACTERISTIC ER_VGT_DTY_LO "KOER step calibration value" VALUE 0x5E9B4 SD_FLOAT32_IEEE 0 SC_ER_VGT_DTY_LO 0 1 /end CHARACTERISTIC
/begin COMPU_METHOD SC_ER_VGT_DTY_LO "ER_VGT_DTY_LO conversion" RAT_FUNC "%10.5" "unitless" COEFFS 0 1 0 0 0 1 /end COMPU_METHOD
/begin CHARACTERISTIC ER_VGT_HI_TM "Time to run VGT high test in KOER mode" VALUE 0x5F10C SD_FLOAT32_IEEE 0 SC_ER_VGT_HI_TM 0 1000 /end CHARACTERISTIC
/begin COMPU_METHOD SC_ER_VGT_HI_TM "ER_VGT_HI_TM conversion" RAT_FUNC "%10.5" "s" COEFFS 0 1 0 0 0 1 /end COMPU_METHOD
/begin CHARACTERISTIC ER_VGT_LO_TM "Time to run VGT low test in KOER mode" VALUE 0x5F108 SD_FLOAT32_IEEE 0 SC_ER_VGT_LO_TM 0 1000 /end CHARACTERISTIC
/begin COMPU_METHOD SC_ER_VGT_LO_TM "ER_VGT_LO_TM conversion" RAT_FUNC "%10.5" "s" COEFFS 0 1 0 0 0 1 /end COMPU_METHOD
/begin MEASUREMENT ETC_ON_REQ "" UBYTE MC_ETC_ON_REQ 0 0 0 0 ECU_ADDRESS 0x3F9CF8 /end MEASUREMENT
/begin COMPU_METHOD MC_ETC_ON_REQ "ETC_ON_REQ conversion" RAT_FUNC "%3.0" "Unitless" COEFFS 0 1 0 0 0 1 /end COMPU_METHOD
/begin MEASUREMENT ETC_PDL_FL1 "Closed  pedal mode flag." UBYTE MC_ETC_PDL_FL1 0 0 0 0 ECU_ADDRESS 0x3FA331 /end MEASUREMENT
/begin COMPU_METHOD MC_ETC_PDL_FL1 "ETC_PDL_FL1 conversion" RAT_FUNC "%3.0" "Unitless" COEFFS 0 1 0 0 0 1 /end COMPU_METHOD
/begin MEASUREMENT ETC_PDL_FL2 "WOP  / pedal mode flag." UBYTE MC_ETC_PDL_FL2 0 0 0 0 ECU_ADDRESS 0x3FA330 /end MEASUREMENT
/begin COMPU_METHOD MC_ETC_PDL_FL2 "ETC_PDL_FL2 conversion" RAT_FUNC "%3.0" "Unitless" COEFFS 0 1 0 0 0 1 /end COMPU_METHOD
/begin MEASUREMENT ETC_TP_REL "Closed in throttle bore TP_REL." FLOAT32_IEEE MC_ETC_TP_REL 0 0 0 0 ECU_ADDRESS 0x3FA278 /end MEASUREMENT
/begin COMPU_METHOD MC_ETC_TP_REL "ETC_TP_REL conversion" RAT_FUNC "%10.5" "Unitless" COEFFS 0 1 0 0 0 1 /end COMPU_METHOD
/begin CHARACTERISTIC ETKP2_SHADOW0_CAL_EN "" VALUE 0x5CB34 SD_UBYTE 0 SC_ETKP2_SHADOW0_CAL_EN 0 1 /end CHARACTERISTIC
/begin COMPU_METHOD SC_ETKP2_SHADOW0_CAL_EN "ETKP2_SHADOW0_CAL_EN conversion" RAT_FUNC "%3.0" "unitless" COEFFS 0 1 0 0 0 1 /end COMPU_METHOD
/begin CHARACTERISTIC ETKP2_SHADOW1_CAL_EN "" VALUE 0x5CB33 SD_UBYTE 0 SC_ETKP2_SHADOW1_CAL_EN 0 1 /end CHARACTERISTIC
/begin COMPU_METHOD SC_ETKP2_SHADOW1_CAL_EN "ETKP2_SHADOW1_CAL_EN conversion" RAT_FUNC "%3.0" "unitless" COEFFS 0 1 0 0 0 1 /end COMPU_METHOD
/begin CHARACTERISTIC ETKP2_SHADOW2_CAL_EN "" VALUE 0x5CB32 SD_UBYTE 0 SC_ETKP2_SHADOW2_CAL_EN 0 1 /end CHARACTERISTIC
/begin COMPU_METHOD SC_ETKP2_SHADOW2_CAL_EN "ETKP2_SHADOW2_CAL_EN conversion" RAT_FUNC "%3.0" "unitless" COEFFS 0 1 0 0 0 1 /end COMPU_METHOD
/begin MEASUREMENT EXP_INCODE1 "Expected INCODE1, Used in secure access." UBYTE MC_EXP_INCODE1 0 0 0 0 ECU_ADDRESS 0x3F9DA5 /end MEASUREMENT
/begin COMPU_METHOD MC_EXP_INCODE1 "EXP_INCODE1 conversion" RAT_FUNC "%3.0" "Unitless" COEFFS 0 1 0 0 0 1 /end COMPU_METHOD
/begin MEASUREMENT EXP_INCODE2 "Expected INCODE2, used in secure access." UBYTE MC_EXP_INCODE2 0 0 0 0 ECU_ADDRESS 0x3F9DA4 /end MEASUREMENT
/begin COMPU_METHOD MC_EXP_INCODE2 "EXP_INCODE2 conversion" RAT_FUNC "%3.0" "Unitless" COEFFS 0 1 0 0 0 1 /end COMPU_METHOD
/begin MEASUREMENT EXT_CMD "Signed inferred catalyst midbed gas temperature." FLOAT32_IEEE MC_EXT_CMD 0 0 0 0 ECU_ADDRESS 0x3F9C54 /end MEASUREMENT
/begin COMPU_METHOD MC_EXT_CMD "EXT_CMD conversion" RAT_FUNC "%10.5" "Unitless" COEFFS 0 1 0 0 0 1 /end COMPU_METHOD
/begin MEASUREMENT EXT_CMD_MF "Instantaneous inferred exhaust gas midbed temperature." FLOAT32_IEEE MC_EXT_CMD_MF 0 0 0 0 ECU_ADDRESS 0x3F9C44 /end MEASUREMENT
/begin COMPU_METHOD MC_EXT_CMD_MF "EXT_CMD_MF conversion" RAT_FUNC "%10.5" "Unitless" COEFFS 0 1 0 0 0 1 /end COMPU_METHOD
/begin MEASUREMENT FALL_EDGE_TOOTH "" UBYTE MC_FALL_EDGE_TOOTH 0 0 0 0 ECU_ADDRESS 0x3FB6E9 /end MEASUREMENT
/begin COMPU_METHOD MC_FALL_EDGE_TOOTH "FALL_EDGE_TOOTH conversion" RAT_FUNC "%3.0" "Unitless" COEFFS 0 1 0 0 0 1 /end COMPU_METHOD
/begin CHARACTERISTIC FAN_SPD_SAMPLE_RATE "Sampling rate for fan speed to determine its derivative." VALUE 0x5E0F0 SD_UWORD 0 SC_FAN_SPD_SAMPLE_RATE 0 65535 /end CHARACTERISTIC
/begin COMPU_METHOD SC_FAN_SPD_SAMPLE_RATE "FAN_SPD_SAMPLE_RATE conversion" RAT_FUNC "%5.0" "unitless" COEFFS 0 1 0 0 0 1 /end COMPU_METHOD
/begin CHARACTERISTIC FCPPS "TIME CONSTANT FOR PEDAL FILTERING" VALUE 0x5D510 SD_FLOAT32_IEEE 0 SC_FCPPS 0 5000 /end CHARACTERISTIC
/begin COMPU_METHOD SC_FCPPS "FCPPS conversion" RAT_FUNC "%10.5" "unitless" COEFFS 0 1 0 0 0 1 /end COMPU_METHOD
/begin MEASUREMENT FFG_ACT "OBDII system FMEM flag for ACT; 1 -> ACT is currently unreliable." UBYTE MC_FFG_ACT 0 0 0 0 ECU_ADDRESS 0x3FA2C0 /end MEASUREMENT
/begin COMPU_METHOD MC_FFG_ACT "FFG_ACT conversion" RAT_FUNC "%3.0" "Unitless" COEFFS 0 1 0 0 0 1 /end COMPU_METHOD
/begin MEASUREMENT FFG_CID "OBDII system FMEM flag for CID - 1 -> CID is not currently reliable." UBYTE MC_FFG_CID 0 0 0 0 ECU_ADDRESS 0x3FB2A3 /end MEASUREMENT
/begin COMPU_METHOD MC_FFG_CID "FFG_CID conversion" RAT_FUNC "%3.0" "Unitless" COEFFS 0 1 0 0 0 1 /end COMPU_METHOD
/begin MEASUREMENT FFG_ECT "OBDII system FMEM flag for ECT; 1 -> ECT is currently unreliable." UBYTE MC_FFG_ECT 0 0 0 0 ECU_ADDRESS 0x3FA2BF /end MEASUREMENT
/begin COMPU_METHOD MC_FFG_ECT "FFG_ECT conversion" RAT_FUNC "%3.0" "Unitless" COEFFS 0 1 0 0 0 1 /end COMPU_METHOD
/begin MEASUREMENT FFG_EGO[0][0] "" UBYTE MC_FFG_EGO 0 0 0 1 ECU_ADDRESS 0x3F9B28 /end MEASUREMENT
/begin COMPU_METHOD MC_FFG_EGO "FFG_EGO conversion" RAT_FUNC "%3.0" "Unitless" COEFFS 0 1 0 0 0 1 /end COMPU_METHOD
/begin MEASUREMENT FFG_EGO[0][1] "" UBYTE MC_FFG_EGO 0 0 0 1 ECU_ADDRESS 0x3F9B29 /end MEASUREMENT
/begin MEASUREMENT FFG_EGO[1][0] "" UBYTE MC_FFG_EGO 0 0 0 1 ECU_ADDRESS 0x3F9B2A /end MEASUREMENT
/begin MEASUREMENT FFG_EGO[1][1] "" UBYTE MC_FFG_EGO 0 0 0 1 ECU_ADDRESS 0x3F9B2B /end MEASUREMENT
/begin MEASUREMENT FFG_EGR "OBDII system FMEM flag for the EGR system - 1 -> EGR system not currently operationg reliably." UBYTE MC_FFG_EGR 0 0 0 0 ECU_ADDRESS 0x3F9CCD /end MEASUREMENT
/begin COMPU_METHOD MC_FFG_EGR "FFG_EGR conversion" RAT_FUNC "%3.0" "Unitless" COEFFS 0 1 0 0 0 1 /end COMPU_METHOD
/begin CHARACTERISTIC FFG_EGR_SW "Bybass egr fmem." VALUE 0x5CE59 SD_UBYTE 0 SC_FFG_EGR_SW 0 1 /end CHARACTERISTIC
/begin COMPU_METHOD SC_FFG_EGR_SW "FFG_EGR_SW conversion" RAT_FUNC "%3.0" "unitless" COEFFS 0 1 0 0 0 1 /end COMPU_METHOD
/begin MEASUREMENT FFG_EOT "OBDII system FMEM flag for EOT; 1 EOT is currently unreliable." UBYTE MC_FFG_EOT 0 0 0 0 ECU_ADDRESS 0x3FB389 /end MEASUREMENT
/begin COMPU_METHOD MC_FFG_EOT "FFG_EOT conversion" RAT_FUNC "%3.0" "Unitless" COEFFS 0 1 0 0 0 1 /end COMPU_METHOD
/begin MEASUREMENT FFG_FRP "OBDII system FMEM flag for FRP" UBYTE MC_FFG_FRP 0 0 0 0 ECU_ADDRESS 0x3F9CCA /end MEASUREMENT
/begin COMPU_METHOD MC_FFG_FRP "FFG_FRP conversion" RAT_FUNC "%3.0" "Unitless" COEFFS 0 1 0 0 0 1 /end COMPU_METHOD
/begin MEASUREMENT FFG_LAMBSE1 "OBDII system FMEM flag for LAMBSE1 - 1 -> LAMBSE1 is not currently reliable." UBYTE MC_FFG_LAMBSE1 0 0 0 0 ECU_ADDRESS 0x3F9CCC /end MEASUREMENT
/begin COMPU_METHOD MC_FFG_LAMBSE1 "FFG_LAMBSE1 conversion" RAT_FUNC "%3.0" "Unitless" COEFFS 0 1 0 0 0 1 /end COMPU_METHOD
/begin MEASUREMENT FFG_LAMBSE2 "OBDII system FMEM flag for LAMBSE2 - 1 -> LAMBSE2 is not currently reliable." UBYTE MC_FFG_LAMBSE2 0 0 0 0 ECU_ADDRESS 0x3F9CCB /end MEASUREMENT
/begin COMPU_METHOD MC_FFG_LAMBSE2 "FFG_LAMBSE2 conversion" RAT_FUNC "%3.0" "Unitless" COEFFS 0 1 0 0 0 1 /end COMPU_METHOD
/begin MEASUREMENT FFG_MAF "OBD-II system FMEM flag for MAF" UBYTE MC_FFG_MAF 0 0 0 0 ECU_ADDRESS 0x3F9CD0 /end MEASUREMENT
/begin COMPU_METHOD MC_FFG_MAF "FFG_MAF conversion" RAT_FUNC "%3.0" "Unitless" COEFFS 0 1 0 0 0 1 /end COMPU_METHOD
/begin MEASUREMENT FFG_MAP "OBD-II system FMEM flag for MAP" UBYTE MC_FFG_MAP 0 0 0 0 ECU_ADDRESS 0x3F9CD1 /end MEASUREMENT
/begin COMPU_METHOD MC_FFG_MAP "FFG_MAP conversion" RAT_FUNC "%3.0" "Unitless" COEFFS 0 1 0 0 0 1 /end COMPU_METHOD
/begin CHARACTERISTIC FFG_MAP_SW "map sensor indicator: 0 = no map sensor; 1 = map sensor present." VALUE 0x5CE58 SD_UBYTE 0 SC_FFG_MAP_SW 0 1 /end CHARACTERISTIC
/begin COMPU_METHOD SC_FFG_MAP_SW "FFG_MAP_SW conversion" RAT_FUNC "%3.0" "unitless" COEFFS 0 1 0 0 0 1 /end COMPU_METHOD
/begin MEASUREMENT FFG_MISFIRE "OBDII system FMEM flag for engine misfire - 1 -> currently misfiring." UBYTE MC_FFG_MISFIRE 0 0 0 0 ECU_ADDRESS 0x3FB2AC /end MEASUREMENT
/begin COMPU_METHOD MC_FFG_MISFIRE "FFG_MISFIRE conversion" RAT_FUNC "%3.0" "Unitless" COEFFS 0 1 0 0 0 1 /end COMPU_METHOD
/begin MEASUREMENT FFG_MLFUPD_EN """malf"" diagnostic counter enable flag" UBYTE MC_FFG_MLFUPD_EN 0 0 0 0 ECU_ADDRESS 0x3F9E9A /end MEASUREMENT
/begin COMPU_METHOD MC_FFG_MLFUPD_EN "FFG_MLFUPD_EN conversion" RAT_FUNC "%3.0" "Unitless" COEFFS 0 1 0 0 0 1 /end COMPU_METHOD
/begin MEASUREMENT FFG_PIP "OBDII system FMEM flag for PIP - 1 -> PIP not currently reliable." UBYTE MC_FFG_PIP 0 0 0 0 ECU_ADDRESS 0x3FB2A2 /end MEASUREMENT
/begin COMPU_METHOD MC_FFG_PIP "FFG_PIP conversion" RAT_FUNC "%3.0" "Unitless" COEFFS 0 1 0 0 0 1 /end COMPU_METHOD
/begin MEASUREMENT FFG_PURG "OBDII system FMEM flag for the purge system - 1 -> purge system is not under control reliably." UBYTE MC_FFG_PURG 0 0 0 0 ECU_ADDRESS 0x3F9CCF /end MEASUREMENT
/begin COMPU_METHOD MC_FFG_PURG "FFG_PURG conversion" RAT_FUNC "%3.0" "Unitless" COEFFS 0 1 0 0 0 1 /end COMPU_METHOD
/begin MEASUREMENT FFG_SAIR "OBDII system FMEM flag for the sair system - 1 -> sair sytem is not currently under control reliably" UBYTE MC_FFG_SAIR 0 0 0 0 ECU_ADDRESS 0x3F9CCE /end MEASUREMENT
/begin COMPU_METHOD MC_FFG_SAIR "FFG_SAIR conversion" RAT_FUNC "%3.0" "Unitless" COEFFS 0 1 0 0 0 1 /end COMPU_METHOD
/begin MEASUREMENT FFG_TP "OBDII system FMEM flag for TP - 1 -> TP is not currently reliable." UBYTE MC_FFG_TP 0 0 0 0 ECU_ADDRESS 0x3F9CD3 /end MEASUREMENT
/begin COMPU_METHOD MC_FFG_TP "FFG_TP conversion" RAT_FUNC "%3.0" "Unitless" COEFFS 0 1 0 0 0 1 /end COMPU_METHOD
/begin MEASUREMENT FFG_VS "OBDII system FMEM flag for VS - 1 -> VS is currently unreliable." UBYTE MC_FFG_VS 0 0 0 0 ECU_ADDRESS 0x3F9CD2 /end MEASUREMENT
/begin COMPU_METHOD MC_FFG_VS "FFG_VS conversion" RAT_FUNC "%3.0" "Unitless" COEFFS 0 1 0 0 0 1 /end COMPU_METHOD
/begin MEASUREMENT FFG_VSS "Imediate Fault or Noise Detected on the VSS." UBYTE MC_FFG_VSS 0 0 0 0 ECU_ADDRESS 0x3FA6A5 /end MEASUREMENT
/begin COMPU_METHOD MC_FFG_VSS "FFG_VSS conversion" RAT_FUNC "%3.0" "Unitless" COEFFS 0 1 0 0 0 1 /end COMPU_METHOD
/begin MEASUREMENT FFH_CMD "Fuel fire heater command(ON/OFF)" UBYTE MC_FFH_CMD 0 0 0 0 ECU_ADDRESS 0x3FA6B0 /end MEASUREMENT
/begin COMPU_METHOD MC_FFH_CMD "FFH_CMD conversion" RAT_FUNC "%3.0" "Unitless" COEFFS 0 1 0 0 0 1 /end COMPU_METHOD
/begin CHARACTERISTIC FFH_ECT_LMN "Fuel fire heater is enabled below this coolant temp." VALUE 0x5D968 SD_FLOAT32_IEEE 0 SC_FFH_ECT_LMN -40 160 /end CHARACTERISTIC
/begin COMPU_METHOD SC_FFH_ECT_LMN "FFH_ECT_LMN conversion" RAT_FUNC "%10.5" "degC" COEFFS 0 1 0 0 0 1 /end COMPU_METHOD
/begin CHARACTERISTIC FFH_HYST_VAL "Fuel fire heater hysterisis band" VALUE 0x5D96C SD_FLOAT32_IEEE 0 SC_FFH_HYST_VAL 0 50 /end CHARACTERISTIC
/begin COMPU_METHOD SC_FFH_HYST_VAL "FFH_HYST_VAL conversion" RAT_FUNC "%10.5" "degC" COEFFS 0 1 0 0 0 1 /end COMPU_METHOD
/begin CHARACTERISTIC FFH_IAT_EN_LMN "Fuel fire heater is enabled below this limit" VALUE 0x5D970 SD_FLOAT32_IEEE 0 SC_FFH_IAT_EN_LMN 0 150 /end CHARACTERISTIC
/begin COMPU_METHOD SC_FFH_IAT_EN_LMN "FFH_IAT_EN_LMN conversion" RAT_FUNC "%10.5" "degC" COEFFS 0 1 0 0 0 1 /end COMPU_METHOD
/begin MEASUREMENT FF_CODE "Code number of fault for which freeze frame conditions are stored. freeze frame is loaded." UWORD MC_FF_CODE 0 0 0 0 ECU_ADDRESS 0x3FCCCE /end MEASUREMENT
/begin COMPU_METHOD MC_FF_CODE "FF_CODE conversion" RAT_FUNC "%5.0" "Unitless" COEFFS 0 1 0 0 0 1 /end COMPU_METHOD
/begin MEASUREMENT FF_ECT_DEGC "Freeze Frame - Engine coolant temperature. (DEGREES C)" FLOAT32_IEEE MC_FF_ECT_DEGC 0 0 0 0 ECU_ADDRESS 0x3FCCBC /end MEASUREMENT
/begin COMPU_METHOD MC_FF_ECT_DEGC "FF_ECT_DEGC conversion" RAT_FUNC "%10.5" "Unitless" COEFFS 0 1 0 0 0 1 /end COMPU_METHOD
/begin MEASUREMENT FF_FUEL_MIS "Freeze frame FUEL or MISFIRE data stored flag. 1 -> freeze frame was stored due to FUEL or MISFIRE." UBYTE MC_FF_FUEL_MIS 0 0 0 0 ECU_ADDRESS 0x3FCCD1 /end MEASUREMENT
/begin COMPU_METHOD MC_FF_FUEL_MIS "FF_FUEL_MIS conversion" RAT_FUNC "%3.0" "Unitless" COEFFS 0 1 0 0 0 1 /end COMPU_METHOD
/begin MEASUREMENT FF_KAMREF[0] "Value of KAMRF1 (adaptive correction) at the time the freeze frame was stored." FLOAT32_IEEE MC_FF_KAMREF 0 0 0 255.996 ECU_ADDRESS 0x3FCCA4 /end MEASUREMENT
/begin COMPU_METHOD MC_FF_KAMREF "FF_KAMREF conversion" RAT_FUNC "%10.5" "UNITLESS" COEFFS 0 1 0 0 0 1 /end COMPU_METHOD
/begin MEASUREMENT FF_KAMREF[1] "Value of KAMRF1 (adaptive correction) at the time the freeze frame was stored." FLOAT32_IEEE MC_FF_KAMREF 0 0 0 255.996 ECU_ADDRESS 0x3FCCA8 /end MEASUREMENT
/begin MEASUREMENT FF_LAMBSE[0] "An array containing the values of LAMBSE (short term fuel trim) at the time the freeze frame was stored." FLOAT32_IEEE MC_FF_LAMBSE 0 0 0 1.9999 ECU_ADDRESS 0x3FCCAC /end MEASUREMENT
/begin COMPU_METHOD MC_FF_LAMBSE "FF_LAMBSE conversion" RAT_FUNC "%10.5" "UNITLESS" COEFFS 0 1 0 0 0 1 /end COMPU_METHOD
/begin MEASUREMENT FF_LAMBSE[1] "An array containing the values of LAMBSE (short term fuel trim) at the time the freeze frame was stored." FLOAT32_IEEE MC_FF_LAMBSE 0 0 0 1.9999 ECU_ADDRESS 0x3FCCB0 /end MEASUREMENT
/begin MEASUREMENT FF_LOAD_PCT_PID "load freeze frame value-pid format" UBYTE MC_FF_LOAD_PCT_PID 0 0 0 0 ECU_ADDRESS 0x3FCCDB /end MEASUREMENT
/begin COMPU_METHOD MC_FF_LOAD_PCT_PID "FF_LOAD_PCT_PID conversion" RAT_FUNC "%3.0" "Unitless" COEFFS 0 1 0 0 0 1 /end COMPU_METHOD
/begin MEASUREMENT FF_OL_DM "Value of OL_DESIRED at time freeze frame was stored." UBYTE MC_FF_OL_DM 0 0 0 0 ECU_ADDRESS 0x3FCCD4 /end MEASUREMENT
/begin COMPU_METHOD MC_FF_OL_DM "FF_OL_DM conversion" RAT_FUNC "%3.0" "Unitless" COEFFS 0 1 0 0 0 1 /end COMPU_METHOD
/begin MEASUREMENT FF_OL_FAULT "Flag, when set representing closed loop with EGO fault at time the freeze frame was stored." UBYTE MC_FF_OL_FAULT 0 0 0 0 ECU_ADDRESS 0x3FCCD2 /end MEASUREMENT
/begin COMPU_METHOD MC_FF_OL_FAULT "FF_OL_FAULT conversion" RAT_FUNC "%3.0" "Unitless" COEFFS 0 1 0 0 0 1 /end COMPU_METHOD
/begin MEASUREMENT FF_OL_FDBACK "Flag, when set representing closed loop fuel control when freeze frame was stored." UBYTE MC_FF_OL_FDBACK 0 0 0 0 ECU_ADDRESS 0x3FCCD5 /end MEASUREMENT
/begin COMPU_METHOD MC_FF_OL_FDBACK "FF_OL_FDBACK conversion" RAT_FUNC "%3.0" "Unitless" COEFFS 0 1 0 0 0 1 /end COMPU_METHOD
/begin MEASUREMENT FF_OL_FMEM "Value of OL_FMEM at time freeze frame was stored." UBYTE MC_FF_OL_FMEM 0 0 0 0 ECU_ADDRESS 0x3FCCD3 /end MEASUREMENT
/begin COMPU_METHOD MC_FF_OL_FMEM "FF_OL_FMEM conversion" RAT_FUNC "%3.0" "Unitless" COEFFS 0 1 0 0 0 1 /end COMPU_METHOD
/begin MEASUREMENT FF_OL_HOLD "Value of OL_HOLD when freeze frame was stored." UBYTE MC_FF_OL_HOLD 0 0 0 0 ECU_ADDRESS 0x3FCCD6 /end MEASUREMENT
/begin COMPU_METHOD MC_FF_OL_HOLD "FF_OL_HOLD conversion" RAT_FUNC "%3.0" "Unitless" COEFFS 0 1 0 0 0 1 /end COMPU_METHOD
/begin MEASUREMENT FF_PTO_ACTIVE "PTO active" UBYTE MC_FF_PTO_ACTIVE 0 0 0 0 ECU_ADDRESS 0x3FCCD7 /end MEASUREMENT
/begin COMPU_METHOD MC_FF_PTO_ACTIVE "FF_PTO_ACTIVE conversion" RAT_FUNC "%3.0" "Unitless" COEFFS 0 1 0 0 0 1 /end COMPU_METHOD
/begin MEASUREMENT FF_RPM "Value of engine speed at the time the freeze frame was stored." FLOAT32_IEEE MC_FF_RPM 0 0 0 0 ECU_ADDRESS 0x3FCCC0 /end MEASUREMENT
/begin COMPU_METHOD MC_FF_RPM "FF_RPM conversion" RAT_FUNC "%10.5" "Unitless" COEFFS 0 1 0 0 0 1 /end COMPU_METHOD
/begin CHARACTERISTIC FICMM_F_DEC "FICM PCM diagnostic fault counter decrement value" VALUE 0x5D73C SD_SLONG 0 SC_FICMM_F_DEC 0 65535 /end CHARACTERISTIC
/begin COMPU_METHOD SC_FICMM_F_DEC "FICMM_F_DEC conversion" RAT_FUNC "%10.0" "unitless" COEFFS 0 1 0 0 0 1 /end COMPU_METHOD
/begin CHARACTERISTIC FICMM_F_INC "FICM PCM diagnostic monitor fault counter increment value." VALUE 0x5D738 SD_SLONG 0 SC_FICMM_F_INC 0 65535 /end CHARACTERISTIC
/begin COMPU_METHOD SC_FICMM_F_INC "FICMM_F_INC conversion" RAT_FUNC "%10.0" "unitless" COEFFS 0 1 0 0 0 1 /end COMPU_METHOD
/begin MEASUREMENT FICMM_ORH_CNTR "FICM PCM input driver diagnostic fault counter." SLONG MC_FICMM_ORH_CNTR 0 0 0 0 ECU_ADDRESS 0x3FA510 /end MEASUREMENT
/begin COMPU_METHOD MC_FICMM_ORH_CNTR "FICMM_ORH_CNTR conversion" RAT_FUNC "%10.0" "Unitless" COEFFS 0 1 0 0 0 1 /end COMPU_METHOD
/begin MEASUREMENT FICMM_UPDATE_CNTR "FICM PCM i/p driver diagnostic monitor update counter." SLONG MC_FICMM_UPDATE_CNTR 0 0 0 0 ECU_ADDRESS 0x3FA50C /end MEASUREMENT
/begin COMPU_METHOD MC_FICMM_UPDATE_CNTR "FICMM_UPDATE_CNTR conversion" RAT_FUNC "%10.0" "Unitless" COEFFS 0 1 0 0 0 1 /end COMPU_METHOD
/begin MEASUREMENT FICM_KL_ORH_CNTR "FICM supply voltage circuit high side failure counter" SLONG MC_FICM_KL_ORH_CNTR 0 0 0 0 ECU_ADDRESS 0x3FA444 /end MEASUREMENT
/begin COMPU_METHOD MC_FICM_KL_ORH_CNTR "FICM_KL_ORH_CNTR conversion" RAT_FUNC "%10.0" "Unitless" COEFFS 0 1 0 0 0 1 /end COMPU_METHOD
/begin CHARACTERISTIC FICM_KL_ORH_DEC "FICM voltage supply circuit high side failure counter decrement value" VALUE 0x5D650 SD_SLONG 0 SC_FICM_KL_ORH_DEC 0 65535 /end CHARACTERISTIC
/begin COMPU_METHOD SC_FICM_KL_ORH_DEC "FICM_KL_ORH_DEC conversion" RAT_FUNC "%10.0" "unitless" COEFFS 0 1 0 0 0 1 /end COMPU_METHOD
/begin CHARACTERISTIC FICM_KL_ORH_INC "FICM voltage supply circuit high side failure counter increment value" VALUE 0x5D654 SD_SLONG 0 SC_FICM_KL_ORH_INC 0 65535 /end CHARACTERISTIC
/begin COMPU_METHOD SC_FICM_KL_ORH_INC "FICM_KL_ORH_INC conversion" RAT_FUNC "%10.0" "unitless" COEFFS 0 1 0 0 0 1 /end COMPU_METHOD
/begin MEASUREMENT FICM_KL_ORL_CNTR "FICM supply voltage circuit low side failure counter" SLONG MC_FICM_KL_ORL_CNTR 0 0 0 0 ECU_ADDRESS 0x3FA448 /end MEASUREMENT
/begin COMPU_METHOD MC_FICM_KL_ORL_CNTR "FICM_KL_ORL_CNTR conversion" RAT_FUNC "%10.0" "Unitless" COEFFS 0 1 0 0 0 1 /end COMPU_METHOD
/begin CHARACTERISTIC FICM_KL_ORL_DEC "FICM voltage supply circuit low side failure counter decrement value" VALUE 0x5D658 SD_SLONG 0 SC_FICM_KL_ORL_DEC 0 65535 /end CHARACTERISTIC
/begin COMPU_METHOD SC_FICM_KL_ORL_DEC "FICM_KL_ORL_DEC conversion" RAT_FUNC "%10.0" "unitless" COEFFS 0 1 0 0 0 1 /end COMPU_METHOD
/begin CHARACTERISTIC FICM_KL_ORL_INC "FICM voltage supply circuit low side failure counter increment value" VALUE 0x5D65C SD_SLONG 0 SC_FICM_KL_ORL_INC 0 65535 /end CHARACTERISTIC
/begin COMPU_METHOD SC_FICM_KL_ORL_INC "FICM_KL_ORL_INC conversion" RAT_FUNC "%10.0" "unitless" COEFFS 0 1 0 0 0 1 /end COMPU_METHOD
/begin MEASUREMENT FICM_VSS_HI_STATUS "status of FICM supply voltage circuit high side." UBYTE MC_FICM_VSS_HI_STATUS 0 0 0 0 ECU_ADDRESS 0x3FA515 /end MEASUREMENT
/begin COMPU_METHOD MC_FICM_VSS_HI_STATUS "FICM_VSS_HI_STATUS conversion" RAT_FUNC "%3.0" "Unitless" COEFFS 0 1 0 0 0 1 /end COMPU_METHOD
/begin MEASUREMENT FICM_VSS_LO_STATUS "status of FICM supply voltage circuit low side." UBYTE MC_FICM_VSS_LO_STATUS 0 0 0 0 ECU_ADDRESS 0x3FA516 /end MEASUREMENT
/begin COMPU_METHOD MC_FICM_VSS_LO_STATUS "FICM_VSS_LO_STATUS conversion" RAT_FUNC "%3.0" "Unitless" COEFFS 0 1 0 0 0 1 /end COMPU_METHOD
/begin MEASUREMENT FILT_BP_ENG_KPA "Filtered BP engineering value, kPA" FLOAT32_IEEE MC_FILT_BP_ENG_KPA 0 0 0 0 ECU_ADDRESS 0x3F9EA4 /end MEASUREMENT
/begin COMPU_METHOD MC_FILT_BP_ENG_KPA "FILT_BP_ENG_KPA conversion" RAT_FUNC "%10.5" "Unitless" COEFFS 0 1 0 0 0 1 /end COMPU_METHOD
/begin MEASUREMENT FILT_BP_KPA "Previous cycle BP" FLOAT32_IEEE MC_FILT_BP_KPA 0 0 0 0 ECU_ADDRESS 0x3FCD18 /end MEASUREMENT
/begin COMPU_METHOD MC_FILT_BP_KPA "FILT_BP_KPA conversion" RAT_FUNC "%10.5" "Unitless" COEFFS 0 1 0 0 0 1 /end COMPU_METHOD
/begin MEASUREMENT FILT_EBP "previouse cycle filtered ebp value" FLOAT32_IEEE MC_FILT_EBP 0 0 0 0 ECU_ADDRESS 0x3FCD98 /end MEASUREMENT
/begin COMPU_METHOD MC_FILT_EBP "FILT_EBP conversion" RAT_FUNC "%10.5" "Unitless" COEFFS 0 1 0 0 0 1 /end COMPU_METHOD
/begin MEASUREMENT FILT_ECT_C "previous cycle eot value" FLOAT32_IEEE MC_FILT_ECT_C 0 0 0 0 ECU_ADDRESS 0x3FCD20 /end MEASUREMENT
/begin COMPU_METHOD MC_FILT_ECT_C "FILT_ECT_C conversion" RAT_FUNC "%10.5" "Unitless" COEFFS 0 1 0 0 0 1 /end COMPU_METHOD
/begin MEASUREMENT FILT_EGRP "Previous cycle EGRP" FLOAT32_IEEE MC_FILT_EGRP 0 0 0 0 ECU_ADDRESS 0x3FCD24 /end MEASUREMENT
/begin COMPU_METHOD MC_FILT_EGRP "FILT_EGRP conversion" RAT_FUNC "%10.5" "Unitless" COEFFS 0 1 0 0 0 1 /end COMPU_METHOD
/begin MEASUREMENT FILT_EOT_C "previous cycle eot value" FLOAT32_IEEE MC_FILT_EOT_C 0 0 0 0 ECU_ADDRESS 0x3FCD1C /end MEASUREMENT
/begin COMPU_METHOD MC_FILT_EOT_C "FILT_EOT_C conversion" RAT_FUNC "%10.5" "Unitless" COEFFS 0 1 0 0 0 1 /end COMPU_METHOD
/begin MEASUREMENT FILT_IAT "Previous cycle intake air temperature" FLOAT32_IEEE MC_FILT_IAT 0 0 0 0 ECU_ADDRESS 0x3FCD94 /end MEASUREMENT
/begin COMPU_METHOD MC_FILT_IAT "FILT_IAT conversion" RAT_FUNC "%10.5" "Unitless" COEFFS 0 1 0 0 0 1 /end COMPU_METHOD
/begin MEASUREMENT FILT_ICP_MPA "previous cycle icp value" FLOAT32_IEEE MC_FILT_ICP_MPA 0 0 0 0 ECU_ADDRESS 0x3FCD38 /end MEASUREMENT
/begin COMPU_METHOD MC_FILT_ICP_MPA "FILT_ICP_MPA conversion" RAT_FUNC "%10.5" "Unitless" COEFFS 0 1 0 0 0 1 /end COMPU_METHOD
/begin MEASUREMENT FILT_ITHP "Previous cycle intake throttle position" FLOAT32_IEEE MC_FILT_ITHP 0 0 0 0 ECU_ADDRESS 0x3FCD9C /end MEASUREMENT
/begin COMPU_METHOD MC_FILT_ITHP "FILT_ITHP conversion" RAT_FUNC "%10.5" "Unitless" COEFFS 0 1 0 0 0 1 /end COMPU_METHOD
/begin MEASUREMENT FILT_IVPWR "Previous cycle System voltage" FLOAT32_IEEE MC_FILT_IVPWR 0 0 0 0 ECU_ADDRESS 0x3FCDA0 /end MEASUREMENT
/begin COMPU_METHOD MC_FILT_IVPWR "FILT_IVPWR conversion" RAT_FUNC "%10.5" "Unitless" COEFFS 0 1 0 0 0 1 /end COMPU_METHOD
/begin MEASUREMENT FILT_MAF_GMS "Previous cycle MAF in gms" FLOAT32_IEEE MC_FILT_MAF_GMS 0 0 0 0 ECU_ADDRESS 0x3FCD44 /end MEASUREMENT
/begin COMPU_METHOD MC_FILT_MAF_GMS "FILT_MAF_GMS conversion" RAT_FUNC "%10.5" "Unitless" COEFFS 0 1 0 0 0 1 /end COMPU_METHOD
/begin MEASUREMENT FILT_MAP_KPA "Previous cycle filtered MAP value" FLOAT32_IEEE MC_FILT_MAP_KPA 0 0 0 0 ECU_ADDRESS 0x3FCD48 /end MEASUREMENT
/begin COMPU_METHOD MC_FILT_MAP_KPA "FILT_MAP_KPA conversion" RAT_FUNC "%10.5" "Unitless" COEFFS 0 1 0 0 0 1 /end COMPU_METHOD
/begin MEASUREMENT FILT_MAT "Previous cycle filtered MAT value" FLOAT32_IEEE MC_FILT_MAT 0 0 0 0 ECU_ADDRESS 0x3FCD4C /end MEASUREMENT
/begin COMPU_METHOD MC_FILT_MAT "FILT_MAT conversion" RAT_FUNC "%10.5" "Unitless" COEFFS 0 1 0 0 0 1 /end COMPU_METHOD
/begin CHARACTERISTIC FIL_HYST "Hysteresis term to prevent spurious exit of Failure Mode strategy." VALUE 0x5EC28 SD_FLOAT32_IEEE 0 SC_FIL_HYST 0 0.996 /end CHARACTERISTIC
/begin COMPU_METHOD SC_FIL_HYST "FIL_HYST conversion" RAT_FUNC "%10.5" "enumerated" COEFFS 0 1 0 0 0 1 /end COMPU_METHOD
/begin MEASUREMENT FIRST_PIP "INDICATES THAT FIRST PIP HAS BEEN RECEIVED" UBYTE MC_FIRST_PIP 0 0 0 0 ECU_ADDRESS 0x3F9AC5 /end MEASUREMENT
/begin COMPU_METHOD MC_FIRST_PIP "FIRST_PIP conversion" RAT_FUNC "%3.0" "Unitless" COEFFS 0 1 0 0 0 1 /end COMPU_METHOD
/begin CHARACTERISTIC FKDNDT_TQI "Filter constant for DNDT_TQI" VALUE 0x5D8B8 SD_FLOAT32_IEEE 0 SC_FKDNDT_TQI 0 0.999985 /end CHARACTERISTIC
/begin COMPU_METHOD SC_FKDNDT_TQI "FKDNDT_TQI conversion" RAT_FUNC "%10.5" "unitless" COEFFS 0 1 0 0 0 1 /end COMPU_METHOD
/begin CHARACTERISTIC FKTQBRKS "Filter constant for TQ_BRK_SBAR" VALUE 0x5D8B4 SD_FLOAT32_IEEE 0 SC_FKTQBRKS 0 0.999985 /end CHARACTERISTIC
/begin COMPU_METHOD SC_FKTQBRKS "FKTQBRKS conversion" RAT_FUNC "%10.5" "unitless" COEFFS 0 1 0 0 0 1 /end COMPU_METHOD
/begin CHARACTERISTIC FK_IPP "FILTER CONSTANT for IPP term in ROLAV" VALUE 0x5DB84 SD_FLOAT32_IEEE 0 SC_FK_IPP 0 0.999985 /end CHARACTERISTIC
/begin COMPU_METHOD SC_FK_IPP "FK_IPP conversion" RAT_FUNC "%10.5" "unitless" COEFFS 0 1 0 0 0 1 /end COMPU_METHOD
/begin CHARACTERISTIC FK_MFREF "Filter constant for MFREF term filtering Neutral/Drive transitions" VALUE 0x5DBE4 SD_FLOAT32_IEEE 0 SC_FK_MFREF 0 0.999985 /end CHARACTERISTIC
/begin COMPU_METHOD SC_FK_MFREF "FK_MFREF conversion" RAT_FUNC "%10.5" "unitless" COEFFS 0 1 0 0 0 1 /end COMPU_METHOD
/begin CHARACTERISTIC FK_MPH_FILT "FILTER CONSTANT for MPH_FILT term in ROLAV" VALUE 0x5D14C SD_FLOAT32_IEEE 0 SC_FK_MPH_FILT 0 0.999985 /end CHARACTERISTIC
/begin COMPU_METHOD SC_FK_MPH_FILT "FK_MPH_FILT conversion" RAT_FUNC "%10.5" "unitless" COEFFS 0 1 0 0 0 1 /end COMPU_METHOD
/begin CHARACTERISTIC FK_RDSP "FILTER CONSTANT for RDSP_FILT term in ROLAV" VALUE 0x5D148 SD_FLOAT32_IEEE 0 SC_FK_RDSP 0 0.999985 /end CHARACTERISTIC
/begin COMPU_METHOD SC_FK_RDSP "FK_RDSP conversion" RAT_FUNC "%10.5" "unitless" COEFFS 0 1 0 0 0 1 /end COMPU_METHOD
/begin CHARACTERISTIC FLF_TST_SW "Mapped byte of sys_FLF_SW flag bits in the order(0..7): {cat,ccm,purg,sair,fuel,ego,egr,mis}." VALUE 0x5CE32 SD_UBYTE 0 SC_FLF_TST_SW 0 255 /end CHARACTERISTIC
/begin COMPU_METHOD SC_FLF_TST_SW "FLF_TST_SW conversion" RAT_FUNC "%3.0" "MAPPED_BYTE" COEFFS 0 1 0 0 0 1 /end COMPU_METHOD
/begin MEASUREMENT FLG4X4L "4X4 LOW FLAG" UBYTE MC_FLG4X4L 0 0 0 0 ECU_ADDRESS 0x3F9945 /end MEASUREMENT
/begin COMPU_METHOD MC_FLG4X4L "FLG4X4L conversion" RAT_FUNC "%3.0" "Unitless" COEFFS 0 1 0 0 0 1 /end COMPU_METHOD
/begin MEASUREMENT FLG_AC_HLD "Indicates that A/C and/or fans should not change state." UBYTE MC_FLG_AC_HLD 0 0 0 0 ECU_ADDRESS 0x3F9D58 /end MEASUREMENT
/begin COMPU_METHOD MC_FLG_AC_HLD "FLG_AC_HLD conversion" RAT_FUNC "%3.0" "Unitless" COEFFS 0 1 0 0 0 1 /end COMPU_METHOD
/begin MEASUREMENT FLG_CONT_MON "Flag set when continuous monitors are enabled in the OBD-II system." UBYTE MC_FLG_CONT_MON 0 0 0 0 ECU_ADDRESS 0x3F9E37 /end MEASUREMENT
/begin COMPU_METHOD MC_FLG_CONT_MON "FLG_CONT_MON conversion" RAT_FUNC "%3.0" "Unitless" COEFFS 0 1 0 0 0 1 /end COMPU_METHOD
/begin MEASUREMENT FLG_CRV_LK "SCHEDULED CURVE LOCKUP FLAG" UBYTE MC_FLG_CRV_LK 0 0 0 0 ECU_ADDRESS 0x3FA7B4 /end MEASUREMENT
/begin COMPU_METHOD MC_FLG_CRV_LK "FLG_CRV_LK conversion" RAT_FUNC "%3.0" "Unitless" COEFFS 0 1 0 0 0 1 /end COMPU_METHOD
/begin MEASUREMENT FLG_ENG_IN "ENGAGEMENT IN PROGRESS FLAG" UBYTE MC_FLG_ENG_IN 0 0 0 0 ECU_ADDRESS 0x3FA29F /end MEASUREMENT
/begin COMPU_METHOD MC_FLG_ENG_IN "FLG_ENG_IN conversion" RAT_FUNC "%3.0" "Unitless" COEFFS 0 1 0 0 0 1 /end COMPU_METHOD
/begin MEASUREMENT FLG_INHIBIT "Flag to inhibit reverse engagements" UBYTE MC_FLG_INHIBIT 0 0 0 0 ECU_ADDRESS 0x3FA7B5 /end MEASUREMENT
/begin COMPU_METHOD MC_FLG_INHIBIT "FLG_INHIBIT conversion" RAT_FUNC "%3.0" "Unitless" COEFFS 0 1 0 0 0 1 /end COMPU_METHOD
/begin MEASUREMENT FLG_MAX_LINE "" UBYTE MC_FLG_MAX_LINE 0 0 0 0 ECU_ADDRESS 0x3FB741 /end MEASUREMENT
/begin COMPU_METHOD MC_FLG_MAX_LINE "FLG_MAX_LINE conversion" RAT_FUNC "%3.0" "Unitless" COEFFS 0 1 0 0 0 1 /end COMPU_METHOD
/begin MEASUREMENT FLG_PTO_ST "PTO OPERATIONAL WHILE VEHICLE IS STATIONARY" UBYTE MC_FLG_PTO_ST 0 0 0 0 ECU_ADDRESS 0x3FB18D /end MEASUREMENT
/begin COMPU_METHOD MC_FLG_PTO_ST "FLG_PTO_ST conversion" RAT_FUNC "%3.0" "Unitless" COEFFS 0 1 0 0 0 1 /end COMPU_METHOD
/begin MEASUREMENT FLG_SFT_IN "Shift in progress flag." UBYTE MC_FLG_SFT_IN 0 0 0 0 ECU_ADDRESS 0x3FA29E /end MEASUREMENT
/begin COMPU_METHOD MC_FLG_SFT_IN "FLG_SFT_IN conversion" RAT_FUNC "%3.0" "Unitless" COEFFS 0 1 0 0 0 1 /end COMPU_METHOD
/begin MEASUREMENT FLG_STALL "Indicating that a stall has occured; transition." UBYTE MC_FLG_STALL 0 0 0 0 ECU_ADDRESS 0x3FB38A /end MEASUREMENT
/begin COMPU_METHOD MC_FLG_STALL "FLG_STALL conversion" RAT_FUNC "%3.0" "Unitless" COEFFS 0 1 0 0 0 1 /end COMPU_METHOD
/begin MEASUREMENT FLG_TCS "Transmission Control Switch Flag" UBYTE MC_FLG_TCS 0 0 0 0 ECU_ADDRESS 0x3FB65C /end MEASUREMENT
/begin COMPU_METHOD MC_FLG_TCS "FLG_TCS conversion" RAT_FUNC "%3.0" "Unitless" COEFFS 0 1 0 0 0 1 /end COMPU_METHOD
/begin MEASUREMENT FLG_THFT_FCO "Flag indicating when fuel is being cut out due to anti theft system action.  1 -> cutting out fuel." UBYTE MC_FLG_THFT_FCO 0 0 0 0 ECU_ADDRESS 0x3F9DF8 /end MEASUREMENT
/begin COMPU_METHOD MC_FLG_THFT_FCO "FLG_THFT_FCO conversion" RAT_FUNC "%3.0" "Unitless" COEFFS 0 1 0 0 0 1 /end COMPU_METHOD
/begin MEASUREMENT FLG_THFT_PCO "Flag indicating when fuel pump is being inihibited due to anti theft system action.  1 -> inhibiting fuel pump operation" UBYTE MC_FLG_THFT_PCO 0 0 0 0 ECU_ADDRESS 0x3F9DF7 /end MEASUREMENT
/begin COMPU_METHOD MC_FLG_THFT_PCO "FLG_THFT_PCO conversion" RAT_FUNC "%3.0" "Unitless" COEFFS 0 1 0 0 0 1 /end COMPU_METHOD
/begin MEASUREMENT FLICNT "Counter to track the number of FLI_ENG readings used to initialize the value of PGM_FUEL_LVL." UBYTE MC_FLICNT 0 0 0 0 ECU_ADDRESS 0x3FA00E /end MEASUREMENT
/begin COMPU_METHOD MC_FLICNT "FLICNT conversion" RAT_FUNC "%3.0" "Unitless" COEFFS 0 1 0 0 0 1 /end COMPU_METHOD
/begin MEASUREMENT FLI_1ST_PS "First pass flag of the FLI sensor FMEM test; 1 -> first pass seen." UBYTE MC_FLI_1ST_PS 0 0 0 0 ECU_ADDRESS 0x3FA014 /end MEASUREMENT
/begin COMPU_METHOD MC_FLI_1ST_PS "FLI_1ST_PS conversion" RAT_FUNC "%3.0" "Unitless" COEFFS 0 1 0 0 0 1 /end COMPU_METHOD
/begin MEASUREMENT FLI_ACCUM "Cummulative average of FLI_ENG readings used to initialize filtered fuel level, % fill." FLOAT32_IEEE MC_FLI_ACCUM 0 0 0 0 ECU_ADDRESS 0x3FA004 /end MEASUREMENT
/begin COMPU_METHOD MC_FLI_ACCUM "FLI_ACCUM conversion" RAT_FUNC "%10.5" "Unitless" COEFFS 0 1 0 0 0 1 /end COMPU_METHOD
/begin CHARACTERISTIC FLI_DTMX_CNT "Number of  noisy FLI events seen to set the fault code" VALUE 0x5D13E SD_UBYTE 0 SC_FLI_DTMX_CNT 0 255 /end CHARACTERISTIC
/begin COMPU_METHOD SC_FLI_DTMX_CNT "FLI_DTMX_CNT conversion" RAT_FUNC "%3.0" "1/event" COEFFS 0 1 0 0 0 1 /end COMPU_METHOD
/begin MEASUREMENT FLI_DTMX_CTR "Counter incremented if  Fuel Level Input is noisy" UBYTE MC_FLI_DTMX_CTR 0 0 0 0 ECU_ADDRESS 0x3FA013 /end MEASUREMENT
/begin COMPU_METHOD MC_FLI_DTMX_CTR "FLI_DTMX_CTR conversion" RAT_FUNC "%3.0" "Unitless" COEFFS 0 1 0 0 0 1 /end COMPU_METHOD
/begin CHARACTERISTIC FLI_DT_LVL "Maximum delta value above which the FLI sensor is noisy, %." VALUE 0x5D138 SD_FLOAT32_IEEE 0 SC_FLI_DT_LVL 0 1.99 /end CHARACTERISTIC
/begin COMPU_METHOD SC_FLI_DT_LVL "FLI_DT_LVL conversion" RAT_FUNC "%10.5" "%" COEFFS 0 1 0 0 0 1 /end COMPU_METHOD
/begin MEASUREMENT FLI_ENG "Fuel level in engineering units, % fill" FLOAT32_IEEE MC_FLI_ENG 0 0 0 0 ECU_ADDRESS 0x3FB764 /end MEASUREMENT
/begin COMPU_METHOD MC_FLI_ENG "FLI_ENG conversion" RAT_FUNC "%10.5" "Unitless" COEFFS 0 1 0 0 0 1 /end COMPU_METHOD
/begin MEASUREMENT FLI_ENG_LAST "Last pass value of fuel level in engineering units, % fill" FLOAT32_IEEE MC_FLI_ENG_LAST 0 0 0 0 ECU_ADDRESS 0x3F9FFC /end MEASUREMENT
/begin COMPU_METHOD MC_FLI_ENG_LAST "FLI_ENG_LAST conversion" RAT_FUNC "%10.5" "Unitless" COEFFS 0 1 0 0 0 1 /end COMPU_METHOD
/begin MEASUREMENT FLI_ENG_MN "Minimum FLI_ENG value during FLI sensor stuck test, % fill" FLOAT32_IEEE MC_FLI_ENG_MN 0 0 0 0 ECU_ADDRESS 0x3F9FF8 /end MEASUREMENT
/begin COMPU_METHOD MC_FLI_ENG_MN "FLI_ENG_MN conversion" RAT_FUNC "%10.5" "Unitless" COEFFS 0 1 0 0 0 1 /end COMPU_METHOD
/begin MEASUREMENT FLI_ENG_MX "Maximum FLI_ENG value during FLI sensor stuck test, % fill" FLOAT32_IEEE MC_FLI_ENG_MX 0 0 0 0 ECU_ADDRESS 0x3F9FF4 /end MEASUREMENT
/begin COMPU_METHOD MC_FLI_ENG_MX "FLI_ENG_MX conversion" RAT_FUNC "%10.5" "Unitless" COEFFS 0 1 0 0 0 1 /end COMPU_METHOD
/begin MEASUREMENT FLI_ERR_TIM "Time required with failure present to set code, SECONDS." FLOAT32_IEEE MC_FLI_ERR_TIM 0 0 0 0 ECU_ADDRESS 0x3F9FEC /end MEASUREMENT
/begin COMPU_METHOD MC_FLI_ERR_TIM "FLI_ERR_TIM conversion" RAT_FUNC "%10.5" "Unitless" COEFFS 0 1 0 0 0 1 /end COMPU_METHOD
/begin CHARACTERISTIC FLI_ER_TM "Time required with failure present to set code, SECONDS." VALUE 0x5D134 SD_FLOAT32_IEEE 0 SC_FLI_ER_TM 0 63.99 /end CHARACTERISTIC
/begin COMPU_METHOD SC_FLI_ER_TM "FLI_ER_TM conversion" RAT_FUNC "%10.5" "s" COEFFS 0 1 0 0 0 1 /end COMPU_METHOD
/begin CHARACTERISTIC FLI_ER_TM2 "Time required with failure present to set code during on-demand engine off or running test, SECONDS." VALUE 0x5D130 SD_FLOAT32_IEEE 0 SC_FLI_ER_TM2 0 63.99 /end CHARACTERISTIC
/begin COMPU_METHOD SC_FLI_ER_TM2 "FLI_ER_TM2 conversion" RAT_FUNC "%10.5" "s" COEFFS 0 1 0 0 0 1 /end COMPU_METHOD
/begin MEASUREMENT FLI_ER_TMR "Timer that increments when an FLI sensor fault is present, SECONDS." FLOAT32_IEEE MC_FLI_ER_TMR 0 0 0 0 ECU_ADDRESS 0x3F9FF0 /end MEASUREMENT
/begin COMPU_METHOD MC_FLI_ER_TMR "FLI_ER_TMR conversion" RAT_FUNC "%10.5" "Unitless" COEFFS 0 1 0 0 0 1 /end COMPU_METHOD
/begin CHARACTERISTIC FLI_FM_TM "Minimum time in FMEM mode once initiated, SECONDS." VALUE 0x5D12C SD_FLOAT32_IEEE 0 SC_FLI_FM_TM 0 63.99 /end CHARACTERISTIC
/begin COMPU_METHOD SC_FLI_FM_TM "FLI_FM_TM conversion" RAT_FUNC "%10.5" "s" COEFFS 0 1 0 0 0 1 /end COMPU_METHOD
/begin MEASUREMENT FLI_FM_TMR "Timer that is cleared during an FLI sensor FMEM condition, SECONDS." FLOAT32_IEEE MC_FLI_FM_TMR 0 0 0 0 ECU_ADDRESS 0x3F9FE8 /end MEASUREMENT
/begin COMPU_METHOD MC_FLI_FM_TMR "FLI_FM_TMR conversion" RAT_FUNC "%10.5" "Unitless" COEFFS 0 1 0 0 0 1 /end COMPU_METHOD
/begin MEASUREMENT FLI_KAMN "Minimum fuel level, stored in KAM, during FLI sensor FMEM test, % fill" FLOAT32_IEEE MC_FLI_KAMN 0 0 0 0 ECU_ADDRESS 0x3FCD30 /end MEASUREMENT
/begin COMPU_METHOD MC_FLI_KAMN "FLI_KAMN conversion" RAT_FUNC "%10.5" "Unitless" COEFFS 0 1 0 0 0 1 /end COMPU_METHOD
/begin MEASUREMENT FLI_KAM_TMR "Cummulative time, stored in KAM, that FLI sensor has not moved within a specified tolerance band, sec." FLOAT32_IEEE MC_FLI_KAM_TMR 0 0 0 0 ECU_ADDRESS 0x3FCD34 /end MEASUREMENT
/begin COMPU_METHOD MC_FLI_KAM_TMR "FLI_KAM_TMR conversion" RAT_FUNC "%10.5" "Unitless" COEFFS 0 1 0 0 0 1 /end COMPU_METHOD
/begin CHARACTERISTIC FLI_MON_TM "Time required to indicate that a ""trip"" is complete for this sensor, SECONDS." VALUE 0x5D128 SD_FLOAT32_IEEE 0 SC_FLI_MON_TM 0 63.99 /end CHARACTERISTIC
/begin COMPU_METHOD SC_FLI_MON_TM "FLI_MON_TM conversion" RAT_FUNC "%10.5" "s" COEFFS 0 1 0 0 0 1 /end COMPU_METHOD
/begin MEASUREMENT FLI_REFUEL "Fuel level refuel event flag; 1 -> refuel event occurred." UBYTE MC_FLI_REFUEL 0 0 0 0 ECU_ADDRESS 0x3FA012 /end MEASUREMENT
/begin COMPU_METHOD MC_FLI_REFUEL "FLI_REFUEL conversion" RAT_FUNC "%3.0" "Unitless" COEFFS 0 1 0 0 0 1 /end COMPU_METHOD
/begin MEASUREMENT FLI_RFUL_CHK "Fuel level refuel event check flag; 1 -> checked for refuel event occurred." UBYTE MC_FLI_RFUL_CHK 0 0 0 0 ECU_ADDRESS 0x3FA011 /end MEASUREMENT
/begin COMPU_METHOD MC_FLI_RFUL_CHK "FLI_RFUL_CHK conversion" RAT_FUNC "%3.0" "Unitless" COEFFS 0 1 0 0 0 1 /end COMPU_METHOD
/begin CHARACTERISTIC FLI_RFUL_LIM "Fuel level change limit above which a refuel event is indicated." VALUE 0x5D124 SD_FLOAT32_IEEE 0 SC_FLI_RFUL_LIM 0 1.99 /end CHARACTERISTIC
/begin COMPU_METHOD SC_FLI_RFUL_LIM "FLI_RFUL_LIM conversion" RAT_FUNC "%10.5" "%" COEFFS 0 1 0 0 0 1 /end COMPU_METHOD
/begin CHARACTERISTIC FLI_SMPL_TM "Time delay between FLI_ENG readings used to initialize PGM_FUEL_LVL, seconds." VALUE 0x5D120 SD_FLOAT32_IEEE 0 SC_FLI_SMPL_TM 0 63.99 /end CHARACTERISTIC
/begin COMPU_METHOD SC_FLI_SMPL_TM "FLI_SMPL_TM conversion" RAT_FUNC "%10.5" "s" COEFFS 0 1 0 0 0 1 /end COMPU_METHOD
/begin MEASUREMENT FLI_SMPL_TMR "Timer that decrements between FLI_ENG readings when initializing PGM_FUEL_LVL, seconds." FLOAT32_IEEE MC_FLI_SMPL_TMR 0 0 0 0 ECU_ADDRESS 0x3F9FE4 /end MEASUREMENT
/begin COMPU_METHOD MC_FLI_SMPL_TMR "FLI_SMPL_TMR conversion" RAT_FUNC "%10.5" "Unitless" COEFFS 0 1 0 0 0 1 /end COMPU_METHOD
/begin MEASUREMENT FLI_STATUS "Status of Fuel Level Input from the high level input driver; 0=ok, 1=under voltage, 2=over voltage" UBYTE MC_FLI_STATUS 0 0 0 0 ECU_ADDRESS 0x3F9948 /end MEASUREMENT
/begin COMPU_METHOD MC_FLI_STATUS "FLI_STATUS conversion" RAT_FUNC "%3.0" "Unitless" COEFFS 0 1 0 0 0 1 /end COMPU_METHOD
/begin MEASUREMENT FLI_STK_DN "Fuel level sensor stuck check complete flag; 1 -> stuck check complete." UBYTE MC_FLI_STK_DN 0 0 0 0 ECU_ADDRESS 0x3FA010 /end MEASUREMENT
/begin COMPU_METHOD MC_FLI_STK_DN "FLI_STK_DN conversion" RAT_FUNC "%3.0" "Unitless" COEFFS 0 1 0 0 0 1 /end COMPU_METHOD
/begin CHARACTERISTIC FLI_STK_LDMN "Minimum LOAD to perform FLI sensor ""stuck"" check." VALUE 0x5D11C SD_FLOAT32_IEEE 0 SC_FLI_STK_LDMN 0 1 /end CHARACTERISTIC
/begin COMPU_METHOD SC_FLI_STK_LDMN "FLI_STK_LDMN conversion" RAT_FUNC "%10.5" "UNITLESS" COEFFS 0 1 0 0 0 1 /end COMPU_METHOD
/begin CHARACTERISTIC FLI_STK_TM "Maximum time allowed for movement of FLI sensor before malfunction is indicated, SECONDS." VALUE 0x5D110 SD_FLOAT32_IEEE 0 SC_FLI_STK_TM 0 65535 /end CHARACTERISTIC
/begin COMPU_METHOD SC_FLI_STK_TM "FLI_STK_TM conversion" RAT_FUNC "%10.5" "s" COEFFS 0 1 0 0 0 1 /end COMPU_METHOD
/begin MEASUREMENT FLI_STK_TMR "Amount of time filtered fuel level has not moved within a specified tolerance band, SECONDS." FLOAT32_IEEE MC_FLI_STK_TMR 0 0 0 0 ECU_ADDRESS 0x3F9FE0 /end MEASUREMENT
/begin COMPU_METHOD MC_FLI_STK_TMR "FLI_STK_TMR conversion" RAT_FUNC "%10.5" "Unitless" COEFFS 0 1 0 0 0 1 /end COMPU_METHOD
/begin CHARACTERISTIC FLI_STK_TOL "Tolerance band within which FLI sensor is considered stuck, % fill" VALUE 0x5D118 SD_FLOAT32_IEEE 0 SC_FLI_STK_TOL 0 1.99 /end CHARACTERISTIC
/begin COMPU_METHOD SC_FLI_STK_TOL "FLI_STK_TOL conversion" RAT_FUNC "%10.5" "%" COEFFS 0 1 0 0 0 1 /end COMPU_METHOD
/begin CHARACTERISTIC FLI_STK_VSMN "Minimum VSBAR to perform FLI sensor ""stuck"" check, MPH." VALUE 0x5D114 SD_FLOAT32_IEEE 0 SC_FLI_STK_VSMN 0 127.5 /end CHARACTERISTIC
/begin COMPU_METHOD SC_FLI_STK_VSMN "FLI_STK_VSMN conversion" RAT_FUNC "%10.5" "MPH" COEFFS 0 1 0 0 0 1 /end COMPU_METHOD
/begin MEASUREMENT FLI_STUCK "Fuel level sensor stuck flag; 1 -> sensor is stuck." UBYTE MC_FLI_STUCK 0 0 0 0 ECU_ADDRESS 0x3FA00F /end MEASUREMENT
/begin COMPU_METHOD MC_FLI_STUCK "FLI_STUCK conversion" RAT_FUNC "%3.0" "Unitless" COEFFS 0 1 0 0 0 1 /end COMPU_METHOD
/begin MEASUREMENT FLI_VOLT_PID "Fuel level input voltage, created for PID interface" FLOAT32_IEEE MC_FLI_VOLT_PID 0 0 0 0 ECU_ADDRESS 0x3FA438 /end MEASUREMENT
/begin COMPU_METHOD MC_FLI_VOLT_PID "FLI_VOLT_PID conversion" RAT_FUNC "%10.5" "Unitless" COEFFS 0 1 0 0 0 1 /end COMPU_METHOD
/begin MEASUREMENT FLOW_TST_PRG "Flow test in progress flag - EGR OBDII" UBYTE MC_FLOW_TST_PRG 0 0 0 0 ECU_ADDRESS 0x3F9CE5 /end MEASUREMENT
/begin COMPU_METHOD MC_FLOW_TST_PRG "FLOW_TST_PRG conversion" RAT_FUNC "%3.0" "Unitless" COEFFS 0 1 0 0 0 1 /end COMPU_METHOD
/begin CHARACTERISTIC FM_EGR_SEL "" VALUE 0x5E611 SD_UBYTE 0 SC_FM_EGR_SEL 0 1 /end CHARACTERISTIC
/begin COMPU_METHOD SC_FM_EGR_SEL "FM_EGR_SEL conversion" RAT_FUNC "%3.0" "unitless" COEFFS 0 1 0 0 0 1 /end COMPU_METHOD
/begin CHARACTERISTIC FN011DS_A "Engine speed normalization function" CURVE 0x4B12C FD_FLOAT32_IEEE 0 FCY_FN011DS_A 0 13 /begin AXIS_DESCR STD_AXIS N FCX_FN011DS_A 14 0 5000 /end AXIS_DESCR /end CHARACTERISTIC
/begin COMPU_METHOD FCX_FN011DS_A "FN011DS_A X-axis conversion" RAT_FUNC "%10.5" "RPM" COEFFS 0 1 0 0 0 1 /end COMPU_METHOD
/begin COMPU_METHOD FCY_FN011DS_A "FN011DS_A Y-axis conversion" RAT_FUNC "%10.5" "unitless" COEFFS 0 1 0 0 0 1 /end COMPU_METHOD
/begin CHARACTERISTIC FN011P_A "Engine speed normalization function" CURVE 0x4B19C FD_FLOAT32_IEEE 0 FCY_FN011P_A 0 13 /begin AXIS_DESCR STD_AXIS N FCX_FN011P_A 14 0 5000 /end AXIS_DESCR /end CHARACTERISTIC
/begin COMPU_METHOD FCX_FN011P_A "FN011P_A X-axis conversion" RAT_FUNC "%10.5" "RPM" COEFFS 0 1 0 0 0 1 /end COMPU_METHOD
/begin COMPU_METHOD FCY_FN011P_A "FN011P_A Y-axis conversion" RAT_FUNC "%10.5" "unitless" COEFFS 0 1 0 0 0 1 /end COMPU_METHOD
/begin CHARACTERISTIC FN012DS_A "" CURVE 0x465CC FD_FLOAT32_IEEE 0 FCY_FN012DS_A 0 13 /begin AXIS_DESCR STD_AXIS N FCX_FN012DS_A 14 0 5000 /end AXIS_DESCR /end CHARACTERISTIC
/begin COMPU_METHOD FCX_FN012DS_A "FN012DS_A X-axis conversion" RAT_FUNC "%10.5" "RPM" COEFFS 0 1 0 0 0 1 /end COMPU_METHOD
/begin COMPU_METHOD FCY_FN012DS_A "FN012DS_A Y-axis conversion" RAT_FUNC "%10.5" "unitless" COEFFS 0 1 0 0 0 1 /end COMPU_METHOD
/begin CHARACTERISTIC FN012P_B "" CURVE 0x4663C FD_FLOAT32_IEEE 0 FCY_FN012P_B 0 13 /begin AXIS_DESCR STD_AXIS N FCX_FN012P_B 10 0 5000 /end AXIS_DESCR /end CHARACTERISTIC
/begin COMPU_METHOD FCX_FN012P_B "FN012P_B X-axis conversion" RAT_FUNC "%10.5" "RPM" COEFFS 0 1 0 0 0 1 /end COMPU_METHOD
/begin COMPU_METHOD FCY_FN012P_B "FN012P_B Y-axis conversion" RAT_FUNC "%10.5" "unitless" COEFFS 0 1 0 0 0 1 /end COMPU_METHOD
/begin CHARACTERISTIC FN013DS_A "Normalized mass fuel desired (mg/stroke)" CURVE 0x48A1C FD_FLOAT32_IEEE 0 FCY_FN013DS_A 0 13 /begin AXIS_DESCR STD_AXIS MFDES FCX_FN013DS_A 14 0 120 /end AXIS_DESCR /end CHARACTERISTIC
/begin COMPU_METHOD FCX_FN013DS_A "FN013DS_A X-axis conversion" RAT_FUNC "%10.5" "unitless" COEFFS 0 1 0 0 0 1 /end COMPU_METHOD
/begin COMPU_METHOD FCY_FN013DS_A "FN013DS_A Y-axis conversion" RAT_FUNC "%10.5" "unitless" COEFFS 0 1 0 0 0 1 /end COMPU_METHOD
/begin CHARACTERISTIC FN014DS "Engine speed normalization for torque limited fuel table" CURVE 0x4622C FD_FLOAT32_IEEE 0 FCY_FN014DS 0 13 /begin AXIS_DESCR STD_AXIS N FCX_FN014DS 14 0 5000 /end AXIS_DESCR /end CHARACTERISTIC
/begin COMPU_METHOD FCX_FN014DS "FN014DS X-axis conversion" RAT_FUNC "%10.5" "RPM" COEFFS 0 1 0 0 0 1 /end COMPU_METHOD
/begin COMPU_METHOD FCY_FN014DS "FN014DS Y-axis conversion" RAT_FUNC "%10.5" "unitless" COEFFS 0 1 0 0 0 1 /end COMPU_METHOD
/begin CHARACTERISTIC FN014P "Engine speed normalization for torque limited fuel table" CURVE 0x4637C FD_FLOAT32_IEEE 0 FCY_FN014P 0 13 /begin AXIS_DESCR STD_AXIS N FCX_FN014P 14 0 5000 /end AXIS_DESCR /end CHARACTERISTIC
/begin COMPU_METHOD FCX_FN014P "FN014P X-axis conversion" RAT_FUNC "%10.5" "RPM" COEFFS 0 1 0 0 0 1 /end COMPU_METHOD
/begin COMPU_METHOD FCY_FN014P "FN014P Y-axis conversion" RAT_FUNC "%10.5" "unitless" COEFFS 0 1 0 0 0 1 /end COMPU_METHOD
/begin CHARACTERISTIC FN015DS_ECT_C_A "" CURVE 0x4629C FD_FLOAT32_IEEE 0 FCY_FN015DS_ECT_C_A 0 13 /begin AXIS_DESCR STD_AXIS ECT_C FCX_FN015DS_ECT_C_A 14 -40 1000 /end AXIS_DESCR /end CHARACTERISTIC
/begin COMPU_METHOD FCX_FN015DS_ECT_C_A "FN015DS_ECT_C_A X-axis conversion" RAT_FUNC "%10.5" "degC" COEFFS 0 1 0 0 0 1 /end COMPU_METHOD
/begin COMPU_METHOD FCY_FN015DS_ECT_C_A "FN015DS_ECT_C_A Y-axis conversion" RAT_FUNC "%10.5" "unitless" COEFFS 0 1 0 0 0 1 /end COMPU_METHOD
/begin CHARACTERISTIC FN015DS_EOT_C_A "" CURVE 0x4630C FD_FLOAT32_IEEE 0 FCY_FN015DS_EOT_C_A 0 13 /begin AXIS_DESCR STD_AXIS EOT_C FCX_FN015DS_EOT_C_A 14 -200 1000 /end AXIS_DESCR /end CHARACTERISTIC
/begin COMPU_METHOD FCX_FN015DS_EOT_C_A "FN015DS_EOT_C_A X-axis conversion" RAT_FUNC "%10.5" "degC" COEFFS 0 1 0 0 0 1 /end COMPU_METHOD
/begin COMPU_METHOD FCY_FN015DS_EOT_C_A "FN015DS_EOT_C_A Y-axis conversion" RAT_FUNC "%10.5" "unitless" COEFFS 0 1 0 0 0 1 /end COMPU_METHOD
/begin CHARACTERISTIC FN015P_ECT_C_A "" CURVE 0x463EC FD_FLOAT32_IEEE 0 FCY_FN015P_ECT_C_A 0 13 /begin AXIS_DESCR STD_AXIS ECT_C FCX_FN015P_ECT_C_A 14 -200 1000 /end AXIS_DESCR /end CHARACTERISTIC
/begin COMPU_METHOD FCX_FN015P_ECT_C_A "FN015P_ECT_C_A X-axis conversion" RAT_FUNC "%10.5" "degC" COEFFS 0 1 0 0 0 1 /end COMPU_METHOD
/begin COMPU_METHOD FCY_FN015P_ECT_C_A "FN015P_ECT_C_A Y-axis conversion" RAT_FUNC "%10.5" "unitless" COEFFS 0 1 0 0 0 1 /end COMPU_METHOD
/begin CHARACTERISTIC FN015P_EOT_C_A "" CURVE 0x4645C FD_FLOAT32_IEEE 0 FCY_FN015P_EOT_C_A 0 13 /begin AXIS_DESCR STD_AXIS EOT_C FCX_FN015P_EOT_C_A 14 -200 1000 /end AXIS_DESCR /end CHARACTERISTIC
/begin COMPU_METHOD FCX_FN015P_EOT_C_A "FN015P_EOT_C_A X-axis conversion" RAT_FUNC "%10.5" "degC" COEFFS 0 1 0 0 0 1 /end COMPU_METHOD
/begin COMPU_METHOD FCY_FN015P_EOT_C_A "FN015P_EOT_C_A Y-axis conversion" RAT_FUNC "%10.5" "unitless" COEFFS 0 1 0 0 0 1 /end COMPU_METHOD
/begin CHARACTERISTIC FN019DS "Normalized engine speed (RPM)" CURVE 0x48AFC FD_FLOAT32_IEEE 0 FCY_FN019DS 0 10 /begin AXIS_DESCR STD_AXIS N FCX_FN019DS 12 0 5000 /end AXIS_DESCR /end CHARACTERISTIC
/begin COMPU_METHOD FCX_FN019DS "FN019DS X-axis conversion" RAT_FUNC "%10.5" "unitless" COEFFS 0 1 0 0 0 1 /end COMPU_METHOD
/begin COMPU_METHOD FCY_FN019DS "FN019DS Y-axis conversion" RAT_FUNC "%10.5" "unitless" COEFFS 0 1 0 0 0 1 /end COMPU_METHOD
/begin CHARACTERISTIC FN019DS_A "Normalized engine speed (RPM)" CURVE 0x48A8C FD_FLOAT32_IEEE 0 FCY_FN019DS_A 0 13 /begin AXIS_DESCR STD_AXIS N FCX_FN019DS_A 14 0 5000 /end AXIS_DESCR /end CHARACTERISTIC
/begin COMPU_METHOD FCX_FN019DS_A "FN019DS_A X-axis conversion" RAT_FUNC "%10.5" "unitless" COEFFS 0 1 0 0 0 1 /end COMPU_METHOD
/begin COMPU_METHOD FCY_FN019DS_A "FN019DS_A Y-axis conversion" RAT_FUNC "%10.5" "unitless" COEFFS 0 1 0 0 0 1 /end COMPU_METHOD
/begin CHARACTERISTIC FN021DS "Engine Speed (n) normalization function" CURVE 0x44E6C FD_FLOAT32_IEEE 0 FCY_FN021DS 0 13 /begin AXIS_DESCR STD_AXIS N FCX_FN021DS 14 0 5000 /end AXIS_DESCR /end CHARACTERISTIC
/begin COMPU_METHOD FCX_FN021DS "FN021DS X-axis conversion" RAT_FUNC "%10.5" "RPM" COEFFS 0 1 0 0 0 1 /end COMPU_METHOD
/begin COMPU_METHOD FCY_FN021DS "FN021DS Y-axis conversion" RAT_FUNC "%10.5" "unitless" COEFFS 0 1 0 0 0 1 /end COMPU_METHOD
/begin CHARACTERISTIC FN021P "Engine Speed (n) normalization function" CURVE 0x44F4C FD_FLOAT32_IEEE 0 FCY_FN021P 0 13 /begin AXIS_DESCR STD_AXIS N FCX_FN021P 14 0 5000 /end AXIS_DESCR /end CHARACTERISTIC
/begin COMPU_METHOD FCX_FN021P "FN021P X-axis conversion" RAT_FUNC "%10.5" "RPM" COEFFS 0 1 0 0 0 1 /end COMPU_METHOD
/begin COMPU_METHOD FCY_FN021P "FN021P Y-axis conversion" RAT_FUNC "%10.5" "unitless" COEFFS 0 1 0 0 0 1 /end COMPU_METHOD
/begin CHARACTERISTIC FN021_IPP "Engine Speed (n) normalization function for IPP" CURVE 0x45584 FD_FLOAT32_IEEE 0 FCY_FN021_IPP 0 13 /begin AXIS_DESCR STD_AXIS N FCX_FN021_IPP 14 0 5000 /end AXIS_DESCR /end CHARACTERISTIC
/begin COMPU_METHOD FCX_FN021_IPP "FN021_IPP X-axis conversion" RAT_FUNC "%10.5" "RPM" COEFFS 0 1 0 0 0 1 /end COMPU_METHOD
/begin COMPU_METHOD FCY_FN021_IPP "FN021_IPP Y-axis conversion" RAT_FUNC "%10.5" "unitless" COEFFS 0 1 0 0 0 1 /end COMPU_METHOD
/begin CHARACTERISTIC FN022DS "EOT normalization function for GPC" CURVE 0x52F74 FD_FLOAT32_IEEE 0 FCY_FN022DS 0 10 /begin AXIS_DESCR STD_AXIS EOT_C FCX_FN022DS 12 -40 150 /end AXIS_DESCR /end CHARACTERISTIC
/begin COMPU_METHOD FCX_FN022DS "FN022DS X-axis conversion" RAT_FUNC "%10.5" "degC" COEFFS 0 1 0 0 0 1 /end COMPU_METHOD
/begin COMPU_METHOD FCY_FN022DS "FN022DS Y-axis conversion" RAT_FUNC "%10.5" "unitless" COEFFS 0 1 0 0 0 1 /end COMPU_METHOD
/begin CHARACTERISTIC FN023DS "IVPWR normalization function for GPC" CURVE 0x52FD4 FD_FLOAT32_IEEE 0 FCY_FN023DS 0 5 /begin AXIS_DESCR STD_AXIS IVPWR FCX_FN023DS 8 6 25.2 /end AXIS_DESCR /end CHARACTERISTIC
/begin COMPU_METHOD FCX_FN023DS "FN023DS X-axis conversion" RAT_FUNC "%10.5" "V" COEFFS 0 1 0 0 0 1 /end COMPU_METHOD
/begin COMPU_METHOD FCY_FN023DS "FN023DS Y-axis conversion" RAT_FUNC "%10.5" "unitless" COEFFS 0 1 0 0 0 1 /end COMPU_METHOD
/begin CHARACTERISTIC FN028_IPP "mfgov normalization function for IPP" CURVE 0x45514 FD_FLOAT32_IEEE 0 FCY_FN028_IPP 0 13 /begin AXIS_DESCR STD_AXIS MFGOV FCX_FN028_IPP 14 0 160 /end AXIS_DESCR /end CHARACTERISTIC
/begin COMPU_METHOD FCX_FN028_IPP "FN028_IPP X-axis conversion" RAT_FUNC "%10.5" "unitless" COEFFS 0 1 0 0 0 1 /end COMPU_METHOD
/begin COMPU_METHOD FCY_FN028_IPP "FN028_IPP Y-axis conversion" RAT_FUNC "%10.5" "unitless" COEFFS 0 1 0 0 0 1 /end COMPU_METHOD
/begin CHARACTERISTIC FN030DS_A "" CURVE 0x4668C FD_FLOAT32_IEEE 0 FCY_FN030DS_A 0 13 /begin AXIS_DESCR STD_AXIS MGP FCX_FN030DS_A 14 0 1000 /end AXIS_DESCR /end CHARACTERISTIC
/begin COMPU_METHOD FCX_FN030DS_A "FN030DS_A X-axis conversion" RAT_FUNC "%10.5" "kPa" COEFFS 0 1 0 0 0 1 /end COMPU_METHOD
/begin COMPU_METHOD FCY_FN030DS_A "FN030DS_A Y-axis conversion" RAT_FUNC "%10.5" "unitless" COEFFS 0 1 0 0 0 1 /end COMPU_METHOD
/begin CHARACTERISTIC FN030P_B "" CURVE 0x466FC FD_FLOAT32_IEEE 0 FCY_FN030P_B 0 13 /begin AXIS_DESCR STD_AXIS MGP FCX_FN030P_B 10 0 1000 /end AXIS_DESCR /end CHARACTERISTIC
/begin COMPU_METHOD FCX_FN030P_B "FN030P_B X-axis conversion" RAT_FUNC "%10.5" "kPa" COEFFS 0 1 0 0 0 1 /end COMPU_METHOD
/begin COMPU_METHOD FCY_FN030P_B "FN030P_B Y-axis conversion" RAT_FUNC "%10.5" "unitless" COEFFS 0 1 0 0 0 1 /end COMPU_METHOD
/begin CHARACTERISTIC FN031DS_A "Normalize mass fuel quantity for ICPDES table lookup" CURVE 0x4B20C FD_FLOAT32_IEEE 0 FCY_FN031DS_A 0 13 /begin AXIS_DESCR STD_AXIS MFDES FCX_FN031DS_A 14 0 255.996 /end AXIS_DESCR /end CHARACTERISTIC
/begin COMPU_METHOD FCX_FN031DS_A "FN031DS_A X-axis conversion" RAT_FUNC "%10.5" "unitless" COEFFS 0 1 0 0 0 1 /end COMPU_METHOD
/begin COMPU_METHOD FCY_FN031DS_A "FN031DS_A Y-axis conversion" RAT_FUNC "%10.5" "unitless" COEFFS 0 1 0 0 0 1 /end COMPU_METHOD
/begin CHARACTERISTIC FN031P_A "Normalize mass fuel quantity for ICPDES table lookup" CURVE 0x4B27C FD_FLOAT32_IEEE 0 FCY_FN031P_A 0 13 /begin AXIS_DESCR STD_AXIS MFDES FCX_FN031P_A 14 0 255.996 /end AXIS_DESCR /end CHARACTERISTIC
/begin COMPU_METHOD FCX_FN031P_A "FN031P_A X-axis conversion" RAT_FUNC "%10.5" "unitless" COEFFS 0 1 0 0 0 1 /end COMPU_METHOD
/begin COMPU_METHOD FCY_FN031P_A "FN031P_A Y-axis conversion" RAT_FUNC "%10.5" "unitless" COEFFS 0 1 0 0 0 1 /end COMPU_METHOD
/begin CHARACTERISTIC FN032DS "Normalized Engine Oil Temperature (EOT degrees C)" CURVE 0x48B9C FD_FLOAT32_IEEE 0 FCY_FN032DS 0 7 /begin AXIS_DESCR STD_AXIS EOT_C FCX_FN032DS 8 -40 150 /end AXIS_DESCR /end CHARACTERISTIC
/begin COMPU_METHOD FCX_FN032DS "FN032DS X-axis conversion" RAT_FUNC "%10.5" "unitless" COEFFS 0 1 0 0 0 1 /end COMPU_METHOD
/begin COMPU_METHOD FCY_FN032DS "FN032DS Y-axis conversion" RAT_FUNC "%10.5" "unitless" COEFFS 0 1 0 0 0 1 /end COMPU_METHOD
/begin CHARACTERISTIC FN033DS "" CURVE 0x48B5C FD_FLOAT32_IEEE 0 FCY_FN033DS 0 6 /begin AXIS_DESCR STD_AXIS N FCX_FN033DS 8 0 5000 /end AXIS_DESCR /end CHARACTERISTIC
/begin COMPU_METHOD FCX_FN033DS "FN033DS X-axis conversion" RAT_FUNC "%10.5" "unitless" COEFFS 0 1 0 0 0 1 /end COMPU_METHOD
/begin COMPU_METHOD FCY_FN033DS "FN033DS Y-axis conversion" RAT_FUNC "%10.5" "unitless" COEFFS 0 1 0 0 0 1 /end COMPU_METHOD
/begin CHARACTERISTIC FN034MIS "Load normalizing function for misfire, supports a misfire bypass table with 8 Load breakpoints." CURVE 0x59D4C FD_FLOAT32_IEEE 0 FCY_FN034MIS 0 7 /begin AXIS_DESCR STD_AXIS LOAD FCX_FN034MIS 8 0 1.99997 /end AXIS_DESCR /end CHARACTERISTIC
/begin COMPU_METHOD FCX_FN034MIS "FN034MIS X-axis conversion" RAT_FUNC "%10.5" "%" COEFFS 0 1 0 0 0 1 /end COMPU_METHOD
/begin COMPU_METHOD FCY_FN034MIS "FN034MIS Y-axis conversion" RAT_FUNC "%10.5" "normalised" COEFFS 0 1 0 0 0 1 /end COMPU_METHOD
/begin CHARACTERISTIC FN035DS "Drive-By-Wire Pedal normalization function" CURVE 0x44EDC FD_FLOAT32_IEEE 0 FCY_FN035DS 0 13 /begin AXIS_DESCR STD_AXIS PPS FCX_FN035DS 14 0 1023 /end AXIS_DESCR /end CHARACTERISTIC
/begin COMPU_METHOD FCX_FN035DS "FN035DS X-axis conversion" RAT_FUNC "%10.5" "ADct" COEFFS 0 1 0 0 0 1 /end COMPU_METHOD
/begin COMPU_METHOD FCY_FN035DS "FN035DS Y-axis conversion" RAT_FUNC "%10.5" "unitless" COEFFS 0 1 0 0 0 1 /end COMPU_METHOD
/begin CHARACTERISTIC FN035P "Drive-By-Wire Pedal normalization function" CURVE 0x44FBC FD_FLOAT32_IEEE 0 FCY_FN035P 0 13 /begin AXIS_DESCR STD_AXIS PPS FCX_FN035P 14 0 1023 /end AXIS_DESCR /end CHARACTERISTIC
/begin COMPU_METHOD FCX_FN035P "FN035P X-axis conversion" RAT_FUNC "%10.5" "ADct" COEFFS 0 1 0 0 0 1 /end COMPU_METHOD
/begin COMPU_METHOD FCY_FN035P "FN035P Y-axis conversion" RAT_FUNC "%10.5" "unitless" COEFFS 0 1 0 0 0 1 /end COMPU_METHOD
/begin CHARACTERISTIC FN040DS_KDSH "" CURVE 0x4B2EC FD_FLOAT32_IEEE 0 FCY_FN040DS_KDSH 0 15 /begin AXIS_DESCR STD_AXIS N FCX_FN040DS_KDSH 14 0 5500 /end AXIS_DESCR /end CHARACTERISTIC
/begin COMPU_METHOD FCX_FN040DS_KDSH "FN040DS_KDSH X-axis conversion" RAT_FUNC "%10.5" "unitless" COEFFS 0 1 0 0 0 1 /end COMPU_METHOD
/begin COMPU_METHOD FCY_FN040DS_KDSH "FN040DS_KDSH Y-axis conversion" RAT_FUNC "%10.5" "unitless" COEFFS 0 1 0 0 0 1 /end COMPU_METHOD
/begin CHARACTERISTIC FN041DS_KDSH "" CURVE 0x4B35C FD_FLOAT32_IEEE 0 FCY_FN041DS_KDSH 0 15 /begin AXIS_DESCR STD_AXIS MFDES FCX_FN041DS_KDSH 14 0 350 /end AXIS_DESCR /end CHARACTERISTIC
/begin COMPU_METHOD FCX_FN041DS_KDSH "FN041DS_KDSH X-axis conversion" RAT_FUNC "%10.5" "unitless" COEFFS 0 1 0 0 0 1 /end COMPU_METHOD
/begin COMPU_METHOD FCY_FN041DS_KDSH "FN041DS_KDSH Y-axis conversion" RAT_FUNC "%10.5" "unitless" COEFFS 0 1 0 0 0 1 /end COMPU_METHOD
/begin CHARACTERISTIC FN046DS "IPR_FLOW normalization for ICP feed forward term" CURVE 0x4B3CC FD_FLOAT32_IEEE 0 FCY_FN046DS 0 10 /begin AXIS_DESCR STD_AXIS IPR_FLOW FCX_FN046DS 11 0 50 /end AXIS_DESCR /end CHARACTERISTIC
/begin COMPU_METHOD FCX_FN046DS "FN046DS X-axis conversion" RAT_FUNC "%10.5" "L/min" COEFFS 0 1 0 0 0 1 /end COMPU_METHOD
/begin COMPU_METHOD FCY_FN046DS "FN046DS Y-axis conversion" RAT_FUNC "%10.5" "unitless" COEFFS 0 1 0 0 0 1 /end COMPU_METHOD
/begin CHARACTERISTIC FN047DS "ICP_DES normalization for ICP feed forward term" CURVE 0x4B424 FD_FLOAT32_IEEE 0 FCY_FN047DS 0 10 /begin AXIS_DESCR STD_AXIS ICP_DES FCX_FN047DS 11 0 30 /end AXIS_DESCR /end CHARACTERISTIC
/begin COMPU_METHOD FCX_FN047DS "FN047DS X-axis conversion" RAT_FUNC "%10.5" "MPa" COEFFS 0 1 0 0 0 1 /end COMPU_METHOD
/begin COMPU_METHOD FCY_FN047DS "FN047DS Y-axis conversion" RAT_FUNC "%10.5" "unitless" COEFFS 0 1 0 0 0 1 /end COMPU_METHOD
/begin CHARACTERISTIC FN052DS "MFDES normalization function" CURVE 0x45FE4 FD_FLOAT32_IEEE 0 FCY_FN052DS 0 9 /begin AXIS_DESCR STD_AXIS MFDES FCX_FN052DS 10 0 255.996 /end AXIS_DESCR /end CHARACTERISTIC
/begin COMPU_METHOD FCX_FN052DS "FN052DS X-axis conversion" RAT_FUNC "%10.5" "unitless" COEFFS 0 1 0 0 0 1 /end COMPU_METHOD
/begin COMPU_METHOD FCY_FN052DS "FN052DS Y-axis conversion" RAT_FUNC "%10.5" "unitless" COEFFS 0 1 0 0 0 1 /end COMPU_METHOD
/begin CHARACTERISTIC FN053DS "Engine speed normalization function" CURVE 0x46034 FD_FLOAT32_IEEE 0 FCY_FN053DS 0 9 /begin AXIS_DESCR STD_AXIS N FCX_FN053DS 10 0 5000 /end AXIS_DESCR /end CHARACTERISTIC
/begin COMPU_METHOD FCX_FN053DS "FN053DS X-axis conversion" RAT_FUNC "%10.5" "RPM" COEFFS 0 1 0 0 0 1 /end COMPU_METHOD
/begin COMPU_METHOD FCY_FN053DS "FN053DS Y-axis conversion" RAT_FUNC "%10.5" "unitless" COEFFS 0 1 0 0 0 1 /end COMPU_METHOD
/begin CHARACTERISTIC FN055DS "Normalized Engine Oil Temperature (degrees C)" CURVE 0x4898C FD_FLOAT32_IEEE 0 FCY_FN055DS 0 8 /begin AXIS_DESCR STD_AXIS EOT_C FCX_FN055DS 9 -40 150 /end AXIS_DESCR /end CHARACTERISTIC
/begin COMPU_METHOD FCX_FN055DS "FN055DS X-axis conversion" RAT_FUNC "%10.5" "unitless" COEFFS 0 1 0 0 0 1 /end COMPU_METHOD
/begin COMPU_METHOD FCY_FN055DS "FN055DS Y-axis conversion" RAT_FUNC "%10.5" "unitless" COEFFS 0 1 0 0 0 1 /end COMPU_METHOD
/begin CHARACTERISTIC FN055DS_A "Normalized Engine Oil Temperature (degrees C)" CURVE 0x4B4C4 FD_FLOAT32_IEEE 0 FCY_FN055DS_A 0 8 /begin AXIS_DESCR STD_AXIS EOT_C FCX_FN055DS_A 9 -40 150 /end AXIS_DESCR /end CHARACTERISTIC
/begin COMPU_METHOD FCX_FN055DS_A "FN055DS_A X-axis conversion" RAT_FUNC "%10.5" "unitless" COEFFS 0 1 0 0 0 1 /end COMPU_METHOD
/begin COMPU_METHOD FCY_FN055DS_A "FN055DS_A Y-axis conversion" RAT_FUNC "%10.5" "unitless" COEFFS 0 1 0 0 0 1 /end COMPU_METHOD
/begin CHARACTERISTIC FN056DS "Normalized engine speed (RPM)" CURVE 0x489D4 FD_FLOAT32_IEEE 0 FCY_FN056DS 0 8 /begin AXIS_DESCR STD_AXIS N FCX_FN056DS 9 0 5000 /end AXIS_DESCR /end CHARACTERISTIC
/begin COMPU_METHOD FCX_FN056DS "FN056DS X-axis conversion" RAT_FUNC "%10.5" "unitless" COEFFS 0 1 0 0 0 1 /end COMPU_METHOD
/begin COMPU_METHOD FCY_FN056DS "FN056DS Y-axis conversion" RAT_FUNC "%10.5" "unitless" COEFFS 0 1 0 0 0 1 /end COMPU_METHOD
/begin CHARACTERISTIC FN056DS_A "Normalized Engine Oil Temperature (degrees C)" CURVE 0x4B50C FD_FLOAT32_IEEE 0 FCY_FN056DS_A 0 8 /begin AXIS_DESCR STD_AXIS N FCX_FN056DS_A 9 0 5500 /end AXIS_DESCR /end CHARACTERISTIC
/begin COMPU_METHOD FCX_FN056DS_A "FN056DS_A X-axis conversion" RAT_FUNC "%10.5" "unitless" COEFFS 0 1 0 0 0 1 /end COMPU_METHOD
/begin COMPU_METHOD FCY_FN056DS_A "FN056DS_A Y-axis conversion" RAT_FUNC "%10.5" "unitless" COEFFS 0 1 0 0 0 1 /end COMPU_METHOD
/begin CHARACTERISTIC FN057DS "Normalized Mass Fuel Desired (mg/stroke)" CURVE 0x488EC FD_FLOAT32_IEEE 0 FCY_FN057DS 0 9 /begin AXIS_DESCR STD_AXIS MFDES FCX_FN057DS 10 0 255.996 /end AXIS_DESCR /end CHARACTERISTIC
/begin COMPU_METHOD FCX_FN057DS "FN057DS X-axis conversion" RAT_FUNC "%10.5" "unitless" COEFFS 0 1 0 0 0 1 /end COMPU_METHOD
/begin COMPU_METHOD FCY_FN057DS "FN057DS Y-axis conversion" RAT_FUNC "%10.5" "unitless" COEFFS 0 1 0 0 0 1 /end COMPU_METHOD
/begin CHARACTERISTIC FN058DS "Normalized engine speed (RPM)" CURVE 0x4893C FD_FLOAT32_IEEE 0 FCY_FN058DS 0 9 /begin AXIS_DESCR STD_AXIS N FCX_FN058DS 10 0 5000 /end AXIS_DESCR /end CHARACTERISTIC
/begin COMPU_METHOD FCX_FN058DS "FN058DS X-axis conversion" RAT_FUNC "%10.5" "unitless" COEFFS 0 1 0 0 0 1 /end COMPU_METHOD
/begin COMPU_METHOD FCY_FN058DS "FN058DS Y-axis conversion" RAT_FUNC "%10.5" "unitless" COEFFS 0 1 0 0 0 1 /end COMPU_METHOD
/begin CHARACTERISTIC FN059DS "Normalized Mass Fuel Desired (mg/stroke)" CURVE 0x4884C FD_FLOAT32_IEEE 0 FCY_FN059DS 0 9 /begin AXIS_DESCR STD_AXIS MFDES FCX_FN059DS 10 0 255.996 /end AXIS_DESCR /end CHARACTERISTIC
/begin COMPU_METHOD FCX_FN059DS "FN059DS X-axis conversion" RAT_FUNC "%10.5" "unitless" COEFFS 0 1 0 0 0 1 /end COMPU_METHOD
/begin COMPU_METHOD FCY_FN059DS "FN059DS Y-axis conversion" RAT_FUNC "%10.5" "unitless" COEFFS 0 1 0 0 0 1 /end COMPU_METHOD
/begin CHARACTERISTIC FN060DS "Normalized engine speed (RPM)" CURVE 0x4889C FD_FLOAT32_IEEE 0 FCY_FN060DS 0 9 /begin AXIS_DESCR STD_AXIS N FCX_FN060DS 10 0 5000 /end AXIS_DESCR /end CHARACTERISTIC
/begin COMPU_METHOD FCX_FN060DS "FN060DS X-axis conversion" RAT_FUNC "%10.5" "unitless" COEFFS 0 1 0 0 0 1 /end COMPU_METHOD
/begin COMPU_METHOD FCY_FN060DS "FN060DS Y-axis conversion" RAT_FUNC "%10.5" "unitless" COEFFS 0 1 0 0 0 1 /end COMPU_METHOD
/begin CHARACTERISTIC FN070C "RPM normalizing function for torque purposes, for TQ_NET calculation." CURVE 0x4186C FD_FLOAT32_IEEE 0 FCY_FN070C 0 5 /begin AXIS_DESCR STD_AXIS N FCX_FN070C 7 0 16383.8 /end AXIS_DESCR /end CHARACTERISTIC
/begin COMPU_METHOD FCX_FN070C "FN070C X-axis conversion" RAT_FUNC "%10.5" "RPM" COEFFS 0 1 0 0 0 1 /end COMPU_METHOD
/begin COMPU_METHOD FCY_FN070C "FN070C Y-axis conversion" RAT_FUNC "%10.5" "NORMD" COEFFS 0 1 0 0 0 1 /end COMPU_METHOD
/begin CHARACTERISTIC FN070MIS "RPM normalizating function for misfire, supports a misfire bypass table with 10 RPM breakpoints." CURVE 0x59D8C FD_FLOAT32_IEEE 0 FCY_FN070MIS 0 9 /begin AXIS_DESCR STD_AXIS N FCX_FN070MIS 10 0 16383.8 /end AXIS_DESCR /end CHARACTERISTIC
/begin COMPU_METHOD FCX_FN070MIS "FN070MIS X-axis conversion" RAT_FUNC "%10.5" "RPM" COEFFS 0 1 0 0 0 1 /end COMPU_METHOD
/begin COMPU_METHOD FCY_FN070MIS "FN070MIS Y-axis conversion" RAT_FUNC "%10.5" "normalised" COEFFS 0 1 0 0 0 1 /end COMPU_METHOD
/begin CHARACTERISTIC FN090DS_EGR "" CURVE 0x530DC FD_FLOAT32_IEEE 0 FCY_FN090DS_EGR 0 5000 /begin AXIS_DESCR STD_AXIS N FCX_FN090DS_EGR 14 0 5001 /end AXIS_DESCR /end CHARACTERISTIC
/begin COMPU_METHOD FCX_FN090DS_EGR "FN090DS_EGR X-axis conversion" RAT_FUNC "%10.5" "unitless" COEFFS 0 1 0 0 0 1 /end COMPU_METHOD
/begin COMPU_METHOD FCY_FN090DS_EGR "FN090DS_EGR Y-axis conversion" RAT_FUNC "%10.5" "unitless" COEFFS 0 1 0 0 0 1 /end COMPU_METHOD
/begin CHARACTERISTIC FN090DS_ITH "" CURVE 0x5615C FD_FLOAT32_IEEE 0 FCY_FN090DS_ITH 0 15 /begin AXIS_DESCR STD_AXIS N FCX_FN090DS_ITH 14 0 5000 /end AXIS_DESCR /end CHARACTERISTIC
/begin COMPU_METHOD FCX_FN090DS_ITH "FN090DS_ITH X-axis conversion" RAT_FUNC "%10.5" "unitless" COEFFS 0 1 0 0 0 1 /end COMPU_METHOD
/begin COMPU_METHOD FCY_FN090DS_ITH "FN090DS_ITH Y-axis conversion" RAT_FUNC "%10.5" "unitless" COEFFS 0 1 0 0 0 1 /end COMPU_METHOD
/begin CHARACTERISTIC FN090DS_TQ "" CURVE 0x4D4FC FD_FLOAT32_IEEE 0 FCY_FN090DS_TQ 0 14 /begin AXIS_DESCR STD_AXIS N FCX_FN090DS_TQ 14 0 8000 /end AXIS_DESCR /end CHARACTERISTIC
/begin COMPU_METHOD FCX_FN090DS_TQ "FN090DS_TQ X-axis conversion" RAT_FUNC "%10.5" "unitless" COEFFS 0 1 0 0 0 1 /end COMPU_METHOD
/begin COMPU_METHOD FCY_FN090DS_TQ "FN090DS_TQ Y-axis conversion" RAT_FUNC "%10.5" "unitless" COEFFS 0 1 0 0 0 1 /end COMPU_METHOD
/begin CHARACTERISTIC FN090P_AFR_A "" CURVE 0x4650C FD_FLOAT32_IEEE 0 FCY_FN090P_AFR_A 0 12 /begin AXIS_DESCR STD_AXIS N FCX_FN090P_AFR_A 8 0 5000 /end AXIS_DESCR /end CHARACTERISTIC
/begin COMPU_METHOD FCX_FN090P_AFR_A "FN090P_AFR_A X-axis conversion" RAT_FUNC "%10.5" "unitless" COEFFS 0 1 0 0 0 1 /end COMPU_METHOD
/begin COMPU_METHOD FCY_FN090P_AFR_A "FN090P_AFR_A Y-axis conversion" RAT_FUNC "%10.5" "unitless" COEFFS 0 1 0 0 0 1 /end COMPU_METHOD
/begin RECORD_LAYOUT SD_UBYTE FNC_VALUES 1 UBYTE ROW_DIR DIRECT /end RECORD_LAYOUT
/begin RECORD_LAYOUT SD_UWORD FNC_VALUES 1 UWORD ROW_DIR DIRECT /end RECORD_LAYOUT
/begin RECORD_LAYOUT SD_SLONG FNC_VALUES 1 SLONG ROW_DIR DIRECT /end RECORD_LAYOUT
/begin RECORD_LAYOUT SD_FLOAT32_IEEE FNC_VALUES 1 FLOAT32_IEEE ROW_DIR DIRECT /end RECORD_LAYOUT
/begin RECORD_LAYOUT FD_FLOAT32_IEEE AXIS_PTS_X 1 FLOAT32_IEEE INDEX_INCR DIRECT FNC_VALUES 2 FLOAT32_IEEE ALTERNATE_WITH_X DIRECT /end RECORD_LAYOUT
/end MODULE
/end PROJECT
