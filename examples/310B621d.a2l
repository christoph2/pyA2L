ASAP2_VERSION 1 21
/begin PROJECT Brs_6Zylinder "310B6"
/begin HEADER "" VERSION "_310B621d" PROJECT_NO Brs_6Zylinder /end HEADER
/begin MODULE DIM ""
/begin MOD_COMMON "" BYTE_ORDER MSB_LAST S_REC_LAYOUT DAMOS /end MOD_COMMON
/begin AXIS_PTS SGA06MFUB "" 0x10042 xgang SstAUbSstUb 255 dez 6 0 255 DEPOSIT ABSOLUTE /end AXIS_PTS
/begin AXIS_PTS SNM06MFUB "" 0x10049 nmot SstAUbSstUb 10200 nmot_ub_q40 6 0 10200 DEPOSIT ABSOLUTE /end AXIS_PTS
/begin AXIS_PTS SNM08__UB "Stützstellenverteilung Drehzahl, 8 Sst." 0x1007F nmot SstAUbSstUb 10200 nmot_ub_q40 8 0 10200 DEPOSIT ABSOLUTE /end AXIS_PTS
/begin AXIS_PTS SNM16ZUUB "Stützstellenverteilung Drehzahl, 16 Sst." 0x100A6 nmot SstAUbSstUb 10200 nmot_ub_q40 16 0 10200 DEPOSIT ABSOLUTE /end AXIS_PTS
/begin AXIS_PTS SRL12ZUUB "Stützstellenverteilung relative Luftfüllung, 12 St." 0x100C4 rl SstAUbSstUb 191.25 rel_ub_q0p75 12 0 191.25 DEPOSIT ABSOLUTE /end AXIS_PTS
/begin AXIS_PTS SNM12ESUB "SST-Verteilung für die Motordrehzahl nmot" 0x10088 nmot SstAUbSstUb 10200 nmot_ub_q40 12 0 10200 DEPOSIT ABSOLUTE /end AXIS_PTS
/begin AXIS_PTS SRL12ESUB "Sst-Verteilung für die relative Füllung rl" 0x100B7 rl SstAUbSstUb 191.25 rel_ub_q0p75 12 0 191.25 DEPOSIT ABSOLUTE /end AXIS_PTS
/begin AXIS_PTS SAN12ESUW "SST-Verteilung für den begrenzten Einspritzzähler anztib_w" 0x11BE8 anztib_w SstAUwSstUw 65535 dez 12 0 65535 DEPOSIT ABSOLUTE /end AXIS_PTS
/begin AXIS_PTS SRL08LSUW "Stützstellenverteilung Reglerparameter" 0x11C12 rl_w SstAUwSstUw 1535.98 rel_uw_q0p0234 8 0 1535.98 DEPOSIT ABSOLUTE /end AXIS_PTS
/begin AXIS_PTS SNM07LSUW "Stützstellenverteilung Reglerparameter LRS" 0x11C02 nmot_w SstAUwSstUw 16383.8 nmot_uw_q0p25 7 0 16383.8 DEPOSIT ABSOLUTE /end AXIS_PTS
/begin AXIS_PTS STM06__UB "Stützstellenverteilung Motortemperatur, 6 Sst." 0x10078 tmot SstAUbSstUb 191.25 temp_ub_q0p75_o48 6 -48 143.25 DEPOSIT ABSOLUTE /end AXIS_PTS
/begin AXIS_PTS STM05SAUB "Stützstellenverteilung" 0x10072 tmot SstAUbSstUb 191.25 temp_ub_q0p75_o48 5 -48 143.25 DEPOSIT ABSOLUTE /end AXIS_PTS
/begin AXIS_PTS STM12ESUB "SST-Verteilung für die Motortemperatur tmot" 0x100D1 tmot SstAUbSstUb 191.25 temp_ub_q0p75_o48 12 -48 143.25 DEPOSIT ABSOLUTE /end AXIS_PTS
/begin AXIS_PTS STS12ESUB "SST-Verteilung für Motorstarttemperatur" 0x100DE tmst SstAUbSstUb 191.25 temp_ub_q0p75_o48 12 -48 143.25 DEPOSIT ABSOLUTE /end AXIS_PTS
/begin AXIS_PTS STA06ESUB "SST-Verteilung für die Ansauglufttemperatur" 0x1006B tans SstAUbSstUb 191.25 temp_ub_q0p75_o48 6 -48 143.25 DEPOSIT ABSOLUTE /end AXIS_PTS
/begin AXIS_PTS SNM16KRUB "Stützstellenverteilung Drehzahl, 16 Sst." 0x10050 nmot SstAUbSstUb 10200 nmot_ub_q40 16 0 10200 DEPOSIT ABSOLUTE /end AXIS_PTS
/begin AXIS_PTS SRL04KRUB "Stützstellenverteilung relative Füllung, 4 Sst." 0x10066 rl SstAUbSstUb 191.25 rel_ub_q0p75 4 0 191.25 DEPOSIT ABSOLUTE /end AXIS_PTS
/begin AXIS_PTS SNM16CIUB "Stützstellenverteilung Drehzahl, 16 Sst." 0x10095 nmot SstAUbSstUb 10200 nmot_ub_q40 16 0 10200 DEPOSIT ABSOLUTE /end AXIS_PTS
/begin AXIS_PTS SRL04DYUB "Stützstellenverteilung relative Füllung, 4 Sst." 0x10061 rl SstAUbSstUb 191.25 rel_ub_q0p75 4 0 191.25 DEPOSIT ABSOLUTE /end AXIS_PTS
/begin AXIS_PTS SML07TMUW "Stützstellenverteilung, Luftmasse, 7 Stützstellen" 0x11BD8 ml_w SstAUwSstUw 6553.5 m_uw_b6553p5 7 0 6553.5 DEPOSIT ABSOLUTE /end AXIS_PTS
/begin CHARACTERISTIC CDLSV "Codewort Sondendiagnose vor KAT im OBDII-Mode" VALUE 0x1003E KwUb 255 dez 0 255 FORMAT "%5.1" /end CHARACTERISTIC
/begin CHARACTERISTIC CDHSV "Codewort Heizerdiagnose vor Kat im (CDHSV = 0  => keine Diagnose)" VALUE 0x1003D KwUb 255 dez 0 255 FORMAT "%5.1" /end CHARACTERISTIC
/begin CHARACTERISTIC CDATS "Konfigurationsbyte Diagnose Abgastemperatursensor" VALUE 0x1003C KwUb 255 dez 0 255 FORMAT "%5.1" /end CHARACTERISTIC
/begin CHARACTERISTIC CWKONLS "Codewort für Konfiguration Lambda Sonden" VALUE 0x1003F KwUb 255 dez 0 255 FORMAT "%5.1" /end CHARACTERISTIC
/begin CHARACTERISTIC CWMDAPP "Codewort Applikation ohne Drehmomentfunktionen" VALUE 0x10040 KwUb 255 dez 0 255 FORMAT "%5.1" /end CHARACTERISTIC
/begin CHARACTERISTIC CWUHR "Codewort für Uhr" VALUE 0x10041 KwUb 255 dez 0 255 FORMAT "%5.1" /end CHARACTERISTIC
/begin CHARACTERISTIC CWVSV "Codewort für Deaktivierung VS_VERST (CWVSV = 0: VS_VERST nicht aktiv)" VALUE 0x1010C KwUb 255 dez 0 255 FORMAT "%5.1" /end CHARACTERISTIC
/begin CHARACTERISTIC TARA "Temperaturschwelle Ansaugluft" VALUE 0x10C8A KwUb 191.25 temp_ub_q0p75_o48 -48 143.25 FORMAT "%5.1" /end CHARACTERISTIC
/begin CHARACTERISTIC TMRAA "Einschalttemperatur LRA" VALUE 0x10C8B KwUb 191.25 temp_ub_q0p75_o48 -48 143.25 FORMAT "%5.1" /end CHARACTERISTIC
/begin CHARACTERISTIC TVLRA "Verzögerungszeit für Aktivierung Gemischadaption nach Lambdaregelung aktiv" VALUE 0x10C8C KwUb 25.4 t100msxs_ub_b25p5 0.1 25.5 FORMAT "%5.2" /end CHARACTERISTIC
/begin CHARACTERISTIC WDKARN "DK-Winkel-Schwelle für Gemischadaption aktiv" CURVE 0x10C75 KlAUbSstUbWUb 99.6094 rel_ub_b99p6 0 99.6094 FORMAT "%5.2" /begin AXIS_DESCR STD_AXIS nmot nmot_ub_q40 10 0 10200 DEPOSIT ABSOLUTE /end AXIS_DESCR /end CHARACTERISTIC
/begin CHARACTERISTIC TEMIN "minimales TE" VALUE 0x12B9E KwUw 209.712 tinjection_sy 0 209.712 FORMAT "%8.4" /end CHARACTERISTIC
/begin CHARACTERISTIC FKKVS "Korrekturfaktor Kraftstoffversorgungssystem" MAP 0x12976 KfAxUbAyUbSstxUbSstyUwWUw 1.99997 fak_uw_b2 0 1.99997 FORMAT "%8.6" /begin AXIS_DESCR STD_AXIS nmot nmot_ub_q40 18 0 10200 DEPOSIT ABSOLUTE /end AXIS_DESCR
 /begin AXIS_DESCR STD_AXIS tevfa_w_kge tinjection_sy 14 0 209.712 DEPOSIT ABSOLUTE /end AXIS_DESCR
/end CHARACTERISTIC
/begin CHARACTERISTIC CJCONFIG "Auswahl der Hardware-Variante" VALUE 0x10CEE KwUb 255 dez 0 255 FORMAT "%5.1" READ_ONLY /end CHARACTERISTIC
/begin CHARACTERISTIC READCLOMEM "Echtzeit aus Memory lesen" VALUE 0x10F12 KwUb 1 dez 0 1 FORMAT "%5.3" /end CHARACTERISTIC
/begin CHARACTERISTIC SETCLOMEM "Echtzeit im Memory setzen" VALUE 0x10F13 KwUb 1 dez 0 1 FORMAT "%5.3" /end CHARACTERISTIC
/begin CHARACTERISTIC CLOMEMHR "Echtzeiteingabe für Memory, Stunde" VALUE 0x10F0E KwUb 23 dez 0 23 FORMAT "%5.2" /end CHARACTERISTIC
/begin CHARACTERISTIC CLOMEMMIN "Echtzeiteingabe für Memory, Minute" VALUE 0x10F0F KwUb 59 dez 0 59 FORMAT "%5.2" /end CHARACTERISTIC
/begin CHARACTERISTIC CLOMEMSEC "Echtzeiteingabe für Memory, Sekunde" VALUE 0x10F11 KwUb 59 dez 0 59 FORMAT "%5.2" /end CHARACTERISTIC
/begin CHARACTERISTIC CLOMEMYR "Echtzeiteingabe für Memory, Jahr" VALUE 0x12E1C KwUw 130 dez 1970 2100 FORMAT "%8.3" /end CHARACTERISTIC
/begin CHARACTERISTIC CLOMEMMON "Echtzeiteingabe für Memory, Monat" VALUE 0x10F10 KwUb 11 dez 1 12 FORMAT "%5.2" /end CHARACTERISTIC
/begin CHARACTERISTIC CLOMEMDAY "Echtzeiteingabe für Memory, Tag" VALUE 0x10F0D KwUb 30 dez 1 31 FORMAT "%5.2" /end CHARACTERISTIC
/begin CHARACTERISTIC SUS_IN_FL "Eingabe Federwegposition, eingefedert, vorne links" VALUE 0x12E24 KwSw 655.35 mm_uw_q100 -327.68 327.67 FORMAT "%8.4" /end CHARACTERISTIC
/begin CHARACTERISTIC SUS_IN_FR "Eingabe Federwegposition, eingefedert, vorne rechts" VALUE 0x12E26 KwSw 655.35 mm_uw_q100 -327.68 327.67 FORMAT "%8.4" /end CHARACTERISTIC
/begin CHARACTERISTIC SUS_IN_RL "Eingabe Federwegposition, eingefedert, hinten links" VALUE 0x12E28 KwSw 655.35 mm_uw_q100 -327.68 327.67 FORMAT "%8.4" /end CHARACTERISTIC
/begin CHARACTERISTIC SUS_IN_RR "Eingabe Federwegposition, eingefedert, hinten rechts" VALUE 0x12E2A KwSw 655.35 mm_uw_q100 -327.68 327.67 FORMAT "%8.4" /end CHARACTERISTIC
/begin CHARACTERISTIC SUS_OUT_FL "Eingabe Federwegposition, ausgefedert, vorne links" VALUE 0x12E2C KwSw 655.35 mm_uw_q100 -327.68 327.67 FORMAT "%8.4" /end CHARACTERISTIC
/begin CHARACTERISTIC SUS_OUT_FR "Eingabe Federwegposition, ausgefedert, vorne rechts" VALUE 0x12E2E KwSw 655.35 mm_uw_q100 -327.68 327.67 FORMAT "%8.4" /end CHARACTERISTIC
/begin CHARACTERISTIC SUS_OUT_RL "Eingabe Federwegposition, ausgefedert, hinten links" VALUE 0x12E30 KwSw 655.35 mm_uw_q100 -327.68 327.67 FORMAT "%8.4" /end CHARACTERISTIC
/begin CHARACTERISTIC SUS_OUT_RR "Eingabe Federwegposition, ausgefedert, hinten rechts" VALUE 0x12E32 KwSw 655.35 mm_uw_q100 -327.68 327.67 FORMAT "%8.4" /end CHARACTERISTIC
/begin CHARACTERISTIC STEERANGL "Eingabe Lenkwinkel bei Linksanschlag" VALUE 0x12E1E KwSw 6553.5 deg_uw_q10 -3276.8 3276.7 FORMAT "%8.3" /end CHARACTERISTIC
/begin CHARACTERISTIC STEERANGR "Eingabe Lenkwinkel bei Rechtsanschlag" VALUE 0x12E20 KwSw 6553.5 deg_uw_q10 -3276.8 3276.7 FORMAT "%8.3" /end CHARACTERISTIC
/begin CHARACTERISTIC ACCBW "Eingabe Längsbeschleunigung bei Kippen des Sensors nach hinten" VALUE 0x12E10 KwSw 655.35 g_uw_q100 -327.68 327.67 FORMAT "%8.4" /end CHARACTERISTIC
/begin CHARACTERISTIC ACCFW "Eingabe Längsbeschleunigung bei Kippen des Sensors nach vorn" VALUE 0x12E12 KwSw 655.35 g_uw_q100 -327.68 327.67 FORMAT "%8.4" /end CHARACTERISTIC
/begin CHARACTERISTIC ACCLE "Eingabe Querbeschleunigung bei Kippen des Sensors nach links" VALUE 0x12E14 KwSw 655.35 g_uw_q100 -327.68 327.67 FORMAT "%8.4" /end CHARACTERISTIC
/begin CHARACTERISTIC ACCRI "Eingabe Querbeschleunigung bei Kippen des Sensors nach rechts" VALUE 0x12E18 KwSw 655.35 g_uw_q100 -327.68 327.67 FORMAT "%8.4" /end CHARACTERISTIC
/begin CHARACTERISTIC SUS_ZER_FL "Eingabe Nullposition für Federweg vorne links" VALUE 0x12E34 KwSw 655.35 mm_uw_q100 -327.68 327.67 FORMAT "%8.4" /end CHARACTERISTIC
/begin CHARACTERISTIC SUS_ZER_FR "Eingabe Nullposition für Federweg vorne rechts" VALUE 0x12E36 KwSw 655.35 mm_uw_q100 -327.68 327.67 FORMAT "%8.4" /end CHARACTERISTIC
/begin CHARACTERISTIC SUS_ZER_RL "Eingabe Nullposition für Federweg hinten links" VALUE 0x12E38 KwSw 655.35 mm_uw_q100 -327.68 327.67 FORMAT "%8.4" /end CHARACTERISTIC
/begin CHARACTERISTIC SUS_ZER_RR "Eingabe Nullposition für Federweg hinten rechts" VALUE 0x12E3A KwSw 655.35 mm_uw_q100 -327.68 327.67 FORMAT "%8.4" /end CHARACTERISTIC
/begin CHARACTERISTIC STEERZERO "Eingabe Nullposition für Lenkwinkel" VALUE 0x12E22 KwSw 6553.5 deg_uw_q10 -3276.8 3276.7 FORMAT "%8.3" /end CHARACTERISTIC
/begin CHARACTERISTIC ACCLZERO "Eingabe Nullposition für Längsbeschleunigung" VALUE 0x12E16 KwSw 655.35 g_uw_q100 -327.68 327.67 FORMAT "%8.4" /end CHARACTERISTIC
/begin CHARACTERISTIC ACCTZERO "Eingabe Nullposition für Querbeschleunigung" VALUE 0x12E1A KwSw 655.35 g_uw_q100 -327.68 327.67 FORMAT "%8.4" /end CHARACTERISTIC
/begin CHARACTERISTIC ADJ_ACT "Eingabe für Justierung der Fahrwerksdatenerfassung" VALUE 0x10F0B KwUb 255 dez 0 255 FORMAT "%5.1" /end CHARACTERISTIC
/begin CHARACTERISTIC CHK_ACT "Eingabe für Prüfmodus" VALUE 0x10F0C KwUb 255 dez 0 255 FORMAT "%5.1" /end CHARACTERISTIC
/begin CHARACTERISTIC CLRMINMAX "Rücksetzen der Minimal- und Maximalwerte manuell" VALUE 0x10F14 KwUb 255 dez 0 255 FORMAT "%5.1" /end CHARACTERISTIC
/begin CHARACTERISTIC CWMINMAX "Codewort für Min/Max-Datenerfassung" VALUE 0x10F15 KwUb 255 dez 0 255 FORMAT "%5.1" /end CHARACTERISTIC
/begin CHARACTERISTIC NMINMAX "Minimaldrehzahl für Min/Max-Datenerfassung" VALUE 0x130AA KwUw 16383.8 nmot_uw_q0p25 0 16383.8 FORMAT "%8.2" /end CHARACTERISTIC
/begin CHARACTERISTIC WDKMINMAX "Minimaler DK-Winkel für Min/Max-Datenerfassung" VALUE 0x10F16 KwUb 100 relDK_ub_b100 0 100 FORMAT "%5.1" /end CHARACTERISTIC
/begin CHARACTERISTIC NASNOT "Drehzahlschwelle für ASR-Verbot wegen Abwürgeschutz" VALUE 0x10F17 KwUb 2560 nmot_ub_q40 0 2560 FORMAT "%5.0" /end CHARACTERISTIC
/begin CHARACTERISTIC CWZWOPT "Codewort für Umschaltung zwopt" VALUE 0x10F18 KwUb 255 dez 0 255 FORMAT "%5.1" /end CHARACTERISTIC
/begin CHARACTERISTIC KFMIOP "Kennfeld optimales Motormoment" MAP 0x130CE KfAxUbAyUbSstxUbSstyUwWUw 99.9985 rel_uw_b100 0 99.9985 FORMAT "%8.5" /begin AXIS_DESCR STD_AXIS nmot nmot_ub_q40 16 0 10200 DEPOSIT ABSOLUTE /end AXIS_DESCR /begin AXIS_DESCR STD_AXIS rl_w rel_uw_q0p0234 12 0 1535.98 DEPOSIT ABSOLUTE /end AXIS_DESCR /end CHARACTERISTIC
/begin CHARACTERISTIC KFZWOP "optimaler Zündwinkel" MAP 0x13278 KfAxUbAyUbSstxUbSstyUwWUb 191.25 zw_sb_q0p75 0 191.25 FORMAT "%5.1" /begin AXIS_DESCR STD_AXIS nmot nmot_ub_q40 18 0 10200 DEPOSIT ABSOLUTE /end AXIS_DESCR /begin AXIS_DESCR STD_AXIS rl_w rel_uw_q0p0234 14 0 1535.98 DEPOSIT ABSOLUTE /end AXIS_DESCR /end CHARACTERISTIC
/begin CHARACTERISTIC ETALAM "Lambda-Wirkungsgrad" CURVE 0x10F5A KlAUbSstUbWUb 127.5 rel_ub_b127p5 0 127.5 FORMAT "%5.1" /begin AXIS_DESCR STD_AXIS lambas fak_ub_b2 10 0 1.99219 DEPOSIT ABSOLUTE /end AXIS_DESCR /end CHARACTERISTIC
/begin CHARACTERISTIC ETADZW "ZW-Wirkungsgrad in Abhängigkeit von delta ZW" CURVE 0x10F19 FklWUb 127.5 rel_ub_b127p5 0 127.5 FORMAT "%5.1" /begin AXIS_DESCR FIX_AXIS dzw_kge zw_sb_q0p75 65 0 48 FIX_AXIS_PAR 0 0 65 /end AXIS_DESCR /end CHARACTERISTIC
/begin CHARACTERISTIC DZWOLA "Lambda-Abhängigkeit des optimalen Zündwinkels bezogen auf Lambda 1" CURVE 0x130AC KlAUbSstUbWSb 191.25 zw_sb_q0p75 -96 95.25 FORMAT "%5.2" /begin AXIS_DESCR STD_AXIS lambas fak_ub_b2 10 0 1.99219 DEPOSIT ABSOLUTE /end AXIS_DESCR /end CHARACTERISTIC
/begin CHARACTERISTIC DZWOM "temperaturabhängiger Offset des optimalen ZW" CURVE 0x130C2 KlAUbSstUbWSb 191.25 zw_sb_q0p75 -96 95.25 FORMAT "%5.2"
 /begin AXIS_DESCR STD_AXIS tmot temp_ub_q0p75_o48 5 -48 143.25 DEPOSIT ABSOLUTE /end AXIS_DESCR
/end CHARACTERISTIC
/begin CHARACTERISTIC CWLWSD "Codewort für die Strukturumschaltung bei Lastwechselschlagdämpfung" VALUE 0x10F6F KwUb 255 dez 0 255 FORMAT "%5.1" /end CHARACTERISTIC
/begin CHARACTERISTIC TMLWSD "Motortemperaturschwelle für Lastwechselschlagdämpfung" VALUE 0x1104B KwUb 191.25 temp_ub_q0p75_o48 -48 143.25 FORMAT "%5.1" /end CHARACTERISTIC
/begin CHARACTERISTIC VLWSD "Geschwindigkeitsschwelle für Lastwechselschlagdämpfung" VALUE 0x1104D KwUb 318.75 vfzg_ub_q1p25 0 318.75 FORMAT "%5.1" /end CHARACTERISTIC
/begin CHARACTERISTIC DMLWSDU "Untere Drehmomentschwelle für Lastwechselschlagdämpfung" VALUE 0x10F72 KwUb 50 rel_ub_b50 0 50 FORMAT "%5.2" /end CHARACTERISTIC
/begin CHARACTERISTIC TVLWSDSA "Zeit für Bedingung Lastwechselschlagdämpfung nach Schubabschaltung" VALUE 0x1104C KwUb 25.5 t100msxs_ub_b25p5 0 25.5 FORMAT "%5.2" /end CHARACTERISTIC
/begin CHARACTERISTIC DMDFAO "Dämpfung für Filterung des Fahrer-Momentes bei großem Kupplungsmoment" VALUE 0x10F70 KwUb 0.996094 fak_ub_b1 0 0.996094 FORMAT "%5.3" /end CHARACTERISTIC
/begin CHARACTERISTIC DMDFAWE "Dämpfung für Filterung des Fahrer-Momentes bei passivem Wiedereinsetzen" VALUE 0x10F71 KwUb 0.996094 fak_ub_b1 0 0.996094 FORMAT "%5.3" /end CHARACTERISTIC
/begin CHARACTERISTIC ZMDFAO "Zeitkonstante für Filterung des Fahrer-Momentes bei großem Kupplungsmoment" VALUE 0x1104E KwUb 2.54 zk10msxs_ub_b2p55 0.01 2.55 FORMAT "%5.3" /end CHARACTERISTIC
/begin CHARACTERISTIC ZMDFAWE "Zeitkonstante für Filterung des Fahrer-Momentes bei passivem Wiedereinsetzen" VALUE 0x1104F KwUb 2.54 zk10msxs_ub_b2p55 0.01 2.55 FORMAT "%5.3" /end CHARACTERISTIC
/begin CHARACTERISTIC KLDMLWSDO "Delta Moment Auslösung Lastschlagdämpfung" CURVE 0x133C8 KlAUwSstUwWUb 50 rel_ub_b50 0 50 FORMAT "%5.2" /begin AXIS_DESCR STD_AXIS mifil_w rel_uw_b100 6 0 99.9985 DEPOSIT ABSOLUTE /end AXIS_DESCR /end CHARACTERISTIC
/begin CHARACTERISTIC MILWON "Obere Momentenschwelle für Parameterumschaltung  bei Lastwechselschlagdämpfung" CURVE 0x133A4 GklWSw 199.997 rel_sw_b100 -100 99.9969 FORMAT "%8.4" /begin AXIS_DESCR COM_AXIS nmot nmot_ub_q40 6 0 10200 AXIS_PTS_REF SNM06MFUB /end AXIS_DESCR /end CHARACTERISTIC
/begin CHARACTERISTIC KLMILWSD "" CURVE 0x133DC GklWSw 199.997 rel_sw_b100 -100 99.9969 FORMAT "%8.4" /begin AXIS_DESCR COM_AXIS nmot nmot_ub_q40 6 0 10200 AXIS_PTS_REF SNM06MFUB /end AXIS_DESCR /end CHARACTERISTIC
/begin CHARACTERISTIC MILWUN "Untere Momentenschwelle für Parameterumschaltung bei Lastwechselschlagdämpfung" CURVE 0x133B0 GklWSw 199.997 rel_sw_b100 -100 99.9969 FORMAT "%8.4" /begin AXIS_DESCR COM_AXIS nmot nmot_ub_q40 6 0 10200 AXIS_PTS_REF SNM06MFUB /end AXIS_DESCR /end CHARACTERISTIC
/begin CHARACTERISTIC MILWUSAN "Untere Momentenschw. für Parameterumsch. bei Lastwechselschlagdämpfung nach SA" CURVE 0x133BC GklWSw 199.997 rel_sw_b100 -100 99.9969 FORMAT "%8.4" /begin AXIS_DESCR COM_AXIS nmot nmot_ub_q40 6 0 10200 AXIS_PTS_REF SNM06MFUB /end AXIS_DESCR /end CHARACTERISTIC
/begin CHARACTERISTIC KFDMDFA "Kennfeld Dämpfung für Filterung des Fahrer-Momentes" MAP 0x10F73 GkfWUb 0.996094 fak_ub_b1 0 0.996094 FORMAT "%5.3" /begin AXIS_DESCR COM_AXIS xgang dez 6 0 255 AXIS_PTS_REF SGA06MFUB /end AXIS_DESCR /begin AXIS_DESCR COM_AXIS nmot nmot_ub_q40 6 0 10200 AXIS_PTS_REF SNM06MFUB /end AXIS_DESCR /end CHARACTERISTIC
/begin CHARACTERISTIC KFDMDFAU "Kennfeld untere Dämpfung für Filterung des Fahrer-Momentes" MAP 0x10FBB GkfWUb 0.996094 fak_ub_b1 0 0.996094 FORMAT "%5.3" /begin AXIS_DESCR COM_AXIS xgang dez 6 0 255 AXIS_PTS_REF SGA06MFUB /end AXIS_DESCR /begin AXIS_DESCR COM_AXIS nmot nmot_ub_q40 6 0 10200 AXIS_PTS_REF SNM06MFUB /end AXIS_DESCR /end CHARACTERISTIC
/begin CHARACTERISTIC KFDMDFAS "Kennfeld Dämpfung für Filterung des Fahrer-Momentes aus Schub" MAP 0x10F97 GkfWUb 0.996094 fak_ub_b1 0 0.996094 FORMAT "%5.3" /begin AXIS_DESCR COM_AXIS xgang dez 6 0 255 AXIS_PTS_REF SGA06MFUB /end AXIS_DESCR /begin AXIS_DESCR COM_AXIS nmot nmot_ub_q40 6 0 10200 AXIS_PTS_REF SNM06MFUB /end AXIS_DESCR /end CHARACTERISTIC
/begin CHARACTERISTIC KFZMDFA "Kennfeld Zeitkonstante für Filterung des Fahrer-Momentes" MAP 0x10FDF GkfWUb 2.54 zk10msxs_ub_b2p55 0.01 2.55 FORMAT "%5.3" /begin AXIS_DESCR COM_AXIS xgang dez 6 0 255 AXIS_PTS_REF SGA06MFUB /end AXIS_DESCR /begin AXIS_DESCR COM_AXIS nmot nmot_ub_q40 6 0 10200 AXIS_PTS_REF SNM06MFUB /end AXIS_DESCR /end CHARACTERISTIC
/begin CHARACTERISTIC KFZMDFAU "Kennfeld untere Zeitkonstante für Filterung des Fahrer-Momentes" MAP 0x11027 GkfWUb 2.54 zk10msxs_ub_b2p55 0.01 2.55 FORMAT "%5.3" /begin AXIS_DESCR COM_AXIS xgang dez 6 0 255 AXIS_PTS_REF SGA06MFUB /end AXIS_DESCR /begin AXIS_DESCR COM_AXIS nmot nmot_ub_q40 6 0 10200 AXIS_PTS_REF SNM06MFUB /end AXIS_DESCR /end CHARACTERISTIC
/begin CHARACTERISTIC KFZMDFAS "Kennfeld Zeitkonstante für Filterung des Fahrer-Momentes aus Schub" MAP 0x11003 GkfWUb 2.54 zk10msxs_ub_b2p55 0.01 2.55 FORMAT "%5.3" /begin AXIS_DESCR COM_AXIS xgang dez 6 0 255 AXIS_PTS_REF SGA06MFUB /end AXIS_DESCR /begin AXIS_DESCR COM_AXIS nmot nmot_ub_q40 6 0 10200 AXIS_PTS_REF SNM06MFUB /end AXIS_DESCR /end CHARACTERISTIC
/begin CHARACTERISTIC MDIMX "Maximales indiziertes Motormoment" VALUE 0x11050 KwUb 99.6094 rel_ub_b99p6 0 99.6094 FORMAT "%5.2" /end CHARACTERISTIC
/begin CHARACTERISTIC DNMAXH "Überschreitung der Maximaldrehzahl für Einspritzausblendung an allen Zylindern" VALUE 0x133E8 KwUw 2550 nmot_uw_q0p25 0 2550 FORMAT "%8.3" /end CHARACTERISTIC
/begin CHARACTERISTIC TNMXPR "Drehzahl-Prädiktionshorizont für NMAX-Regelung" VALUE 0x11062 KwUb 2.55 t10msxs_ub_b2p55 0 2.55 FORMAT "%5.3" /end CHARACTERISTIC
/begin CHARACTERISTIC NMAXPRL "P-Glied bei NMAX-Regelung" CURVE 0x11051 KlAUbSstUbWUb 0.996094 relnmot_q0p0039 0 0.996094 FORMAT "%5.3" /begin AXIS_DESCR STD_AXIS rl rel_ub_q0p75 8 0 191.25 DEPOSIT ABSOLUTE /end AXIS_DESCR /end CHARACTERISTIC
/begin CHARACTERISTIC ZINMAXRL "I-Steigung für NMAX-Regelung" CURVE 0x11063 KlAUbSstUbWUb 2.54 zk10msxs_ub_b2p55 0.01 2.55 FORMAT "%5.3" /begin AXIS_DESCR STD_AXIS rl rel_ub_q0p75 8 0 191.25 DEPOSIT ABSOLUTE /end AXIS_DESCR /end CHARACTERISTIC
/begin CHARACTERISTIC NMAXGANG "Drehzahlbegrenzung gangabhängig" CURVE 0x133EA FklWUw 16383.8 nmot_uw_q0p25 0 16383.8 FORMAT "%8.2" /begin AXIS_DESCR FIX_AXIS gangi dez 7 0 6 FIX_AXIS_PAR 0 0 7 /end AXIS_DESCR /end CHARACTERISTIC
/begin CHARACTERISTIC MDHYEZ "Momenten-Hysterese bei Entscheidung der Zylinderausblendung" VALUE 0x1107F KwUb 99.6094 rel_ub_b99p6 0 99.6094 FORMAT "%5.2" /end CHARACTERISTIC
/begin CHARACTERISTIC REDHYOC "Hysterese der Reduzierstufe bei größerer Soll-Reduzierstufe als Ist-Wert" VALUE 0x11080 KwSb 3.98438 rel_sb_q0p02 -2 1.98438 FORMAT "%5.3" /end CHARACTERISTIC
/begin CHARACTERISTIC REDHYUC "Hysterese der Reduzierstufe bei kleinerer Soll-Reduzierstufe als Ist-Wert" VALUE 0x11081 KwSb 3.98438 rel_sb_q0p02 -2 1.98438 FORMAT "%5.3" /end CHARACTERISTIC
/begin CHARACTERISTIC REDZEM "Schwelle zwischen Zündeingriff und Einspritzausblendung" CURVE 0x11074 KlAUbSstUbWUb 255 dez 0 255 FORMAT "%5.1"
 /begin AXIS_DESCR STD_AXIS tmot temp_ub_q0p75_o48 5 -48 143.25 DEPOSIT ABSOLUTE /end AXIS_DESCR
/end CHARACTERISTIC
/begin CHARACTERISTIC VMAXO "Vmax-Begrenzungswert (Linie mit 16 Varianten)" VALUE 0x1340E KwUw 511.992 vfzg_uw_q0p00781 0 511.992 FORMAT "%8.4" /end CHARACTERISTIC
/begin CHARACTERISTIC VMAXOMPH "Geschwindigkeitsbegrenzung, Eingabe in mph" VALUE 0x13410 KwUw 318.205 vfzgmph_uw_q0p00781 0 318.205 FORMAT "%8.4" /end CHARACTERISTIC
/begin CHARACTERISTIC DVHYST "Schwelle für Reglerstop VMAX-Begrenzung" VALUE 0x133F8 KwUw 511.992 vfzg_uw_q0p00781 0 511.992 FORMAT "%8.4" /end CHARACTERISTIC
/begin CHARACTERISTIC DVMAXEIN "Schwelle für VMAX-Begrenzung ein" VALUE 0x133FC KwUw 511.992 vfzg_uw_q0p00781 0 511.992 FORMAT "%8.4" /end CHARACTERISTIC
/begin CHARACTERISTIC DVMAXAUS "Schwelle für VMAX-Begrenzung aus" VALUE 0x133FA KwUw 511.992 vfzg_uw_q0p00781 0 511.992 FORMAT "%8.4" /end CHARACTERISTIC
/begin CHARACTERISTIC ZBFIL "Zeitkonstante für Beschleunigungsfilter" VALUE 0x11086 KwUb 2.54 zk10msxs_ub_b2p55 0.01 2.55 FORMAT "%5.3" /end CHARACTERISTIC
/begin CHARACTERISTIC TVMXPR "Geschwindigkeit-Prädiktionshorizont für VMAX-Regelung" VALUE 0x11084 KwUb 2.55 t10msxs_ub_b2p55 0 2.55 FORMAT "%5.3" /end CHARACTERISTIC
/begin CHARACTERISTIC VMAXP "P-Glied bei VMAX-Regelung" VALUE 0x11085 KwUb 99.705 rel_ub_q0p391 0 99.705 FORMAT "%5.2" /end CHARACTERISTIC
/begin CHARACTERISTIC ZIVMAX "I-Steigung für VMAX-Regelung" VALUE 0x11087 KwUb 25.4996 zk100msxs_ub_b25p5 0.100392 25.6 FORMAT "%5.2" /end CHARACTERISTIC
/begin CHARACTERISTIC NMINVMX "Minimale Drehzahlschwelle zur VMAX-Regelung" VALUE 0x11083 KwUb 10200 nmot_ub_q40 0 10200 FORMAT "%5.0" /end CHARACTERISTIC
/begin CHARACTERISTIC CWVMAX "Codewort Geschwindigkeitsbegrenzung" VALUE 0x11082 KwUb 255 dez 0 255 FORMAT "%5.1" /end CHARACTERISTIC
/begin CHARACTERISTIC MIVMXG "Vorsteuermoment für Geschwindigkeitsbegrenzung" CURVE 0x133FE FklWUw 99.9985 rel_uw_b100 0 99.9985 FORMAT "%8.5" /begin AXIS_DESCR FIX_AXIS gangi dez 8 0 7 FIX_AXIS_PAR 0 0 8 /end AXIS_DESCR /end CHARACTERISTIC
/begin CHARACTERISTIC TDMFBSA "Zeitkonstante PT1-Filter beim Schubabschalten" VALUE 0x13416 KwUw 655.35 zk10msxs_uw_b655 0.0100002 655.36 FORMAT "%8.4" /end CHARACTERISTIC
/begin CHARACTERISTIC TDMFBWE "Zeitkonstante PT1-Filter beim weichen Wiedereinsetzen" VALUE 0x13418 KwUw 655.35 zk10msxs_uw_b655 0.0100002 655.36 FORMAT "%8.4" /end CHARACTERISTIC
/begin CHARACTERISTIC DMRSA "Deltamomentschwelle für das Rücksetzen von B_fil                 |" VALUE 0x13412 KwUw 99.9985 rel_uw_b100 0 99.9985 FORMAT "%8.5" /end CHARACTERISTIC
/begin CHARACTERISTIC NGFSAWE "Schwelle Drehzahlgradient für Sperrung Filter SA/WE" VALUE 0x13414 KwSw 25599.9 nmotg_sw_q0p39 -12800.2 12799.8 FORMAT "%8.2" /end CHARACTERISTIC
/begin CHARACTERISTIC CWSAVFZG "Codewort Sperren SA bei Fahrzeugstillstand" VALUE 0x11088 KwUb 255 dez 0 255 FORMAT "%5.1" /end CHARACTERISTIC
/begin CHARACTERISTIC CLRLT "Rücksetzen Lebensdauerspeicher" VALUE 0x110B6 KwUb 255 dez 0 255 FORMAT "%5.1" /end CHARACTERISTIC
/begin CHARACTERISTIC NLTSTORE "Drehzahlschwelle für Zwangsspeicherung Lebensdauer" VALUE 0x13424 KwUw 16383.8 nmot_uw_q0p25 0 16383.8 FORMAT "%8.2" /end CHARACTERISTIC
/begin CHARACTERISTIC NLTMON "Drehzahlschwelle für Drehzahlmonitor" VALUE 0x13422 KwUw 16383.8 nmot_uw_q0p25 0 16383.8 FORMAT "%8.2" /end CHARACTERISTIC
/begin CHARACTERISTIC TNLSGMN "Minimale Zeit für SG-Nachlauf" VALUE 0x134AE KwUw 6553.3 t100msxs_uw_b6553p6 0.2 6553.5 FORMAT "%8.3" /end CHARACTERISTIC
/begin CHARACTERISTIC TNLSGMX "Maximale Zeit für SG-Nachlauf" VALUE 0x134B0 KwUw 6553.5 t100msxs_uw_b6553p6 0 6553.5 FORMAT "%8.3" /end CHARACTERISTIC
/begin CHARACTERISTIC UBNLMN "Minimale Batterie-Sollspannung" VALUE 0x11191 KwUb 17.3655 spg_ubatt 0 17.3655 FORMAT "%5.2" /end CHARACTERISTIC
/begin CHARACTERISTIC CLRS "Codewort für Betriebsmodi LRS" VALUE 0x11204 KwUb 255 dez 0 255 FORMAT "%5.1" /end CHARACTERISTIC
/begin CHARACTERISTIC FDFRMIN "Default-Wert untere Schranke dfr_w" VALUE 0x11205 KwSb 1.99219 fak_sb_b1 -1 0.992188 FORMAT "%5.3" /end CHARACTERISTIC
/begin CHARACTERISTIC FRMAX "obere Regelbereichsgrenze" VALUE 0x13536 KwUw 1.99997 fak_uw_b2 0 1.99997 FORMAT "%8.6" /end CHARACTERISTIC
/begin CHARACTERISTIC FRMIN "untere Regelbereichsgrenze" VALUE 0x13538 KwUw 1.99997 fak_uw_b2 0 1.99997 FORMAT "%8.6" /end CHARACTERISTIC
/begin CHARACTERISTIC LALIUSMN "minimales, ueber LALIUS (%GGLSU) messbares Lambda" VALUE 0x136AC KwUw 15.9998 fak_uw_b16 0 15.9998 FORMAT "%8.5" /end CHARACTERISTIC
/begin CHARACTERISTIC Y2MAX "Obere Schranke Integralanteil LRS" VALUE 0x136AE KwSw 1.99997 fak_sw_b1 -1 0.999969 FORMAT "%8.6" /end CHARACTERISTIC
/begin CHARACTERISTIC Y2MIN "Untere Schranke Integralanteil LRS" VALUE 0x136B0 KwSw 1.99997 fak_sw_b1 -1 0.999969 FORMAT "%8.6" /end CHARACTERISTIC
/begin CHARACTERISTIC KFLRSP "Kennfeld Reglerparameter P-Anteil fuer stetigen Lambdaregler" MAP 0x135AA GkfWSw 63.999 fak_sw_b32 -32 31.999 FORMAT "%8.5"
 /begin AXIS_DESCR COM_AXIS nmot_w nmot_uw_q0p25 7 0 16383.8 AXIS_PTS_REF SNM07LSUW /end AXIS_DESCR
 /begin AXIS_DESCR COM_AXIS rl_w rel_uw_q0p0234 8 0 1535.98 AXIS_PTS_REF SRL08LSUW /end AXIS_DESCR
/end CHARACTERISTIC
/begin CHARACTERISTIC KFLRSI "Kennfeld Reglerparameter I-Anteil fuer stetigen Lambdaregler" MAP 0x1353A GkfWUw 63.999 fak_uw_b64 0 63.999 FORMAT "%8.5"
 /begin AXIS_DESCR COM_AXIS nmot_w nmot_uw_q0p25 7 0 16383.8 AXIS_PTS_REF SNM07LSUW /end AXIS_DESCR
 /begin AXIS_DESCR COM_AXIS rl_w rel_uw_q0p0234 8 0 1535.98 AXIS_PTS_REF SRL08LSUW /end AXIS_DESCR
/end CHARACTERISTIC
/begin CHARACTERISTIC KFLRST "Kennfeld Streckentotzeit" MAP 0x1361A KfAxUwAyUwSstxUwSstyUwWUw 327.67 tz10msxs_uw_b327p68 0.01 327.68 FORMAT "%8.4" /begin AXIS_DESCR STD_AXIS nmot_w nmot_uw_q0p25 7 0 16383.8 DEPOSIT ABSOLUTE /end AXIS_DESCR /begin AXIS_DESCR STD_AXIS rl_w rel_uw_q0p0234 8 0 1535.98 DEPOSIT ABSOLUTE /end AXIS_DESCR /end CHARACTERISTIC
/begin CHARACTERISTIC DLAMXSA "max Regeldifferenz, für die nach SA die LRS gesperrt bleibt" VALUE 0x136C6 KwUw 15.9998 fak_uw_b16 0 15.9998 FORMAT "%8.5" /end CHARACTERISTIC
/begin CHARACTERISTIC DTMR "Hysterese für Einschaltschwelle" VALUE 0x11206 KwUb 191.25 temp_ub_b191p25 0 191.25 FORMAT "%5.1" /end CHARACTERISTIC
/begin CHARACTERISTIC IMLSALR "Schwellwert integr. Luftmasse f. Einschaltverzögerung LR nach SA" VALUE 0x136C8 KwUw 4660.27 m_uw_b4660 0 4660.27 FORMAT "%8.3" /end CHARACTERISTIC
/begin CHARACTERISTIC NLRSHB "Drehzahlschwelle, Abschalten LR bei Schub, in Verbindung mit LL und TLLRSHB" VALUE 0x11207 KwUb 10200 nmot_ub_q40 0 10200 FORMAT "%5.0" /end CHARACTERISTIC
/begin CHARACTERISTIC RLLRSHB "relative Lastschwelle, Abschalten LR bei SLS, in Verbindung mit LL und NLRSHB" VALUE 0x11208 KwUb 191.25 rel_ub_q0p75 0 191.25 FORMAT "%5.1" /end CHARACTERISTIC
/begin CHARACTERISTIC TASHS "Schwelle Ansauglufttemp. für Auslösung TLRHS - Sperrzeit LR bei Heißstart" VALUE 0x1121A KwUb 191.25 temp_ub_q0p75_o48 -48 143.25 FORMAT "%5.1" /end CHARACTERISTIC
/begin CHARACTERISTIC TLRHS "Sperrzeit LR bei Heißstart, ausgelöst über Schwellen TASHS und TMSHS" VALUE 0x1122C KwUb 25.5 t100msxs_ub_b25p5 0 25.5 FORMAT "%5.2" /end CHARACTERISTIC
/begin CHARACTERISTIC TLRSZWSA "Zeitdauer für LRS-Zwangseinschaltung nach Schubabschneiden" VALUE 0x136B2 KwUw 6553.5 t100msxs_uw_b6553p5 0 6553.5 FORMAT "%8.3" /end CHARACTERISTIC
/begin CHARACTERISTIC TMRA1 "Ausschaltbedingung (S_LL = 0)" VALUE 0x1123E KwUb 191.25 temp_ub_q0p75_o48 -48 143.25 FORMAT "%5.1" /end CHARACTERISTIC
/begin CHARACTERISTIC TMRA2 "Ausschaltbedingung (S_LL = 1)" VALUE 0x1123F KwUb 191.25 temp_ub_q0p75_o48 -48 143.25 FORMAT "%5.1" /end CHARACTERISTIC
/begin CHARACTERISTIC TMSHS "Schwelle Motortemp. für Auslösung TLRHS - Sperrzeit LR bei Heißstart" VALUE 0x11240 KwUb 191.25 temp_ub_q0p75_o48 -48 143.25 FORMAT "%5.1" /end CHARACTERISTIC
/begin CHARACTERISTIC TRAU "Überwachungszeit für untere Lastschwelle der Lambdaregelung" VALUE 0x11241 KwUb 25.5 t100msxs_ub_b25p5 0 25.5 FORMAT "%5.2" /end CHARACTERISTIC
/begin CHARACTERISTIC RLLRUN "Kennlinie über nmot, untere rL Regelgrenze für Regler vor KAT" CURVE 0x11209 KlAUbSstUbWUb 191.25 rel_ub_q0p75 0 191.25 FORMAT "%5.1" /begin AXIS_DESCR STD_AXIS nmot nmot_ub_q40 8 0 10200 DEPOSIT ABSOLUTE /end AXIS_DESCR /end CHARACTERISTIC
/begin CHARACTERISTIC TLRBAM "Sperrzeit für Einschalten LR nach BA" CURVE 0x1121B KlAUbSstUbWUb 2.55 t10msxs_ub_b2p55 0 2.55 FORMAT "%5.3"
 /begin AXIS_DESCR STD_AXIS tmot temp_ub_q0p75_o48 8 -48 143.25 DEPOSIT ABSOLUTE /end AXIS_DESCR
/end CHARACTERISTIC
/begin CHARACTERISTIC TLRTMS "Sperrzeit LR nach Start, abhängig von der Motortemperatur bei Start" CURVE 0x136CA KlAUbSstUbWUw 6553.5 t100msxs_uw_b6553p5 0 6553.5 FORMAT "%8.3"
 /begin AXIS_DESCR STD_AXIS tmst temp_ub_q0p75_o48 5 -48 143.25 DEPOSIT ABSOLUTE /end AXIS_DESCR
/end CHARACTERISTIC
/begin CHARACTERISTIC TLRVAM "Sperrzeit für Einschalten LR nach VA" CURVE 0x1122D KlAUbSstUbWUb 2.55 t10msxs_ub_b2p55 0 2.55 FORMAT "%5.3"
 /begin AXIS_DESCR STD_AXIS tmot temp_ub_q0p75_o48 8 -48 143.25 DEPOSIT ABSOLUTE /end AXIS_DESCR
/end CHARACTERISTIC
/begin CHARACTERISTIC TSBBLSU "Verzögerung Regelbetriebsbereitschaft" CURVE 0x136B4 KlAUwSstUwWUw 6553.5 t100msxs_uw_b6553p5 0 6553.5 FORMAT "%8.3"
 /begin AXIS_DESCR STD_AXIS lamsstat_w fak_uw_b16 4 0 15.9998 DEPOSIT ABSOLUTE /end AXIS_DESCR
/end CHARACTERISTIC
/begin CHARACTERISTIC CWPWF "Codewort Powerfail" VALUE 0x11242 KwUb 255 dez 0 255 FORMAT "%5.1" /end CHARACTERISTIC
/begin CHARACTERISTIC AUFWSYNC "" VALUE 0x1125C KwUb 5100 t20usxus_q20 0 5100 FORMAT "%5.0" /end CHARACTERISTIC
/begin CHARACTERISTIC AUFW10MS "" VALUE 0x1125A KwUb 5100 t20usxus_q20 0 5100 FORMAT "%5.0" /end CHARACTERISTIC
/begin CHARACTERISTIC AUFW20MS "" VALUE 0x1125B KwUb 5100 t20usxus_q20 0 5100 FORMAT "%5.0" /end CHARACTERISTIC
/begin CHARACTERISTIC AUFW100M "" VALUE 0x11259 KwUb 5100 t20usxus_q20 0 5100 FORMAT "%5.0" /end CHARACTERISTIC
/begin CHARACTERISTIC RESETMAX "" VALUE 0x11258 KwUb 1 dez 0 1 FORMAT "%5.3" /end CHARACTERISTIC
/begin CHARACTERISTIC DZWETA "Deltazündwinkel aus Wirkungsgrad" CURVE 0x1125E FklWSb 191.25 zw_sb_q0p75 -96 95.25 FORMAT "%5.2"
 /begin AXIS_DESCR FIX_AXIS dzweta_in rel_ub_b127p5 201 0 100 FIX_AXIS_PAR 0 0 201 /end AXIS_DESCR
/end CHARACTERISTIC
/begin CHARACTERISTIC WPHN "Phasengang" CURVE 0x11357 GklWSb 191.25 zw_sb_q0p75 -96 95.25 FORMAT "%5.2" /begin AXIS_DESCR COM_AXIS nmot nmot_ub_q40 8 0 10200 AXIS_PTS_REF SNM08__UB /end AXIS_DESCR /end CHARACTERISTIC
/begin CHARACTERISTIC DZWZUEN1 "Zylinderindividueller Zündwinkeloffset, Zündung 1" CURVE 0x11327 GklWSb 12 zw_sb_q0p75 -6 6 FORMAT "%5.3" /begin AXIS_DESCR COM_AXIS nmot nmot_ub_q40 8 0 10200 AXIS_PTS_REF SNM08__UB /end AXIS_DESCR /end CHARACTERISTIC
/begin CHARACTERISTIC DZWZUEN2 "Zylinderindividueller Zündwinkeloffset, Zündung 2" CURVE 0x1132F GklWSb 12 zw_sb_q0p75 -6 6 FORMAT "%5.3" /begin AXIS_DESCR COM_AXIS nmot nmot_ub_q40 8 0 10200 AXIS_PTS_REF SNM08__UB /end AXIS_DESCR /end CHARACTERISTIC
/begin CHARACTERISTIC DZWZUEN3 "Zylinderindividueller Zündwinkeloffset, Zündung 3" CURVE 0x11337 GklWSb 12 zw_sb_q0p75 -6 6 FORMAT "%5.3" /begin AXIS_DESCR COM_AXIS nmot nmot_ub_q40 8 0 10200 AXIS_PTS_REF SNM08__UB /end AXIS_DESCR /end CHARACTERISTIC
/begin CHARACTERISTIC DZWZUEN4 "Zylinderindividueller Zündwinkeloffset, Zündung 4" CURVE 0x1133F GklWSb 12 zw_sb_q0p75 -6 6 FORMAT "%5.3" /begin AXIS_DESCR COM_AXIS nmot nmot_ub_q40 8 0 10200 AXIS_PTS_REF SNM08__UB /end AXIS_DESCR /end CHARACTERISTIC
/begin CHARACTERISTIC DZWZUEN5 "Zylinderindividueller Zündwinkeloffset, Zündung 5" CURVE 0x11347 GklWSb 12 zw_sb_q0p75 -6 6 FORMAT "%5.3" /begin AXIS_DESCR COM_AXIS nmot nmot_ub_q40 8 0 10200 AXIS_PTS_REF SNM08__UB /end AXIS_DESCR /end CHARACTERISTIC
/begin CHARACTERISTIC DZWZUEN6 "Zylinderindividueller Zündwinkeloffset, Zündung 6" CURVE 0x1134F GklWSb 12 zw_sb_q0p75 -6 6 FORMAT "%5.3" /begin AXIS_DESCR COM_AXIS nmot nmot_ub_q40 8 0 10200 AXIS_PTS_REF SNM08__UB /end AXIS_DESCR /end CHARACTERISTIC
/begin CHARACTERISTIC TSZOMIN "Mindestoffenzeit für Schliesszeitberechnung" VALUE 0x1399E KwUw 6553.5 txms_uw_q0p1 0 6553.5 FORMAT "%8.3" /end CHARACTERISTIC
/begin CHARACTERISTIC CWSZLIM "Codewort Schliesszeitbegrenzung" VALUE 0x1135F KwUb 255 dez 0 255 FORMAT "%5.1" /end CHARACTERISTIC
/begin CHARACTERISTIC KFSZT "Schließzeit-Kennfeld" MAP 0x11371 KfAxUbAyUbSstxUbSstyUbWUb 25.5 txms_ub_q0p1 0 25.5 FORMAT "%5.2" /begin AXIS_DESCR STD_AXIS ub spg_ubatt 6 0 17.3655 DEPOSIT ABSOLUTE /end AXIS_DESCR /begin AXIS_DESCR STD_AXIS nmot nmot_ub_q40 4 0 10200 DEPOSIT ABSOLUTE /end AXIS_DESCR /end CHARACTERISTIC
/begin CHARACTERISTIC FSZTM "Faktor Schließzeitkorrektur tmot-abhängig" CURVE 0x11360 KlAUbSstUbWUb 1.99219 fak_ub_b2 0 1.99219 FORMAT "%5.3"
 /begin AXIS_DESCR STD_AXIS tmot temp_ub_q0p75_o48 8 -48 143.25 DEPOSIT ABSOLUTE /end AXIS_DESCR
/end CHARACTERISTIC
/begin CHARACTERISTIC DZWAPPL "Delta Zündwinkel über Applikationstool" VALUE 0x11395 KwSb 12 zw_sb_q0p75 -6 6 FORMAT "%5.3" /end CHARACTERISTIC
/begin CHARACTERISTIC DZWNWSUE "Delta Zündwinkel abhängig von Nockenwellenüberschneidung" CURVE 0x13B0A KlAUbSstUbWSb 191.25 zw_sb_q0p75 -96 95.25 FORMAT "%5.2" /begin AXIS_DESCR STD_AXIS wnwue kw_ub_q0p5 10 0 127.5 DEPOSIT ABSOLUTE /end AXIS_DESCR /end CHARACTERISTIC
/begin CHARACTERISTIC DZWMAP2N "Zündwinkeloffset bei Mapposition 2" CURVE 0x13ABE KlAUbSstUbWSb 191.25 zw_sb_q0p75 -96 95.25 FORMAT "%5.2" /begin AXIS_DESCR STD_AXIS nmot nmot_ub_q40 18 0 10200 DEPOSIT ABSOLUTE /end AXIS_DESCR /end CHARACTERISTIC
/begin CHARACTERISTIC DZWMAP3N "Zündwinkeloffset bei Mapposition 3" CURVE 0x13AE4 KlAUbSstUbWSb 191.25 zw_sb_q0p75 -96 95.25 FORMAT "%5.2" /begin AXIS_DESCR STD_AXIS nmot nmot_ub_q40 18 0 10200 DEPOSIT ABSOLUTE /end AXIS_DESCR /end CHARACTERISTIC
/begin CHARACTERISTIC KFDZWKG "Zündwinkelkorrektur durch Verschieben der Klopfgrenze" MAP 0x13B20 KfAxUbAyUbSstxUbSstyUbWSb 15 zw_sb_q0p75 0 15 FORMAT "%5.2" /begin AXIS_DESCR STD_AXIS nmot nmot_ub_q40 8 0 10200 DEPOSIT ABSOLUTE /end AXIS_DESCR /begin AXIS_DESCR STD_AXIS lambas fak_ub_b2 5 0 1.99219 DEPOSIT ABSOLUTE /end AXIS_DESCR /end CHARACTERISTIC
/begin CHARACTERISTIC KFZW "Zündwinkelkennfeld" MAP 0x139A0 KfAxUbAyUbSstxUbSstyUbWSb 191.25 zw_sb_q0p75 -96 95.25 FORMAT "%5.2" /begin AXIS_DESCR STD_AXIS nmot nmot_ub_q40 18 0 10200 DEPOSIT ABSOLUTE /end AXIS_DESCR /begin AXIS_DESCR STD_AXIS rl rel_ub_q0p75 14 0 191.25 DEPOSIT ABSOLUTE /end AXIS_DESCR /end CHARACTERISTIC
/begin CHARACTERISTIC KFZW2 "Zündwinkelkennfeld Variante 2" MAP 0x11396 GkfWSb 191.25 zw_sb_q0p75 -96 95.25 FORMAT "%5.2"
 /begin AXIS_DESCR COM_AXIS nmot nmot_ub_q40 16 0 10200 AXIS_PTS_REF SNM16ZUUB /end AXIS_DESCR
 /begin AXIS_DESCR COM_AXIS rl rel_ub_q0p75 12 0 191.25 AXIS_PTS_REF SRL12ZUUB /end AXIS_DESCR
/end CHARACTERISTIC
/begin CHARACTERISTIC ZZWMNST "Zeitkonstante für Abregelung ZW-Begrenzung im Nachstart" VALUE 0x13B58 KwUw 13107 zk200msxs_uw_b13107 0.200003 13107.2 FORMAT "%10.4" /end CHARACTERISTIC
/begin CHARACTERISTIC DZWSPM "Delta spätester Zündwinkel abhängig von Motortemperatur" CURVE 0x11456 GklWSb 191.25 zw_sb_q0p75 -96 95.25 FORMAT "%5.2"
 /begin AXIS_DESCR COM_AXIS tmot temp_ub_q0p75_o48 6 -48 143.25 AXIS_PTS_REF STM06__UB /end AXIS_DESCR
/end CHARACTERISTIC
/begin CHARACTERISTIC KFZWMN "Min-Zündwinkel" MAP 0x1145C GkfWSb 191.25 zw_sb_q0p75 -96 95.25 FORMAT "%5.2"
 /begin AXIS_DESCR COM_AXIS nmot nmot_ub_q40 16 0 10200 AXIS_PTS_REF SNM16ZUUB /end AXIS_DESCR
 /begin AXIS_DESCR COM_AXIS rl rel_ub_q0p75 12 0 191.25 AXIS_PTS_REF SRL12ZUUB /end AXIS_DESCR
/end CHARACTERISTIC
/begin CHARACTERISTIC KFZWMNST "Min-Zündwinkel für Start und Nachstart" MAP 0x1151C GkfWSb 191.25 zw_sb_q0p75 -96 95.25 FORMAT "%5.2"
 /begin AXIS_DESCR COM_AXIS nmot nmot_ub_q40 16 0 10200 AXIS_PTS_REF SNM16ZUUB /end AXIS_DESCR
 /begin AXIS_DESCR COM_AXIS rl rel_ub_q0p75 12 0 191.25 AXIS_PTS_REF SRL12ZUUB /end AXIS_DESCR
/end CHARACTERISTIC
/begin CHARACTERISTIC FZWSTNM "Zündwinkel im Start" CURVE 0x13B76 KlAUbSstUbWSb 191.25 zw_sb_q0p75 -96 95.25 FORMAT "%5.2" /begin AXIS_DESCR STD_AXIS nmot nmot_ub_q40 6 0 10200 DEPOSIT ABSOLUTE /end AXIS_DESCR /end CHARACTERISTIC
/begin CHARACTERISTIC FZWSTTM "Zündwinkel im Start" CURVE 0x13B68 KlAUbSstUbWSb 191.25 zw_sb_q0p75 -96 95.25 FORMAT "%5.2"
 /begin AXIS_DESCR STD_AXIS tmst temp_ub_q0p75_o48 6 -48 143.25 DEPOSIT ABSOLUTE /end AXIS_DESCR
/end CHARACTERISTIC
/begin CHARACTERISTIC DZWSTTA "Delta Zündwinkel im Start" CURVE 0x13B5A KlAUbSstUbWSb 191.25 zw_sb_q0p75 -96 95.25 FORMAT "%5.2"
 /begin AXIS_DESCR STD_AXIS tans temp_ub_q0p75_o48 6 -48 143.25 DEPOSIT ABSOLUTE /end AXIS_DESCR
/end CHARACTERISTIC
/begin CHARACTERISTIC KFZWWLTM "Delta Zündwinkel im Warmlauf" MAP 0x13B84 KfAxUbAyUbSstxUbSstyUbWSb 191.25 zw_sb_q0p75 -96 95.25 FORMAT "%5.2"
 /begin AXIS_DESCR STD_AXIS tmot temp_ub_q0p75_o48 6 -48 143.25 DEPOSIT ABSOLUTE /end AXIS_DESCR
 /begin AXIS_DESCR STD_AXIS tmst temp_ub_q0p75_o48 6 -48 143.25 DEPOSIT ABSOLUTE /end AXIS_DESCR
/end CHARACTERISTIC
/begin CHARACTERISTIC KFZWWLNM "Delta Zündwinkel im Warmlauf" MAP 0x13BB6 KfAxUbAyUbSstxUbSstyUbWSb 191.25 zw_sb_q0p75 -96 95.25 FORMAT "%5.2" /begin AXIS_DESCR STD_AXIS rl rel_ub_q0p75 6 0 191.25 DEPOSIT ABSOLUTE /end AXIS_DESCR
 /begin AXIS_DESCR STD_AXIS tans temp_ub_q0p75_o48 6 -48 143.25 DEPOSIT ABSOLUTE /end AXIS_DESCR
/end CHARACTERISTIC
/begin MEASUREMENT acclchk "Längsbeschleunigung, Kontrollwert" SWORD g_uw_q100 1 100 -327.68 327.67 FORMAT "%8.4" /begin IF_DATA ASAP1B_KWP2000 KP_BLOB 0x380CFE EXTERN 0x2 /end IF_DATA /begin IF_DATA ETK KP_BLOB 0x380CFE EXTERN 0x2 /end IF_DATA /end MEASUREMENT
/begin MEASUREMENT acctchk "Querbeschleunigung, Kontrollwert" SWORD g_uw_q100 1 100 -327.68 327.67 FORMAT "%8.4" /begin IF_DATA ASAP1B_KWP2000 KP_BLOB 0x380D00 EXTERN 0x2 /end IF_DATA /begin IF_DATA ETK KP_BLOB 0x380D00 EXTERN 0x2 /end IF_DATA /end MEASUREMENT
/begin MEASUREMENT adjstat "Statusbyte für Fahrwerksjustierung" UBYTE default 1 100 0 255 FORMAT "%5.1" /begin IF_DATA ASAP1B_KWP2000 KP_BLOB 0x380420 EXTERN 0x1 /end IF_DATA /begin IF_DATA ETK KP_BLOB 0x380420 EXTERN 0x1 /end IF_DATA /end MEASUREMENT
/begin MEASUREMENT anzsegsz "Anzahl der Segmente für Berechnung Schliesszeitbegrenzung" UBYTE dez 1 100 0 255 FORMAT "%5.1" /begin IF_DATA ASAP1B_KWP2000 KP_BLOB 0x380476 EXTERN 0x1 /end IF_DATA /begin IF_DATA ETK KP_BLOB 0x380476 EXTERN 0x1 /end IF_DATA /end MEASUREMENT
/begin MEASUREMENT bfzglf "Fahrzeuglängsbeschleunigung gefiltert" SBYTE bfzg_sb_q0p217 1 100 -27.776 27.559 FORMAT "%5.2" /begin IF_DATA ASAP1B_KWP2000 KP_BLOB 0x38043C EXTERN 0x1 /end IF_DATA /begin IF_DATA ETK KP_BLOB 0x38043C EXTERN 0x1 /end IF_DATA /end MEASUREMENT
/begin MEASUREMENT B_adj "Justierung der Fahrwerkssensoren aktiv" UWORD B_TRUE 1 100 0 1 BIT_MASK 0x100 FORMAT "%5.3" /begin IF_DATA ASAP1B_KWP2000 KP_BLOB 0xFD2E INTERN 0x2 /end IF_DATA /begin IF_DATA ETK KP_BLOB 0xFD2E INTERN 0x2 /end IF_DATA /end MEASUREMENT
/begin MEASUREMENT B_asr "Bedingung für ASR aktiv" UWORD B_TRUE 1 100 0 1 BIT_MASK 0x2000 FORMAT "%5.3" /begin IF_DATA ASAP1B_KWP2000 KP_BLOB 0xFD16 INTERN 0x2 /end IF_DATA /begin IF_DATA ETK KP_BLOB 0xFD16 INTERN 0x2 /end IF_DATA /end MEASUREMENT
/begin MEASUREMENT B_bm "Bedingung Bezugsmarke erkannt" UWORD B_TRUE 1 100 0 1 BIT_MASK 0x200 FORMAT "%5.3" /begin IF_DATA ASAP1B_KWP2000 KP_BLOB 0xFD16 INTERN 0x2 /end IF_DATA /begin IF_DATA ETK KP_BLOB 0xFD16 INTERN 0x2 /end IF_DATA /end MEASUREMENT
/begin MEASUREMENT B_cdats "Bedingung Diagnose Abgastemperatursensor freigegeben" UWORD B_TRUE 1 100 0 1 BIT_MASK 0x200 FORMAT "%5.3" /begin IF_DATA ASAP1B_KWP2000 KP_BLOB 0x380536 EXTERN 0x2 /end IF_DATA /begin IF_DATA ETK KP_BLOB 0x380536 EXTERN 0x2 /end IF_DATA /end MEASUREMENT
/begin MEASUREMENT B_cdhsv "Funktion über Codewort CDHSV freigegeben" UWORD B_TRUE 1 100 0 1 BIT_MASK 0x40 FORMAT "%5.3" /begin IF_DATA ASAP1B_KWP2000 KP_BLOB 0x380536 EXTERN 0x2 /end IF_DATA /begin IF_DATA ETK KP_BLOB 0x380536 EXTERN 0x2 /end IF_DATA /end MEASUREMENT
/begin MEASUREMENT B_cdlsv "Funktion über Codewort CDLSV freigegeben" UWORD B_TRUE 1 100 0 1 BIT_MASK 0x8 FORMAT "%5.3" /begin IF_DATA ASAP1B_KWP2000 KP_BLOB 0x380536 EXTERN 0x2 /end IF_DATA /begin IF_DATA ETK KP_BLOB 0x380536 EXTERN 0x2 /end IF_DATA /end MEASUREMENT
/begin MEASUREMENT B_chk "Prüfmodus aktiv" UWORD B_TRUE 1 100 0 1 BIT_MASK 0x200 FORMAT "%5.3" /begin IF_DATA ASAP1B_KWP2000 KP_BLOB 0xFD2E INTERN 0x2 /end IF_DATA /begin IF_DATA ETK KP_BLOB 0xFD2E INTERN 0x2 /end IF_DATA /end MEASUREMENT
/begin MEASUREMENT B_clrltdi "Bedingung zurückgelegte Strecke über Lebensdauer löschen" UWORD B_TRUE 1 100 0 1 BIT_MASK 0x200 FORMAT "%5.3" /begin IF_DATA ASAP1B_KWP2000 KP_BLOB 0xFD38 INTERN 0x2 /end IF_DATA /begin IF_DATA ETK KP_BLOB 0xFD38 INTERN 0x2 /end IF_DATA /end MEASUREMENT
/begin MEASUREMENT B_clrltmot "Bedingung Motorbetriebszeit löschen" UWORD B_TRUE 1 100 0 1 BIT_MASK 0x400 FORMAT "%5.3" /begin IF_DATA ASAP1B_KWP2000 KP_BLOB 0xFD38 INTERN 0x2 /end IF_DATA /begin IF_DATA ETK KP_BLOB 0xFD38 INTERN 0x2 /end IF_DATA /end MEASUREMENT
/begin MEASUREMENT B_clrltnmo "Bedingung Drehzahlmonitor löschen" UWORD B_TRUE 1 100 0 1 BIT_MASK 0x800 FORMAT "%5.3" /begin IF_DATA ASAP1B_KWP2000 KP_BLOB 0xFD38 INTERN 0x2 /end IF_DATA /begin IF_DATA ETK KP_BLOB 0xFD38 INTERN 0x2 /end IF_DATA /end MEASUREMENT
/begin MEASUREMENT B_clrltnmx "Bedingung Maximaldrehzahlspeicher löschen" UWORD B_TRUE 1 100 0 1 BIT_MASK 0x1000 FORMAT "%5.3" /begin IF_DATA ASAP1B_KWP2000 KP_BLOB 0xFD38 INTERN 0x2 /end IF_DATA /begin IF_DATA ETK KP_BLOB 0xFD38 INTERN 0x2 /end IF_DATA /end MEASUREMENT
/begin MEASUREMENT B_delaysyn "Flag für eine Verzögerung um 1 Lücke zur Neusynchronisierung" UWORD B_TRUE 1 100 0 1 BIT_MASK 0x800 FORMAT "%5.3" /begin IF_DATA ASAP1B_KWP2000 KP_BLOB 0xFD1A INTERN 0x2 /end IF_DATA /begin IF_DATA ETK KP_BLOB 0xFD1A INTERN 0x2 /end IF_DATA /end MEASUREMENT
/begin MEASUREMENT B_dssv "Bedingung Saugrohr-Drucksensor vorhanden als Hauptlastsensor" UWORD B_TRUE 1 100 0 1 BIT_MASK 0x4000 FORMAT "%5.3" /begin IF_DATA ASAP1B_KWP2000 KP_BLOB 0xFD16 INTERN 0x2 /end IF_DATA /begin IF_DATA ETK KP_BLOB 0xFD16 INTERN 0x2 /end IF_DATA /end MEASUREMENT
/begin MEASUREMENT B_dsuv "Umgebungsdrucksensor ist vorhanden" UWORD B_TRUE 1 100 0 1 BIT_MASK 0x8000 FORMAT "%5.3" /begin IF_DATA ASAP1B_KWP2000 KP_BLOB 0xFD16 INTERN 0x2 /end IF_DATA /begin IF_DATA ETK KP_BLOB 0xFD16 INTERN 0x2 /end IF_DATA /end MEASUREMENT
/begin MEASUREMENT B_eobdlr "OBDII-Summenfehler. sperrt die LR" UWORD B_TRUE 1 100 0 1 BIT_MASK 0x200 FORMAT "%5.3" /begin IF_DATA ASAP1B_KWP2000 KP_BLOB 0xFD42 INTERN 0x2 /end IF_DATA /begin IF_DATA ETK KP_BLOB 0xFD42 INTERN 0x2 /end IF_DATA /end MEASUREMENT
/begin MEASUREMENT B_eobdlr2 "OBDII-Summenfehler. sperrt die LR, Bank 2" UWORD B_TRUE 1 100 0 1 BIT_MASK 0x400 FORMAT "%5.3" /begin IF_DATA ASAP1B_KWP2000 KP_BLOB 0xFD42 INTERN 0x2 /end IF_DATA /begin IF_DATA ETK KP_BLOB 0xFD42 INTERN 0x2 /end IF_DATA /end MEASUREMENT
/begin MEASUREMENT B_fbm "Bedingung Bezugsmarkenfehler => mindestens 1 Zahn zuviel oder zuwenig erkannt" UWORD B_TRUE 1 100 0 1 BIT_MASK 0x400 FORMAT "%5.3" /begin IF_DATA ASAP1B_KWP2000 KP_BLOB 0xFD16 INTERN 0x2 /end IF_DATA /begin IF_DATA ETK KP_BLOB 0xFD16 INTERN 0x2 /end IF_DATA /end MEASUREMENT
/begin MEASUREMENT B_fil "Bedingung PT1-Filter für SAWE aktiv" UWORD B_TRUE 1 100 0 1 BIT_MASK 0x20 FORMAT "%5.3" /begin IF_DATA ASAP1B_KWP2000 KP_BLOB 0xFD36 INTERN 0x2 /end IF_DATA /begin IF_DATA ETK KP_BLOB 0xFD36 INTERN 0x2 /end IF_DATA /end MEASUREMENT
/begin MEASUREMENT B_frmax "Lambda-Regelung setzt Bit sobald FR am Anschlag FRMAX" UWORD B_TRUE 1 100 0 1 BIT_MASK 0x2000 FORMAT "%5.3" /begin IF_DATA ASAP1B_KWP2000 KP_BLOB 0xFD40 INTERN 0x2 /end IF_DATA /begin IF_DATA ETK KP_BLOB 0xFD40 INTERN 0x2 /end IF_DATA /end MEASUREMENT
/begin MEASUREMENT B_frmax2 "Lambda-Regelung setzt Bit sobald FR am Anschlag FRMAX, Bank 2" UWORD B_TRUE 1 100 0 1 BIT_MASK 0x4000 FORMAT "%5.3" /begin IF_DATA ASAP1B_KWP2000 KP_BLOB 0xFD40 INTERN 0x2 /end IF_DATA /begin IF_DATA ETK KP_BLOB 0xFD40 INTERN 0x2 /end IF_DATA /end MEASUREMENT
/begin MEASUREMENT B_frmin "Lambda-Regelung setzt Bit sobald FR am Anschlag FRMIN" UWORD B_TRUE 1 100 0 1 BIT_MASK 0x8000 FORMAT "%5.3" /begin IF_DATA ASAP1B_KWP2000 KP_BLOB 0xFD40 INTERN 0x2 /end IF_DATA /begin IF_DATA ETK KP_BLOB 0xFD40 INTERN 0x2 /end IF_DATA /end MEASUREMENT
/begin MEASUREMENT B_frmin2 "Lambda-Regelung setzt Bit sobald FR am Anschlag FRMIN, Bank 2" UWORD B_TRUE 1 100 0 1 BIT_MASK 0x1 FORMAT "%5.3" /begin IF_DATA ASAP1B_KWP2000 KP_BLOB 0xFD42 INTERN 0x2 /end IF_DATA /begin IF_DATA ETK KP_BLOB 0xFD42 INTERN 0x2 /end IF_DATA /end MEASUREMENT
/begin MEASUREMENT B_gasp "Bedingung Grundadaption gesperrt" UWORD B_TRUE 1 100 0 1 BIT_MASK 0x2000 FORMAT "%5.3" /begin IF_DATA ASAP1B_KWP2000 KP_BLOB 0xFD28 INTERN 0x2 /end IF_DATA /begin IF_DATA ETK KP_BLOB 0xFD28 INTERN 0x2 /end IF_DATA /end MEASUREMENT
/begin MEASUREMENT B_hr "Bedingung Hauptrelais ein" UWORD B_TRUE 1 100 0 1 BIT_MASK 0x4 FORMAT "%5.3" /begin IF_DATA ASAP1B_KWP2000 KP_BLOB 0xFD2A INTERN 0x2 /end IF_DATA /begin IF_DATA ETK KP_BLOB 0xFD2A INTERN 0x2 /end IF_DATA /end MEASUREMENT
/begin MEASUREMENT B_iflsd "Bedingung Initialisierung Filter Lastschlagdämpfung" UWORD B_TRUE 1 100 0 1 BIT_MASK 0x200 FORMAT "%5.3" /begin IF_DATA ASAP1B_KWP2000 KP_BLOB 0xFD34 INTERN 0x2 /end IF_DATA /begin IF_DATA ETK KP_BLOB 0xFD34 INTERN 0x2 /end IF_DATA /end MEASUREMENT
/begin MEASUREMENT B_iniSyn "" UWORD B_TRUE 1 100 0 1 BIT_MASK 0x800 FORMAT "%5.3" /begin IF_DATA ASAP1B_KWP2000 KP_BLOB 0xFD16 INTERN 0x2 /end IF_DATA /begin IF_DATA ETK KP_BLOB 0xFD16 INTERN 0x2 /end IF_DATA /end MEASUREMENT
/begin MEASUREMENT B_kl15 "Bedingung Klemme 15" UWORD B_TRUE 1 100 0 1 BIT_MASK 0x8 FORMAT "%5.3" /begin IF_DATA ASAP1B_KWP2000 KP_BLOB 0xFD2A INTERN 0x2 /end IF_DATA /begin IF_DATA ETK KP_BLOB 0xFD2A INTERN 0x2 /end IF_DATA /end MEASUREMENT
/begin MEASUREMENT B_lr "LREB: Bedingung Lambdaregelung (vor Kat); (Bank 1)" UWORD B_TRUE 1 100 0 1 BIT_MASK 0x800 FORMAT "%5.3" /begin IF_DATA ASAP1B_KWP2000 KP_BLOB 0xFD42 INTERN 0x2 /end IF_DATA /begin IF_DATA ETK KP_BLOB 0xFD42 INTERN 0x2 /end IF_DATA /end MEASUREMENT
/begin MEASUREMENT B_lr2 "Bedingung Lambdaregelung (vor Kat); Bank 2" UWORD B_TRUE 1 100 0 1 BIT_MASK 0x1000 FORMAT "%5.3" /begin IF_DATA ASAP1B_KWP2000 KP_BLOB 0xFD42 INTERN 0x2 /end IF_DATA /begin IF_DATA ETK KP_BLOB 0xFD42 INTERN 0x2 /end IF_DATA /end MEASUREMENT
/begin MEASUREMENT B_lra "Bedingung Gemischadaption freigegeben" UWORD B_TRUE 1 100 0 1 BIT_MASK 0x4000 FORMAT "%5.3" /begin IF_DATA ASAP1B_KWP2000 KP_BLOB 0xFD28 INTERN 0x2 /end IF_DATA /begin IF_DATA ETK KP_BLOB 0xFD28 INTERN 0x2 /end IF_DATA /end MEASUREMENT
/begin MEASUREMENT B_lra2 "Bedingung Gemischadaption 2 freigegeben" UWORD B_TRUE 1 100 0 1 BIT_MASK 0x8000 FORMAT "%5.3" /begin IF_DATA ASAP1B_KWP2000 KP_BLOB 0xFD28 INTERN 0x2 /end IF_DATA /begin IF_DATA ETK KP_BLOB 0xFD28 INTERN 0x2 /end IF_DATA /end MEASUREMENT
/begin MEASUREMENT B_lrin "Steuerbit LRS intern" UWORD B_TRUE 1 100 0 1 BIT_MASK 0x2 FORMAT "%5.3" /begin IF_DATA ASAP1B_KWP2000 KP_BLOB 0xFD42 INTERN 0x2 /end IF_DATA /begin IF_DATA ETK KP_BLOB 0xFD42 INTERN 0x2 /end IF_DATA /end MEASUREMENT
/begin MEASUREMENT B_lrin2 "Steuerbit LRS intern, Bank2" UWORD B_TRUE 1 100 0 1 BIT_MASK 0x4 FORMAT "%5.3" /begin IF_DATA ASAP1B_KWP2000 KP_BLOB 0xFD42 INTERN 0x2 /end IF_DATA /begin IF_DATA ETK KP_BLOB 0xFD42 INTERN 0x2 /end IF_DATA /end MEASUREMENT
/begin MEASUREMENT B_lrms "Bedingung Abmagerungsverbot für stetige Regelung" UWORD B_TRUE 1 100 0 1 BIT_MASK 0x2000 FORMAT "%5.3" /begin IF_DATA ASAP1B_KWP2000 KP_BLOB 0xFD42 INTERN 0x2 /end IF_DATA /begin IF_DATA ETK KP_BLOB 0xFD42 INTERN 0x2 /end IF_DATA /end MEASUREMENT
/begin MEASUREMENT B_lrnda "LR Bank1 aktiv bei Bedingungen : B_lrpspa & B_lrkasn & !E_obdlr" UWORD B_TRUE 1 100 0 1 BIT_MASK 0x4000 FORMAT "%5.3" /begin IF_DATA ASAP1B_KWP2000 KP_BLOB 0xFD42 INTERN 0x2 /end IF_DATA /begin IF_DATA ETK KP_BLOB 0xFD42 INTERN 0x2 /end IF_DATA /end MEASUREMENT
/begin MEASUREMENT B_lrnda2 "LR Bank2 aktiv bei Bedingungen : B_lrpspa & B_lrkasn & !E_obdlr" UWORD B_TRUE 1 100 0 1 BIT_MASK 0x8000 FORMAT "%5.3" /begin IF_DATA ASAP1B_KWP2000 KP_BLOB 0xFD42 INTERN 0x2 /end IF_DATA /begin IF_DATA ETK KP_BLOB 0xFD42 INTERN 0x2 /end IF_DATA /end MEASUREMENT
/begin MEASUREMENT B_lrrl "LREB: Von Last abhängige Bedingung Lambdaregelung (vor Kat)" UWORD B_TRUE 1 100 0 1 BIT_MASK 0x1 FORMAT "%5.3" /begin IF_DATA ASAP1B_KWP2000 KP_BLOB 0xFD44 INTERN 0x2 /end IF_DATA /begin IF_DATA ETK KP_BLOB 0xFD44 INTERN 0x2 /end IF_DATA /end MEASUREMENT
/begin MEASUREMENT B_lrs "LRSEB: Bedingung Lambdaregelung intern (vor Kat), Bank 1" UWORD B_TRUE 1 100 0 1 BIT_MASK 0x2 FORMAT "%5.3" /begin IF_DATA ASAP1B_KWP2000 KP_BLOB 0xFD44 INTERN 0x2 /end IF_DATA /begin IF_DATA ETK KP_BLOB 0xFD44 INTERN 0x2 /end IF_DATA /end MEASUREMENT
/begin MEASUREMENT B_lrs2 "LRSEB: Bedingung Lambdaregelung intern (vor Kat), Bank 2" UWORD B_TRUE 1 100 0 1 BIT_MASK 0x4 FORMAT "%5.3" /begin IF_DATA ASAP1B_KWP2000 KP_BLOB 0xFD44 INTERN 0x2 /end IF_DATA /begin IF_DATA ETK KP_BLOB 0xFD44 INTERN 0x2 /end IF_DATA /end MEASUREMENT
/begin MEASUREMENT B_lrssa "LRSEB: Einschaltbed. für Lambdareg. nach Schub bei langsamer Sonde" UWORD B_TRUE 1 100 0 1 BIT_MASK 0x8 FORMAT "%5.3" /begin IF_DATA ASAP1B_KWP2000 KP_BLOB 0xFD44 INTERN 0x2 /end IF_DATA /begin IF_DATA ETK KP_BLOB 0xFD44 INTERN 0x2 /end IF_DATA /end MEASUREMENT
/begin MEASUREMENT B_lrssa2 "Einschaltbed. für Lambdareg. nach Schub bei langsamer Sonde, Bank2" UWORD B_TRUE 1 100 0 1 BIT_MASK 0x10 FORMAT "%5.3" /begin IF_DATA ASAP1B_KWP2000 KP_BLOB 0xFD44 INTERN 0x2 /end IF_DATA /begin IF_DATA ETK KP_BLOB 0xFD44 INTERN 0x2 /end IF_DATA /end MEASUREMENT
/begin MEASUREMENT B_lsh "Bedingung Lambda-Sonde hinter Kat verbaut" UWORD B_TRUE 1 100 0 1 BIT_MASK 0x1 FORMAT "%5.3" /begin IF_DATA ASAP1B_KWP2000 KP_BLOB 0xFD18 INTERN 0x2 /end IF_DATA /begin IF_DATA ETK KP_BLOB 0xFD18 INTERN 0x2 /end IF_DATA /end MEASUREMENT
/begin MEASUREMENT B_lsh2 "Bedingung Lambda-Sonde hinter Kat verbaut (Bank2)" UWORD B_TRUE 1 100 0 1 BIT_MASK 0x2 FORMAT "%5.3" /begin IF_DATA ASAP1B_KWP2000 KP_BLOB 0xFD18 INTERN 0x2 /end IF_DATA /begin IF_DATA ETK KP_BLOB 0xFD18 INTERN 0x2 /end IF_DATA /end MEASUREMENT
/begin MEASUREMENT B_lsv "Bedingung Lambda-Sonde vor Kat verbaut, 1. Sonde nach Auslaß (Bank1)" UWORD B_TRUE 1 100 0 1 BIT_MASK 0x4 FORMAT "%5.3" /begin IF_DATA ASAP1B_KWP2000 KP_BLOB 0xFD18 INTERN 0x2 /end IF_DATA /begin IF_DATA ETK KP_BLOB 0xFD18 INTERN 0x2 /end IF_DATA /end MEASUREMENT
/begin MEASUREMENT B_lsv2 "Bedingung Lambda-Sonde vor Kat verbaut, 1. Sonde nach Auslaß (Bank2)" UWORD B_TRUE 1 100 0 1 BIT_MASK 0x8 FORMAT "%5.3" /begin IF_DATA ASAP1B_KWP2000 KP_BLOB 0xFD18 INTERN 0x2 /end IF_DATA /begin IF_DATA ETK KP_BLOB 0xFD18 INTERN 0x2 /end IF_DATA /end MEASUREMENT
/begin MEASUREMENT B_lt6min "Bedingung SG-Betriebszeit, 6 Minuten verstrichen" UWORD B_TRUE 1 100 0 1 BIT_MASK 0x2000 FORMAT "%5.3" /begin IF_DATA ASAP1B_KWP2000 KP_BLOB 0xFD38 INTERN 0x2 /end IF_DATA /begin IF_DATA ETK KP_BLOB 0xFD38 INTERN 0x2 /end IF_DATA /end MEASUREMENT
/begin MEASUREMENT B_ltnmotmx "Bedingung neue Maximaldrehzahl aufgetreten" UWORD B_TRUE 1 100 0 1 BIT_MASK 0x4000 FORMAT "%5.3" /begin IF_DATA ASAP1B_KWP2000 KP_BLOB 0xFD38 INTERN 0x2 /end IF_DATA /begin IF_DATA ETK KP_BLOB 0xFD38 INTERN 0x2 /end IF_DATA /end MEASUREMENT
/begin MEASUREMENT B_lwsd "Bedingung Lastwechselschlagdämpfung läuft" UWORD B_TRUE 1 100 0 1 BIT_MASK 0x2000 FORMAT "%5.3" /begin IF_DATA ASAP1B_KWP2000 KP_BLOB 0xFD34 INTERN 0x2 /end IF_DATA /begin IF_DATA ETK KP_BLOB 0xFD34 INTERN 0x2 /end IF_DATA /end MEASUREMENT
/begin MEASUREMENT B_lwsdsa "Bedingung Lastwechselschlagdämpfung aus Schubabschaltung" UWORD B_TRUE 1 100 0 1 BIT_MASK 0x400 FORMAT "%5.3" /begin IF_DATA ASAP1B_KWP2000 KP_BLOB 0xFD34 INTERN 0x2 /end IF_DATA /begin IF_DATA ETK KP_BLOB 0xFD34 INTERN 0x2 /end IF_DATA /end MEASUREMENT
/begin MEASUREMENT B_lwsfao "Bedingung obere Kupplungsschwelle überschritten" UWORD B_TRUE 1 100 0 1 BIT_MASK 0x800 FORMAT "%5.3" /begin IF_DATA ASAP1B_KWP2000 KP_BLOB 0xFD34 INTERN 0x2 /end IF_DATA /begin IF_DATA ETK KP_BLOB 0xFD34 INTERN 0x2 /end IF_DATA /end MEASUREMENT
/begin MEASUREMENT B_lwsuk "Bedingung Lastwechselschlagdämpfung untere Kupplungsmomentscwelle unterschritten" UWORD B_TRUE 1 100 0 1 BIT_MASK 0x1000 FORMAT "%5.3" /begin IF_DATA ASAP1B_KWP2000 KP_BLOB 0xFD34 INTERN 0x2 /end IF_DATA /begin IF_DATA ETK KP_BLOB 0xFD34 INTERN 0x2 /end IF_DATA /end MEASUREMENT
/begin MEASUREMENT B_mappin1 "Bedingung SG-Pin für Mapschalter, Pin1" UWORD B_TRUE 1 100 0 1 BIT_MASK 0x10 FORMAT "%5.3" /begin IF_DATA ASAP1B_KWP2000 KP_BLOB 0xFD2A INTERN 0x2 /end IF_DATA /begin IF_DATA ETK KP_BLOB 0xFD2A INTERN 0x2 /end IF_DATA /end MEASUREMENT
/begin MEASUREMENT B_mappin2 "Bedingung SG-Pin für Mapschalter, Pin2" UWORD B_TRUE 1 100 0 1 BIT_MASK 0x20 FORMAT "%5.3" /begin IF_DATA ASAP1B_KWP2000 KP_BLOB 0xFD2A INTERN 0x2 /end IF_DATA /begin IF_DATA ETK KP_BLOB 0xFD2A INTERN 0x2 /end IF_DATA /end MEASUREMENT
/begin MEASUREMENT B_mcacti "Bedingung McMESS aktiv" UWORD B_TRUE 1 100 0 1 BIT_MASK 0x80 FORMAT "%5.3" /begin IF_DATA ASAP1B_KWP2000 KP_BLOB 0xFD18 INTERN 0x2 /end IF_DATA /begin IF_DATA ETK KP_BLOB 0xFD18 INTERN 0x2 /end IF_DATA /end MEASUREMENT
/begin MEASUREMENT B_mdee "Bedingung Momentenreduzierung über Einspritzausblendung erlaubt" UWORD B_TRUE 1 100 0 1 BIT_MASK 0x1 FORMAT "%5.3" /begin IF_DATA ASAP1B_KWP2000 KP_BLOB 0xFD36 INTERN 0x2 /end IF_DATA /begin IF_DATA ETK KP_BLOB 0xFD36 INTERN 0x2 /end IF_DATA /end MEASUREMENT
/begin MEASUREMENT B_mdredhyein "" UWORD B_TRUE 1 100 0 1 BIT_MASK 0x2 FORMAT "%5.3" /begin IF_DATA ASAP1B_KWP2000 KP_BLOB 0xFD36 INTERN 0x2 /end IF_DATA /begin IF_DATA ETK KP_BLOB 0xFD36 INTERN 0x2 /end IF_DATA /end MEASUREMENT
/begin MEASUREMENT B_memainf "Bedingung Aufzeichnungsinformation in Ordnung" UWORD B_TRUE 1 100 0 1 BIT_MASK 0x400 FORMAT "%5.3" /begin IF_DATA ASAP1B_KWP2000 KP_BLOB 0xFD2E INTERN 0x2 /end IF_DATA /begin IF_DATA ETK KP_BLOB 0xFD2E INTERN 0x2 /end IF_DATA /end MEASUREMENT
/begin MEASUREMENT B_memcan "Bedingung externes Memory erkannt" UWORD B_TRUE 1 100 0 1 BIT_MASK 0x800 FORMAT "%5.3" /begin IF_DATA ASAP1B_KWP2000 KP_BLOB 0xFD2E INTERN 0x2 /end IF_DATA /begin IF_DATA ETK KP_BLOB 0xFD2E INTERN 0x2 /end IF_DATA /end MEASUREMENT
/begin MEASUREMENT B_memcard "Bedingung Speicherkarte in Memory erkannt" UWORD B_TRUE 1 100 0 1 BIT_MASK 0x1000 FORMAT "%5.3" /begin IF_DATA ASAP1B_KWP2000 KP_BLOB 0xFD2E INTERN 0x2 /end IF_DATA /begin IF_DATA ETK KP_BLOB 0xFD2E INTERN 0x2 /end IF_DATA /end MEASUREMENT
/begin MEASUREMENT B_memcardn "Bedingung neu initialisierte  Karte erkannt" UWORD B_TRUE 1 100 0 1 BIT_MASK 0x2000 FORMAT "%5.3" /begin IF_DATA ASAP1B_KWP2000 KP_BLOB 0xFD2E INTERN 0x2 /end IF_DATA /begin IF_DATA ETK KP_BLOB 0xFD2E INTERN 0x2 /end IF_DATA /end MEASUREMENT
/begin MEASUREMENT B_memkenn "Bedingung Kennung der Aufzeichnungsinformation in Ordnung" UWORD B_TRUE 1 100 0 1 BIT_MASK 0x4000 FORMAT "%5.3" /begin IF_DATA ASAP1B_KWP2000 KP_BLOB 0xFD2E INTERN 0x2 /end IF_DATA /begin IF_DATA ETK KP_BLOB 0xFD2E INTERN 0x2 /end IF_DATA /end MEASUREMENT
/begin MEASUREMENT B_memlap "Bedingung Rundeninformation wird gesendet" UWORD B_TRUE 1 100 0 1 BIT_MASK 0x8000 FORMAT "%5.3" /begin IF_DATA ASAP1B_KWP2000 KP_BLOB 0xFD2E INTERN 0x2 /end IF_DATA /begin IF_DATA ETK KP_BLOB 0xFD2E INTERN 0x2 /end IF_DATA /end MEASUREMENT
/begin MEASUREMENT B_memrec "Bedingung Aufzeichnung aktiv" UWORD B_TRUE 1 100 0 1 BIT_MASK 0x1 FORMAT "%5.3" /begin IF_DATA ASAP1B_KWP2000 KP_BLOB 0xFD30 INTERN 0x2 /end IF_DATA /begin IF_DATA ETK KP_BLOB 0xFD30 INTERN 0x2 /end IF_DATA /end MEASUREMENT
/begin MEASUREMENT B_memstat "Bedingung Statusblock wird gesendet" UWORD B_TRUE 1 100 0 1 BIT_MASK 0x2 FORMAT "%5.3" /begin IF_DATA ASAP1B_KWP2000 KP_BLOB 0xFD30 INTERN 0x2 /end IF_DATA /begin IF_DATA ETK KP_BLOB 0xFD30 INTERN 0x2 /end IF_DATA /end MEASUREMENT
/begin MEASUREMENT B_memwgcom "Bedingung Block mit falschem Kommando wurde übermittelt" UWORD B_TRUE 1 100 0 1 BIT_MASK 0x4 FORMAT "%5.3" /begin IF_DATA ASAP1B_KWP2000 KP_BLOB 0xFD30 INTERN 0x2 /end IF_DATA /begin IF_DATA ETK KP_BLOB 0xFD30 INTERN 0x2 /end IF_DATA /end MEASUREMENT
/begin MEASUREMENT B_minmax "Bedingung Freigabe der Min/Max-Datenerfassung" UWORD B_TRUE 1 100 0 1 BIT_MASK 0x20 FORMAT "%5.3" /begin IF_DATA ASAP1B_KWP2000 KP_BLOB 0xFD34 INTERN 0x2 /end IF_DATA /begin IF_DATA ETK KP_BLOB 0xFD34 INTERN 0x2 /end IF_DATA /end MEASUREMENT
/begin MEASUREMENT B_mlrsa "LRSEB: Ausschaltbed. für Lambdareg. auf bei und nach Schub über Luftmassenschw." UWORD B_TRUE 1 100 0 1 BIT_MASK 0x20 FORMAT "%5.3" /begin IF_DATA ASAP1B_KWP2000 KP_BLOB 0xFD44 INTERN 0x2 /end IF_DATA /begin IF_DATA ETK KP_BLOB 0xFD44 INTERN 0x2 /end IF_DATA /end MEASUREMENT
/begin MEASUREMENT B_nachl "Steuerung SG-Nachlauf" UWORD B_TRUE 1 100 0 1 BIT_MASK 0x8000 FORMAT "%5.3" /begin IF_DATA ASAP1B_KWP2000 KP_BLOB 0x382B62 EXTERN 0x2 /end IF_DATA /begin IF_DATA ETK KP_BLOB 0x382B62 EXTERN 0x2 /end IF_DATA /end MEASUREMENT
/begin MEASUREMENT B_nachlend "Bedingung SG-Nachlauf regulär beendet" UWORD B_TRUE 1 100 0 1 BIT_MASK 0x4000 FORMAT "%5.3" /begin IF_DATA ASAP1B_KWP2000 KP_BLOB 0x382B62 EXTERN 0x2 /end IF_DATA /begin IF_DATA ETK KP_BLOB 0x382B62 EXTERN 0x2 /end IF_DATA /end MEASUREMENT
/begin MEASUREMENT B_nlEEPR "Bedingung Nachlauf EEPROM schreiben" UWORD B_TRUE 1 100 0 1 BIT_MASK 0x20 FORMAT "%5.3" /begin IF_DATA ASAP1B_KWP2000 KP_BLOB 0x382B62 EXTERN 0x2 /end IF_DATA /begin IF_DATA ETK KP_BLOB 0x382B62 EXTERN 0x2 /end IF_DATA /end MEASUREMENT
/begin MEASUREMENT B_nlobd "Anforderung Steuergerätenachlauf von OBD" UWORD B_TRUE 1 100 0 1 BIT_MASK 0x10 FORMAT "%5.3" /begin IF_DATA ASAP1B_KWP2000 KP_BLOB 0x382B62 EXTERN 0x2 /end IF_DATA /begin IF_DATA ETK KP_BLOB 0x382B62 EXTERN 0x2 /end IF_DATA /end MEASUREMENT
/begin MEASUREMENT B_nmax "Bedingung Drehzahlbegrenzung aktiv" UWORD B_TRUE 1 100 0 1 BIT_MASK 0x4000 FORMAT "%5.3" /begin IF_DATA ASAP1B_KWP2000 KP_BLOB 0xFD34 INTERN 0x2 /end IF_DATA /begin IF_DATA ETK KP_BLOB 0xFD34 INTERN 0x2 /end IF_DATA /end MEASUREMENT
/begin MEASUREMENT B_nmaxd "Bedingung Drehzahlbegrenzung mit Einspritzausblendung an allen Zylindern" UWORD B_TRUE 1 100 0 1 BIT_MASK 0x8000 FORMAT "%5.3" /begin IF_DATA ASAP1B_KWP2000 KP_BLOB 0xFD34 INTERN 0x2 /end IF_DATA /begin IF_DATA ETK KP_BLOB 0xFD34 INTERN 0x2 /end IF_DATA /end MEASUREMENT
/begin MEASUREMENT B_nosynph "Flag für falsche Zylinderzuordnung bei Synchronisierlücke" UWORD B_TRUE 1 100 0 1 BIT_MASK 0x1000 FORMAT "%5.3" /begin IF_DATA ASAP1B_KWP2000 KP_BLOB 0xFD1A INTERN 0x2 /end IF_DATA /begin IF_DATA ETK KP_BLOB 0xFD1A INTERN 0x2 /end IF_DATA /end MEASUREMENT
/begin MEASUREMENT B_nozwe "Bedingung kein Zündwinkeleingriff der Drehmomentstruktur" UWORD B_TRUE 1 100 0 1 BIT_MASK 0x100 FORMAT "%5.3" /begin IF_DATA ASAP1B_KWP2000 KP_BLOB 0xFD34 INTERN 0x2 /end IF_DATA /begin IF_DATA ETK KP_BLOB 0xFD34 INTERN 0x2 /end IF_DATA /end MEASUREMENT
/begin MEASUREMENT B_pspaus "Bedingung LR inaktiv bei projektspez. AUS-Bedingungen" UWORD B_TRUE 1 100 0 1 BIT_MASK 0x40 FORMAT "%5.3" /begin IF_DATA ASAP1B_KWP2000 KP_BLOB 0xFD44 INTERN 0x2 /end IF_DATA /begin IF_DATA ETK KP_BLOB 0xFD44 INTERN 0x2 /end IF_DATA /end MEASUREMENT
/begin MEASUREMENT B_pspwl "Bedingung LR inaktiv bei projektspez. Warmlauf-Bedingungen" UWORD B_TRUE 1 100 0 1 BIT_MASK 0x80 FORMAT "%5.3" /begin IF_DATA ASAP1B_KWP2000 KP_BLOB 0xFD44 INTERN 0x2 /end IF_DATA /begin IF_DATA ETK KP_BLOB 0xFD44 INTERN 0x2 /end IF_DATA /end MEASUREMENT
/begin MEASUREMENT B_pwf "Bedingung Powerfail" UWORD B_TRUE 1 100 0 1 BIT_MASK 0x800 FORMAT "%5.3" /begin IF_DATA ASAP1B_KWP2000 KP_BLOB 0xFD44 INTERN 0x2 /end IF_DATA /begin IF_DATA ETK KP_BLOB 0xFD44 INTERN 0x2 /end IF_DATA /end MEASUREMENT
/begin MEASUREMENT B_sa "Bedingung Schubabschalten" UWORD B_TRUE 1 100 0 1 BIT_MASK 0x4 FORMAT "%5.3" /begin IF_DATA ASAP1B_KWP2000 KP_BLOB 0xFD36 INTERN 0x2 /end IF_DATA /begin IF_DATA ETK KP_BLOB 0xFD36 INTERN 0x2 /end IF_DATA /end MEASUREMENT
/begin MEASUREMENT B_temin "Bedingung TEMIN-Begrenzung aktiv, Bank 1" UWORD B_TRUE 1 100 0 1 BIT_MASK 0x1 FORMAT "%5.3" /begin IF_DATA ASAP1B_KWP2000 KP_BLOB 0xFD2A INTERN 0x2 /end IF_DATA /begin IF_DATA ETK KP_BLOB 0xFD2A INTERN 0x2 /end IF_DATA /end MEASUREMENT
/begin MEASUREMENT B_temin2 "Bedingung TEMIN-Begrenzung aktiv, Bank 2" UWORD B_TRUE 1 100 0 1 BIT_MASK 0x2 FORMAT "%5.3" /begin IF_DATA ASAP1B_KWP2000 KP_BLOB 0xFD2A INTERN 0x2 /end IF_DATA /begin IF_DATA ETK KP_BLOB 0xFD2A INTERN 0x2 /end IF_DATA /end MEASUREMENT
/begin MEASUREMENT B_timfast "EGAS: DFH Geschwindigkeit; Timer läuft schnell" UWORD B_TRUE 1 100 0 1 BIT_MASK 0x1000 FORMAT "%5.3" /begin IF_DATA ASAP1B_KWP2000 KP_BLOB 0xFD1E INTERN 0x2 /end IF_DATA /begin IF_DATA ETK KP_BLOB 0xFD1E INTERN 0x2 /end IF_DATA /end MEASUREMENT
/begin MEASUREMENT B_tmlr "LREB: Von Motortemp. abhängige Bedingungen Lambdaregelung (vor Kat)" UWORD B_TRUE 1 100 0 1 BIT_MASK 0x100 FORMAT "%5.3" /begin IF_DATA ASAP1B_KWP2000 KP_BLOB 0xFD44 INTERN 0x2 /end IF_DATA /begin IF_DATA ETK KP_BLOB 0xFD44 INTERN 0x2 /end IF_DATA /end MEASUREMENT
/begin MEASUREMENT B_Tper10msAllZ "" UWORD B_TRUE 1 100 0 1 BIT_MASK 0x1000 FORMAT "%5.3" /begin IF_DATA ASAP1B_KWP2000 KP_BLOB 0xFD16 INTERN 0x2 /end IF_DATA /begin IF_DATA ETK KP_BLOB 0xFD16 INTERN 0x2 /end IF_DATA /end MEASUREMENT
/begin MEASUREMENT B_trev_inc "" UWORD B_TRUE 1 100 0 1 BIT_MASK 0x2 FORMAT "%5.3" /begin IF_DATA ASAP1B_KWP2000 KP_BLOB 0xFD16 INTERN 0x2 /end IF_DATA /begin IF_DATA ETK KP_BLOB 0xFD16 INTERN 0x2 /end IF_DATA /end MEASUREMENT
/begin MEASUREMENT B_uhrrsec "Bedingung Uhr mit relativem Sekundenzähler" UWORD B_TRUE 1 100 0 1 BIT_MASK 0x10 FORMAT "%5.3" /begin IF_DATA ASAP1B_KWP2000 KP_BLOB 0xFD18 INTERN 0x2 /end IF_DATA /begin IF_DATA ETK KP_BLOB 0xFD18 INTERN 0x2 /end IF_DATA /end MEASUREMENT
/begin MEASUREMENT B_update "B_update = false    kein Update der Zustandsgroessen in der LRS" UWORD B_TRUE 1 100 0 1 BIT_MASK 0x8 FORMAT "%5.3" /begin IF_DATA ASAP1B_KWP2000 KP_BLOB 0xFD42 INTERN 0x2 /end IF_DATA /begin IF_DATA ETK KP_BLOB 0xFD42 INTERN 0x2 /end IF_DATA /end MEASUREMENT
/begin MEASUREMENT B_update2 "B_update2= false    kein Update der Zustandsgroessen in der LRS, Bank2" UWORD B_TRUE 1 100 0 1 BIT_MASK 0x10 FORMAT "%5.3" /begin IF_DATA ASAP1B_KWP2000 KP_BLOB 0xFD42 INTERN 0x2 /end IF_DATA /begin IF_DATA ETK KP_BLOB 0xFD42 INTERN 0x2 /end IF_DATA /end MEASUREMENT
/begin MEASUREMENT B_vmax "Bedingung VMAX-Regelung aktiv" UWORD dez 1 100 0 1 BIT_MASK 0x8 FORMAT "%5.3" /begin IF_DATA ASAP1B_KWP2000 KP_BLOB 0xFD36 INTERN 0x2 /end IF_DATA /begin IF_DATA ETK KP_BLOB 0xFD36 INTERN 0x2 /end IF_DATA /end MEASUREMENT
/begin MEASUREMENT B_vmaxreq "Flag VMAX-Begrenzung angefordert" UWORD dez 1 100 0 1 BIT_MASK 0x10 FORMAT "%5.3" /begin IF_DATA ASAP1B_KWP2000 KP_BLOB 0xFD36 INTERN 0x2 /end IF_DATA /begin IF_DATA ETK KP_BLOB 0xFD36 INTERN 0x2 /end IF_DATA /end MEASUREMENT
/begin MEASUREMENT B_y2max "Integralanteil der LRS hat obere Schranke erreicht" UWORD B_TRUE 1 100 0 1 BIT_MASK 0x20 FORMAT "%5.3" /begin IF_DATA ASAP1B_KWP2000 KP_BLOB 0xFD42 INTERN 0x2 /end IF_DATA /begin IF_DATA ETK KP_BLOB 0xFD42 INTERN 0x2 /end IF_DATA /end MEASUREMENT
/begin MEASUREMENT B_y2max2 "Integralanteil der LRS hat obere Schranke erreicht, Bank2" UWORD B_TRUE 1 100 0 1 BIT_MASK 0x40 FORMAT "%5.3" /begin IF_DATA ASAP1B_KWP2000 KP_BLOB 0xFD42 INTERN 0x2 /end IF_DATA /begin IF_DATA ETK KP_BLOB 0xFD42 INTERN 0x2 /end IF_DATA /end MEASUREMENT
/begin MEASUREMENT B_y2min "Integralanteil der LRS hat untere Schranke erreicht" UWORD B_TRUE 1 100 0 1 BIT_MASK 0x80 FORMAT "%5.3" /begin IF_DATA ASAP1B_KWP2000 KP_BLOB 0xFD42 INTERN 0x2 /end IF_DATA /begin IF_DATA ETK KP_BLOB 0xFD42 INTERN 0x2 /end IF_DATA /end MEASUREMENT
/begin MEASUREMENT B_y2min2 "Integralanteil der LRS hat untere Schranke erreicht, Bank2" UWORD B_TRUE 1 100 0 1 BIT_MASK 0x100 FORMAT "%5.3" /begin IF_DATA ASAP1B_KWP2000 KP_BLOB 0xFD42 INTERN 0x2 /end IF_DATA /begin IF_DATA ETK KP_BLOB 0xFD42 INTERN 0x2 /end IF_DATA /end MEASUREMENT
/begin MEASUREMENT B_zwappl "Bedingung Zündwinkelapplikation ohne Drehmomenteingriffe" UWORD B_TRUE 1 100 0 1 BIT_MASK 0x20 FORMAT "%5.3" /begin IF_DATA ASAP1B_KWP2000 KP_BLOB 0xFD18 INTERN 0x2 /end IF_DATA /begin IF_DATA ETK KP_BLOB 0xFD18 INTERN 0x2 /end IF_DATA /end MEASUREMENT
/begin MEASUREMENT B_zwkra "Bedingung: Zündwinkel der KR wird ausgegeben" UWORD B_TRUE 1 100 0 1 BIT_MASK 0x20 FORMAT "%5.3" /begin IF_DATA ASAP1B_KWP2000 KP_BLOB 0xFD46 INTERN 0x2 /end IF_DATA /begin IF_DATA ETK KP_BLOB 0xFD46 INTERN 0x2 /end IF_DATA /end MEASUREMENT
/begin MEASUREMENT B_zwmnste "Bedingung Abregelung der Zündwinkelspätbegrenzung erfüllt" UWORD B_TRUE 1 100 0 1 BIT_MASK 0x80 FORMAT "%5.3" /begin IF_DATA ASAP1B_KWP2000 KP_BLOB 0xFD46 INTERN 0x2 /end IF_DATA /begin IF_DATA ETK KP_BLOB 0xFD46 INTERN 0x2 /end IF_DATA /end MEASUREMENT
/begin MEASUREMENT B_zwspae "Bedingung: Zündwinkel zwspae bei Schubabschaltung wird ausgegeben" UWORD B_TRUE 1 100 0 1 BIT_MASK 0x40 FORMAT "%5.3" /begin IF_DATA ASAP1B_KWP2000 KP_BLOB 0xFD46 INTERN 0x2 /end IF_DATA /begin IF_DATA ETK KP_BLOB 0xFD46 INTERN 0x2 /end IF_DATA /end MEASUREMENT
/begin MEASUREMENT cb_13 "" UBYTE dez 1 100 0 255 FORMAT "%5.1" ARRAY_SIZE 10 /begin IF_DATA ASAP1B_KWP2000 KP_BLOB 0x380455 EXTERN 0x1 /end IF_DATA /begin IF_DATA ETK KP_BLOB 0x380455 EXTERN 0x1 /end IF_DATA /end MEASUREMENT
/begin MEASUREMENT cd_bits1_w "" UWORD dez 1 100 0 65535 FORMAT "%8.2" /begin IF_DATA ASAP1B_KWP2000 KP_BLOB 0x380536 EXTERN 0x2 /end IF_DATA /begin IF_DATA ETK KP_BLOB 0x380536 EXTERN 0x2 /end IF_DATA /end MEASUREMENT
/begin MEASUREMENT cd_bits2_w "" UWORD dez 1 100 0 65535 FORMAT "%8.2" /begin IF_DATA ASAP1B_KWP2000 KP_BLOB 0x380538 EXTERN 0x2 /end IF_DATA /begin IF_DATA ETK KP_BLOB 0x380538 EXTERN 0x2 /end IF_DATA /end MEASUREMENT
/begin MEASUREMENT cyclebg_w "" UWORD runtime2_sy 1 100 0 838848 FORMAT "%8.1" /begin IF_DATA ASAP1B_KWP2000 KP_BLOB 0x381510 EXTERN 0x2 /end IF_DATA /begin IF_DATA ETK KP_BLOB 0x381510 EXTERN 0x2 /end IF_DATA /end MEASUREMENT
/begin MEASUREMENT dfr2_w "Delta Lambdaregler (Faktor ), Bank2" SWORD fak_sw_b1 1 100 -1 0.999969 FORMAT "%8.6" /begin IF_DATA ASAP1B_KWP2000 KP_BLOB 0x3813BC EXTERN 0x2 /end IF_DATA /begin IF_DATA ETK KP_BLOB 0x3813BC EXTERN 0x2 /end IF_DATA /end MEASUREMENT
/begin MEASUREMENT dfrmin2_w "Untergrenze von dfr_w bei Abmagerungsverbot (B_lrms=true), Bank2" SWORD fak_sw_b1 1 100 -1 0.999969 FORMAT "%8.6" /begin IF_DATA ASAP1B_KWP2000 KP_BLOB 0x3813BE EXTERN 0x2 /end IF_DATA /begin IF_DATA ETK KP_BLOB 0x3813BE EXTERN 0x2 /end IF_DATA /end MEASUREMENT
/begin MEASUREMENT dfrmin_w "Untergrenze von dfr_w bei Abmagerungsverbot (B_lrms=true)" SWORD fak_sw_b1 1 100 -1 0.999969 FORMAT "%8.6" /begin IF_DATA ASAP1B_KWP2000 KP_BLOB 0x3813C0 EXTERN 0x2 /end IF_DATA /begin IF_DATA ETK KP_BLOB 0x3813C0 EXTERN 0x2 /end IF_DATA /end MEASUREMENT
/begin MEASUREMENT dfr_w "Delta Lambdaregler (Faktor )" SWORD fak_sw_b1 1 100 -1 0.999969 FORMAT "%8.6" /begin IF_DATA ASAP1B_KWP2000 KP_BLOB 0x3813C2 EXTERN 0x2 /end IF_DATA /begin IF_DATA ETK KP_BLOB 0x3813C2 EXTERN 0x2 /end IF_DATA /end MEASUREMENT
/begin MEASUREMENT dmdfa "Dämpfung für die Filterung des Fahrermomentes" UBYTE fak_ub_b1 1 100 0 0.996094 FORMAT "%5.3" /begin IF_DATA ASAP1B_KWP2000 KP_BLOB 0x38042B EXTERN 0x1 /end IF_DATA /begin IF_DATA ETK KP_BLOB 0x38042B EXTERN 0x1 /end IF_DATA /end MEASUREMENT
/begin MEASUREMENT dmdfag "Dämpfung gangabhängig für Filterung Fahrermoment" UBYTE fak_ub_b1 1 100 0 0.996094 FORMAT "%5.3" /begin IF_DATA ASAP1B_KWP2000 KP_BLOB 0x38042C EXTERN 0x1 /end IF_DATA /begin IF_DATA ETK KP_BLOB 0x38042C EXTERN 0x1 /end IF_DATA /end MEASUREMENT
/begin MEASUREMENT dmdfasg "Dämpfung gangabhängig für Filterung Fahrermoment nach SA" UBYTE fak_ub_b1 1 100 0 0.996094 FORMAT "%5.3" /begin IF_DATA ASAP1B_KWP2000 KP_BLOB 0x38042D EXTERN 0x1 /end IF_DATA /begin IF_DATA ETK KP_BLOB 0x38042D EXTERN 0x1 /end IF_DATA /end MEASUREMENT
/begin MEASUREMENT dmdfaug "untere Dämpfung gangabhängig für Filterung Fahrermoment" UBYTE fak_ub_b1 1 100 0 0.996094 FORMAT "%5.3" /begin IF_DATA ASAP1B_KWP2000 KP_BLOB 0x38042E EXTERN 0x1 /end IF_DATA /begin IF_DATA ETK KP_BLOB 0x38042E EXTERN 0x1 /end IF_DATA /end MEASUREMENT
/begin MEASUREMENT dmifav "Fahrerwunschmomentenänderung" UBYTE rel_ub_b50 1 100 0 50 FORMAT "%5.2" /begin IF_DATA ASAP1B_KWP2000 KP_BLOB 0x380434 EXTERN 0x1 /end IF_DATA /begin IF_DATA ETK KP_BLOB 0x380434 EXTERN 0x1 /end IF_DATA /end MEASUREMENT
/begin MEASUREMENT dmnmxi_w "Drehmoment aus Integralanteil der NMAX-Regelung" SWORD rel_sw_b100 1 100 -100 99.9969 FORMAT "%8.4" /begin IF_DATA ASAP1B_KWP2000 KP_BLOB 0x381302 EXTERN 0x2 /end IF_DATA /begin IF_DATA ETK KP_BLOB 0x381302 EXTERN 0x2 /end IF_DATA /end MEASUREMENT
/begin MEASUREMENT dmnmxp_w "Drehmoment aus Proportionalanteil der NMAX-Regelung" SWORD rel_sw_b100 1 100 -100 99.9969 FORMAT "%8.4" /begin IF_DATA ASAP1B_KWP2000 KP_BLOB 0x381304 EXTERN 0x2 /end IF_DATA /begin IF_DATA ETK KP_BLOB 0x381304 EXTERN 0x2 /end IF_DATA /end MEASUREMENT
/begin MEASUREMENT dmvmxi_w "Drehmoment I-Anteil bei VMAX-Regelung" SWORD rel_sw_b100 1 100 -100 99.9969 FORMAT "%8.4" /begin IF_DATA ASAP1B_KWP2000 KP_BLOB 0x381318 EXTERN 0x2 /end IF_DATA /begin IF_DATA ETK KP_BLOB 0x381318 EXTERN 0x2 /end IF_DATA /end MEASUREMENT
/begin MEASUREMENT dmvmxp_w "Drehmoment P-Anteil bei VMAX-Regelung" SWORD rel_sw_b100 1 100 -100 99.9969 FORMAT "%8.4" /begin IF_DATA ASAP1B_KWP2000 KP_BLOB 0x38131A EXTERN 0x2 /end IF_DATA /begin IF_DATA ETK KP_BLOB 0x38131A EXTERN 0x2 /end IF_DATA /end MEASUREMENT
/begin MEASUREMENT dnsi_w "Differenz zwischen Soll- und Ist-Motordrehzahl" SWORD nmot_sw_q0p25 1 100 -8192 8191.75 FORMAT "%8.3" /begin IF_DATA ASAP1B_KWP2000 KP_BLOB 0x381306 EXTERN 0x2 /end IF_DATA /begin IF_DATA ETK KP_BLOB 0x381306 EXTERN 0x2 /end IF_DATA /end MEASUREMENT
/begin MEASUREMENT dvprae_w "Prädizierter Geschwindigkeitsanteil" UWORD vfzg_uw_q0p00781 1 100 0 511.992 FORMAT "%8.4" /begin IF_DATA ASAP1B_KWP2000 KP_BLOB 0x38131C EXTERN 0x2 /end IF_DATA /begin IF_DATA ETK KP_BLOB 0x38131C EXTERN 0x2 /end IF_DATA /end MEASUREMENT
/begin MEASUREMENT dvsi_w "Abweichung zwischen Soll- und Istgeschwindigkeit der VMAX-Regelung" SWORD vfzg_sw_q0p00781 1 100 -256 255.992 FORMAT "%8.4" /begin IF_DATA ASAP1B_KWP2000 KP_BLOB 0x38131E EXTERN 0x2 /end IF_DATA /begin IF_DATA ETK KP_BLOB 0x38131E EXTERN 0x2 /end IF_DATA /end MEASUREMENT
/begin MEASUREMENT dynPeriod "" SWORD dez 1 100 -32768 32767 FORMAT "%8.2" /begin IF_DATA ASAP1B_KWP2000 KP_BLOB 0x3804C8 EXTERN 0x2 /end IF_DATA /begin IF_DATA ETK KP_BLOB 0x3804C8 EXTERN 0x2 /end IF_DATA /end MEASUREMENT
/begin MEASUREMENT dzwb "Differenz BasisZW optimaler Zündwinkel" SBYTE zw_sb_q0p75 1 100 -96 95.25 FORMAT "%5.2" /begin IF_DATA ASAP1B_KWP2000 KP_BLOB 0x380421 EXTERN 0x1 /end IF_DATA /begin IF_DATA ETK KP_BLOB 0x380421 EXTERN 0x1 /end IF_DATA /end MEASUREMENT
/begin MEASUREMENT dzweta_in "" UBYTE rel_ub_b127p5 1 100 0 127.5 FORMAT "%5.1" /begin IF_DATA ASAP1B_KWP2000 KP_BLOB 0x380468 EXTERN 0x1 /end IF_DATA /begin IF_DATA ETK KP_BLOB 0x380468 EXTERN 0x1 /end IF_DATA /end MEASUREMENT
/begin MEASUREMENT dzwi "Delta Zündwinkel zwischen zwopt und zwout" SBYTE zw_sb_q0p75 1 100 -96 95.25 FORMAT "%5.2" /begin IF_DATA ASAP1B_KWP2000 KP_BLOB 0x380435 EXTERN 0x1 /end IF_DATA /begin IF_DATA ETK KP_BLOB 0x380435 EXTERN 0x1 /end IF_DATA /end MEASUREMENT
/begin MEASUREMENT dzwkg "Delta-Zündwinkel Verschiebung Klopfgrenze" SBYTE zw_sb_q0p75 1 100 -96 95.25 FORMAT "%5.2" /begin IF_DATA ASAP1B_KWP2000 KP_BLOB 0x380477 EXTERN 0x1 /end IF_DATA /begin IF_DATA ETK KP_BLOB 0x380477 EXTERN 0x1 /end IF_DATA /end MEASUREMENT
/begin MEASUREMENT dzwnwsu "" SBYTE zw_sb_q0p75 1 100 -96 95.25 FORMAT "%5.2" /begin IF_DATA ASAP1B_KWP2000 KP_BLOB 0x380478 EXTERN 0x1 /end IF_DATA /begin IF_DATA ETK KP_BLOB 0x380478 EXTERN 0x1 /end IF_DATA /end MEASUREMENT
/begin MEASUREMENT dzwol "lambdaabh. Zündwinkelkorrektur des optimalen ZW" SBYTE zw_sb_q0p75 1 100 -96 95.25 FORMAT "%5.2" /begin IF_DATA ASAP1B_KWP2000 KP_BLOB 0x380422 EXTERN 0x1 /end IF_DATA /begin IF_DATA ETK KP_BLOB 0x380422 EXTERN 0x1 /end IF_DATA /end MEASUREMENT
/begin MEASUREMENT dzwotm "temperaturabhängige Zündwinkelkorrektur des optimalen ZW" SBYTE zw_sb_q0p75 1 100 -96 95.25 FORMAT "%5.2" /begin IF_DATA ASAP1B_KWP2000 KP_BLOB 0x380423 EXTERN 0x1 /end IF_DATA /begin IF_DATA ETK KP_BLOB 0x380423 EXTERN 0x1 /end IF_DATA /end MEASUREMENT
/begin MEASUREMENT dzws "Delta Zündwinekl zwischen zwopt und zwsol" SBYTE zw_sb_q0p75 1 100 -96 95.25 FORMAT "%5.2" /begin IF_DATA ASAP1B_KWP2000 KP_BLOB 0x380469 EXTERN 0x1 /end IF_DATA /begin IF_DATA ETK KP_BLOB 0x380469 EXTERN 0x1 /end IF_DATA /end MEASUREMENT
/begin MEASUREMENT dzwspae "Korrektur-Zündwinkel für den spätest erlaubten Zündwinkel" SBYTE zw_sb_q0p75 1 100 -96 95.25 FORMAT "%5.2" /begin IF_DATA ASAP1B_KWP2000 KP_BLOB 0x38047C EXTERN 0x1 /end IF_DATA /begin IF_DATA ETK KP_BLOB 0x38047C EXTERN 0x1 /end IF_DATA /end MEASUREMENT
/begin MEASUREMENT dzwwl "Delta Zuendwinkel aus Warmlauf" SBYTE zw_sb_q0p75 1 100 -96 95.25 FORMAT "%5.2" /begin IF_DATA ASAP1B_KWP2000 KP_BLOB 0x38047F EXTERN 0x1 /end IF_DATA /begin IF_DATA ETK KP_BLOB 0x38047F EXTERN 0x1 /end IF_DATA /end MEASUREMENT
/begin MEASUREMENT dzwzyl "Zylinderindividueller Zündwinkeloffset" SBYTE zw_sb_q0p75 1 100 -96 95.25 FORMAT "%5.2" ARRAY_SIZE 6 /begin IF_DATA ASAP1B_KWP2000 KP_BLOB 0x38157C INTERN 0x1 /end IF_DATA /begin IF_DATA ETK KP_BLOB 0x38157C INTERN 0x1 /end IF_DATA /end MEASUREMENT
/begin MEASUREMENT dzw_kge "Eingang Delta-Zündwinkel für mehrfach verwendete Kenngrößen" SBYTE zw_sb_q0p75 1 100 -96 95.25 FORMAT "%5.2" /begin IF_DATA ASAP1B_KWP2000 KP_BLOB 0x380424 EXTERN 0x1 /end IF_DATA /begin IF_DATA ETK KP_BLOB 0x380424 EXTERN 0x1 /end IF_DATA /end MEASUREMENT
/begin MEASUREMENT eltcread_state "" UBYTE msd_text_eltcread 1 100 0 255 FORMAT "%5.1" /begin IF_DATA ASAP1B_KWP2000 KP_BLOB 0x382946 EXTERN 0x1 /end IF_DATA /begin IF_DATA ETK KP_BLOB 0x382946 EXTERN 0x1 /end IF_DATA /end MEASUREMENT
/begin MEASUREMENT esst_san12esuw "" UWORD dez 1 100 0 65535 FORMAT "%8.2" /begin IF_DATA ASAP1B_KWP2000 KP_BLOB 0x38054E EXTERN 0x2 /end IF_DATA /begin IF_DATA ETK KP_BLOB 0x38054E EXTERN 0x2 /end IF_DATA /end MEASUREMENT
/begin MEASUREMENT esst_sga06mfub "" UWORD dez 1 100 0 65535 FORMAT "%8.2" /begin IF_DATA ASAP1B_KWP2000 KP_BLOB 0x38053A EXTERN 0x2 /end IF_DATA /begin IF_DATA ETK KP_BLOB 0x38053A EXTERN 0x2 /end IF_DATA /end MEASUREMENT
/begin MEASUREMENT esst_sml07tmuw "" UWORD dez 1 100 0 65535 FORMAT "%8.2" /begin IF_DATA ASAP1B_KWP2000 KP_BLOB 0x38053C EXTERN 0x2 /end IF_DATA /begin IF_DATA ETK KP_BLOB 0x38053C EXTERN 0x2 /end IF_DATA /end MEASUREMENT
/begin MEASUREMENT esst_snm06mfub "" UWORD dez 1 100 0 65535 FORMAT "%8.2" /begin IF_DATA ASAP1B_KWP2000 KP_BLOB 0x38053E EXTERN 0x2 /end IF_DATA /begin IF_DATA ETK KP_BLOB 0x38053E EXTERN 0x2 /end IF_DATA /end MEASUREMENT
/begin MEASUREMENT esst_snm07lsuw "" UWORD dez 1 100 0 65535 FORMAT "%8.2" /begin IF_DATA ASAP1B_KWP2000 KP_BLOB 0x380550 EXTERN 0x2 /end IF_DATA /begin IF_DATA ETK KP_BLOB 0x380550 EXTERN 0x2 /end IF_DATA /end MEASUREMENT
/begin MEASUREMENT esst_snm08__ub "" UWORD dez 1 100 0 65535 FORMAT "%8.2" /begin IF_DATA ASAP1B_KWP2000 KP_BLOB 0x380552 EXTERN 0x2 /end IF_DATA /begin IF_DATA ETK KP_BLOB 0x380552 EXTERN 0x2 /end IF_DATA /end MEASUREMENT
/begin MEASUREMENT esst_snm12esub "" UWORD dez 1 100 0 65535 FORMAT "%8.2" /begin IF_DATA ASAP1B_KWP2000 KP_BLOB 0x380554 EXTERN 0x2 /end IF_DATA /begin IF_DATA ETK KP_BLOB 0x380554 EXTERN 0x2 /end IF_DATA /end MEASUREMENT
/begin MEASUREMENT esst_snm16ciub "" UWORD dez 1 100 0 65535 FORMAT "%8.2" /begin IF_DATA ASAP1B_KWP2000 KP_BLOB 0x380540 EXTERN 0x2 /end IF_DATA /begin IF_DATA ETK KP_BLOB 0x380540 EXTERN 0x2 /end IF_DATA /end MEASUREMENT
/begin MEASUREMENT esst_snm16krub "" UWORD dez 1 100 0 65535 FORMAT "%8.2" /begin IF_DATA ASAP1B_KWP2000 KP_BLOB 0x380542 EXTERN 0x2 /end IF_DATA /begin IF_DATA ETK KP_BLOB 0x380542 EXTERN 0x2 /end IF_DATA /end MEASUREMENT
/begin MEASUREMENT esst_snm16zuub "" UWORD dez 1 100 0 65535 FORMAT "%8.2" /begin IF_DATA ASAP1B_KWP2000 KP_BLOB 0x380556 EXTERN 0x2 /end IF_DATA /begin IF_DATA ETK KP_BLOB 0x380556 EXTERN 0x2 /end IF_DATA /end MEASUREMENT
/begin MEASUREMENT esst_srl04dyub "" UWORD dez 1 100 0 65535 FORMAT "%8.2" /begin IF_DATA ASAP1B_KWP2000 KP_BLOB 0x380544 EXTERN 0x2 /end IF_DATA /begin IF_DATA ETK KP_BLOB 0x380544 EXTERN 0x2 /end IF_DATA /end MEASUREMENT
/begin MEASUREMENT esst_srl04krub "" UWORD dez 1 100 0 65535 FORMAT "%8.2" /begin IF_DATA ASAP1B_KWP2000 KP_BLOB 0x380546 EXTERN 0x2 /end IF_DATA /begin IF_DATA ETK KP_BLOB 0x380546 EXTERN 0x2 /end IF_DATA /end MEASUREMENT
/begin MEASUREMENT esst_srl08lsuw "" UWORD dez 1 100 0 65535 FORMAT "%8.2" /begin IF_DATA ASAP1B_KWP2000 KP_BLOB 0x380558 EXTERN 0x2 /end IF_DATA /begin IF_DATA ETK KP_BLOB 0x380558 EXTERN 0x2 /end IF_DATA /end MEASUREMENT
/begin MEASUREMENT esst_srl12esub "" UWORD dez 1 100 0 65535 FORMAT "%8.2" /begin IF_DATA ASAP1B_KWP2000 KP_BLOB 0x38055A EXTERN 0x2 /end IF_DATA /begin IF_DATA ETK KP_BLOB 0x38055A EXTERN 0x2 /end IF_DATA /end MEASUREMENT
/begin MEASUREMENT esst_srl12zuub "" UWORD dez 1 100 0 65535 FORMAT "%8.2" /begin IF_DATA ASAP1B_KWP2000 KP_BLOB 0x38055C EXTERN 0x2 /end IF_DATA /begin IF_DATA ETK KP_BLOB 0x38055C EXTERN 0x2 /end IF_DATA /end MEASUREMENT
/begin MEASUREMENT esst_sta06esub "" UWORD dez 1 100 0 65535 FORMAT "%8.2" /begin IF_DATA ASAP1B_KWP2000 KP_BLOB 0x380548 EXTERN 0x2 /end IF_DATA /begin IF_DATA ETK KP_BLOB 0x380548 EXTERN 0x2 /end IF_DATA /end MEASUREMENT
/begin MEASUREMENT esst_stm05saub "" UWORD dez 1 100 0 65535 FORMAT "%8.2" /begin IF_DATA ASAP1B_KWP2000 KP_BLOB 0x38054A EXTERN 0x2 /end IF_DATA /begin IF_DATA ETK KP_BLOB 0x38054A EXTERN 0x2 /end IF_DATA /end MEASUREMENT
/begin MEASUREMENT esst_stm06__ub "" UWORD dez 1 100 0 65535 FORMAT "%8.2" /begin IF_DATA ASAP1B_KWP2000 KP_BLOB 0x38054C EXTERN 0x2 /end IF_DATA /begin IF_DATA ETK KP_BLOB 0x38054C EXTERN 0x2 /end IF_DATA /end MEASUREMENT
/begin MEASUREMENT esst_stm12esub "" UWORD dez 1 100 0 65535 FORMAT "%8.2" /begin IF_DATA ASAP1B_KWP2000 KP_BLOB 0x38055E EXTERN 0x2 /end IF_DATA /begin IF_DATA ETK KP_BLOB 0x38055E EXTERN 0x2 /end IF_DATA /end MEASUREMENT
/begin MEASUREMENT esst_sts12esub "" UWORD dez 1 100 0 65535 FORMAT "%8.2" /begin IF_DATA ASAP1B_KWP2000 KP_BLOB 0x380560 EXTERN 0x2 /end IF_DATA /begin IF_DATA ETK KP_BLOB 0x380560 EXTERN 0x2 /end IF_DATA /end MEASUREMENT
/begin MEASUREMENT etalab "Lambda-Wirkungsgrad ohne Eingriff bezogen auf optimales Moment bei Lambda=1" UBYTE rel_ub_b127p5 1 100 0 127.5 FORMAT "%5.1" /begin IF_DATA ASAP1B_KWP2000 KP_BLOB 0x380425 EXTERN 0x1 /end IF_DATA /begin IF_DATA ETK KP_BLOB 0x380425 EXTERN 0x1 /end IF_DATA /end MEASUREMENT
/begin MEASUREMENT etatrmn "minimaler Wert in der Wirkungsgradtrommel" UBYTE rel_ub_b127p5 1 100 0 127.5 FORMAT "%5.1" /begin IF_DATA ASAP1B_KWP2000 KP_BLOB 0x380426 EXTERN 0x1 /end IF_DATA /begin IF_DATA ETK KP_BLOB 0x380426 EXTERN 0x1 /end IF_DATA /end MEASUREMENT
/begin MEASUREMENT etazaist "Ist-Zylinderausblendungswirkungsgrad" UBYTE rel_ub_b127p5 1 100 0 127.5 FORMAT "%5.1" /begin IF_DATA ASAP1B_KWP2000 KP_BLOB 0x380436 EXTERN 0x1 /end IF_DATA /begin IF_DATA ETK KP_BLOB 0x380436 EXTERN 0x1 /end IF_DATA /end MEASUREMENT
/begin MEASUREMENT etazwb "Zündwinkelwirkungsgrad des Basiszündwinkels" UBYTE rel_ub_b127p5 1 100 0 127.5 FORMAT "%5.1" /begin IF_DATA ASAP1B_KWP2000 KP_BLOB 0x380427 EXTERN 0x1 /end IF_DATA /begin IF_DATA ETK KP_BLOB 0x380427 EXTERN 0x1 /end IF_DATA /end MEASUREMENT
/begin MEASUREMENT etazwist "Ist-Zündwinkelwirkungsgrad" UBYTE rel_ub_b127p5 1 100 0 127.5 FORMAT "%5.1" /begin IF_DATA ASAP1B_KWP2000 KP_BLOB 0x380437 EXTERN 0x1 /end IF_DATA /begin IF_DATA ETK KP_BLOB 0x380437 EXTERN 0x1 /end IF_DATA /end MEASUREMENT
/begin MEASUREMENT etazwmn "Minimum-Zündwinkelwirkungsgrad" UBYTE rel_ub_b127p5 1 100 0 127.5 FORMAT "%5.1" /begin IF_DATA ASAP1B_KWP2000 KP_BLOB 0xF934 INTERN 0x1 /end IF_DATA /begin IF_DATA ETK KP_BLOB 0xF934 INTERN 0x1 /end IF_DATA /end MEASUREMENT
/begin MEASUREMENT etazws "Sollzündwinkelwirkungsgrad" UBYTE rel_ub_b127p5 1 100 0 127.5 FORMAT "%5.1" /begin IF_DATA ASAP1B_KWP2000 KP_BLOB 0x38046A EXTERN 0x1 /end IF_DATA /begin IF_DATA ETK KP_BLOB 0x38046A EXTERN 0x1 /end IF_DATA /end MEASUREMENT
/begin MEASUREMENT etazwvst "Zündwinkelwirkungsgrad mit Vorsteuerzündwinkel" UBYTE rel_ub_b127p5 1 100 0 127.5 FORMAT "%5.1" /begin IF_DATA ASAP1B_KWP2000 KP_BLOB 0x380428 EXTERN 0x1 /end IF_DATA /begin IF_DATA ETK KP_BLOB 0x380428 EXTERN 0x1 /end IF_DATA /end MEASUREMENT
/begin MEASUREMENT fr2_w "Lambda-Regler-Ausgang; Bank2 (Word)" UWORD fak_uw_b2 1 100 0 1.99997 FORMAT "%8.6" /begin IF_DATA ASAP1B_KWP2000 KP_BLOB 0x3813C4 EXTERN 0x2 /end IF_DATA /begin IF_DATA ETK KP_BLOB 0x3813C4 EXTERN 0x2 /end IF_DATA /end MEASUREMENT
/begin MEASUREMENT frm2_w "schneller Mittelwert des Lambdaregelfaktors Bank 2(Word)" UWORD fak_uw_b2 1 100 0 1.99997 FORMAT "%8.6" /begin IF_DATA ASAP1B_KWP2000 KP_BLOB 0x3813C6 EXTERN 0x2 /end IF_DATA /begin IF_DATA ETK KP_BLOB 0x3813C6 EXTERN 0x2 /end IF_DATA /end MEASUREMENT
/begin MEASUREMENT frmn_w "Lambda-Regler-Ausgang Minimalwert" UWORD fak_uw_b2 1 100 0 1.99997 FORMAT "%8.6" /begin IF_DATA ASAP1B_KWP2000 KP_BLOB 0x3813C8 EXTERN 0x2 /end IF_DATA /begin IF_DATA ETK KP_BLOB 0x3813C8 EXTERN 0x2 /end IF_DATA /end MEASUREMENT
/begin MEASUREMENT frmx_w "LR mit Integratorstop : Max. Begrenzung Integrator fr,; FRMAX / angehoben d.DSLS" UWORD fak_uw_b2 1 100 0 1.99997 FORMAT "%8.6" /begin IF_DATA ASAP1B_KWP2000 KP_BLOB 0x3813CA EXTERN 0x2 /end IF_DATA /begin IF_DATA ETK KP_BLOB 0x3813CA EXTERN 0x2 /end IF_DATA /end MEASUREMENT
/begin MEASUREMENT frm_w "schneller Mittelwert des Lambdaregelfaktors (Word)" UWORD fak_uw_b2 1 100 0 1.99997 FORMAT "%8.6" /begin IF_DATA ASAP1B_KWP2000 KP_BLOB 0x3813CC EXTERN 0x2 /end IF_DATA /begin IF_DATA ETK KP_BLOB 0x3813CC EXTERN 0x2 /end IF_DATA /end MEASUREMENT
/begin MEASUREMENT froza2_w "Lambda-Regler-Ausgang ohne Zwangsanregung; Bank2" UWORD fak_uw_b2 1 100 0 1.99997 FORMAT "%8.6" /begin IF_DATA ASAP1B_KWP2000 KP_BLOB 0x3813CE EXTERN 0x2 /end IF_DATA /begin IF_DATA ETK KP_BLOB 0x3813CE EXTERN 0x2 /end IF_DATA /end MEASUREMENT
/begin MEASUREMENT froza_w "Lambda-Regler-Ausgang ohne Zwangsanregung" UWORD fak_uw_b2 1 100 0 1.99997 FORMAT "%8.6" /begin IF_DATA ASAP1B_KWP2000 KP_BLOB 0x3813D0 EXTERN 0x2 /end IF_DATA /begin IF_DATA ETK KP_BLOB 0x3813D0 EXTERN 0x2 /end IF_DATA /end MEASUREMENT
/begin MEASUREMENT fr_w "Lambda-Regler-Ausgang (Word)" UWORD fak_uw_b2 1 100 0 1.99997 FORMAT "%8.6" /begin IF_DATA ASAP1B_KWP2000 KP_BLOB 0x3813D2 EXTERN 0x2 /end IF_DATA /begin IF_DATA ETK KP_BLOB 0x3813D2 EXTERN 0x2 /end IF_DATA /end MEASUREMENT
/begin MEASUREMENT ftek2_w "Korrekturfaktor für effektive Einspritzzeit, Bank 2" UWORD fak_uw_b2 1 100 0 1.99997 FORMAT "%8.6" /begin IF_DATA ASAP1B_KWP2000 KP_BLOB 0x380C6E EXTERN 0x2 /end IF_DATA /begin IF_DATA ETK KP_BLOB 0x380C6E EXTERN 0x2 /end IF_DATA /end MEASUREMENT
/begin MEASUREMENT ftek_w "Korrekturfaktor für effektive Einspritzzeit" UWORD fak_uw_b2 1 100 0 1.99997 FORMAT "%8.6" /begin IF_DATA ASAP1B_KWP2000 KP_BLOB 0x380C70 EXTERN 0x2 /end IF_DATA /begin IF_DATA ETK KP_BLOB 0x380C70 EXTERN 0x2 /end IF_DATA /end MEASUREMENT
/begin MEASUREMENT imlrsa_w "Luftmasse nach SA für stetige Lambdaregelung" UWORD m_uw_b4660 1 100 0 4660.27 FORMAT "%8.3" /begin IF_DATA ASAP1B_KWP2000 KP_BLOB 0x38148E EXTERN 0x2 /end IF_DATA /begin IF_DATA ETK KP_BLOB 0x38148E EXTERN 0x2 /end IF_DATA /end MEASUREMENT
/begin MEASUREMENT ladiff2_w "Regelabweichung Lambda;Bank2" SWORD fak_sw_b1 1 100 -1 0.999969 FORMAT "%8.6" /begin IF_DATA ASAP1B_KWP2000 KP_BLOB 0x3813D4 EXTERN 0x2 /end IF_DATA /begin IF_DATA ETK KP_BLOB 0x3813D4 EXTERN 0x2 /end IF_DATA /end MEASUREMENT
/begin MEASUREMENT ladiff_w "Regelabweichung Lambda" SWORD fak_sw_b1 1 100 -1 0.999969 FORMAT "%8.6" /begin IF_DATA ASAP1B_KWP2000 KP_BLOB 0x3813D6 EXTERN 0x2 /end IF_DATA /begin IF_DATA ETK KP_BLOB 0x3813D6 EXTERN 0x2 /end IF_DATA /end MEASUREMENT
/begin MEASUREMENT lamsbgt2_w "Lambdasoll bezogen auf Brennraum Bank 2, totzeitverschoben" UWORD fak_uw_b16 1 100 0 15.9998 FORMAT "%8.5" /begin IF_DATA ASAP1B_KWP2000 KP_BLOB 0x3813D8 EXTERN 0x2 /end IF_DATA /begin IF_DATA ETK KP_BLOB 0x3813D8 EXTERN 0x2 /end IF_DATA /end MEASUREMENT
/begin MEASUREMENT lamsbgt_w "Lambdasoll bezogen auf Brennraum, totzeitverschoben" UWORD fak_uw_b16 1 100 0 15.9998 FORMAT "%8.5" /begin IF_DATA ASAP1B_KWP2000 KP_BLOB 0x3813DA EXTERN 0x2 /end IF_DATA /begin IF_DATA ETK KP_BLOB 0x3813DA EXTERN 0x2 /end IF_DATA /end MEASUREMENT
/begin MEASUREMENT lamsoni2ma "maximal aufgetretenes Lambda, Bank 2" UBYTE fak_ub_b4 1 100 0 3.98438 FORMAT "%5.3" /begin IF_DATA ASAP1B_KWP2000 KP_BLOB 0x38292B EXTERN 0x1 /end IF_DATA /begin IF_DATA ETK KP_BLOB 0x38292B EXTERN 0x1 /end IF_DATA /end MEASUREMENT
/begin MEASUREMENT lamsoni2mi "minimal aufgetretenes Lambda, Bank 2" UBYTE fak_ub_b4 1 100 0 3.98438 FORMAT "%5.3" /begin IF_DATA ASAP1B_KWP2000 KP_BLOB 0x38292C EXTERN 0x1 /end IF_DATA /begin IF_DATA ETK KP_BLOB 0x38292C EXTERN 0x1 /end IF_DATA /end MEASUREMENT
/begin MEASUREMENT lamsonima "maximal aufgetretenes Lambda" UBYTE fak_ub_b4 1 100 0 3.98438 FORMAT "%5.3" /begin IF_DATA ASAP1B_KWP2000 KP_BLOB 0x38292D EXTERN 0x1 /end IF_DATA /begin IF_DATA ETK KP_BLOB 0x38292D EXTERN 0x1 /end IF_DATA /end MEASUREMENT
/begin MEASUREMENT lamsonimi "minimal aufgetretenes Lambda" UBYTE fak_ub_b4 1 100 0 3.98438 FORMAT "%5.3" /begin IF_DATA ASAP1B_KWP2000 KP_BLOB 0x38292E EXTERN 0x1 /end IF_DATA /begin IF_DATA ETK KP_BLOB 0x38292E EXTERN 0x1 /end IF_DATA /end MEASUREMENT
/begin MEASUREMENT lamsstat_w "statische Sollwert Abgaslambda bei Sekundärluft" UWORD fak_uw_b16 1 100 0 15.9998 FORMAT "%8.5" /begin IF_DATA ASAP1B_KWP2000 KP_BLOB 0x38148C EXTERN 0x2 /end IF_DATA /begin IF_DATA ETK KP_BLOB 0x38148C EXTERN 0x2 /end IF_DATA /end MEASUREMENT
/begin MEASUREMENT lamzak2_w "Lambdasondenistwert, korrigiert um Zusatzamplitude, Bank2" UWORD fak_uw_b16 1 100 0 15.9998 FORMAT "%8.5" /begin IF_DATA ASAP1B_KWP2000 KP_BLOB 0x3813DC EXTERN 0x2 /end IF_DATA /begin IF_DATA ETK KP_BLOB 0x3813DC EXTERN 0x2 /end IF_DATA /end MEASUREMENT
/begin MEASUREMENT lamzak_w "Lambdasondenistwert, korrigiert um Zusatzamplitude" UWORD fak_uw_b16 1 100 0 15.9998 FORMAT "%8.5" /begin IF_DATA ASAP1B_KWP2000 KP_BLOB 0x3813DE EXTERN 0x2 /end IF_DATA /begin IF_DATA ETK KP_BLOB 0x3813DE EXTERN 0x2 /end IF_DATA /end MEASUREMENT
/begin MEASUREMENT laufz100_w "" UWORD runtime1_sy 1 100 0 52428 FORMAT "%8.2" /begin IF_DATA ASAP1B_KWP2000 KP_BLOB 0x381512 EXTERN 0x2 /end IF_DATA /begin IF_DATA ETK KP_BLOB 0x381512 EXTERN 0x2 /end IF_DATA /end MEASUREMENT
/begin MEASUREMENT laufz10m_w "" UWORD runtime1_sy 1 100 0 52428 FORMAT "%8.2" /begin IF_DATA ASAP1B_KWP2000 KP_BLOB 0x38151C EXTERN 0x2 /end IF_DATA /begin IF_DATA ETK KP_BLOB 0x38151C EXTERN 0x2 /end IF_DATA /end MEASUREMENT
/begin MEASUREMENT laufz1m_w "" UWORD runtime1_sy 1 100 0 52428 FORMAT "%8.2" /begin IF_DATA ASAP1B_KWP2000 KP_BLOB 0xF91C INTERN 0x2 /end IF_DATA /begin IF_DATA ETK KP_BLOB 0xF91C INTERN 0x2 /end IF_DATA /end MEASUREMENT
/begin MEASUREMENT laufz1s_w "" UWORD runtime1_sy 1 100 0 52428 FORMAT "%8.2" /begin IF_DATA ASAP1B_KWP2000 KP_BLOB 0x38151E EXTERN 0x2 /end IF_DATA /begin IF_DATA ETK KP_BLOB 0x38151E EXTERN 0x2 /end IF_DATA /end MEASUREMENT
/begin MEASUREMENT laufz200_w "" UWORD runtime1_sy 1 100 0 52428 FORMAT "%8.2" /begin IF_DATA ASAP1B_KWP2000 KP_BLOB 0x381514 EXTERN 0x2 /end IF_DATA /begin IF_DATA ETK KP_BLOB 0x381514 EXTERN 0x2 /end IF_DATA /end MEASUREMENT
/begin MEASUREMENT laufz20m_w "" UWORD runtime1_sy 1 100 0 52428 FORMAT "%8.2" /begin IF_DATA ASAP1B_KWP2000 KP_BLOB 0x381520 EXTERN 0x2 /end IF_DATA /begin IF_DATA ETK KP_BLOB 0x381520 EXTERN 0x2 /end IF_DATA /end MEASUREMENT
/begin MEASUREMENT laufz2m_w "" UWORD runtime1_sy 1 100 0 52428 FORMAT "%8.2" /begin IF_DATA ASAP1B_KWP2000 KP_BLOB 0xF91E INTERN 0x2 /end IF_DATA /begin IF_DATA ETK KP_BLOB 0xF91E INTERN 0x2 /end IF_DATA /end MEASUREMENT
/begin MEASUREMENT laufz50m_w "" UWORD runtime1_sy 1 100 0 52428 FORMAT "%8.2" /begin IF_DATA ASAP1B_KWP2000 KP_BLOB 0x381516 EXTERN 0x2 /end IF_DATA /begin IF_DATA ETK KP_BLOB 0x381516 EXTERN 0x2 /end IF_DATA /end MEASUREMENT
/begin MEASUREMENT laufz5m_w "" UWORD runtime1_sy 1 100 0 52428 FORMAT "%8.2" /begin IF_DATA ASAP1B_KWP2000 KP_BLOB 0xF920 INTERN 0x2 /end IF_DATA /begin IF_DATA ETK KP_BLOB 0xF920 INTERN 0x2 /end IF_DATA /end MEASUREMENT
/begin MEASUREMENT laufzbg_w "" UWORD runtime1_sy 1 100 0 52428 FORMAT "%8.2" /begin IF_DATA ASAP1B_KWP2000 KP_BLOB 0x381518 EXTERN 0x2 /end IF_DATA /begin IF_DATA ETK KP_BLOB 0x381518 EXTERN 0x2 /end IF_DATA /end MEASUREMENT
/begin MEASUREMENT laufzfbg_w "" UWORD runtime1_sy 1 100 0 52428 FORMAT "%8.2" /begin IF_DATA ASAP1B_KWP2000 KP_BLOB 0x38151A EXTERN 0x2 /end IF_DATA /begin IF_DATA ETK KP_BLOB 0x38151A EXTERN 0x2 /end IF_DATA /end MEASUREMENT
/begin MEASUREMENT laufzsyn_w "" UWORD runtime1_sy 1 100 0 52428 FORMAT "%8.2" /begin IF_DATA ASAP1B_KWP2000 KP_BLOB 0x381522 EXTERN 0x2 /end IF_DATA /begin IF_DATA ETK KP_BLOB 0x381522 EXTERN 0x2 /end IF_DATA /end MEASUREMENT
/begin MEASUREMENT losphctr "" UBYTE dez 1 100 0 255 FORMAT "%5.1" /begin IF_DATA ASAP1B_KWP2000 KP_BLOB 0x382806 EXTERN 0x1 /end IF_DATA /begin IF_DATA ETK KP_BLOB 0x382806 EXTERN 0x1 /end IF_DATA /end MEASUREMENT
/begin MEASUREMENT lrsi_w "Reglerkoeffizient stetige Lambdaregelung I-Anteil" UWORD fak_uw_b64 1 100 0 63.999 FORMAT "%8.5" /begin IF_DATA ASAP1B_KWP2000 KP_BLOB 0x3813E0 EXTERN 0x2 /end IF_DATA /begin IF_DATA ETK KP_BLOB 0x3813E0 EXTERN 0x2 /end IF_DATA /end MEASUREMENT
/begin MEASUREMENT lrsp_w "Reglerkoeffizient stetige Lampdaregelung P-Anteil" SWORD fak_sw_b32 1 100 -32 31.999 FORMAT "%8.5" /begin IF_DATA ASAP1B_KWP2000 KP_BLOB 0x3813E2 EXTERN 0x2 /end IF_DATA /begin IF_DATA ETK KP_BLOB 0x3813E2 EXTERN 0x2 /end IF_DATA /end MEASUREMENT
/begin MEASUREMENT lrsw12_w "Interner Reglerzustand stetige Lambdaregelung;Bank2" SWORD fak_sw_b4 1 100 -4 3.99988 FORMAT "%8.6" /begin IF_DATA ASAP1B_KWP2000 KP_BLOB 0x3813E4 EXTERN 0x2 /end IF_DATA /begin IF_DATA ETK KP_BLOB 0x3813E4 EXTERN 0x2 /end IF_DATA /end MEASUREMENT
/begin MEASUREMENT lrsw1_w "Interner Reglerzustand stetige Lambdaregelung" SWORD fak_sw_b4 1 100 -4 3.99988 FORMAT "%8.6" /begin IF_DATA ASAP1B_KWP2000 KP_BLOB 0x3813E6 EXTERN 0x2 /end IF_DATA /begin IF_DATA ETK KP_BLOB 0x3813E6 EXTERN 0x2 /end IF_DATA /end MEASUREMENT
/begin MEASUREMENT lrsw22_w "Interner Reglerzustand stetige Lambdaregelung;Bank2" SWORD fak_sw_b4 1 100 -4 3.99988 FORMAT "%8.6" /begin IF_DATA ASAP1B_KWP2000 KP_BLOB 0x3813E8 EXTERN 0x2 /end IF_DATA /begin IF_DATA ETK KP_BLOB 0x3813E8 EXTERN 0x2 /end IF_DATA /end MEASUREMENT
/begin MEASUREMENT lrsw2_w "Interner Reglerzustand stetige Lambdaregelung" SWORD fak_sw_b4 1 100 -4 3.99988 FORMAT "%8.6" /begin IF_DATA ASAP1B_KWP2000 KP_BLOB 0x3813EA EXTERN 0x2 /end IF_DATA /begin IF_DATA ETK KP_BLOB 0x3813EA EXTERN 0x2 /end IF_DATA /end MEASUREMENT
/begin MEASUREMENT lrsxk12_w "Interner Reglerzustand stetige Lambdaregelung;Bank 2" SWORD fak_sw_b1 1 100 -1 0.999969 FORMAT "%8.6" /begin IF_DATA ASAP1B_KWP2000 KP_BLOB 0x3813EC EXTERN 0x2 /end IF_DATA /begin IF_DATA ETK KP_BLOB 0x3813EC EXTERN 0x2 /end IF_DATA /end MEASUREMENT
/begin MEASUREMENT lrsxk1_w "Interner Reglerzustand stetige Lambdaregelung" SWORD fak_sw_b1 1 100 -1 0.999969 FORMAT "%8.6" /begin IF_DATA ASAP1B_KWP2000 KP_BLOB 0x3813EE EXTERN 0x2 /end IF_DATA /begin IF_DATA ETK KP_BLOB 0x3813EE EXTERN 0x2 /end IF_DATA /end MEASUREMENT
/begin MEASUREMENT lrsxk32_w "Interner Reglerzustand stetige Lambdaregelung;Bank2" SWORD fak_sw_b1 1 100 -1 0.999969 FORMAT "%8.6" /begin IF_DATA ASAP1B_KWP2000 KP_BLOB 0x3813F0 EXTERN 0x2 /end IF_DATA /begin IF_DATA ETK KP_BLOB 0x3813F0 EXTERN 0x2 /end IF_DATA /end MEASUREMENT
/begin MEASUREMENT lrsxk3_w "Interner Reglerzustand stetige Lambdaregelung" SWORD fak_sw_b1 1 100 -1 0.999969 FORMAT "%8.6" /begin IF_DATA ASAP1B_KWP2000 KP_BLOB 0x3813F2 EXTERN 0x2 /end IF_DATA /begin IF_DATA ETK KP_BLOB 0x3813F2 EXTERN 0x2 /end IF_DATA /end MEASUREMENT
/begin MEASUREMENT lrsxk42_w "Interner Reglerzustand stetige Lambdaregelung;Bank2" SWORD fak_sw_b1 1 100 -1 0.999969 FORMAT "%8.6" /begin IF_DATA ASAP1B_KWP2000 KP_BLOB 0x3813F4 EXTERN 0x2 /end IF_DATA /begin IF_DATA ETK KP_BLOB 0x3813F4 EXTERN 0x2 /end IF_DATA /end MEASUREMENT
/begin MEASUREMENT lrsxk4_w "Interner Reglerzustand stetige Lambdaregelung" SWORD fak_sw_b1 1 100 -1 0.999969 FORMAT "%8.6" /begin IF_DATA ASAP1B_KWP2000 KP_BLOB 0x3813F6 EXTERN 0x2 /end IF_DATA /begin IF_DATA ETK KP_BLOB 0x3813F6 EXTERN 0x2 /end IF_DATA /end MEASUREMENT
/begin MEASUREMENT lrsy22_w "Interner Reglerzustand stetige Lambdaregelung;Bank2" SWORD fak_sw_b1 1 100 -1 0.999969 FORMAT "%8.6" /begin IF_DATA ASAP1B_KWP2000 KP_BLOB 0x3813F8 EXTERN 0x2 /end IF_DATA /begin IF_DATA ETK KP_BLOB 0x3813F8 EXTERN 0x2 /end IF_DATA /end MEASUREMENT
/begin MEASUREMENT lrsy2_w "Interner Reglerzustand stetige Lambdaregelung" SWORD fak_sw_b1 1 100 -1 0.999969 FORMAT "%8.6" /begin IF_DATA ASAP1B_KWP2000 KP_BLOB 0x3813FA EXTERN 0x2 /end IF_DATA /begin IF_DATA ETK KP_BLOB 0x3813FA EXTERN 0x2 /end IF_DATA /end MEASUREMENT
/begin MEASUREMENT lrsy42_w "Interner Reglerzustand stetige Lambdaregelung;Bank2" SWORD fak_sw_b8 1 100 -8 7.99976 FORMAT "%8.6" /begin IF_DATA ASAP1B_KWP2000 KP_BLOB 0x3813FC EXTERN 0x2 /end IF_DATA /begin IF_DATA ETK KP_BLOB 0x3813FC EXTERN 0x2 /end IF_DATA /end MEASUREMENT
/begin MEASUREMENT lrsy4_w "Interner Reglerzustand stetige Lambdaregelung" SWORD fak_sw_b8 1 100 -8 7.99976 FORMAT "%8.6" /begin IF_DATA ASAP1B_KWP2000 KP_BLOB 0x3813FE EXTERN 0x2 /end IF_DATA /begin IF_DATA ETK KP_BLOB 0x3813FE EXTERN 0x2 /end IF_DATA /end MEASUREMENT
/begin MEASUREMENT ltdicree_w "Zurückgelegte Strecke über Lebensdauer, Impulszähler, abgespeichert im EEPROM" UWORD dez 1 100 0 65535 FORMAT "%8.2" /begin IF_DATA ASAP1B_KWP2000 KP_BLOB 0xF916 INTERN 0x2 /end IF_DATA /begin IF_DATA ETK KP_BLOB 0xF916 INTERN 0x2 /end IF_DATA /end MEASUREMENT
/begin MEASUREMENT ltdikmee_w "Zurückgelegte Strecke über Lebensdauer, Kilometerzähler, abgespeichert im EEPROM" UWORD dist_uw_q0p1 1 100 0 65535 FORMAT "%8.2" /begin IF_DATA ASAP1B_KWP2000 KP_BLOB 0x381360 EXTERN 0x2 /end IF_DATA /begin IF_DATA ETK KP_BLOB 0x381360 EXTERN 0x2 /end IF_DATA /end MEASUREMENT
/begin MEASUREMENT ltdistkm_w "Zurückgelegte Strecke über Lebensdauer, Kilometerzähler" UWORD dist_uw_q0p1 1 100 0 65535 FORMAT "%8.2" /begin IF_DATA ASAP1B_KWP2000 KP_BLOB 0x381362 EXTERN 0x2 /end IF_DATA /begin IF_DATA ETK KP_BLOB 0x381362 EXTERN 0x2 /end IF_DATA /end MEASUREMENT
/begin MEASUREMENT ltdistm_w "Zurückgelegte Strecke über Lebensdauer, Meterzähler" UWORD distm_uw_q0p1 1 100 0 6553.5 FORMAT "%8.3" /begin IF_DATA ASAP1B_KWP2000 KP_BLOB 0x381364 EXTERN 0x2 /end IF_DATA /begin IF_DATA ETK KP_BLOB 0x381364 EXTERN 0x2 /end IF_DATA /end MEASUREMENT
/begin MEASUREMENT ltecuee_w "SG-Betriebszeit, abgespeichert im EEPROM" UWORD t6minxmin_q6 1 100 0 6553.5 FORMAT "%8.3" /begin IF_DATA ASAP1B_KWP2000 KP_BLOB 0x382B50 EXTERN 0x2 /end IF_DATA /begin IF_DATA ETK KP_BLOB 0x382B50 EXTERN 0x2 /end IF_DATA /end MEASUREMENT
/begin MEASUREMENT ltecusec_w "SG-Betriebszeit, Sekundenzähler" UWORD t1sxs_uw_q1 1 100 0 65535 FORMAT "%8.2" /begin IF_DATA ASAP1B_KWP2000 KP_BLOB 0x382B4C EXTERN 0x2 /end IF_DATA /begin IF_DATA ETK KP_BLOB 0x382B4C EXTERN 0x2 /end IF_DATA /end MEASUREMENT
/begin MEASUREMENT ltecu_w "SG-Betriebszeit" UWORD t6minxmin_q6 1 100 0 6553.5 FORMAT "%8.3" /begin IF_DATA ASAP1B_KWP2000 KP_BLOB 0x382B52 EXTERN 0x2 /end IF_DATA /begin IF_DATA ETK KP_BLOB 0x382B52 EXTERN 0x2 /end IF_DATA /end MEASUREMENT
/begin MEASUREMENT lteestat "Statusbyte EEPROM Lebensdauerspeicher" UBYTE msd_text_eltcwrite 1 100 0 255 FORMAT "%5.1" /begin IF_DATA ASAP1B_KWP2000 KP_BLOB 0x382947 EXTERN 0x1 /end IF_DATA /begin IF_DATA ETK KP_BLOB 0x382947 EXTERN 0x1 /end IF_DATA /end MEASUREMENT
/begin MEASUREMENT ltmotee_w "Motorbetriebszeit, abgespeichert im EEPROM" UWORD t6minxmin_q6 1 100 0 6553.5 FORMAT "%8.3" /begin IF_DATA ASAP1B_KWP2000 KP_BLOB 0x382B54 EXTERN 0x2 /end IF_DATA /begin IF_DATA ETK KP_BLOB 0x382B54 EXTERN 0x2 /end IF_DATA /end MEASUREMENT
/begin MEASUREMENT ltmotsec_w "Motorbetriebszeit, Sekundenzähler" UWORD t1sxs_uw_q1 1 100 0 65535 FORMAT "%8.2" /begin IF_DATA ASAP1B_KWP2000 KP_BLOB 0x382B4E EXTERN 0x2 /end IF_DATA /begin IF_DATA ETK KP_BLOB 0x382B4E EXTERN 0x2 /end IF_DATA /end MEASUREMENT
/begin MEASUREMENT ltmot_w "Motorbetriebszeit" UWORD t6minxmin_q6 1 100 0 6553.5 FORMAT "%8.3" /begin IF_DATA ASAP1B_KWP2000 KP_BLOB 0x382B56 EXTERN 0x2 /end IF_DATA /begin IF_DATA ETK KP_BLOB 0x382B56 EXTERN 0x2 /end IF_DATA /end MEASUREMENT
/begin MEASUREMENT ltnmoee_w "Drehzahlmonitor, abgespeichert im EEPROM" UWORD tmin_uw_qms 1 100 0 6553.5 FORMAT "%8.3" /begin IF_DATA ASAP1B_KWP2000 KP_BLOB 0x382B58 EXTERN 0x2 /end IF_DATA /begin IF_DATA ETK KP_BLOB 0x382B58 EXTERN 0x2 /end IF_DATA /end MEASUREMENT
/begin MEASUREMENT ltnmotmo_w "Drehzahlmonitor" UWORD tmin_uw_qms 1 100 0 6553.5 FORMAT "%8.3" /begin IF_DATA ASAP1B_KWP2000 KP_BLOB 0x382B5A EXTERN 0x2 /end IF_DATA /begin IF_DATA ETK KP_BLOB 0x382B5A EXTERN 0x2 /end IF_DATA /end MEASUREMENT
/begin MEASUREMENT ltnmotmx_w "Maximaldrehzahlspeicher" UWORD nmot_uw_q0p25 1 100 0 16383.8 FORMAT "%8.2" /begin IF_DATA ASAP1B_KWP2000 KP_BLOB 0x382B5C EXTERN 0x2 /end IF_DATA /begin IF_DATA ETK KP_BLOB 0x382B5C EXTERN 0x2 /end IF_DATA /end MEASUREMENT
/begin MEASUREMENT ltnmxee_w "Maximaldrehzahlspeicher, abgespeichert im EEPROM" UWORD nmot_uw_q0p25 1 100 0 16383.8 FORMAT "%8.2" /begin IF_DATA ASAP1B_KWP2000 KP_BLOB 0x382B5E EXTERN 0x2 /end IF_DATA /begin IF_DATA ETK KP_BLOB 0x382B5E EXTERN 0x2 /end IF_DATA /end MEASUREMENT
/begin MEASUREMENT ltstcree_w "Zähler Speichervorgänge Lebensdauer" UWORD dez 1 100 0 65535 FORMAT "%8.2" /begin IF_DATA ASAP1B_KWP2000 KP_BLOB 0x382B60 EXTERN 0x2 /end IF_DATA /begin IF_DATA ETK KP_BLOB 0x382B60 EXTERN 0x2 /end IF_DATA /end MEASUREMENT
/begin MEASUREMENT lzmaxnmot "" UBYTE nmot_ub_q40 1 100 0 10200 FORMAT "%5.0" /begin IF_DATA ASAP1B_KWP2000 KP_BLOB 0x382949 EXTERN 0x1 /end IF_DATA /begin IF_DATA ETK KP_BLOB 0x382949 EXTERN 0x1 /end IF_DATA /end MEASUREMENT
/begin MEASUREMENT lzmaxrl "" UBYTE rel_ub_b99p6 1 100 0 99.6094 FORMAT "%5.2" /begin IF_DATA ASAP1B_KWP2000 KP_BLOB 0x38294A EXTERN 0x1 /end IF_DATA /begin IF_DATA ETK KP_BLOB 0x38294A EXTERN 0x1 /end IF_DATA /end MEASUREMENT
/begin MEASUREMENT lzmaxstate "" UBYTE dez 1 100 0 255 FORMAT "%5.1" /begin IF_DATA ASAP1B_KWP2000 KP_BLOB 0x38294B EXTERN 0x1 /end IF_DATA /begin IF_DATA ETK KP_BLOB 0x38294B EXTERN 0x1 /end IF_DATA /end MEASUREMENT
/begin MEASUREMENT lzmaxwdkba "" UBYTE relDK_ub_b100 1 100 0 100 FORMAT "%5.1" /begin IF_DATA ASAP1B_KWP2000 KP_BLOB 0x38294C EXTERN 0x1 /end IF_DATA /begin IF_DATA ETK KP_BLOB 0x38294C EXTERN 0x1 /end IF_DATA /end MEASUREMENT
/begin MEASUREMENT lzmaxwped "" UBYTE rel_ub_b99p6 1 100 0 99.6094 FORMAT "%5.2" /begin IF_DATA ASAP1B_KWP2000 KP_BLOB 0x38294D EXTERN 0x1 /end IF_DATA /begin IF_DATA ETK KP_BLOB 0x38294D EXTERN 0x1 /end IF_DATA /end MEASUREMENT
/begin MEASUREMENT lzs_dash "" UBYTE B_TRUE 1 100 0 1 BIT_MASK 0x10 FORMAT "%5.3" /begin IF_DATA ASAP1B_KWP2000 KP_BLOB 0x38294B EXTERN 0x1 /end IF_DATA /begin IF_DATA ETK KP_BLOB 0x38294B EXTERN 0x1 /end IF_DATA /end MEASUREMENT
/begin MEASUREMENT lzs_kr "" UBYTE B_TRUE 1 100 0 1 BIT_MASK 0x1 FORMAT "%5.3" /begin IF_DATA ASAP1B_KWP2000 KP_BLOB 0x38294B EXTERN 0x1 /end IF_DATA /begin IF_DATA ETK KP_BLOB 0x38294B EXTERN 0x1 /end IF_DATA /end MEASUREMENT
/begin MEASUREMENT lzs_ldr "" UBYTE B_TRUE 1 100 0 1 BIT_MASK 0x4 FORMAT "%5.3" /begin IF_DATA ASAP1B_KWP2000 KP_BLOB 0x38294B EXTERN 0x1 /end IF_DATA /begin IF_DATA ETK KP_BLOB 0x38294B EXTERN 0x1 /end IF_DATA /end MEASUREMENT
/begin MEASUREMENT lzs_lr "" UBYTE B_TRUE 1 100 0 1 BIT_MASK 0x2 FORMAT "%5.3" /begin IF_DATA ASAP1B_KWP2000 KP_BLOB 0x38294B EXTERN 0x1 /end IF_DATA /begin IF_DATA ETK KP_BLOB 0x38294B EXTERN 0x1 /end IF_DATA /end MEASUREMENT
/begin MEASUREMENT lzs_lsd "" UBYTE B_TRUE 1 100 0 1 BIT_MASK 0x8 FORMAT "%5.3" /begin IF_DATA ASAP1B_KWP2000 KP_BLOB 0x38294B EXTERN 0x1 /end IF_DATA /begin IF_DATA ETK KP_BLOB 0x38294B EXTERN 0x1 /end IF_DATA /end MEASUREMENT
/begin MEASUREMENT lzs_sa "" UBYTE B_TRUE 1 100 0 1 BIT_MASK 0x20 FORMAT "%5.3" /begin IF_DATA ASAP1B_KWP2000 KP_BLOB 0x38294B EXTERN 0x1 /end IF_DATA /begin IF_DATA ETK KP_BLOB 0x38294B EXTERN 0x1 /end IF_DATA /end MEASUREMENT
/begin MEASUREMENT mapposma "maximal aufgetretene Mapschalterposition" UBYTE default 1 100 0 255 FORMAT "%5.1" /begin IF_DATA ASAP1B_KWP2000 KP_BLOB 0x38292F EXTERN 0x1 /end IF_DATA /begin IF_DATA ETK KP_BLOB 0x38292F EXTERN 0x1 /end IF_DATA /end MEASUREMENT
/begin MEASUREMENT mapposmi "minimal aufgetretene Mapschalterposition" UBYTE default 1 100 0 255 FORMAT "%5.1" /begin IF_DATA ASAP1B_KWP2000 KP_BLOB 0x382930 EXTERN 0x1 /end IF_DATA /begin IF_DATA ETK KP_BLOB 0x382930 EXTERN 0x1 /end IF_DATA /end MEASUREMENT
/begin MEASUREMENT mdindg_w "indiziertes Motormoment Hochdruckphase wenn alle Zylinder befeuert" UWORD rel_uw_b100 1 100 0 99.9985 FORMAT "%8.5" /begin IF_DATA ASAP1B_KWP2000 KP_BLOB 0x3812FE EXTERN 0x2 /end IF_DATA /begin IF_DATA ETK KP_BLOB 0x3812FE EXTERN 0x2 /end IF_DATA /end MEASUREMENT
/begin MEASUREMENT memadc10_w "Spannung des CardMemory Analogkanals 10 (nur im Prüfmodus)" UWORD spg_uw_mV 1 100 0 5004.81 FORMAT "%8.3" /begin IF_DATA ASAP1B_KWP2000 KP_BLOB 0x380D02 EXTERN 0x2 /end IF_DATA /begin IF_DATA ETK KP_BLOB 0x380D02 EXTERN 0x2 /end IF_DATA /end MEASUREMENT
/begin MEASUREMENT memadc11_w "Spannung des CardMemory Analogkanals 11 (nur im Prüfmodus)" UWORD spg_uw_mV 1 100 0 5004.81 FORMAT "%8.3" /begin IF_DATA ASAP1B_KWP2000 KP_BLOB 0x380D04 EXTERN 0x2 /end IF_DATA /begin IF_DATA ETK KP_BLOB 0x380D04 EXTERN 0x2 /end IF_DATA /end MEASUREMENT
/begin MEASUREMENT memadc12_w "Spannung des CardMemory Analogkanals 12 (nur im Prüfmodus)" UWORD spg_uw_mV 1 100 0 5004.81 FORMAT "%8.3" /begin IF_DATA ASAP1B_KWP2000 KP_BLOB 0x380D06 EXTERN 0x2 /end IF_DATA /begin IF_DATA ETK KP_BLOB 0x380D06 EXTERN 0x2 /end IF_DATA /end MEASUREMENT
/begin MEASUREMENT memadc13_w "Spannung des CardMemory Analogkanals 13 (nur im Prüfmodus)" UWORD spg_uw_mV 1 100 0 5004.81 FORMAT "%8.3" /begin IF_DATA ASAP1B_KWP2000 KP_BLOB 0x380D08 EXTERN 0x2 /end IF_DATA /begin IF_DATA ETK KP_BLOB 0x380D08 EXTERN 0x2 /end IF_DATA /end MEASUREMENT
/begin MEASUREMENT memadc14_w "Spannung des CardMemory Analogkanals 14 (nur im Prüfmodus)" UWORD spg_uw_mV 1 100 0 5004.81 FORMAT "%8.3" /begin IF_DATA ASAP1B_KWP2000 KP_BLOB 0x380D0A EXTERN 0x2 /end IF_DATA /begin IF_DATA ETK KP_BLOB 0x380D0A EXTERN 0x2 /end IF_DATA /end MEASUREMENT
/begin MEASUREMENT memadc15_w "Spannung des CardMemory Analogkanals 15 (nur im Prüfmodus)" UWORD spg_uw_mV 1 100 0 5004.81 FORMAT "%8.3" /begin IF_DATA ASAP1B_KWP2000 KP_BLOB 0x380D0C EXTERN 0x2 /end IF_DATA /begin IF_DATA ETK KP_BLOB 0x380D0C EXTERN 0x2 /end IF_DATA /end MEASUREMENT
/begin MEASUREMENT memadc16_w "Spannung des CardMemory-internen Tempertursensors (nur im Prüfmodus)" UWORD spg_uw_mV 1 100 0 5004.81 FORMAT "%8.3" /begin IF_DATA ASAP1B_KWP2000 KP_BLOB 0x380D0E EXTERN 0x2 /end IF_DATA /begin IF_DATA ETK KP_BLOB 0x380D0E EXTERN 0x2 /end IF_DATA /end MEASUREMENT
/begin MEASUREMENT memadc1_w "Spannung des CardMemory Analogkanals 1 (nur im Prüfmodus)" UWORD spg_uw_mV 1 100 0 5004.81 FORMAT "%8.3" /begin IF_DATA ASAP1B_KWP2000 KP_BLOB 0x380D10 EXTERN 0x2 /end IF_DATA /begin IF_DATA ETK KP_BLOB 0x380D10 EXTERN 0x2 /end IF_DATA /end MEASUREMENT
/begin MEASUREMENT memadc2_w "Spannung des CardMemory Analogkanals 2 (nur im Prüfmodus)" UWORD spg_uw_mV 1 100 0 5004.81 FORMAT "%8.3" /begin IF_DATA ASAP1B_KWP2000 KP_BLOB 0x380D12 EXTERN 0x2 /end IF_DATA /begin IF_DATA ETK KP_BLOB 0x380D12 EXTERN 0x2 /end IF_DATA /end MEASUREMENT
/begin MEASUREMENT memadc3_w "Spannung des CardMemory Analogkanals 3 (nur im Prüfmodus)" UWORD spg_uw_mV 1 100 0 5004.81 FORMAT "%8.3" /begin IF_DATA ASAP1B_KWP2000 KP_BLOB 0x380D14 EXTERN 0x2 /end IF_DATA /begin IF_DATA ETK KP_BLOB 0x380D14 EXTERN 0x2 /end IF_DATA /end MEASUREMENT
/begin MEASUREMENT memadc4_w "Spannung des CardMemory Analogkanals 4 (nur im Prüfmodus)" UWORD spg_uw_mV 1 100 0 5004.81 FORMAT "%8.3" /begin IF_DATA ASAP1B_KWP2000 KP_BLOB 0x380D16 EXTERN 0x2 /end IF_DATA /begin IF_DATA ETK KP_BLOB 0x380D16 EXTERN 0x2 /end IF_DATA /end MEASUREMENT
/begin MEASUREMENT memadc5_w "Spannung des CardMemory Analogkanals 5 (nur im Prüfmodus)" UWORD spg_uw_mV 1 100 0 5004.81 FORMAT "%8.3" /begin IF_DATA ASAP1B_KWP2000 KP_BLOB 0x380D18 EXTERN 0x2 /end IF_DATA /begin IF_DATA ETK KP_BLOB 0x380D18 EXTERN 0x2 /end IF_DATA /end MEASUREMENT
/begin MEASUREMENT memadc6_w "Spannung des CardMemory Analogkanals 6 (nur im Prüfmodus)" UWORD spg_uw_mV 1 100 0 5004.81 FORMAT "%8.3" /begin IF_DATA ASAP1B_KWP2000 KP_BLOB 0x380D1A EXTERN 0x2 /end IF_DATA /begin IF_DATA ETK KP_BLOB 0x380D1A EXTERN 0x2 /end IF_DATA /end MEASUREMENT
/begin MEASUREMENT memadc7_w "Spannung des CardMemory Analogkanals 7 (nur im Prüfmodus)" UWORD spg_uw_mV 1 100 0 5004.81 FORMAT "%8.3" /begin IF_DATA ASAP1B_KWP2000 KP_BLOB 0x380D1C EXTERN 0x2 /end IF_DATA /begin IF_DATA ETK KP_BLOB 0x380D1C EXTERN 0x2 /end IF_DATA /end MEASUREMENT
/begin MEASUREMENT memadc8_w "Spannung des CardMemory Analogkanals 8 (nur im Prüfmodus)" UWORD spg_uw_mV 1 100 0 5004.81 FORMAT "%8.3" /begin IF_DATA ASAP1B_KWP2000 KP_BLOB 0x380D1E EXTERN 0x2 /end IF_DATA /begin IF_DATA ETK KP_BLOB 0x380D1E EXTERN 0x2 /end IF_DATA /end MEASUREMENT
/begin MEASUREMENT memadc9_w "Spannung des CardMemory Analogkanals 9 (nur im Prüfmodus)" UWORD spg_uw_mV 1 100 0 5004.81 FORMAT "%8.3" /begin IF_DATA ASAP1B_KWP2000 KP_BLOB 0x380D20 EXTERN 0x2 /end IF_DATA /begin IF_DATA ETK KP_BLOB 0x380D20 EXTERN 0x2 /end IF_DATA /end MEASUREMENT
/begin MEASUREMENT memcoppr_w "Kopierschutzstand des Memory" UWORD dez 1 100 0 65535 FORMAT "%8.2" /begin IF_DATA ASAP1B_KWP2000 KP_BLOB 0x380D22 EXTERN 0x2 /end IF_DATA /begin IF_DATA ETK KP_BLOB 0x380D22 EXTERN 0x2 /end IF_DATA /end MEASUREMENT
/begin MEASUREMENT memdist_w "Wegspur für Memoryaufzeichnung" UWORD dez 1 100 0 65535 FORMAT "%8.2" /begin IF_DATA ASAP1B_KWP2000 KP_BLOB 0x382B22 EXTERN 0x2 /end IF_DATA /begin IF_DATA ETK KP_BLOB 0x382B22 EXTERN 0x2 /end IF_DATA /end MEASUREMENT
/begin MEASUREMENT memfirm_w "Firmwarestand des Memory" UWORD dez 1 100 0 65535 FORMAT "%8.2" /begin IF_DATA ASAP1B_KWP2000 KP_BLOB 0x380D24 EXTERN 0x2 /end IF_DATA /begin IF_DATA ETK KP_BLOB 0x380D24 EXTERN 0x2 /end IF_DATA /end MEASUREMENT
/begin MEASUREMENT memimp_w "Periodendauer des CardMemory Drehzahleingangs (nur im Prüfmodus)" UWORD time_uw_ms 1 100 0 104.856 FORMAT "%8.4" /begin IF_DATA ASAP1B_KWP2000 KP_BLOB 0x380D26 EXTERN 0x2 /end IF_DATA /begin IF_DATA ETK KP_BLOB 0x380D26 EXTERN 0x2 /end IF_DATA /end MEASUREMENT
/begin MEASUREMENT memrst_w "Zähler für Versuche Kommunikationsaufbau" UWORD dez 1 100 0 65535 FORMAT "%8.2" /begin IF_DATA ASAP1B_KWP2000 KP_BLOB 0x380D28 EXTERN 0x2 /end IF_DATA /begin IF_DATA ETK KP_BLOB 0x380D28 EXTERN 0x2 /end IF_DATA /end MEASUREMENT
/begin MEASUREMENT memsblk_w "Zähler für übertragene Synchroblöcke" UWORD dez 1 100 0 65535 FORMAT "%8.2" /begin IF_DATA ASAP1B_KWP2000 KP_BLOB 0x380D2A EXTERN 0x2 /end IF_DATA /begin IF_DATA ETK KP_BLOB 0x380D2A EXTERN 0x2 /end IF_DATA /end MEASUREMENT
/begin MEASUREMENT memtblk_w "Zähler für übertragene Zeitblöcke" UWORD dez 1 100 0 65535 FORMAT "%8.2" /begin IF_DATA ASAP1B_KWP2000 KP_BLOB 0x380D2C EXTERN 0x2 /end IF_DATA /begin IF_DATA ETK KP_BLOB 0x380D2C EXTERN 0x2 /end IF_DATA /end MEASUREMENT
/begin MEASUREMENT memtime_w "Zeitspur für Memoryaufzeichnung" UWORD dez 1 100 0 65535 FORMAT "%8.2" /begin IF_DATA ASAP1B_KWP2000 KP_BLOB 0x382B24 EXTERN 0x2 /end IF_DATA /begin IF_DATA ETK KP_BLOB 0x382B24 EXTERN 0x2 /end IF_DATA /end MEASUREMENT
/begin MEASUREMENT miasrs_w "Indiziertes Soll-Motormoment ASR für schnellen Eingriff" UWORD rel_uw_b100 1 100 0 99.9985 FORMAT "%8.5" /begin IF_DATA ASAP1B_KWP2000 KP_BLOB 0x3812CE EXTERN 0x2 /end IF_DATA /begin IF_DATA ETK KP_BLOB 0x3812CE EXTERN 0x2 /end IF_DATA /end MEASUREMENT
/begin MEASUREMENT mibas_w "indiziertes Basis-Moment" UWORD rel_uw_b100 1 100 0 99.9985 FORMAT "%8.5" /begin IF_DATA ASAP1B_KWP2000 KP_BLOB 0x3812DA EXTERN 0x2 /end IF_DATA /begin IF_DATA ETK KP_BLOB 0x3812DA EXTERN 0x2 /end IF_DATA /end MEASUREMENT
/begin MEASUREMENT miext_w "von außen (ASR, GS, usw.) angefordertes indiziertes Motormoment" UWORD rel_uw_b100 1 100 0 99.9985 FORMAT "%8.5" /begin IF_DATA ASAP1B_KWP2000 KP_BLOB 0x3812D0 EXTERN 0x2 /end IF_DATA /begin IF_DATA ETK KP_BLOB 0x3812D0 EXTERN 0x2 /end IF_DATA /end MEASUREMENT
/begin MEASUREMENT mifa "indiziertes Motormoment Fahrerwunsch" UBYTE rel_ub_b100 1 100 0 99.6094 FORMAT "%5.2" /begin IF_DATA ASAP1B_KWP2000 KP_BLOB 0x380429 EXTERN 0x1 /end IF_DATA /begin IF_DATA ETK KP_BLOB 0x380429 EXTERN 0x1 /end IF_DATA /end MEASUREMENT
/begin MEASUREMENT mifalws_w "indiziertes Motormoment Fahrerwunsch nach Lastwechselschlagdämpfung" UWORD rel_uw_b100 1 100 0 99.9985 FORMAT "%8.5" /begin IF_DATA ASAP1B_KWP2000 KP_BLOB 0x3812EC EXTERN 0x2 /end IF_DATA /begin IF_DATA ETK KP_BLOB 0x3812EC EXTERN 0x2 /end IF_DATA /end MEASUREMENT
/begin MEASUREMENT mifa_w "indiziertes Motormoment Fahrerwunsch" UWORD rel_uw_b100 1 100 0 99.9985 FORMAT "%8.5" /begin IF_DATA ASAP1B_KWP2000 KP_BLOB 0x3812DC EXTERN 0x2 /end IF_DATA /begin IF_DATA ETK KP_BLOB 0x3812DC EXTERN 0x2 /end IF_DATA /end MEASUREMENT
/begin MEASUREMENT mifil_w "Indiziertes Fahrerwunschmoment nach Komfortfunktionenfilterung" UWORD rel_uw_b100 1 100 0 99.9985 FORMAT "%8.5" /begin IF_DATA ASAP1B_KWP2000 KP_BLOB 0x3812D8 EXTERN 0x2 /end IF_DATA /begin IF_DATA ETK KP_BLOB 0x3812D8 EXTERN 0x2 /end IF_DATA /end MEASUREMENT
/begin MEASUREMENT miist_w "indiziertes Motormoment Hochdruckphase Istwert" UWORD rel_uw_b100 1 100 0 99.9985 FORMAT "%8.5" /begin IF_DATA ASAP1B_KWP2000 KP_BLOB 0x381300 EXTERN 0x2 /end IF_DATA /begin IF_DATA ETK KP_BLOB 0x381300 EXTERN 0x2 /end IF_DATA /end MEASUREMENT
/begin MEASUREMENT minmxb_w "indiziertes Soll-Moment für NMAX-Begrenzung ohne Begrenzung" SWORD rel_sw_b100 1 100 -100 99.9969 FORMAT "%8.4" /begin IF_DATA ASAP1B_KWP2000 KP_BLOB 0x381308 EXTERN 0x2 /end IF_DATA /begin IF_DATA ETK KP_BLOB 0x381308 EXTERN 0x2 /end IF_DATA /end MEASUREMENT
/begin MEASUREMENT minmx_w "Momentenanforderung der Drehzahlbegrenzung" UWORD rel_uw_b100 1 100 0 99.9985 FORMAT "%8.5" /begin IF_DATA ASAP1B_KWP2000 KP_BLOB 0x38130A EXTERN 0x2 /end IF_DATA /begin IF_DATA ETK KP_BLOB 0x38130A EXTERN 0x2 /end IF_DATA /end MEASUREMENT
/begin MEASUREMENT mioes_w "Indiziertes resultierendes Sollmoment ohne Eingriffe" UWORD rel_uw_b100 1 100 0 99.9985 FORMAT "%8.5" /begin IF_DATA ASAP1B_KWP2000 KP_BLOB 0x3812D2 EXTERN 0x2 /end IF_DATA /begin IF_DATA ETK KP_BLOB 0x3812D2 EXTERN 0x2 /end IF_DATA /end MEASUREMENT
/begin MEASUREMENT mioptl1_w "optimales indiziertes Motormoment bei Lambda = 1" UWORD rel_uw_b100 1 100 0 99.9985 FORMAT "%8.5" /begin IF_DATA ASAP1B_KWP2000 KP_BLOB 0x3812DE EXTERN 0x2 /end IF_DATA /begin IF_DATA ETK KP_BLOB 0x3812DE EXTERN 0x2 /end IF_DATA /end MEASUREMENT
/begin MEASUREMENT miopt_w "optimales indiziertes Moment" UWORD rel_uw_b100 1 100 0 99.9985 FORMAT "%8.5" /begin IF_DATA ASAP1B_KWP2000 KP_BLOB 0x3812E0 EXTERN 0x2 /end IF_DATA /begin IF_DATA ETK KP_BLOB 0x3812E0 EXTERN 0x2 /end IF_DATA /end MEASUREMENT
/begin MEASUREMENT miptzwei_w "indiziertes Motormoment nach PT2-Filterung Lastwechselschlagdämpfung" UWORD rel_uw_b100 1 100 0 99.9985 FORMAT "%8.5" /begin IF_DATA ASAP1B_KWP2000 KP_BLOB 0x3812EE EXTERN 0x2 /end IF_DATA /begin IF_DATA ETK KP_BLOB 0x3812EE EXTERN 0x2 /end IF_DATA /end MEASUREMENT
/begin MEASUREMENT misawe_w "Indiziertes Fahrerwunschmoment nach Filterung SAWE" UWORD rel_uw_b100 1 100 0 99.9985 FORMAT "%8.5" /begin IF_DATA ASAP1B_KWP2000 KP_BLOB 0x381328 EXTERN 0x2 /end IF_DATA /begin IF_DATA ETK KP_BLOB 0x381328 EXTERN 0x2 /end IF_DATA /end MEASUREMENT
/begin MEASUREMENT misol_w "Indiziertes resultierendes Sollmoment" UWORD rel_uw_b100 1 100 0 99.9985 FORMAT "%8.5" /begin IF_DATA ASAP1B_KWP2000 KP_BLOB 0xF904 INTERN 0x2 /end IF_DATA /begin IF_DATA ETK KP_BLOB 0xF904 INTERN 0x2 /end IF_DATA /end MEASUREMENT
/begin MEASUREMENT mivmx_w "Indiziertes Sollmoment der VMAX-Regelung" UWORD rel_uw_b100 1 100 0 99.9985 FORMAT "%8.5" /begin IF_DATA ASAP1B_KWP2000 KP_BLOB 0x381320 EXTERN 0x2 /end IF_DATA /begin IF_DATA ETK KP_BLOB 0x381320 EXTERN 0x2 /end IF_DATA /end MEASUREMENT
/begin MEASUREMENT mizsol_w "Indiziertes resultierendes Sollmoment für ZW-Eingriff" UWORD rel_uw_b100 1 100 0 99.9985 FORMAT "%8.5" /begin IF_DATA ASAP1B_KWP2000 KP_BLOB 0x3812D4 EXTERN 0x2 /end IF_DATA /begin IF_DATA ETK KP_BLOB 0x3812D4 EXTERN 0x2 /end IF_DATA /end MEASUREMENT
/begin MEASUREMENT mizwmn_w "indiziertes Motormoment beim spätesten Zündwinkel" UWORD rel_uw_b100 1 100 0 99.9985 FORMAT "%8.5" /begin IF_DATA ASAP1B_KWP2000 KP_BLOB 0x381314 EXTERN 0x2 /end IF_DATA /begin IF_DATA ETK KP_BLOB 0x381314 EXTERN 0x2 /end IF_DATA /end MEASUREMENT
/begin MEASUREMENT nmotma_w "maximal aufgetretene Motordrehzahl" UWORD nmot_uw_q0p25 1 100 0 16383.8 FORMAT "%8.2" /begin IF_DATA ASAP1B_KWP2000 KP_BLOB 0x382B32 EXTERN 0x2 /end IF_DATA /begin IF_DATA ETK KP_BLOB 0x382B32 EXTERN 0x2 /end IF_DATA /end MEASUREMENT
/begin MEASUREMENT nmotpr_w "Prädizierte Motordrehzahl für NMAX-Regelung" UWORD nmot_uw_q0p25 1 100 0 16383.8 FORMAT "%8.2" /begin IF_DATA ASAP1B_KWP2000 KP_BLOB 0x38130C EXTERN 0x2 /end IF_DATA /begin IF_DATA ETK KP_BLOB 0x38130C EXTERN 0x2 /end IF_DATA /end MEASUREMENT
/begin MEASUREMENT nsber_w "Solldrehzahl für NMAX-Regelung" UWORD nmot_uw_q0p25 1 100 0 16383.8 FORMAT "%8.2" /begin IF_DATA ASAP1B_KWP2000 KP_BLOB 0x38130E EXTERN 0x2 /end IF_DATA /begin IF_DATA ETK KP_BLOB 0x38130E EXTERN 0x2 /end IF_DATA /end MEASUREMENT
/begin MEASUREMENT perffilt_w "" UWORD rel_q0p025 1 100 0 1638.38 FORMAT "%8.3" /begin IF_DATA ASAP1B_KWP2000 KP_BLOB 0x381524 EXTERN 0x2 /end IF_DATA /begin IF_DATA ETK KP_BLOB 0x381524 EXTERN 0x2 /end IF_DATA /end MEASUREMENT
/begin MEASUREMENT perfmax_w "" UWORD rel_q0p025 1 100 0 1638.38 FORMAT "%8.3" /begin IF_DATA ASAP1B_KWP2000 KP_BLOB 0x382F84 EXTERN 0x2 /end IF_DATA /begin IF_DATA ETK KP_BLOB 0x382F84 EXTERN 0x2 /end IF_DATA /end MEASUREMENT
/begin MEASUREMENT perfmin_w "" UWORD rel_q0p025 1 100 0 1638.38 FORMAT "%8.3" /begin IF_DATA ASAP1B_KWP2000 KP_BLOB 0x382F86 EXTERN 0x2 /end IF_DATA /begin IF_DATA ETK KP_BLOB 0x382F86 EXTERN 0x2 /end IF_DATA /end MEASUREMENT
/begin MEASUREMENT perform_w "" UWORD rel_q0p025 1 100 0 1638.38 FORMAT "%8.3" /begin IF_DATA ASAP1B_KWP2000 KP_BLOB 0x381526 EXTERN 0x2 /end IF_DATA /begin IF_DATA ETK KP_BLOB 0x381526 EXTERN 0x2 /end IF_DATA /end MEASUREMENT
/begin MEASUREMENT peri50ms_w "" UWORD runtime2_sy 1 100 0 838848 FORMAT "%8.1" /begin IF_DATA ASAP1B_KWP2000 KP_BLOB 0x381528 EXTERN 0x2 /end IF_DATA /begin IF_DATA ETK KP_BLOB 0x381528 EXTERN 0x2 /end IF_DATA /end MEASUREMENT
/begin MEASUREMENT pfuelma "maximal aufgetretener Kraftstoffdruck" UBYTE msd_poil_ub_0 1 100 0 16 FORMAT "%5.2" /begin IF_DATA ASAP1B_KWP2000 KP_BLOB 0x382931 EXTERN 0x1 /end IF_DATA /begin IF_DATA ETK KP_BLOB 0x382931 EXTERN 0x1 /end IF_DATA /end MEASUREMENT
/begin MEASUREMENT pfuelmi "minimal aufgetretener Kraftstoffdruck" UBYTE msd_poil_ub_0 1 100 0 16 FORMAT "%5.2" /begin IF_DATA ASAP1B_KWP2000 KP_BLOB 0x382932 EXTERN 0x1 /end IF_DATA /begin IF_DATA ETK KP_BLOB 0x382932 EXTERN 0x1 /end IF_DATA /end MEASUREMENT
/begin MEASUREMENT poelma "maximal aufgetretener Öldruck" UBYTE msd_poil_ub_0 1 100 0 16 FORMAT "%5.2" /begin IF_DATA ASAP1B_KWP2000 KP_BLOB 0x382933 EXTERN 0x1 /end IF_DATA /begin IF_DATA ETK KP_BLOB 0x382933 EXTERN 0x1 /end IF_DATA /end MEASUREMENT
/begin MEASUREMENT poelmi "minimal aufgetretener Öldruck" UBYTE msd_poil_ub_0 1 100 0 16 FORMAT "%5.2" /begin IF_DATA ASAP1B_KWP2000 KP_BLOB 0x382934 EXTERN 0x1 /end IF_DATA /begin IF_DATA ETK KP_BLOB 0x382934 EXTERN 0x1 /end IF_DATA /end MEASUREMENT
/begin MEASUREMENT puma "maximal aufgetretener Umgebungsdruck" UBYTE p_ub_q5 1 100 0 1275 FORMAT "%5.0" /begin IF_DATA ASAP1B_KWP2000 KP_BLOB 0x382935 EXTERN 0x1 /end IF_DATA /begin IF_DATA ETK KP_BLOB 0x382935 EXTERN 0x1 /end IF_DATA /end MEASUREMENT
/begin MEASUREMENT pumi "minimal aufgetretener Umgebungsdruck" UBYTE p_ub_q5 1 100 0 1275 FORMAT "%5.0" /begin IF_DATA ASAP1B_KWP2000 KP_BLOB 0x382936 EXTERN 0x1 /end IF_DATA /begin IF_DATA ETK KP_BLOB 0x382936 EXTERN 0x1 /end IF_DATA /end MEASUREMENT
/begin MEASUREMENT redhyst "Reduzierstufenhysterese" SBYTE rel_sb_q0p02 1 100 -2 1.98438 FORMAT "%5.3" /begin IF_DATA ASAP1B_KWP2000 KP_BLOB 0x380438 EXTERN 0x1 /end IF_DATA /begin IF_DATA ETK KP_BLOB 0x380438 EXTERN 0x1 /end IF_DATA /end MEASUREMENT
/begin MEASUREMENT redneu "neu berechnete Reduzierstufe" UBYTE dez 1 100 0 255 FORMAT "%5.1" /begin IF_DATA ASAP1B_KWP2000 KP_BLOB 0x380439 EXTERN 0x1 /end IF_DATA /begin IF_DATA ETK KP_BLOB 0x380439 EXTERN 0x1 /end IF_DATA /end MEASUREMENT
/begin MEASUREMENT redsol "Berechnete Soll-Reduzierstufe" UBYTE dez 1 100 0 255 FORMAT "%5.1" /begin IF_DATA ASAP1B_KWP2000 KP_BLOB 0x38043A EXTERN 0x1 /end IF_DATA /begin IF_DATA ETK KP_BLOB 0x38043A EXTERN 0x1 /end IF_DATA /end MEASUREMENT
/begin MEASUREMENT redze "Schwelle in Reduzierstufe zwischen Zünd- und Einspritzeingriff" UBYTE dez 1 100 0 255 FORMAT "%5.1" /begin IF_DATA ASAP1B_KWP2000 KP_BLOB 0x38043B EXTERN 0x1 /end IF_DATA /begin IF_DATA ETK KP_BLOB 0x38043B EXTERN 0x1 /end IF_DATA /end MEASUREMENT
/begin MEASUREMENT redzst_w "Reduzierstufe ohne Hysterese und Rundung" UWORD rel_uw_q0p001 1 100 0 65.535 FORMAT "%8.5" /begin IF_DATA ASAP1B_KWP2000 KP_BLOB 0x381316 EXTERN 0x2 /end IF_DATA /begin IF_DATA ETK KP_BLOB 0x381316 EXTERN 0x2 /end IF_DATA /end MEASUREMENT
/begin MEASUREMENT resetMonIdx "" UWORD dez 1 100 0 65535 FORMAT "%8.2" /begin IF_DATA ASAP1B_KWP2000 KP_BLOB 0x382F6A EXTERN 0x2 /end IF_DATA /begin IF_DATA ETK KP_BLOB 0x382F6A EXTERN 0x2 /end IF_DATA /end MEASUREMENT
/begin MEASUREMENT rlossCtr_w "" UWORD dez 1 100 0 65535 FORMAT "%8.2" /begin IF_DATA ASAP1B_KWP2000 KP_BLOB 0x382F88 EXTERN 0x2 /end IF_DATA /begin IF_DATA ETK KP_BLOB 0x382F88 EXTERN 0x2 /end IF_DATA /end MEASUREMENT
/begin MEASUREMENT rstMon "" UWORD dez 1 100 0 65535 FORMAT "%8.2" ARRAY_SIZE 12 /begin IF_DATA ASAP1B_KWP2000 KP_BLOB 0x382F6C EXTERN 0x2 /end IF_DATA /begin IF_DATA ETK KP_BLOB 0x382F6C EXTERN 0x2 /end IF_DATA /end MEASUREMENT
/begin MEASUREMENT stangchk "Lenkwinkel, Kontrollwert" SWORD deg_uw_q10 1 100 -3276.8 3276.7 FORMAT "%8.3" /begin IF_DATA ASAP1B_KWP2000 KP_BLOB 0x380D2E EXTERN 0x2 /end IF_DATA /begin IF_DATA ETK KP_BLOB 0x380D2E EXTERN 0x2 /end IF_DATA /end MEASUREMENT
/begin MEASUREMENT susflchk "Federweg vorne links, Kontrollwert" SWORD mm_uw_q100 1 100 -327.68 327.67 FORMAT "%8.4" /begin IF_DATA ASAP1B_KWP2000 KP_BLOB 0x380D30 EXTERN 0x2 /end IF_DATA /begin IF_DATA ETK KP_BLOB 0x380D30 EXTERN 0x2 /end IF_DATA /end MEASUREMENT
/begin MEASUREMENT susfrchk "Federweg vorne rechts, Kontrollwert" SWORD mm_uw_q100 1 100 -327.68 327.67 FORMAT "%8.4" /begin IF_DATA ASAP1B_KWP2000 KP_BLOB 0x380D32 EXTERN 0x2 /end IF_DATA /begin IF_DATA ETK KP_BLOB 0x380D32 EXTERN 0x2 /end IF_DATA /end MEASUREMENT
/begin MEASUREMENT susrlchk "Federweg hinten links, Kontrollwert" SWORD mm_uw_q100 1 100 -327.68 327.67 FORMAT "%8.4" /begin IF_DATA ASAP1B_KWP2000 KP_BLOB 0x380D34 EXTERN 0x2 /end IF_DATA /begin IF_DATA ETK KP_BLOB 0x380D34 EXTERN 0x2 /end IF_DATA /end MEASUREMENT
/begin MEASUREMENT susrrchk "Federweg hinten rechts, Kontrollwert" SWORD mm_uw_q100 1 100 -327.68 327.67 FORMAT "%8.4" /begin IF_DATA ASAP1B_KWP2000 KP_BLOB 0x380D36 EXTERN 0x2 /end IF_DATA /begin IF_DATA ETK KP_BLOB 0x380D36 EXTERN 0x2 /end IF_DATA /end MEASUREMENT
/begin MEASUREMENT swOffDlBits "" UWORD dez 1 100 0 65535 FORMAT "%8.2" /begin IF_DATA ASAP1B_KWP2000 KP_BLOB 0x382B62 EXTERN 0x2 /end IF_DATA /begin IF_DATA ETK KP_BLOB 0x382B62 EXTERN 0x2 /end IF_DATA /end MEASUREMENT
/begin MEASUREMENT szlimit_w "Schliesszeitbegrenzung" UWORD txms_uw_q0p1 1 100 0 6553.5 FORMAT "%8.3" /begin IF_DATA ASAP1B_KWP2000 KP_BLOB 0x381582 EXTERN 0x2 /end IF_DATA /begin IF_DATA ETK KP_BLOB 0x381582 EXTERN 0x2 /end IF_DATA /end MEASUREMENT
/begin MEASUREMENT szoutu_w "Schliesszeit unbegrenzt" UWORD txms_uw_q0p1 1 100 0 6553.5 FORMAT "%8.3" /begin IF_DATA ASAP1B_KWP2000 KP_BLOB 0x381584 EXTERN 0x2 /end IF_DATA /begin IF_DATA ETK KP_BLOB 0x381584 EXTERN 0x2 /end IF_DATA /end MEASUREMENT
/begin MEASUREMENT szout_w "Schließzeitausgabe" UWORD txms_uw_q0p1 1 100 0 6553.5 FORMAT "%8.3" /begin IF_DATA ASAP1B_KWP2000 KP_BLOB 0x381586 EXTERN 0x2 /end IF_DATA /begin IF_DATA ETK KP_BLOB 0x381586 EXTERN 0x2 /end IF_DATA /end MEASUREMENT
/begin MEASUREMENT sztcalc_w "Schliesszeit in Timer 1 Inkrementen" UWORD DEZL 1 100 0 65535 FORMAT "%8.2" /begin IF_DATA ASAP1B_KWP2000 KP_BLOB 0x381588 EXTERN 0x2 /end IF_DATA /begin IF_DATA ETK KP_BLOB 0x381588 EXTERN 0x2 /end IF_DATA /end MEASUREMENT
/begin MEASUREMENT tabgm2ma "maximal aufgetretene Abgastemperatur aus Modell, Bank 2" UBYTE temp_ub_q5_o50 1 100 -50 1225 FORMAT "%5.0" /begin IF_DATA ASAP1B_KWP2000 KP_BLOB 0x382937 EXTERN 0x1 /end IF_DATA /begin IF_DATA ETK KP_BLOB 0x382937 EXTERN 0x1 /end IF_DATA /end MEASUREMENT
/begin MEASUREMENT tabgm2mi "minimal aufgetretene Abgastemperatur aus Modell, Bank 2" UBYTE temp_ub_q5_o50 1 100 -50 1225 FORMAT "%5.0" /begin IF_DATA ASAP1B_KWP2000 KP_BLOB 0x382938 EXTERN 0x1 /end IF_DATA /begin IF_DATA ETK KP_BLOB 0x382938 EXTERN 0x1 /end IF_DATA /end MEASUREMENT
/begin MEASUREMENT tabgmma "maximal aufgetretene Abgastemperatur aus Modell" UBYTE temp_ub_q5_o50 1 100 -50 1225 FORMAT "%5.0" /begin IF_DATA ASAP1B_KWP2000 KP_BLOB 0x382939 EXTERN 0x1 /end IF_DATA /begin IF_DATA ETK KP_BLOB 0x382939 EXTERN 0x1 /end IF_DATA /end MEASUREMENT
/begin MEASUREMENT tabgmmi "minimal aufgetretene Abgastemperatur aus Modell" UBYTE temp_ub_q5_o50 1 100 -50 1225 FORMAT "%5.0" /begin IF_DATA ASAP1B_KWP2000 KP_BLOB 0x38293A EXTERN 0x1 /end IF_DATA /begin IF_DATA ETK KP_BLOB 0x38293A EXTERN 0x1 /end IF_DATA /end MEASUREMENT
/begin MEASUREMENT tansma "maximal aufgetretene Ansauglufttemperatur" UBYTE temp_ub_q0p75_o48 1 100 -48 143.25 FORMAT "%5.1" /begin IF_DATA ASAP1B_KWP2000 KP_BLOB 0x38293B EXTERN 0x1 /end IF_DATA /begin IF_DATA ETK KP_BLOB 0x38293B EXTERN 0x1 /end IF_DATA /end MEASUREMENT
/begin MEASUREMENT tansmi "minimal aufgetretene Ansauglauftemperatur" UBYTE temp_ub_q0p75_o48 1 100 -48 143.25 FORMAT "%5.1" /begin IF_DATA ASAP1B_KWP2000 KP_BLOB 0x38293C EXTERN 0x1 /end IF_DATA /begin IF_DATA ETK KP_BLOB 0x38293C EXTERN 0x1 /end IF_DATA /end MEASUREMENT
/begin MEASUREMENT tansst "Ansaugluft-Temperatur bei Start" UBYTE temp_ub_q0p75_o48 1 100 -48 143.25 FORMAT "%5.1" /begin IF_DATA ASAP1B_KWP2000 KP_BLOB 0x380454 EXTERN 0x1 /end IF_DATA /begin IF_DATA ETK KP_BLOB 0x380454 EXTERN 0x1 /end IF_DATA /end MEASUREMENT
/begin MEASUREMENT tclomemday "Echtzeit aus Memory, Tag" UWORD default 1 100 0 65535 FORMAT "%8.2" /begin IF_DATA ASAP1B_KWP2000 KP_BLOB 0x380D38 EXTERN 0x2 /end IF_DATA /begin IF_DATA ETK KP_BLOB 0x380D38 EXTERN 0x2 /end IF_DATA /end MEASUREMENT
/begin MEASUREMENT tclomemhr "Echtzeit aus Memory, Stunde" UWORD default 1 100 0 65535 FORMAT "%8.2" /begin IF_DATA ASAP1B_KWP2000 KP_BLOB 0x380D3A EXTERN 0x2 /end IF_DATA /begin IF_DATA ETK KP_BLOB 0x380D3A EXTERN 0x2 /end IF_DATA /end MEASUREMENT
/begin MEASUREMENT tclomemmin "Echtzeit aus Memory, Minute" UWORD default 1 100 0 65535 FORMAT "%8.2" /begin IF_DATA ASAP1B_KWP2000 KP_BLOB 0x380D3C EXTERN 0x2 /end IF_DATA /begin IF_DATA ETK KP_BLOB 0x380D3C EXTERN 0x2 /end IF_DATA /end MEASUREMENT
/begin MEASUREMENT tclomemmon "Echtzeit aus Memory, Monat" UWORD default 1 100 0 65535 FORMAT "%8.2" /begin IF_DATA ASAP1B_KWP2000 KP_BLOB 0x380D3E EXTERN 0x2 /end IF_DATA /begin IF_DATA ETK KP_BLOB 0x380D3E EXTERN 0x2 /end IF_DATA /end MEASUREMENT
/begin MEASUREMENT tclomemsec "Echtzeit aus Memory, Sekunde" UWORD default 1 100 0 65535 FORMAT "%8.2" /begin IF_DATA ASAP1B_KWP2000 KP_BLOB 0x380D40 EXTERN 0x2 /end IF_DATA /begin IF_DATA ETK KP_BLOB 0x380D40 EXTERN 0x2 /end IF_DATA /end MEASUREMENT
/begin MEASUREMENT tclomemyr "Echtzeit aus Memory, Jahr" UWORD default 1 100 0 65535 FORMAT "%8.2" /begin IF_DATA ASAP1B_KWP2000 KP_BLOB 0x380D42 EXTERN 0x2 /end IF_DATA /begin IF_DATA ETK KP_BLOB 0x380D42 EXTERN 0x2 /end IF_DATA /end MEASUREMENT
/begin MEASUREMENT tCorrCtr "" UBYTE dez 1 100 0 255 FORMAT "%5.1" /begin IF_DATA ASAP1B_KWP2000 KP_BLOB 0x380302 EXTERN 0x1 /end IF_DATA /begin IF_DATA ETK KP_BLOB 0x380302 EXTERN 0x1 /end IF_DATA /end MEASUREMENT
/begin MEASUREMENT te2_w "effektive Einspritzzeit Bank2 (word)" UWORD tinjection_sy 1 100 0 209.712 FORMAT "%8.4" /begin IF_DATA ASAP1B_KWP2000 KP_BLOB 0x380C72 EXTERN 0x2 /end IF_DATA /begin IF_DATA ETK KP_BLOB 0x380C72 EXTERN 0x2 /end IF_DATA /end MEASUREMENT
/begin MEASUREMENT tema_w "maximal aufgetretene effektive Einspritzzeit" UWORD tinjection_sy 1 100 0 209.712 FORMAT "%8.4" /begin IF_DATA ASAP1B_KWP2000 KP_BLOB 0x382B34 EXTERN 0x2 /end IF_DATA /begin IF_DATA ETK KP_BLOB 0x382B34 EXTERN 0x2 /end IF_DATA /end MEASUREMENT
/begin MEASUREMENT temi_w "minimal aufgetretene effektive Einspritzzeit" UWORD tinjection_sy 1 100 0 209.712 FORMAT "%8.4" /begin IF_DATA ASAP1B_KWP2000 KP_BLOB 0x382B36 EXTERN 0x2 /end IF_DATA /begin IF_DATA ETK KP_BLOB 0x382B36 EXTERN 0x2 /end IF_DATA /end MEASUREMENT
/begin MEASUREMENT tevfa2_w "effektive Einspritzzeit vor Feinabgleich (word)" UWORD tinjection_sy 1 100 0 209.712 FORMAT "%8.4" /begin IF_DATA ASAP1B_KWP2000 KP_BLOB 0x380C74 EXTERN 0x2 /end IF_DATA /begin IF_DATA ETK KP_BLOB 0x380C74 EXTERN 0x2 /end IF_DATA /end MEASUREMENT
/begin MEASUREMENT tevfa_w "effektive Einspritzzeit vor Feinabgleich (word)" UWORD tinjection_sy 1 100 0 209.712 FORMAT "%8.4" /begin IF_DATA ASAP1B_KWP2000 KP_BLOB 0x380C76 EXTERN 0x2 /end IF_DATA /begin IF_DATA ETK KP_BLOB 0x380C76 EXTERN 0x2 /end IF_DATA /end MEASUREMENT
/begin MEASUREMENT tevfa_w_kge "" UWORD tinjection_sy 1 100 0 209.712 FORMAT "%8.4" /begin IF_DATA ASAP1B_KWP2000 KP_BLOB 0x380C78 EXTERN 0x2 /end IF_DATA /begin IF_DATA ETK KP_BLOB 0x380C78 EXTERN 0x2 /end IF_DATA /end MEASUREMENT
/begin MEASUREMENT te_w "effektive Einspritzzeit (word)" UWORD tinjection_sy 1 100 0 209.712 FORMAT "%8.4" /begin IF_DATA ASAP1B_KWP2000 KP_BLOB 0x380C7A EXTERN 0x2 /end IF_DATA /begin IF_DATA ETK KP_BLOB 0x380C7A EXTERN 0x2 /end IF_DATA /end MEASUREMENT
/begin MEASUREMENT ti2_w "Einspritzzeit für Zylinder 2 (word)" UWORD tinjection5_sy 1 100 0 1048.56 FORMAT "%8.3" /begin IF_DATA ASAP1B_KWP2000 KP_BLOB 0x380C7C EXTERN 0x2 /end IF_DATA /begin IF_DATA ETK KP_BLOB 0x380C7C EXTERN 0x2 /end IF_DATA /end MEASUREMENT
/begin MEASUREMENT ti_b1 "Einspritzzeit für EV's auf Bank1" UWORD tinjection_sy 1 100 0 209.712 FORMAT "%8.4" /begin IF_DATA ASAP1B_KWP2000 KP_BLOB 0x380C7E EXTERN 0x2 /end IF_DATA /begin IF_DATA ETK KP_BLOB 0x380C7E EXTERN 0x2 /end IF_DATA /end MEASUREMENT
/begin MEASUREMENT ti_b2 "Einspritzzeit für EV's auf Bank2" UWORD tinjection_sy 1 100 0 209.712 FORMAT "%8.4" /begin IF_DATA ASAP1B_KWP2000 KP_BLOB 0x380C80 EXTERN 0x2 /end IF_DATA /begin IF_DATA ETK KP_BLOB 0x380C80 EXTERN 0x2 /end IF_DATA /end MEASUREMENT
/begin MEASUREMENT ti_tvu_w "Batteriespannungsabhängige Einspritzzeitkorrektur CPU-Quantisierung" UWORD tinjection_sy 1 100 0 209.712 FORMAT "%8.4" /begin IF_DATA ASAP1B_KWP2000 KP_BLOB 0xF87A INTERN 0x2 /end IF_DATA /begin IF_DATA ETK KP_BLOB 0xF87A INTERN 0x2 /end IF_DATA /end MEASUREMENT
/begin MEASUREMENT ti_w "Einspritzzeit" UWORD tinjection5_sy 1 100 0 1048.56 FORMAT "%8.3" /begin IF_DATA ASAP1B_KWP2000 KP_BLOB 0x380C82 EXTERN 0x2 /end IF_DATA /begin IF_DATA ETK KP_BLOB 0x380C82 EXTERN 0x2 /end IF_DATA /end MEASUREMENT
/begin MEASUREMENT tlrs_w "Totzeit der Lambdaregelstrecke" UWORD tz10msxs_uw_b327p68 1 100 0.00500008 327.68 FORMAT "%8.4" /begin IF_DATA ASAP1B_KWP2000 KP_BLOB 0x381400 EXTERN 0x2 /end IF_DATA /begin IF_DATA ETK KP_BLOB 0x381400 EXTERN 0x2 /end IF_DATA /end MEASUREMENT
/begin MEASUREMENT tmotma "maximal aufgetretene Motortemperatur" UBYTE temp_ub_q0p75_o48 1 100 -48 143.25 FORMAT "%5.1" /begin IF_DATA ASAP1B_KWP2000 KP_BLOB 0x38293D EXTERN 0x1 /end IF_DATA /begin IF_DATA ETK KP_BLOB 0x38293D EXTERN 0x1 /end IF_DATA /end MEASUREMENT
/begin MEASUREMENT tmotmi "minimal aufgetretene Motortemperatur" UBYTE temp_ub_q0p75_o48 1 100 -48 143.25 FORMAT "%5.1" /begin IF_DATA ASAP1B_KWP2000 KP_BLOB 0x38293E EXTERN 0x1 /end IF_DATA /begin IF_DATA ETK KP_BLOB 0x38293E EXTERN 0x1 /end IF_DATA /end MEASUREMENT
/begin MEASUREMENT tn2 "Segmentzeit pro Zündung" UWORD tsync_q3p2us 1 100 0 0.209712 FORMAT "%8.6" /begin IF_DATA ASAP1B_KWP2000 KP_BLOB 0xF7AC INTERN 0x2 /end IF_DATA /begin IF_DATA ETK KP_BLOB 0xF7AC INTERN 0x2 /end IF_DATA /end MEASUREMENT
/begin MEASUREMENT tnachl_w "SG-Nachlaufzeit" UWORD t100msxs_uw_b6553p6 1 100 0 6553.5 FORMAT "%8.3" /begin IF_DATA ASAP1B_KWP2000 KP_BLOB 0x382B64 EXTERN 0x2 /end IF_DATA /begin IF_DATA ETK KP_BLOB 0x382B64 EXTERN 0x2 /end IF_DATA /end MEASUREMENT
/begin MEASUREMENT toelma "maximal aufgetretene Öltemperatur" UBYTE temp_ub_q1_o40 1 100 -40 215 FORMAT "%5.1" /begin IF_DATA ASAP1B_KWP2000 KP_BLOB 0x38293F EXTERN 0x1 /end IF_DATA /begin IF_DATA ETK KP_BLOB 0x38293F EXTERN 0x1 /end IF_DATA /end MEASUREMENT
/begin MEASUREMENT toelmi "minimal aufgetretene Öltemperatur" UBYTE temp_ub_q1_o40 1 100 -40 215 FORMAT "%5.1" /begin IF_DATA ASAP1B_KWP2000 KP_BLOB 0x382940 EXTERN 0x1 /end IF_DATA /begin IF_DATA ETK KP_BLOB 0x382940 EXTERN 0x1 /end IF_DATA /end MEASUREMENT
/begin MEASUREMENT tPer10ms "" UBYTE t10msxs_sb_q0p01 1 100 0 2.55 FORMAT "%5.3" ARRAY_SIZE 32 /begin IF_DATA ASAP1B_KWP2000 KP_BLOB 0x380303 EXTERN 0x1 /end IF_DATA /begin IF_DATA ETK KP_BLOB 0x380303 EXTERN 0x1 /end IF_DATA /end MEASUREMENT
/begin MEASUREMENT tPerPtr "" UWORD dez 1 100 0 65535 FORMAT "%8.2" /begin IF_DATA ASAP1B_KWP2000 KP_BLOB 0x38052E EXTERN 0x2 /end IF_DATA /begin IF_DATA ETK KP_BLOB 0x38052E EXTERN 0x2 /end IF_DATA /end MEASUREMENT
/begin MEASUREMENT trevovCtr "" UWORD dez 1 100 0 65535 FORMAT "%8.2" /begin IF_DATA ASAP1B_KWP2000 KP_BLOB 0xF790 INTERN 0x2 /end IF_DATA /begin IF_DATA ETK KP_BLOB 0xF790 INTERN 0x2 /end IF_DATA /end MEASUREMENT
/begin MEASUREMENT tr_zeit_msb "" UBYTE dez 1 100 0 255 FORMAT "%5.1" /begin IF_DATA ASAP1B_KWP2000 KP_BLOB 0xF7AA INTERN 0x1 /end IF_DATA /begin IF_DATA ETK KP_BLOB 0xF7AA INTERN 0x1 /end IF_DATA /end MEASUREMENT
/begin MEASUREMENT tr_zeit_msb_alt "" UBYTE dez 1 100 0 255 FORMAT "%5.1" /begin IF_DATA ASAP1B_KWP2000 KP_BLOB 0x380323 EXTERN 0x1 /end IF_DATA /begin IF_DATA ETK KP_BLOB 0x380323 EXTERN 0x1 /end IF_DATA /end MEASUREMENT
/begin MEASUREMENT tseghi "Winkel-Segmentzeit, high, low byte des high word" UBYTE dez 1 100 0 255 FORMAT "%5.1" /begin IF_DATA ASAP1B_KWP2000 KP_BLOB 0x380324 EXTERN 0x1 /end IF_DATA /begin IF_DATA ETK KP_BLOB 0x380324 EXTERN 0x1 /end IF_DATA /end MEASUREMENT
/begin MEASUREMENT tseg_w "Winkel-Segmentzeit" UWORD tsquant 1 100 0 52428 FORMAT "%8.2" /begin IF_DATA ASAP1B_KWP2000 KP_BLOB 0x380530 EXTERN 0x2 /end IF_DATA /begin IF_DATA ETK KP_BLOB 0x380530 EXTERN 0x2 /end IF_DATA /end MEASUREMENT
/begin MEASUREMENT tToothAt10ms "" UWORD dez 1 100 0 65535 FORMAT "%8.2" /begin IF_DATA ASAP1B_KWP2000 KP_BLOB 0x380532 EXTERN 0x2 /end IF_DATA /begin IF_DATA ETK KP_BLOB 0x380532 EXTERN 0x2 /end IF_DATA /end MEASUREMENT
/begin MEASUREMENT tvblsu2_w "Switch-on Verzögerung von B_LRS2 durch B_sbbvk2 bei lambda <>1" UWORD t10msxs_uw_b655p35 1 100 0 655.35 FORMAT "%8.4" /begin IF_DATA ASAP1B_KWP2000 KP_BLOB 0x381490 EXTERN 0x2 /end IF_DATA /begin IF_DATA ETK KP_BLOB 0x381490 EXTERN 0x2 /end IF_DATA /end MEASUREMENT
/begin MEASUREMENT tvblsu_w "Switch-on Verzögerung von B_LRS durch B_SBBVK bei lambda<>1" UWORD t10msxs_uw_b655p35 1 100 0 655.35 FORMAT "%8.4" /begin IF_DATA ASAP1B_KWP2000 KP_BLOB 0x381492 EXTERN 0x2 /end IF_DATA /begin IF_DATA ETK KP_BLOB 0x381492 EXTERN 0x2 /end IF_DATA /end MEASUREMENT
/begin MEASUREMENT uaccbw_w "Spannung Längsbeschleunigungssensor bei Kippen nach hinten" UWORD spg_uw_mV 1 100 0 5004.81 FORMAT "%8.3" /begin IF_DATA ASAP1B_KWP2000 KP_BLOB 0x380D44 EXTERN 0x2 /end IF_DATA /begin IF_DATA ETK KP_BLOB 0x380D44 EXTERN 0x2 /end IF_DATA /end MEASUREMENT
/begin MEASUREMENT uaccfw_w "Spannung Längsbeschleunigungssensor bei Kippen nach vorn" UWORD spg_uw_mV 1 100 0 5004.81 FORMAT "%8.3" /begin IF_DATA ASAP1B_KWP2000 KP_BLOB 0x380D46 EXTERN 0x2 /end IF_DATA /begin IF_DATA ETK KP_BLOB 0x380D46 EXTERN 0x2 /end IF_DATA /end MEASUREMENT
/begin MEASUREMENT uaccle_w "Spannung Querbeschleunigungssensor bei Kippen nach links" UWORD spg_uw_mV 1 100 0 5004.81 FORMAT "%8.3" /begin IF_DATA ASAP1B_KWP2000 KP_BLOB 0x380D48 EXTERN 0x2 /end IF_DATA /begin IF_DATA ETK KP_BLOB 0x380D48 EXTERN 0x2 /end IF_DATA /end MEASUREMENT
/begin MEASUREMENT uaccri_w "Spannung Querbeschleunigungssensor bei Kippen nach rechts" UWORD spg_uw_mV 1 100 0 5004.81 FORMAT "%8.3" /begin IF_DATA ASAP1B_KWP2000 KP_BLOB 0x380D4A EXTERN 0x2 /end IF_DATA /begin IF_DATA ETK KP_BLOB 0x380D4A EXTERN 0x2 /end IF_DATA /end MEASUREMENT
/begin MEASUREMENT ubma "maximal aufgetretene Batteriespannung" UBYTE spg_ubatt 1 100 0 17.3655 FORMAT "%5.2" /begin IF_DATA ASAP1B_KWP2000 KP_BLOB 0x382941 EXTERN 0x1 /end IF_DATA /begin IF_DATA ETK KP_BLOB 0x382941 EXTERN 0x1 /end IF_DATA /end MEASUREMENT
/begin MEASUREMENT ubmi "minimal aufgetretene Batteriespannung" UBYTE spg_ubatt 1 100 0 17.3655 FORMAT "%5.2" /begin IF_DATA ASAP1B_KWP2000 KP_BLOB 0x382942 EXTERN 0x1 /end IF_DATA /begin IF_DATA ETK KP_BLOB 0x382942 EXTERN 0x1 /end IF_DATA /end MEASUREMENT
/begin MEASUREMENT uma2_res "Antwortbeitrag des Befehlstests" SWORD dez 1 100 -32768 32767 FORMAT "%8.2" /begin IF_DATA ASAP1B_KWP2000 KP_BLOB 0x381552 EXTERN 0x2 /end IF_DATA /begin IF_DATA ETK KP_BLOB 0x381552 EXTERN 0x2 /end IF_DATA /end MEASUREMENT
/begin MEASUREMENT umErrorCtrFr "" UBYTE dez 1 100 0 255 FORMAT "%5.1" /begin IF_DATA ASAP1B_KWP2000 KP_BLOB 0x380467 EXTERN 0x1 /end IF_DATA /begin IF_DATA ETK KP_BLOB 0x380467 EXTERN 0x1 /end IF_DATA /end MEASUREMENT
/begin MEASUREMENT usteerl_w "Spannung Lenkwinkelsensor, Linksanschlag" UWORD spg_uw_mV 1 100 0 5004.81 FORMAT "%8.3" /begin IF_DATA ASAP1B_KWP2000 KP_BLOB 0x380D4C EXTERN 0x2 /end IF_DATA /begin IF_DATA ETK KP_BLOB 0x380D4C EXTERN 0x2 /end IF_DATA /end MEASUREMENT
/begin MEASUREMENT usteerr_w "Spannung Lenkwinkelsensor, Rechtsanschlag" UWORD spg_uw_mV 1 100 0 5004.81 FORMAT "%8.3" /begin IF_DATA ASAP1B_KWP2000 KP_BLOB 0x380D4E EXTERN 0x2 /end IF_DATA /begin IF_DATA ETK KP_BLOB 0x380D4E EXTERN 0x2 /end IF_DATA /end MEASUREMENT
/begin MEASUREMENT ususinfl_w "Spannung Federwegsensor eingefedert, vorne links" UWORD spg_uw_mV 1 100 0 5004.81 FORMAT "%8.3" /begin IF_DATA ASAP1B_KWP2000 KP_BLOB 0x380D50 EXTERN 0x2 /end IF_DATA /begin IF_DATA ETK KP_BLOB 0x380D50 EXTERN 0x2 /end IF_DATA /end MEASUREMENT
/begin MEASUREMENT ususinfr_w "Spannung Federwegsensor eingefedert, vorne rechts" UWORD spg_uw_mV 1 100 0 5004.81 FORMAT "%8.3" /begin IF_DATA ASAP1B_KWP2000 KP_BLOB 0x380D52 EXTERN 0x2 /end IF_DATA /begin IF_DATA ETK KP_BLOB 0x380D52 EXTERN 0x2 /end IF_DATA /end MEASUREMENT
/begin MEASUREMENT ususinrl_w "Spannung Federwegsensor eingefedert, hinten links" UWORD spg_uw_mV 1 100 0 5004.81 FORMAT "%8.3" /begin IF_DATA ASAP1B_KWP2000 KP_BLOB 0x380D54 EXTERN 0x2 /end IF_DATA /begin IF_DATA ETK KP_BLOB 0x380D54 EXTERN 0x2 /end IF_DATA /end MEASUREMENT
/begin MEASUREMENT ususinrr_w "Spannung Federwegsensor eingefedert, hinten rechts" UWORD spg_uw_mV 1 100 0 5004.81 FORMAT "%8.3" /begin IF_DATA ASAP1B_KWP2000 KP_BLOB 0x380D56 EXTERN 0x2 /end IF_DATA /begin IF_DATA ETK KP_BLOB 0x380D56 EXTERN 0x2 /end IF_DATA /end MEASUREMENT
/begin MEASUREMENT ususoufl_w "Spannung Federwegsensor ausgefedert, vorne links" UWORD spg_uw_mV 1 100 0 5004.81 FORMAT "%8.3" /begin IF_DATA ASAP1B_KWP2000 KP_BLOB 0x380D58 EXTERN 0x2 /end IF_DATA /begin IF_DATA ETK KP_BLOB 0x380D58 EXTERN 0x2 /end IF_DATA /end MEASUREMENT
/begin MEASUREMENT ususoufr_w "Spannung Federwegsensor ausgefedert, vorne rechts" UWORD spg_uw_mV 1 100 0 5004.81 FORMAT "%8.3" /begin IF_DATA ASAP1B_KWP2000 KP_BLOB 0x380D5A EXTERN 0x2 /end IF_DATA /begin IF_DATA ETK KP_BLOB 0x380D5A EXTERN 0x2 /end IF_DATA /end MEASUREMENT
/begin MEASUREMENT ususourl_w "Spannung Federwegsensor ausgefedert, hinten links" UWORD spg_uw_mV 1 100 0 5004.81 FORMAT "%8.3" /begin IF_DATA ASAP1B_KWP2000 KP_BLOB 0x380D5C EXTERN 0x2 /end IF_DATA /begin IF_DATA ETK KP_BLOB 0x380D5C EXTERN 0x2 /end IF_DATA /end MEASUREMENT
/begin MEASUREMENT ususourr_w "Spannung Federwegsensor ausgefedert, hinten rechts" UWORD spg_uw_mV 1 100 0 5004.81 FORMAT "%8.3" /begin IF_DATA ASAP1B_KWP2000 KP_BLOB 0x380D5E EXTERN 0x2 /end IF_DATA /begin IF_DATA ETK KP_BLOB 0x380D5E EXTERN 0x2 /end IF_DATA /end MEASUREMENT
/begin MEASUREMENT uzkw_w "Kurbelwellen-Umdrehungszähler" UWORD dez 1 100 0 65535 FORMAT "%8.2" /begin IF_DATA ASAP1B_KWP2000 KP_BLOB 0x380534 EXTERN 0x2 /end IF_DATA /begin IF_DATA ETK KP_BLOB 0x380534 EXTERN 0x2 /end IF_DATA /end MEASUREMENT
/begin MEASUREMENT vfzgpr_w "Prädizierte Fahrzeuggeschwindigkeit für VMAX-Regelung" UWORD vfzg_uw_q0p00781 1 100 0 511.992 FORMAT "%8.4" /begin IF_DATA ASAP1B_KWP2000 KP_BLOB 0x381322 EXTERN 0x2 /end IF_DATA /begin IF_DATA ETK KP_BLOB 0x381322 EXTERN 0x2 /end IF_DATA /end MEASUREMENT
/begin MEASUREMENT vsdmr "Vorgabe Drehmomentreserve über Verstellsystem VSxy" UBYTE rel_ub_q0p3906 1 100 0 99.6094 FORMAT "%5.2" /begin IF_DATA ASAP1B_KWP2000 KP_BLOB 0x380330 EXTERN 0x1 /end IF_DATA /begin IF_DATA ETK KP_BLOB 0x380330 EXTERN 0x1 /end IF_DATA /end MEASUREMENT
/begin MEASUREMENT vsldtv "Verstellgröße LDR-Tastverhältnis vom VSx-System zur Applikation" UBYTE tv_ub_b100 1 100 0 99.6094 FORMAT "%5.2" /begin IF_DATA ASAP1B_KWP2000 KP_BLOB 0x380331 EXTERN 0x1 /end IF_DATA /begin IF_DATA ETK KP_BLOB 0x380331 EXTERN 0x1 /end IF_DATA /end MEASUREMENT
/begin MEASUREMENT vsns "Änderung der Solldrehzahl über Verstellsystem VSxy" UBYTE nmot_ub_q10 1 100 0 2550 FORMAT "%5.0" /begin IF_DATA ASAP1B_KWP2000 KP_BLOB 0x380332 EXTERN 0x1 /end IF_DATA /begin IF_DATA ETK KP_BLOB 0x380332 EXTERN 0x1 /end IF_DATA /end MEASUREMENT
/begin MEASUREMENT vsrlmx "Additive Füllungskorrektur für rlmx vom Verstellsystem" SBYTE rel_sb_q0p75 1 100 -96 95.25 FORMAT "%5.2" /begin IF_DATA ASAP1B_KWP2000 KP_BLOB 0x380333 EXTERN 0x1 /end IF_DATA /begin IF_DATA ETK KP_BLOB 0x380333 EXTERN 0x1 /end IF_DATA /end MEASUREMENT
/begin MEASUREMENT vsvw "Änderung Einspritzvorlagerungswinkel über Verstellsystem" SBYTE zw_sb_q6 1 100 -768 762 FORMAT "%5.1" /begin IF_DATA ASAP1B_KWP2000 KP_BLOB 0x380334 EXTERN 0x1 /end IF_DATA /begin IF_DATA ETK KP_BLOB 0x380334 EXTERN 0x1 /end IF_DATA /end MEASUREMENT
/begin MEASUREMENT vswnws "Änderung der Winkel Nockenwelle (variable NWS) über Verstellsystem VSxy" UBYTE wkw_ub_q0p25 1 100 0 63.75 FORMAT "%5.2" /begin IF_DATA ASAP1B_KWP2000 KP_BLOB 0x380335 EXTERN 0x1 /end IF_DATA /begin IF_DATA ETK KP_BLOB 0x380335 EXTERN 0x1 /end IF_DATA /end MEASUREMENT
/begin MEASUREMENT wdkbama "maximal aufgetretener Drosselklappenwinkel, bezogen auf Anschlag" UBYTE relDK_ub_b100 1 100 0 100 FORMAT "%5.1" /begin IF_DATA ASAP1B_KWP2000 KP_BLOB 0x382943 EXTERN 0x1 /end IF_DATA /begin IF_DATA ETK KP_BLOB 0x382943 EXTERN 0x1 /end IF_DATA /end MEASUREMENT
/begin MEASUREMENT wdkbami "minimal aufgetretener Drosselklappenwinkel, bezogen auf Anschlag" UBYTE relDK_ub_b100 1 100 0 100 FORMAT "%5.1" /begin IF_DATA ASAP1B_KWP2000 KP_BLOB 0x382944 EXTERN 0x1 /end IF_DATA /begin IF_DATA ETK KP_BLOB 0x382944 EXTERN 0x1 /end IF_DATA /end MEASUREMENT
/begin MEASUREMENT wphg "Zündwinkel DG-Phasenkorrektur" SBYTE zw_sb_q0p75 1 100 -96 95.25 FORMAT "%5.2" /begin IF_DATA ASAP1B_KWP2000 KP_BLOB 0x38046C EXTERN 0x1 /end IF_DATA /begin IF_DATA ETK KP_BLOB 0x38046C EXTERN 0x1 /end IF_DATA /end MEASUREMENT
/begin MEASUREMENT xgang "eingelegter Gang" UBYTE dez 1 100 0 255 FORMAT "%5.1" /begin IF_DATA ASAP1B_KWP2000 KP_BLOB 0x38042F EXTERN 0x1 /end IF_DATA /begin IF_DATA ETK KP_BLOB 0x38042F EXTERN 0x1 /end IF_DATA /end MEASUREMENT
/begin MEASUREMENT zmdfa "Zeitkonstante für die Filterung des Fahrermomentes" UBYTE zk10msxs_ub_b2p55 1 100 0.01 2.55 FORMAT "%5.3" /begin IF_DATA ASAP1B_KWP2000 KP_BLOB 0x380430 EXTERN 0x1 /end IF_DATA /begin IF_DATA ETK KP_BLOB 0x380430 EXTERN 0x1 /end IF_DATA /end MEASUREMENT
/begin MEASUREMENT zmdfag "Zeitkonstante gangabhängig für Filterung Fahrermoment" UBYTE zk10msxs_ub_b2p55 1 100 0.01 2.55 FORMAT "%5.3" /begin IF_DATA ASAP1B_KWP2000 KP_BLOB 0x380431 EXTERN 0x1 /end IF_DATA /begin IF_DATA ETK KP_BLOB 0x380431 EXTERN 0x1 /end IF_DATA /end MEASUREMENT
/begin MEASUREMENT zmdfasg "Zeitkonstante gangabhängig für Filterung Fahrermoment nach SA" UBYTE zk10msxs_ub_b2p55 1 100 0.01 2.55 FORMAT "%5.3" /begin IF_DATA ASAP1B_KWP2000 KP_BLOB 0x380432 EXTERN 0x1 /end IF_DATA /begin IF_DATA ETK KP_BLOB 0x380432 EXTERN 0x1 /end IF_DATA /end MEASUREMENT
/begin MEASUREMENT zmdfaug "untere Zeitkonstante gangabhängig für Filterung Fahrermoment" UBYTE zk10msxs_ub_b2p55 1 100 0.01 2.55 FORMAT "%5.3" /begin IF_DATA ASAP1B_KWP2000 KP_BLOB 0x380433 EXTERN 0x1 /end IF_DATA /begin IF_DATA ETK KP_BLOB 0x380433 EXTERN 0x1 /end IF_DATA /end MEASUREMENT
/begin MEASUREMENT zwbas "Basiszündwinkel" SBYTE zw_sb_q0p75 1 100 -96 95.25 FORMAT "%5.2" /begin IF_DATA ASAP1B_KWP2000 KP_BLOB 0xF930 INTERN 0x1 /end IF_DATA /begin IF_DATA ETK KP_BLOB 0xF930 INTERN 0x1 /end IF_DATA /end MEASUREMENT
/begin MEASUREMENT zwbasar "Basiszündwinkelarray" SBYTE zw_sb_q0p75 1 100 -96 95.25 FORMAT "%5.2" ARRAY_SIZE 4 /begin IF_DATA ASAP1B_KWP2000 KP_BLOB 0x38046D EXTERN 0x1 /end IF_DATA /begin IF_DATA ETK KP_BLOB 0x38046D EXTERN 0x1 /end IF_DATA /end MEASUREMENT
/begin MEASUREMENT zwgru "Grundzündwinkel" SBYTE zw_sb_q0p75 1 100 -96 95.25 FORMAT "%5.2" /begin IF_DATA ASAP1B_KWP2000 KP_BLOB 0x380479 EXTERN 0x1 /end IF_DATA /begin IF_DATA ETK KP_BLOB 0x380479 EXTERN 0x1 /end IF_DATA /end MEASUREMENT
/begin MEASUREMENT zwgruu "Grundzündwinkel unbegrenzt" SBYTE zw_sb_q0p75 1 100 -96 95.25 FORMAT "%5.2" /begin IF_DATA ASAP1B_KWP2000 KP_BLOB 0x38047A EXTERN 0x1 /end IF_DATA /begin IF_DATA ETK KP_BLOB 0x38047A EXTERN 0x1 /end IF_DATA /end MEASUREMENT
/begin MEASUREMENT zwist "Ist-Zündwinkel" SBYTE zw_sb_q0p75 1 100 -96 95.25 FORMAT "%5.2" /begin IF_DATA ASAP1B_KWP2000 KP_BLOB 0xF931 INTERN 0x1 /end IF_DATA /begin IF_DATA ETK KP_BLOB 0xF931 INTERN 0x1 /end IF_DATA /end MEASUREMENT
/begin MEASUREMENT zwkrafld "Bitmuster des zyl.ind. abgelegten B_zwkra" UBYTE dez 1 100 0 255 FORMAT "%5.1" /begin IF_DATA ASAP1B_KWP2000 KP_BLOB 0xF932 INTERN 0x1 /end IF_DATA /begin IF_DATA ETK KP_BLOB 0xF932 INTERN 0x1 /end IF_DATA /end MEASUREMENT
/begin MEASUREMENT zwnws "Grundzündwinkel mit Berücksichtigung von Nockenwellensteuerung" SBYTE zw_sb_q0p75 1 100 -96 95.25 FORMAT "%5.2" /begin IF_DATA ASAP1B_KWP2000 KP_BLOB 0x38047B EXTERN 0x1 /end IF_DATA /begin IF_DATA ETK KP_BLOB 0x38047B EXTERN 0x1 /end IF_DATA /end MEASUREMENT
/begin MEASUREMENT zwopt "optimaler Zündwinkel" SBYTE zw_sb_q0p75 1 100 -96 95.25 FORMAT "%5.2" /begin IF_DATA ASAP1B_KWP2000 KP_BLOB 0x38042A EXTERN 0x1 /end IF_DATA /begin IF_DATA ETK KP_BLOB 0x38042A EXTERN 0x1 /end IF_DATA /end MEASUREMENT
/begin MEASUREMENT zwout "Zündwinkel-Ausgabe" SBYTE zw_sb_q0p75 1 100 -96 95.25 FORMAT "%5.2" /begin IF_DATA ASAP1B_KWP2000 KP_BLOB 0xF933 INTERN 0x1 /end IF_DATA /begin IF_DATA ETK KP_BLOB 0xF933 INTERN 0x1 /end IF_DATA /end MEASUREMENT
/begin MEASUREMENT zwoutar "Zündwinkel-Ausgabe Array" SBYTE zw_sb_q0p75 1 100 -96 95.25 FORMAT "%5.2" ARRAY_SIZE 4 /begin IF_DATA ASAP1B_KWP2000 KP_BLOB 0x380471 EXTERN 0x1 /end IF_DATA /begin IF_DATA ETK KP_BLOB 0x380471 EXTERN 0x1 /end IF_DATA /end MEASUREMENT
/begin MEASUREMENT zwsol "Soll-Zündwinkel aus Momenteneingriff" SBYTE zw_sb_q0p75 1 100 -96 95.25 FORMAT "%5.2" /begin IF_DATA ASAP1B_KWP2000 KP_BLOB 0x38046B EXTERN 0x1 /end IF_DATA /begin IF_DATA ETK KP_BLOB 0x38046B EXTERN 0x1 /end IF_DATA /end MEASUREMENT
/begin MEASUREMENT zwspae "Spätester Zündwinkel" SBYTE zw_sb_q0p75 1 100 -96 95.25 FORMAT "%5.2" /begin IF_DATA ASAP1B_KWP2000 KP_BLOB 0x38047D EXTERN 0x1 /end IF_DATA /begin IF_DATA ETK KP_BLOB 0x38047D EXTERN 0x1 /end IF_DATA /end MEASUREMENT
/begin MEASUREMENT zwstt "Zündwinkel im Start" SBYTE zw_sb_q0p75 1 100 -96 95.25 FORMAT "%5.2" /begin IF_DATA ASAP1B_KWP2000 KP_BLOB 0x38047E EXTERN 0x1 /end IF_DATA /begin IF_DATA ETK KP_BLOB 0x38047E EXTERN 0x1 /end IF_DATA /end MEASUREMENT
/begin MEASUREMENT zwzyl1 "Zündwinkel Zylinder 1" SBYTE zw_sb_q0p75 1 100 -96 95.25 FORMAT "%5.2" /begin IF_DATA ASAP1B_KWP2000 KP_BLOB 0x380475 EXTERN 0x1 /end IF_DATA /begin IF_DATA ETK KP_BLOB 0x380475 EXTERN 0x1 /end IF_DATA /end MEASUREMENT
/begin MEASUREMENT zzyl "SW-Zylinderzähler" UBYTE dez 1 100 0 255 FORMAT "%5.1" /begin IF_DATA ASAP1B_KWP2000 KP_BLOB 0x380325 EXTERN 0x1 /end IF_DATA /begin IF_DATA ETK KP_BLOB 0x380325 EXTERN 0x1 /end IF_DATA /end MEASUREMENT
/begin MEASUREMENT zzylzue "SW-Zylinderzähler für Zündungsberechnung" UBYTE dez 1 100 0 255 FORMAT "%5.1" /begin IF_DATA ASAP1B_KWP2000 KP_BLOB 0x380326 EXTERN 0x1 /end IF_DATA /begin IF_DATA ETK KP_BLOB 0x380326 EXTERN 0x1 /end IF_DATA /end MEASUREMENT
/begin FUNCTION LRAEB "Einschaltbedingungen Gemischadaption" /begin DEF_CHARACTERISTIC TARA TMRAA TVLRA WDKARN /end DEF_CHARACTERISTIC /begin REF_CHARACTERISTIC /end REF_CHARACTERISTIC /begin IN_MEASUREMENT B_lr B_lr2 B_ukg B_vl nmot tans tmot wdkba /end IN_MEASUREMENT /begin OUT_MEASUREMENT B_gasp B_lra B_lra2 /end OUT_MEASUREMENT /begin LOC_MEASUREMENT /end LOC_MEASUREMENT /begin SUB_FUNCTION /end SUB_FUNCTION /end FUNCTION
/begin FUNCTION LRS "Stetige Lambdaregelung"
 /begin DEF_CHARACTERISTIC CLRS FDFRMIN FRMAX FRMIN LALIUSMN Y2MAX Y2MIN KFLRSP KFLRSI KFLRST /end DEF_CHARACTERISTIC
 /begin REF_CHARACTERISTIC SRL08LSUW SNM07LSUW /end REF_CHARACTERISTIC
 /begin IN_MEASUREMENT B_lrms B_lrs B_lrs2 esst_snm07lsuw esst_srl08lsuw lamsoni2_w lamsoni_w lamsons2_w lamsons_w ml_w nmot_w rl_w /end IN_MEASUREMENT
 /begin OUT_MEASUREMENT B_frmax B_frmax2 B_frmin B_frmin2 fr2_w frm2_w frmn_w frmx_w frm_w fr_w lamsbgt2_w lamsbgt_w lamzak2_w lamzak_w tlrs_w /end OUT_MEASUREMENT
 /begin LOC_MEASUREMENT B_lrin B_lrin2 B_update B_update2 B_y2max B_y2max2 B_y2min B_y2min2 dfr2_w dfrmin2_w dfrmin_w dfr_w froza2_w froza_w ladiff2_w ladiff_w lrsi_w lrsp_w lrsw12_w lrsw1_w lrsw22_w lrsw2_w lrsxk12_w lrsxk1_w lrsxk32_w lrsxk3_w lrsxk42_w lrsxk4_w lrsy22_w lrsy2_w lrsy42_w lrsy4_w /end LOC_MEASUREMENT
 /begin SUB_FUNCTION /end SUB_FUNCTION
/end FUNCTION
/begin FUNCTION LRSEB "Einschaltbedingungen stetige Lambdaregelung"
 /begin DEF_CHARACTERISTIC DLAMXSA DTMR IMLSALR NLRSHB RLLRSHB TASHS TLRHS TLRSZWSA TMRA1 TMRA2 TMSHS TRAU RLLRUN TLRBAM TLRTMS TLRVAM TSBBLSU /end DEF_CHARACTERISTIC
 /begin REF_CHARACTERISTIC /end REF_CHARACTERISTIC
 /begin IN_MEASUREMENT B_bag B_eev B_evloc B_ll B_sa B_sbbvk B_sbbvk2 B_st B_stend B_temin B_temin2 B_vag lamsoni2_w lamsoni_w lamsons2_w lamsons_w ml_w nmot rl tans tmot tmotlin tmrw tmst /end IN_MEASUREMENT
 /begin OUT_MEASUREMENT B_eobdlr B_eobdlr2 B_lr B_lr2 B_lrms B_lrnda B_lrnda2 B_lrs B_lrs2 B_lrssa B_lrssa2 B_tmlr /end OUT_MEASUREMENT
 /begin LOC_MEASUREMENT B_lrrl B_mlrsa B_pspaus B_pspwl imlrsa_w lamsstat_w tansst tvblsu2_w tvblsu_w /end LOC_MEASUREMENT
 /begin SUB_FUNCTION /end SUB_FUNCTION
/end FUNCTION
/begin FUNCTION LTSTORE "Lebensdauerspeicher" /begin DEF_CHARACTERISTIC CLRLT NLTSTORE NLTMON /end DEF_CHARACTERISTIC /begin REF_CHARACTERISTIC /end REF_CHARACTERISTIC /begin IN_MEASUREMENT B_nmot B_pwf ltdistcr_w nmot nmotma_w nmot_w /end IN_MEASUREMENT
 /begin OUT_MEASUREMENT B_clrltdi B_clrltmot B_clrltnmo B_clrltnmx B_lt6min B_ltnmotmx eltcread_state ltdicree_w ltdikmee_w ltdistkm_w ltdistm_w ltecuee_w ltecusec_w ltecu_w lteestat ltmotee_w ltmotsec_w ltmot_w ltnmoee_w ltnmotmo_w ltnmotmx_w ltnmxee_w ltstcree_w /end OUT_MEASUREMENT
 /begin LOC_MEASUREMENT /end LOC_MEASUREMENT
 /begin SUB_FUNCTION /end SUB_FUNCTION
/end FUNCTION
/begin FUNCTION _MCMESS "" /begin DEF_CHARACTERISTIC /end DEF_CHARACTERISTIC /begin REF_CHARACTERISTIC /end REF_CHARACTERISTIC /begin IN_MEASUREMENT /end IN_MEASUREMENT /begin OUT_MEASUREMENT /end OUT_MEASUREMENT /begin LOC_MEASUREMENT /end LOC_MEASUREMENT /begin SUB_FUNCTION /end SUB_FUNCTION /end FUNCTION
/begin FUNCTION MDBAS "Berechnung der Basisgrößen für Momentenschnittstelle" /begin DEF_CHARACTERISTIC CWZWOPT KFMIOP KFZWOP ETALAM ETADZW DZWOLA DZWOM /end DEF_CHARACTERISTIC /begin REF_CHARACTERISTIC /end REF_CHARACTERISTIC /begin IN_MEASUREMENT dzwnwsu lambas nmot rl_w tmot zwbas zwgruu /end IN_MEASUREMENT
 /begin OUT_MEASUREMENT dzwol dzw_kge etalab etatrmn etazwb etazwvst mibas_w mifa mifa_w miopt_w zwopt /end OUT_MEASUREMENT
 /begin LOC_MEASUREMENT dzwb dzwotm mioptl1_w /end LOC_MEASUREMENT
 /begin SUB_FUNCTION /end SUB_FUNCTION
/end FUNCTION
/begin FUNCTION MDFIL "M7-Momentenfilterung für SAWE, Dashpot, LWS)" /begin DEF_CHARACTERISTIC /end DEF_CHARACTERISTIC /begin REF_CHARACTERISTIC /end REF_CHARACTERISTIC /begin IN_MEASUREMENT B_fil B_ll B_lwsd mifalws_w mifa_w misawe_w /end IN_MEASUREMENT /begin OUT_MEASUREMENT mifil_w /end OUT_MEASUREMENT /begin LOC_MEASUREMENT /end LOC_MEASUREMENT /begin SUB_FUNCTION /end SUB_FUNCTION /end FUNCTION
/begin FUNCTION MDIST10 "" /begin DEF_CHARACTERISTIC /end DEF_CHARACTERISTIC /begin REF_CHARACTERISTIC ETADZW /end REF_CHARACTERISTIC /begin IN_MEASUREMENT dzw_kge miopt_w redist zwist zwopt /end IN_MEASUREMENT /begin OUT_MEASUREMENT etazaist etazwist miist_w /end OUT_MEASUREMENT /begin LOC_MEASUREMENT dzwi mdindg_w /end LOC_MEASUREMENT /begin SUB_FUNCTION /end SUB_FUNCTION /end FUNCTION
/begin FUNCTION MDKOG "Drehmomentenkoordination für Gesamteingriffe" /begin DEF_CHARACTERISTIC NASNOT /end DEF_CHARACTERISTIC /begin REF_CHARACTERISTIC MDIMX /end REF_CHARACTERISTIC
 /begin IN_MEASUREMENT B_ll B_stend mibas_w mifil_w migs_w minmx_w mivmx_w mizwmn_w nmot /end IN_MEASUREMENT
 /begin OUT_MEASUREMENT B_nozwe miasrs_w mioes_w misol_w mizsol_w /end OUT_MEASUREMENT
 /begin LOC_MEASUREMENT miext_w /end LOC_MEASUREMENT
 /begin SUB_FUNCTION /end SUB_FUNCTION
/end FUNCTION
/begin FUNCTION MDLWSD "Momentfilterung Lastwechselschlagdämpfung"
 /begin DEF_CHARACTERISTIC CWLWSD TMLWSD VLWSD DMLWSDU TVLWSDSA DMDFAO DMDFAWE ZMDFAO ZMDFAWE KLDMLWSDO MILWON KLMILWSD MILWUN MILWUSAN KFDMDFA KFDMDFAU KFDMDFAS KFZMDFA KFZMDFAU KFZMDFAS /end DEF_CHARACTERISTIC
 /begin REF_CHARACTERISTIC SGA06MFUB SNM06MFUB /end REF_CHARACTERISTIC
 /begin IN_MEASUREMENT B_ll B_sa B_sab B_st esst_sga06mfub esst_snm06mfub gangi mifa_w mifil_w nmot tmot vfzg /end IN_MEASUREMENT
 /begin OUT_MEASUREMENT B_lwsd mifalws_w xgang /end OUT_MEASUREMENT
 /begin LOC_MEASUREMENT B_iflsd B_lwsdsa B_lwsfao B_lwsuk dmdfa dmdfag dmdfasg dmdfaug dmifav miptzwei_w zmdfa zmdfag zmdfasg zmdfaug /end LOC_MEASUREMENT
 /begin SUB_FUNCTION /end SUB_FUNCTION
/end FUNCTION
/begin FUNCTION MDRED "Berechnung Reduzierstufe aus Momentenanforderung" /begin DEF_CHARACTERISTIC MDHYEZ REDHYOC REDHYUC REDZEM /end DEF_CHARACTERISTIC /begin REF_CHARACTERISTIC /end REF_CHARACTERISTIC
 /begin IN_MEASUREMENT B_asr B_gs B_nmax B_sab B_vmax etazwmn mibas_w miopt_w misol_w tmot /end IN_MEASUREMENT
 /begin OUT_MEASUREMENT B_sa mizwmn_w redsol /end OUT_MEASUREMENT
 /begin LOC_MEASUREMENT B_mdee B_mdredhyein redhyst redneu redze redzst_w /end LOC_MEASUREMENT
 /begin SUB_FUNCTION /end SUB_FUNCTION
/end FUNCTION
/begin FUNCTION MDSAWE "Schubabschalten und Wiedereinsetzen" /begin DEF_CHARACTERISTIC TDMFBSA TDMFBWE DMRSA NGFSAWE CWSAVFZG /end DEF_CHARACTERISTIC /begin REF_CHARACTERISTIC /end REF_CHARACTERISTIC /begin IN_MEASUREMENT B_lwsd B_sa B_sab B_vnull mifa_w miist_w ngfil_w /end IN_MEASUREMENT /begin OUT_MEASUREMENT B_fil misawe_w /end OUT_MEASUREMENT /begin LOC_MEASUREMENT /end LOC_MEASUREMENT /begin SUB_FUNCTION /end SUB_FUNCTION /end FUNCTION
/begin FUNCTION MDZW "Berechnung Moment in Sollzündwinkel" /begin DEF_CHARACTERISTIC DZWETA /end DEF_CHARACTERISTIC /begin REF_CHARACTERISTIC /end REF_CHARACTERISTIC
 /begin IN_MEASUREMENT B_nozwe etazaist etazwvst mibas_w mifa_w miopt_w mizsol_w zwbas zwopt /end IN_MEASUREMENT
 /begin OUT_MEASUREMENT zwsol /end OUT_MEASUREMENT
 /begin LOC_MEASUREMENT dzweta_in dzws etazws /end LOC_MEASUREMENT
 /begin SUB_FUNCTION /end SUB_FUNCTION
/end FUNCTION
/begin FUNCTION MEMEXT ""
 /begin DEF_CHARACTERISTIC READCLOMEM SETCLOMEM CLOMEMHR CLOMEMMIN CLOMEMSEC CLOMEMYR CLOMEMMON CLOMEMDAY SUS_IN_FL SUS_IN_FR SUS_IN_RL SUS_IN_RR SUS_OUT_FL SUS_OUT_FR SUS_OUT_RL SUS_OUT_RR STEERANGL STEERANGR ACCBW ACCFW ACCLE ACCRI SUS_ZER_FL SUS_ZER_FR SUS_ZER_RL SUS_ZER_RR STEERZERO ACCLZERO ACCTZERO ADJ_ACT CHK_ACT /end DEF_CHARACTERISTIC
 /begin REF_CHARACTERISTIC UMRAD KRAN1 KRAN2 KRAN3 KRAN4 KRAN5 KRAN6 KRAN7 DATAVERS LLAP NLTMON /end REF_CHARACTERISTIC
 /begin IN_MEASUREMENT aimvpm B_nmot fra2_w fra_w kvges_w kvlapold_w lamsoni2ma lamsoni2mi lamsonima lamsonimi lapctr laptime laptimeold ltdistkm_w ltdistm_w ltecu_w ltmot_w ltnmotmo_w ltnmotmx_w mapposma mapposmi nmotma_w nmot_w pfuelma pfuelmi poelma poelmi puma pumi rkat2_w rkat_w rkaz2_w rkaz_w tabgm2ma tabgm2mi tabgmma tabgmmi tansma tansmi tema_w temi_w tmotma tmotmi toelma toelmi ubma ubmi vfzg wdkbama wdkbami wkra wkrdya /end IN_MEASUREMENT
 /begin OUT_MEASUREMENT acclchk acctchk adjstat B_adj B_chk B_memainf B_memcan B_memcard B_memcardn B_memkenn B_memlap B_memrec B_memstat B_memwgcom memadc10_w memadc11_w memadc12_w memadc13_w memadc14_w memadc15_w memadc16_w memadc1_w memadc2_w memadc3_w memadc4_w memadc5_w memadc6_w memadc7_w memadc8_w memadc9_w memcoppr_w memdist_w memfirm_w memimp_w memrst_w memsblk_w memtblk_w memtime_w stangchk susflchk susfrchk susrlchk susrrchk tclomemday tclomemhr tclomemmin tclomemmon tclomemsec tclomemyr uaccbw_w uaccfw_w uaccle_w uaccri_w usteerl_w usteerr_w ususinfl_w ususinfr_w ususinrl_w ususinrr_w ususoufl_w ususoufr_w ususourl_w ususourr_w /end OUT_MEASUREMENT
 /begin LOC_MEASUREMENT /end LOC_MEASUREMENT
 /begin SUB_FUNCTION /end SUB_FUNCTION
/end FUNCTION
/begin FUNCTION MINMAX "Erfassung der minimalen und maximalen Betriebsdaten" /begin DEF_CHARACTERISTIC CLRMINMAX CWMINMAX NMINMAX WDKMINMAX /end DEF_CHARACTERISTIC /begin REF_CHARACTERISTIC /end REF_CHARACTERISTIC
 /begin IN_MEASUREMENT B_kl15 B_memcardn B_pwf B_stend lamsoni lamsoni2 mappos nmot_w pfuel poel pu tabgm tabgm2 tans te_w tmot toel ub wdkba /end IN_MEASUREMENT
 /begin OUT_MEASUREMENT B_minmax lamsoni2ma lamsoni2mi lamsonima lamsonimi mapposma mapposmi nmotma_w pfuelma pfuelmi poelma poelmi puma pumi tabgm2ma tabgm2mi tabgmma tabgmmi tansma tansmi tema_w temi_w tmotma tmotmi toelma toelmi ubma ubmi wdkbama wdkbami /end OUT_MEASUREMENT
 /begin LOC_MEASUREMENT /end LOC_MEASUREMENT
 /begin SUB_FUNCTION /end SUB_FUNCTION
/end FUNCTION
/begin FUNCTION MOTAUS "Motor-Abstellen" /begin DEF_CHARACTERISTIC TNLSGMN TNLSGMX UBNLMN /end DEF_CHARACTERISTIC /begin REF_CHARACTERISTIC /end REF_CHARACTERISTIC /begin IN_MEASUREMENT B_pwf ub /end IN_MEASUREMENT /begin OUT_MEASUREMENT B_nachl B_nachlend B_nlEEPR B_nlobd swOffDlBits tnachl_w /end OUT_MEASUREMENT /begin LOC_MEASUREMENT /end LOC_MEASUREMENT /begin SUB_FUNCTION /end SUB_FUNCTION /end FUNCTION
/begin FUNCTION NLPH "Notlauf Phasengeber" /begin DEF_CHARACTERISTIC /end DEF_CHARACTERISTIC /begin REF_CHARACTERISTIC /end REF_CHARACTERISTIC /begin IN_MEASUREMENT B_phas2 B_phase B_phsok B_phsok2 zzvirt zzyl /end IN_MEASUREMENT /begin OUT_MEASUREMENT B_delaysyn B_nosynph /end OUT_MEASUREMENT /begin LOC_MEASUREMENT /end LOC_MEASUREMENT /begin SUB_FUNCTION /end SUB_FUNCTION /end FUNCTION
/begin FUNCTION NMAXMD "Drehzahlbegrenzung" /begin DEF_CHARACTERISTIC MDIMX DNMAXH TNMXPR NMAXPRL ZINMAXRL NMAXGANG /end DEF_CHARACTERISTIC /begin REF_CHARACTERISTIC /end REF_CHARACTERISTIC /begin IN_MEASUREMENT B_dkpu gangi mifa_w ngfil_w nmot_w rl wped /end IN_MEASUREMENT /begin OUT_MEASUREMENT B_nmax B_nmaxd minmx_w /end OUT_MEASUREMENT /begin LOC_MEASUREMENT dmnmxi_w dmnmxp_w dnsi_w minmxb_w nmotpr_w nsber_w /end LOC_MEASUREMENT /begin SUB_FUNCTION /end SUB_FUNCTION /end FUNCTION
/begin FUNCTION PROKON "Projektkonfiguration" /begin DEF_CHARACTERISTIC CDLSV CDHSV CDATS CWKONLS CWMDAPP CWUHR /end DEF_CHARACTERISTIC /begin REF_CHARACTERISTIC /end REF_CHARACTERISTIC /begin IN_MEASUREMENT nmot /end IN_MEASUREMENT
 /begin OUT_MEASUREMENT B_asr B_cdats B_cdhsv B_cdlsv B_dssv B_dsuv B_lsh B_lsh2 B_lsv B_lsv2 B_uhrrsec B_zwappl cd_bits1_w cd_bits2_w /end OUT_MEASUREMENT
 /begin LOC_MEASUREMENT /end LOC_MEASUREMENT
 /begin SUB_FUNCTION /end SUB_FUNCTION
/end FUNCTION
/begin FUNCTION RKTI "Einspritzdauerberechnung ti aus relativer Kraftstoffmasse rk" /begin DEF_CHARACTERISTIC TEMIN FKKVS /end DEF_CHARACTERISTIC /begin REF_CHARACTERISTIC /end REF_CHARACTERISTIC /begin IN_MEASUREMENT B_stend frkte_w nmot rk2_w rk_w tvu_w /end IN_MEASUREMENT
 /begin OUT_MEASUREMENT B_temin B_temin2 ftek2_w ftek_w te2_w tevfa2_w tevfa_w te_w ti2_w ti_b1 ti_b2 ti_tvu_w ti_w /end OUT_MEASUREMENT
 /begin LOC_MEASUREMENT tevfa_w_kge /end LOC_MEASUREMENT
 /begin SUB_FUNCTION /end SUB_FUNCTION
/end FUNCTION
/begin FUNCTION rstmon "Reset Monitor" /begin DEF_CHARACTERISTIC /end DEF_CHARACTERISTIC /begin REF_CHARACTERISTIC /end REF_CHARACTERISTIC /begin IN_MEASUREMENT /end IN_MEASUREMENT /begin OUT_MEASUREMENT resetMonIdx /end OUT_MEASUREMENT /begin LOC_MEASUREMENT rstMon /end LOC_MEASUREMENT /begin SUB_FUNCTION /end SUB_FUNCTION /end FUNCTION
/begin FUNCTION RUNTIME "" /begin DEF_CHARACTERISTIC AUFWSYNC AUFW10MS AUFW20MS AUFW100M RESETMAX /end DEF_CHARACTERISTIC /begin REF_CHARACTERISTIC /end REF_CHARACTERISTIC /begin IN_MEASUREMENT B_kr B_lrs B_sa nmot rl wdkba wped /end IN_MEASUREMENT
 /begin OUT_MEASUREMENT cyclebg_w laufz100_w laufz10m_w laufz1m_w laufz1s_w laufz200_w laufz20m_w laufz2m_w laufz50m_w laufz5m_w laufzbg_w laufzfbg_w laufzsyn_w lzmaxnmot lzmaxrl lzmaxstate lzmaxwdkba lzmaxwped lzs_dash lzs_kr lzs_ldr lzs_lr lzs_lsd lzs_sa perffilt_w perfmax_w perfmin_w perform_w peri50ms_w rlossCtr_w /end OUT_MEASUREMENT
 /begin LOC_MEASUREMENT /end LOC_MEASUREMENT
 /begin SUB_FUNCTION /end SUB_FUNCTION
/end FUNCTION
/begin FUNCTION SSTB ""
 /begin DEF_CHARACTERISTIC SGA06MFUB SNM06MFUB SNM08__UB SNM16ZUUB SRL12ZUUB SNM12ESUB SRL12ESUB SAN12ESUW SRL08LSUW SNM07LSUW STM06__UB STM05SAUB STM12ESUB STS12ESUB STA06ESUB SNM16KRUB SRL04KRUB SNM16CIUB SRL04DYUB SML07TMUW /end DEF_CHARACTERISTIC
 /begin REF_CHARACTERISTIC /end REF_CHARACTERISTIC
 /begin IN_MEASUREMENT anztib_w etazwist mifa ml_w ngfil nmot nmot_w rl rl_w tans tmot tmst ub wped xgang /end IN_MEASUREMENT
 /begin OUT_MEASUREMENT esst_san12esuw esst_sga06mfub esst_sml07tmuw esst_snm06mfub esst_snm07lsuw esst_snm08__ub esst_snm12esub esst_snm16ciub esst_snm16krub esst_snm16zuub esst_srl04dyub esst_srl04krub esst_srl08lsuw esst_srl12esub esst_srl12zuub esst_sta06esub esst_stm05saub esst_stm06__ub esst_stm12esub esst_sts12esub /end OUT_MEASUREMENT
 /begin LOC_MEASUREMENT /end LOC_MEASUREMENT
 /begin SUB_FUNCTION /end SUB_FUNCTION
/end FUNCTION
/begin FUNCTION STARTUPO "" /begin DEF_CHARACTERISTIC CWPWF /end DEF_CHARACTERISTIC /begin REF_CHARACTERISTIC /end REF_CHARACTERISTIC /begin IN_MEASUREMENT /end IN_MEASUREMENT /begin OUT_MEASUREMENT B_pwf cb_13 /end OUT_MEASUREMENT /begin LOC_MEASUREMENT /end LOC_MEASUREMENT /begin SUB_FUNCTION /end SUB_FUNCTION /end FUNCTION
/begin FUNCTION SYK061 "" /begin DEF_CHARACTERISTIC /end DEF_CHARACTERISTIC /begin REF_CHARACTERISTIC /end REF_CHARACTERISTIC /begin IN_MEASUREMENT /end IN_MEASUREMENT /begin OUT_MEASUREMENT /end OUT_MEASUREMENT /begin LOC_MEASUREMENT /end LOC_MEASUREMENT /begin SUB_FUNCTION /end SUB_FUNCTION /end FUNCTION
/begin FUNCTION SYNC71 "" /begin DEF_CHARACTERISTIC /end DEF_CHARACTERISTIC /begin REF_CHARACTERISTIC WESBM /end REF_CHARACTERISTIC /begin IN_MEASUREMENT B_nosynph nmot_w winkl_b1 winkl_b2 zylvek_a /end IN_MEASUREMENT
 /begin OUT_MEASUREMENT B_bm B_fbm B_iniSyn B_Tper10msAllZ losphctr tCorrCtr tn2 tPer10ms tPerPtr tr_zeit_msb tr_zeit_msb_alt tseghi tseg_w tToothAt10ms uzkw_w zzyl zzylzue /end OUT_MEASUREMENT
 /begin LOC_MEASUREMENT /end LOC_MEASUREMENT
 /begin SUB_FUNCTION /end SUB_FUNCTION
/end FUNCTION
/begin FUNCTION SY_DFPM3 "" /begin DEF_CHARACTERISTIC /end DEF_CHARACTERISTIC /begin REF_CHARACTERISTIC /end REF_CHARACTERISTIC /begin IN_MEASUREMENT /end IN_MEASUREMENT /begin OUT_MEASUREMENT /end OUT_MEASUREMENT /begin LOC_MEASUREMENT /end LOC_MEASUREMENT /begin SUB_FUNCTION /end SUB_FUNCTION /end FUNCTION
/begin FUNCTION SY_KONST "" /begin DEF_CHARACTERISTIC /end DEF_CHARACTERISTIC /begin REF_CHARACTERISTIC /end REF_CHARACTERISTIC /begin IN_MEASUREMENT /end IN_MEASUREMENT /begin OUT_MEASUREMENT /end OUT_MEASUREMENT /begin LOC_MEASUREMENT /end LOC_MEASUREMENT /begin SUB_FUNCTION /end SUB_FUNCTION /end FUNCTION
/begin FUNCTION T76061_T "" /begin DEF_CHARACTERISTIC /end DEF_CHARACTERISTIC /begin REF_CHARACTERISTIC /end REF_CHARACTERISTIC /begin IN_MEASUREMENT B_nachl nmot swOffDlBits /end IN_MEASUREMENT /begin OUT_MEASUREMENT dynPeriod /end OUT_MEASUREMENT /begin LOC_MEASUREMENT /end LOC_MEASUREMENT /begin SUB_FUNCTION /end SUB_FUNCTION /end FUNCTION
/begin FUNCTION TIMU1 "" /begin DEF_CHARACTERISTIC /end DEF_CHARACTERISTIC /begin REF_CHARACTERISTIC /end REF_CHARACTERISTIC
 /begin IN_MEASUREMENT B_stend B_ti_cha0 B_ti_cha1 B_ti_cha2 B_ti_cha3 B_ti_cha4 B_ti_cha5 B_ti_cha6 B_ti_cha7 B_ti_out0 B_ti_out1 B_ti_out2 B_ti_out3 B_ti_out4 B_ti_out5 B_ti_out6 B_ti_out7 B_ti_wai0 B_ti_wai1 B_ti_wai2 B_ti_wai3 B_ti_wai4 B_ti_wai5 B_ti_wai6 B_ti_wai7 cc_cha_0 cc_cha_1 cc_cha_2 cc_cha_3 cc_cha_4 cc_cha_5 cc_cha_6 cc_cha_7 tn2 /end IN_MEASUREMENT
 /begin OUT_MEASUREMENT B_timfast /end OUT_MEASUREMENT
 /begin LOC_MEASUREMENT /end LOC_MEASUREMENT
 /begin SUB_FUNCTION /end SUB_FUNCTION
/end FUNCTION
/begin FUNCTION TN "Drehzahlmesser Signal" /begin DEF_CHARACTERISTIC /end DEF_CHARACTERISTIC /begin REF_CHARACTERISTIC /end REF_CHARACTERISTIC /begin IN_MEASUREMENT zzyl /end IN_MEASUREMENT /begin OUT_MEASUREMENT /end OUT_MEASUREMENT /begin LOC_MEASUREMENT /end LOC_MEASUREMENT /begin SUB_FUNCTION /end SUB_FUNCTION /end FUNCTION
/begin FUNCTION TNOT "" /begin DEF_CHARACTERISTIC /end DEF_CHARACTERISTIC /begin REF_CHARACTERISTIC /end REF_CHARACTERISTIC /begin IN_MEASUREMENT /end IN_MEASUREMENT /begin OUT_MEASUREMENT /end OUT_MEASUREMENT /begin LOC_MEASUREMENT /end LOC_MEASUREMENT /begin SUB_FUNCTION /end SUB_FUNCTION /end FUNCTION
/begin FUNCTION TREV_OV "" /begin DEF_CHARACTERISTIC /end DEF_CHARACTERISTIC /begin REF_CHARACTERISTIC /end REF_CHARACTERISTIC /begin IN_MEASUREMENT /end IN_MEASUREMENT /begin OUT_MEASUREMENT B_trev_inc trevovCtr /end OUT_MEASUREMENT /begin LOC_MEASUREMENT /end LOC_MEASUREMENT /begin SUB_FUNCTION /end SUB_FUNCTION /end FUNCTION
/begin FUNCTION UMFMSD "" /begin DEF_CHARACTERISTIC /end DEF_CHARACTERISTIC /begin REF_CHARACTERISTIC /end REF_CHARACTERISTIC /begin IN_MEASUREMENT /end IN_MEASUREMENT /begin OUT_MEASUREMENT /end OUT_MEASUREMENT /begin LOC_MEASUREMENT uma2_res umErrorCtrFr /end LOC_MEASUREMENT /begin SUB_FUNCTION /end SUB_FUNCTION /end FUNCTION
/begin FUNCTION V76061Hw "" /begin DEF_CHARACTERISTIC CJCONFIG /end DEF_CHARACTERISTIC /begin REF_CHARACTERISTIC /end REF_CHARACTERISTIC
 /begin IN_MEASUREMENT bbsu bbsu2 B_ekp B_hsve B_hsve2 B_lsuab B_lsuab2 B_mil B_milspec B_nmot B_oellamp B_shlamp B_stend B_vmaxreq /end IN_MEASUREMENT
 /begin OUT_MEASUREMENT B_hr B_kl15 B_mappin1 B_mappin2 /end OUT_MEASUREMENT
 /begin LOC_MEASUREMENT /end LOC_MEASUREMENT
 /begin SUB_FUNCTION /end SUB_FUNCTION
/end FUNCTION
/begin FUNCTION VMAXMD "Drehmomentanforderung von VMAX-Regelung"
 /begin DEF_CHARACTERISTIC VMAXO VMAXOMPH DVHYST DVMAXEIN DVMAXAUS ZBFIL TVMXPR VMAXP ZIVMAX NMINVMX CWVMAX MIVMXG /end DEF_CHARACTERISTIC
 /begin REF_CHARACTERISTIC MDIMX /end REF_CHARACTERISTIC
 /begin IN_MEASUREMENT bfzgl_b gangi miist_w nmot rl_w vfzg_w /end IN_MEASUREMENT
 /begin OUT_MEASUREMENT B_vmax B_vmaxreq mivmx_w /end OUT_MEASUREMENT
 /begin LOC_MEASUREMENT bfzglf dmvmxi_w dmvmxp_w dvprae_w dvsi_w vfzgpr_w /end LOC_MEASUREMENT
 /begin SUB_FUNCTION /end SUB_FUNCTION
/end FUNCTION
/begin FUNCTION VS_VERS "" /begin DEF_CHARACTERISTIC CWVSV /end DEF_CHARACTERISTIC /begin REF_CHARACTERISTIC /end REF_CHARACTERISTIC /begin IN_MEASUREMENT /end IN_MEASUREMENT /begin OUT_MEASUREMENT vsdmr vsldtv vsns vsrlmx vsvw vswnws /end OUT_MEASUREMENT /begin LOC_MEASUREMENT B_mcacti /end LOC_MEASUREMENT /begin SUB_FUNCTION /end SUB_FUNCTION /end FUNCTION
/begin FUNCTION ZUE258 "" /begin DEF_CHARACTERISTIC WPHN DZWZUEN1 DZWZUEN2 DZWZUEN3 DZWZUEN4 DZWZUEN5 DZWZUEN6 /end DEF_CHARACTERISTIC /begin REF_CHARACTERISTIC SNM08__UB /end REF_CHARACTERISTIC
 /begin IN_MEASUREMENT B_nozwe B_sa B_stend B_zwappl dwkrz dzwwl esst_snm08__ub nmot redist zwgru zwsol zwspae zwstt zzylzue /end IN_MEASUREMENT
 /begin OUT_MEASUREMENT B_zwkra dzwzyl zwbas zwbasar zwist zwkrafld zwout zwoutar zwzyl1 /end OUT_MEASUREMENT
 /begin LOC_MEASUREMENT B_zwspae wphg /end LOC_MEASUREMENT
 /begin SUB_FUNCTION /end SUB_FUNCTION
/end FUNCTION
/begin FUNCTION ZUESZ "Zündung, Berechnung Schließzeit" /begin DEF_CHARACTERISTIC TSZOMIN CWSZLIM KFSZT FSZTM /end DEF_CHARACTERISTIC /begin REF_CHARACTERISTIC CWZNDAUS /end REF_CHARACTERISTIC /begin IN_MEASUREMENT nmot tmot tseg_w ub /end IN_MEASUREMENT /begin OUT_MEASUREMENT anzsegsz szlimit_w szoutu_w szout_w sztcalc_w /end OUT_MEASUREMENT /begin LOC_MEASUREMENT /end LOC_MEASUREMENT /begin SUB_FUNCTION /end SUB_FUNCTION /end FUNCTION
/begin FUNCTION ZWGRU "Grundzündwinkel" /begin DEF_CHARACTERISTIC DZWAPPL DZWNWSUE DZWMAP2N DZWMAP3N KFDZWKG KFZW KFZW2 /end DEF_CHARACTERISTIC /begin REF_CHARACTERISTIC SNM16ZUUB SRL12ZUUB /end REF_CHARACTERISTIC
 /begin IN_MEASUREMENT B_mappos2 B_mappos3 esst_snm16zuub esst_srl12zuub lambas nmot rl wnwue zwopt /end IN_MEASUREMENT
 /begin OUT_MEASUREMENT dzwkg dzwnwsu zwgru zwgruu /end OUT_MEASUREMENT
 /begin LOC_MEASUREMENT zwnws /end LOC_MEASUREMENT
 /begin SUB_FUNCTION /end SUB_FUNCTION
/end FUNCTION
/begin FUNCTION ZWMIN1 "" /begin DEF_CHARACTERISTIC ZZWMNST DZWSPM KFZWMN KFZWMNST /end DEF_CHARACTERISTIC /begin REF_CHARACTERISTIC SNM16ZUUB SRL12ZUUB STM06__UB ETADZW /end REF_CHARACTERISTIC
 /begin IN_MEASUREMENT B_st dzw_kge esst_snm16zuub esst_srl12zuub esst_stm06__ub nmot rl tmot zwopt /end IN_MEASUREMENT
 /begin OUT_MEASUREMENT dzwspae etazwmn zwspae /end OUT_MEASUREMENT
 /begin LOC_MEASUREMENT B_zwmnste /end LOC_MEASUREMENT
 /begin SUB_FUNCTION /end SUB_FUNCTION
/end FUNCTION
/begin FUNCTION ZWSTT "Zündung im Start" /begin DEF_CHARACTERISTIC FZWSTNM FZWSTTM DZWSTTA /end DEF_CHARACTERISTIC /begin REF_CHARACTERISTIC /end REF_CHARACTERISTIC /begin IN_MEASUREMENT B_stend nmot tans tmst /end IN_MEASUREMENT /begin OUT_MEASUREMENT zwstt /end OUT_MEASUREMENT /begin LOC_MEASUREMENT /end LOC_MEASUREMENT /begin SUB_FUNCTION /end SUB_FUNCTION /end FUNCTION
/begin FUNCTION ZWWL "Warmlauf Zündwinkel" /begin DEF_CHARACTERISTIC KFZWWLTM KFZWWLNM /end DEF_CHARACTERISTIC /begin REF_CHARACTERISTIC /end REF_CHARACTERISTIC /begin IN_MEASUREMENT rl tans tmot tmst /end IN_MEASUREMENT /begin OUT_MEASUREMENT dzwwl /end OUT_MEASUREMENT /begin LOC_MEASUREMENT /end LOC_MEASUREMENT /begin SUB_FUNCTION /end SUB_FUNCTION /end FUNCTION
/begin COMPU_METHOD bfzg_sb_q0p217 "" RAT_FUNC "%6.3" "m/s^2" COEFFS 0 1 0 0 0 0.217 /end COMPU_METHOD
/begin COMPU_METHOD B_TRUE "boolsche Zustände, positive Logik" TAB_VERB "%6.3" "" COMPU_TAB_REF B_TRUE /end COMPU_METHOD
/begin COMPU_VTAB B_TRUE "boolsche Zustände, positive Logik" TAB_VERB 2 0 "----" 1 "TRUE" /end COMPU_VTAB
/begin COMPU_METHOD deg_uw_q10 "" RAT_FUNC "%6.3" "deg" COEFFS 0 10 0 0 0 1 /end COMPU_METHOD
/begin COMPU_METHOD dez "1 : 1 Umrechnug (dez/hex)" RAT_FUNC "%6.2" "" COEFFS 0 1 0 0 0 1 /end COMPU_METHOD
/begin COMPU_METHOD DEZL "Dezimalzahl in 16-Bit-Hexzahl" RAT_FUNC "%6.2" "" COEFFS 0 1 0 0 0 1 /end COMPU_METHOD
/begin COMPU_METHOD distm_uw_q0p1 "" RAT_FUNC "%6.3" "m" COEFFS 0 10 0 0 0 1 /end COMPU_METHOD
/begin COMPU_METHOD dist_uw_q0p1 "" RAT_FUNC "%6.2" "km" COEFFS 0 1 0 0 0 1 /end COMPU_METHOD
/begin COMPU_METHOD fak_sb_b1 "" RAT_FUNC "%6.4" "-" COEFFS 0 256 0 0 0 2 /end COMPU_METHOD
/begin COMPU_METHOD fak_sw_b1 "" RAT_FUNC "%7.6" "-" COEFFS 0 65536 0 0 0 2 /end COMPU_METHOD
/begin COMPU_METHOD fak_sw_b32 "" RAT_FUNC "%6.5" "-" COEFFS 0 65536 0 0 0 64 /end COMPU_METHOD
/begin COMPU_METHOD fak_sw_b4 "" RAT_FUNC "%6.5" "-" COEFFS 0 65536 0 0 0 8 /end COMPU_METHOD
/begin COMPU_METHOD fak_sw_b8 "" RAT_FUNC "%6.5" "-" COEFFS 0 65536 0 0 0 16 /end COMPU_METHOD
/begin COMPU_METHOD fak_ub_b1 "" RAT_FUNC "%6.4" "-" COEFFS 0 256 0 0 0 1 /end COMPU_METHOD
/begin COMPU_METHOD fak_ub_b2 "" RAT_FUNC "%6.4" "-" COEFFS 0 256 0 0 0 2 /end COMPU_METHOD
/begin COMPU_METHOD fak_ub_b4 "" RAT_FUNC "%6.4" "-" COEFFS 0 256 0 0 0 4 /end COMPU_METHOD
/begin COMPU_METHOD fak_uw_b16 "" RAT_FUNC "%6.5" "-" COEFFS 0 65536 0 0 0 16 /end COMPU_METHOD
/begin COMPU_METHOD fak_uw_b2 "" RAT_FUNC "%7.6" "-" COEFFS 0 65536 0 0 0 2 /end COMPU_METHOD
/begin COMPU_METHOD fak_uw_b64 "" RAT_FUNC "%6.5" "-" COEFFS 0 65536 0 0 0 64 /end COMPU_METHOD
/begin COMPU_METHOD g_uw_q100 "" RAT_FUNC "%6.4" "g" COEFFS 0 100 0 0 0 1 /end COMPU_METHOD
/begin COMPU_METHOD kw_ub_q0p5 "" RAT_FUNC "%6.3" "°KW" COEFFS 0 256 0 0 0 128 /end COMPU_METHOD
/begin COMPU_METHOD mm_uw_q100 "" RAT_FUNC "%6.4" "mm" COEFFS 0 100 0 0 0 1 /end COMPU_METHOD
/begin COMPU_METHOD msd_poil_ub_0 "" RAT_FUNC "%6.4" "bar" COEFFS 0 255 0 0 0 16 /end COMPU_METHOD
/begin COMPU_METHOD msd_text_eltcread "" TAB_VERB "%6.3" "" COMPU_TAB_REF msd_text_eltcread /end COMPU_METHOD
/begin COMPU_VTAB msd_text_eltcread "" TAB_VERB 5 0 "EEprom load request" 1 "EEprom load request OK" 2 "EEprom load done" 3 "EEprom load error" 4 "EEprom load wrongpar" /end COMPU_VTAB
/begin COMPU_METHOD msd_text_eltcwrite "" TAB_VERB "%6.3" "" COMPU_TAB_REF msd_text_eltcwrite /end COMPU_METHOD
/begin COMPU_VTAB msd_text_eltcwrite "" TAB_VERB 5 0 "EEprom write request" 1 "EEprom write request OK" 2 "EEprom write done" 3 "EEprom write error" 4 "EEprom write wrongpar" /end COMPU_VTAB
/begin COMPU_METHOD m_uw_b4660 "" RAT_FUNC "%6.4" "g" COEFFS 0 3600 0 0 0 256 /end COMPU_METHOD
/begin COMPU_METHOD m_uw_b6553p5 "" RAT_FUNC "%6.3" "kg/h" COEFFS 0 1 0 0 0 0.1 /end COMPU_METHOD
/begin COMPU_METHOD nmotg_sw_q0p39 "" RAT_FUNC "%6.3" "U/min/s" COEFFS 0 1 0 0 0 0.39063 /end COMPU_METHOD
/begin COMPU_METHOD nmot_sw_q0p25 "" RAT_FUNC "%6.3" "U/min" COEFFS 0 1 0 0 0 0.25 /end COMPU_METHOD
/begin COMPU_METHOD nmot_ub_q10 "" RAT_FUNC "%6.1" "U/min" COEFFS 0 1 0 0 0 10 /end COMPU_METHOD
/begin COMPU_METHOD nmot_ub_q40 "" RAT_FUNC "%6.1" "Upm" COEFFS 0 1 0 0 0 40 /end COMPU_METHOD
/begin COMPU_METHOD nmot_uw_q0p25 "" RAT_FUNC "%6.3" "U/min" COEFFS 0 1 0 0 0 0.25 /end COMPU_METHOD
/begin COMPU_METHOD p_ub_q5 "" RAT_FUNC "%6.2" "hPa" COEFFS 0 1 0 0 0 5 /end COMPU_METHOD
/begin COMPU_METHOD relDK_ub_b100 "" RAT_FUNC "%6.3" "% DK" COEFFS 0 255 0 0 0 100 /end COMPU_METHOD
/begin COMPU_METHOD relnmot_q0p0039 "" RAT_FUNC "%6.4" "%/(U/min)" COEFFS 0 256 0 0 0 1 /end COMPU_METHOD
/begin COMPU_METHOD rel_q0p025 "" RAT_FUNC "%6.4" "%" COEFFS 0 1 0 0 0 0.025 /end COMPU_METHOD
/begin COMPU_METHOD rel_sb_q0p02 "" RAT_FUNC "%6.4" "%" COEFFS 0 64 0 0 0 1 /end COMPU_METHOD
/begin COMPU_METHOD rel_sb_q0p75 "" RAT_FUNC "%6.3" "%" COEFFS 0 1 0 0 0 0.75 /end COMPU_METHOD
/begin COMPU_METHOD rel_sw_b100 "" RAT_FUNC "%6.4" "%" COEFFS 0 32768 0 0 0 100 /end COMPU_METHOD
/begin COMPU_METHOD rel_ub_b100 "" RAT_FUNC "%6.3" "%" COEFFS 0 256 0 0 0 100 /end COMPU_METHOD
/begin COMPU_METHOD rel_ub_b127p5 "" RAT_FUNC "%6.3" "%" COEFFS 0 2 0 0 0 1 /end COMPU_METHOD
/begin COMPU_METHOD rel_ub_b50 "" RAT_FUNC "%6.3" "%" COEFFS 0 255 0 0 0 50 /end COMPU_METHOD
/begin COMPU_METHOD rel_ub_b99p6 "" RAT_FUNC "%6.3" "%" COEFFS 0 256 0 0 0 100 /end COMPU_METHOD
/begin COMPU_METHOD rel_ub_q0p3906 "" RAT_FUNC "%6.3" "%" COEFFS 0 256 0 0 0 100 /end COMPU_METHOD
/begin COMPU_METHOD rel_ub_q0p391 "" RAT_FUNC "%6.3" "%/km/h" COEFFS 0 1 0 0 0 0.391 /end COMPU_METHOD
/begin COMPU_METHOD rel_ub_q0p75 "" RAT_FUNC "%6.3" "%" COEFFS 0 1 0 0 0 0.75 /end COMPU_METHOD
/begin COMPU_METHOD rel_uw_b100 "" RAT_FUNC "%6.4" "%" COEFFS 0 65536 0 0 0 100 /end COMPU_METHOD
/begin COMPU_METHOD rel_uw_q0p001 "" RAT_FUNC "%6.4" "%" COEFFS 0 1000 0 0 0 1 /end COMPU_METHOD
/begin COMPU_METHOD rel_uw_q0p0234 "" RAT_FUNC "%6.4" "%" COEFFS 0 32 0 0 0 0.75 /end COMPU_METHOD
/begin COMPU_METHOD runtime1_sy "" RAT_FUNC "%6.2" "us" COEFFS 0 1.25 0 0 0 1 /end COMPU_METHOD
/begin COMPU_METHOD runtime2_sy "" RAT_FUNC "%6.1" "us" COEFFS 0 0.078125 0 0 0 1 /end COMPU_METHOD
/begin COMPU_METHOD spg_ubatt "" RAT_FUNC "%6.4" "V" COEFFS 0 1 0 0 0 0.0681 /end COMPU_METHOD
/begin COMPU_METHOD spg_uw_mV "" RAT_FUNC "%6.4" "mV" COEFFS 0 65472 0 0 0 5000 /end COMPU_METHOD
/begin COMPU_METHOD t100msxs_ub_b25p5 "" RAT_FUNC "%6.3" "s" COEFFS 0 1 0 0 0 0.1 /end COMPU_METHOD
/begin COMPU_METHOD t100msxs_uw_b6553p5 "" RAT_FUNC "%6.3" "s" COEFFS 0 1 0 0 0 0.1 /end COMPU_METHOD
/begin COMPU_METHOD t100msxs_uw_b6553p6 "" RAT_FUNC "%6.3" "s" COEFFS 0 10 0 0 0 1 /end COMPU_METHOD
/begin COMPU_METHOD t10msxs_sb_q0p01 "" RAT_FUNC "%6.4" "s" COEFFS 0 1 0 0 0 0.01 /end COMPU_METHOD
/begin COMPU_METHOD t10msxs_ub_b2p55 "" RAT_FUNC "%6.4" "s" COEFFS 0 1 0 0 0 0.01 /end COMPU_METHOD
/begin COMPU_METHOD t10msxs_uw_b655p35 "" RAT_FUNC "%6.4" "s" COEFFS 0 1 0 0 0 0.01 /end COMPU_METHOD
/begin COMPU_METHOD t1sxs_uw_q1 "" RAT_FUNC "%6.2" "s" COEFFS 0 1 0 0 0 1 /end COMPU_METHOD
/begin COMPU_METHOD t20usxus_q20 "" RAT_FUNC "%6.1" "us" COEFFS 0 1 0 0 0 20 /end COMPU_METHOD
/begin COMPU_METHOD t6minxmin_q6 "" RAT_FUNC "%6.3" "h" COEFFS 0 10 0 0 0 1 /end COMPU_METHOD
/begin COMPU_METHOD temp_ub_b191p25 "" RAT_FUNC "%6.3" "Grad C" COEFFS 0 1 0 0 0 0.75 /end COMPU_METHOD
/begin COMPU_METHOD temp_ub_q0p75_o48 "" RAT_FUNC "%6.2" "Grad C" COEFFS 0 1 48 0 0 0.75 /end COMPU_METHOD
/begin COMPU_METHOD temp_ub_q1_o40 "" RAT_FUNC "%6.2" "Grad C" COEFFS 0 1 40 0 0 1 /end COMPU_METHOD
/begin COMPU_METHOD temp_ub_q5_o50 "" RAT_FUNC "%6.2" "Grad C" COEFFS 0 1 50 0 0 5 /end COMPU_METHOD
/begin COMPU_METHOD time_uw_ms "" RAT_FUNC "%6.4" "ms" COEFFS 0 65536 0 0 0 104.858 /end COMPU_METHOD
/begin COMPU_METHOD tinjection5_sy "" RAT_FUNC "%6.4" "ms" COEFFS 0 62.5 0 0 0 1 /end COMPU_METHOD
/begin COMPU_METHOD tinjection_sy "" RAT_FUNC "%6.4" "ms" COEFFS 0 312.5 0 0 0 1 /end COMPU_METHOD
/begin COMPU_METHOD tmin_uw_qms "" RAT_FUNC "%6.3" "s" COEFFS 0 1 0 0 0 0.1 /end COMPU_METHOD
/begin COMPU_METHOD tsquant "Umrechnung Segmentzeit in DMD" RAT_FUNC "%6.2" "us" COEFFS 0 1.25 0 0 0 1 /end COMPU_METHOD
/begin COMPU_METHOD tsync_q3p2us "" RAT_FUNC "%8.7" "s" COEFFS 0 312500 0 0 0 1 /end COMPU_METHOD
/begin COMPU_METHOD tv_ub_b100 "" RAT_FUNC "%6.3" "%" COEFFS 0 256 0 0 0 100 /end COMPU_METHOD
/begin COMPU_METHOD txms_ub_q0p1 "" RAT_FUNC "%6.3" "ms" COEFFS 0 10 0 0 0 1 /end COMPU_METHOD
/begin COMPU_METHOD txms_uw_q0p1 "" RAT_FUNC "%6.3" "ms" COEFFS 0 10 0 0 0 1 /end COMPU_METHOD
/begin COMPU_METHOD tz10msxs_uw_b327p68 "" RAT_FUNC "%6.2" "s" COEFFS 0 0 327.68 0 1 0 /end COMPU_METHOD
/begin COMPU_METHOD vfzgmph_uw_q0p00781 "" RAT_FUNC "%6.4" "mph" COEFFS 0 1.609 0 0 0 0.0078125 /end COMPU_METHOD
/begin COMPU_METHOD vfzg_sw_q0p00781 "" RAT_FUNC "%6.4" "km/h" COEFFS 0 1 0 0 0 0.0078125 /end COMPU_METHOD
/begin COMPU_METHOD vfzg_ub_q1p25 "" RAT_FUNC "%6.2" "km/h" COEFFS 0 1 0 0 0 1.25 /end COMPU_METHOD
/begin COMPU_METHOD vfzg_uw_q0p00781 "" RAT_FUNC "%6.4" "km/h" COEFFS 0 1 0 0 0 0.0078125 /end COMPU_METHOD
/begin COMPU_METHOD wkw_ub_q0p25 "" RAT_FUNC "%6.3" "° KW" COEFFS 0 100 0 0 0 25 /end COMPU_METHOD
/begin COMPU_METHOD zk100msxs_ub_b25p5 "" RAT_FUNC "%6.3" "s" COEFFS 0 0 256 0 10 0 /end COMPU_METHOD
/begin COMPU_METHOD zk10msxs_ub_b2p55 "" RAT_FUNC "%6.4" "s" COEFFS 0 0 255 0 100 0 /end COMPU_METHOD
/begin COMPU_METHOD zk10msxs_uw_b655 "" RAT_FUNC "%6.2" "s" COEFFS 0 0 65536 0 100 0 /end COMPU_METHOD
/begin COMPU_METHOD zk200msxs_uw_b13107 "" RAT_FUNC "%10.2" "s" COEFFS 0 0 13107.2 0 1 0 /end COMPU_METHOD
/begin COMPU_METHOD zw_sb_q0p75 "" RAT_FUNC "%6.3" "grad KW" COEFFS 0 255 0 0 0 191.25 /end COMPU_METHOD
/begin COMPU_METHOD zw_sb_q6 "" RAT_FUNC "%6.2" "Grad KW" COEFFS 0 1 0 0 0 6 /end COMPU_METHOD
/begin COMPU_METHOD default "" RAT_FUNC "%6.2" "" COEFFS 0 1 0 0 0 1 /end COMPU_METHOD
/begin RECORD_LAYOUT FklWSb FNC_VALUES 1 SBYTE COLUMN_DIR DIRECT /end RECORD_LAYOUT
/begin RECORD_LAYOUT FklWUb FNC_VALUES 1 UBYTE COLUMN_DIR DIRECT /end RECORD_LAYOUT
/begin RECORD_LAYOUT FklWUw FNC_VALUES 1 UWORD COLUMN_DIR DIRECT /end RECORD_LAYOUT
/begin RECORD_LAYOUT GkfWSb FNC_VALUES 1 SBYTE COLUMN_DIR DIRECT /end RECORD_LAYOUT
/begin RECORD_LAYOUT GkfWSw FNC_VALUES 1 SWORD COLUMN_DIR DIRECT /end RECORD_LAYOUT
/begin RECORD_LAYOUT GkfWUb FNC_VALUES 1 UBYTE COLUMN_DIR DIRECT /end RECORD_LAYOUT
/begin RECORD_LAYOUT GkfWUw FNC_VALUES 1 UWORD COLUMN_DIR DIRECT /end RECORD_LAYOUT
/begin RECORD_LAYOUT GklWSb FNC_VALUES 1 SBYTE COLUMN_DIR DIRECT /end RECORD_LAYOUT
/begin RECORD_LAYOUT GklWSw FNC_VALUES 1 SWORD COLUMN_DIR DIRECT /end RECORD_LAYOUT
/begin RECORD_LAYOUT KfAxUbAyUbSstxUbSstyUbWSb NO_AXIS_PTS_X 1 UBYTE NO_AXIS_PTS_Y 2 UBYTE AXIS_PTS_X 3 UBYTE INDEX_INCR DIRECT AXIS_PTS_Y 4 UBYTE INDEX_INCR DIRECT FNC_VALUES 5 SBYTE COLUMN_DIR DIRECT /end RECORD_LAYOUT
/begin RECORD_LAYOUT KfAxUbAyUbSstxUbSstyUbWUb NO_AXIS_PTS_X 1 UBYTE NO_AXIS_PTS_Y 2 UBYTE AXIS_PTS_X 3 UBYTE INDEX_INCR DIRECT AXIS_PTS_Y 4 UBYTE INDEX_INCR DIRECT FNC_VALUES 5 UBYTE COLUMN_DIR DIRECT /end RECORD_LAYOUT
/begin RECORD_LAYOUT KfAxUbAyUbSstxUbSstyUwWUb NO_AXIS_PTS_X 1 UBYTE NO_AXIS_PTS_Y 2 UBYTE AXIS_PTS_X 3 UBYTE INDEX_INCR DIRECT AXIS_PTS_Y 4 UWORD INDEX_INCR DIRECT FNC_VALUES 5 UBYTE COLUMN_DIR DIRECT /end RECORD_LAYOUT
/begin RECORD_LAYOUT KfAxUbAyUbSstxUbSstyUwWUw NO_AXIS_PTS_X 1 UBYTE NO_AXIS_PTS_Y 2 UBYTE AXIS_PTS_X 3 UBYTE INDEX_INCR DIRECT AXIS_PTS_Y 4 UWORD INDEX_INCR DIRECT FNC_VALUES 5 UWORD COLUMN_DIR DIRECT /end RECORD_LAYOUT
/begin RECORD_LAYOUT KfAxUwAyUwSstxUwSstyUwWUw NO_AXIS_PTS_X 1 UWORD NO_AXIS_PTS_Y 2 UWORD AXIS_PTS_X 3 UWORD INDEX_INCR DIRECT AXIS_PTS_Y 4 UWORD INDEX_INCR DIRECT FNC_VALUES 5 UWORD COLUMN_DIR DIRECT /end RECORD_LAYOUT
/begin RECORD_LAYOUT KlAUbSstUbWSb NO_AXIS_PTS_X 1 UBYTE AXIS_PTS_X 2 UBYTE INDEX_INCR DIRECT FNC_VALUES 3 SBYTE COLUMN_DIR DIRECT /end RECORD_LAYOUT
/begin RECORD_LAYOUT KlAUbSstUbWUb NO_AXIS_PTS_X 1 UBYTE AXIS_PTS_X 2 UBYTE INDEX_INCR DIRECT FNC_VALUES 3 UBYTE COLUMN_DIR DIRECT /end RECORD_LAYOUT
/begin RECORD_LAYOUT KlAUbSstUbWUw NO_AXIS_PTS_X 1 UBYTE AXIS_PTS_X 2 UBYTE INDEX_INCR DIRECT FNC_VALUES 3 UWORD COLUMN_DIR DIRECT /end RECORD_LAYOUT
/begin RECORD_LAYOUT KlAUwSstUwWUb NO_AXIS_PTS_X 1 UWORD AXIS_PTS_X 2 UWORD INDEX_INCR DIRECT FNC_VALUES 3 UBYTE COLUMN_DIR DIRECT /end RECORD_LAYOUT
/begin RECORD_LAYOUT KlAUwSstUwWUw NO_AXIS_PTS_X 1 UWORD AXIS_PTS_X 2 UWORD INDEX_INCR DIRECT FNC_VALUES 3 UWORD COLUMN_DIR DIRECT /end RECORD_LAYOUT
/begin RECORD_LAYOUT KwbUw FNC_VALUES 1 UWORD COLUMN_DIR DIRECT /end RECORD_LAYOUT
/begin RECORD_LAYOUT KwSb FNC_VALUES 1 SBYTE COLUMN_DIR DIRECT /end RECORD_LAYOUT
/begin RECORD_LAYOUT KwSw FNC_VALUES 1 SWORD COLUMN_DIR DIRECT /end RECORD_LAYOUT
/begin RECORD_LAYOUT KwUb FNC_VALUES 1 UBYTE COLUMN_DIR DIRECT /end RECORD_LAYOUT
/begin RECORD_LAYOUT KwUw FNC_VALUES 1 UWORD COLUMN_DIR DIRECT /end RECORD_LAYOUT
/begin RECORD_LAYOUT SstAUbSstUb NO_AXIS_PTS_X 1 UBYTE AXIS_PTS_X 2 UBYTE INDEX_INCR DIRECT /end RECORD_LAYOUT
/begin RECORD_LAYOUT SstAUwSstUw NO_AXIS_PTS_X 1 UWORD AXIS_PTS_X 2 UWORD INDEX_INCR DIRECT /end RECORD_LAYOUT
/end MODULE
/end PROJECT
