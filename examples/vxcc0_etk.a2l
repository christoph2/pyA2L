/begin PROJECT DPU-2XX "Visteon Diesel"
/begin HEADER " " VERSION "1" PROJECT_NO Global /end HEADER
/begin MODULE ENGINE "International Engine Controller"
/begin MOD_COMMON " " BYTE_ORDER MSB_FIRST /end MOD_COMMON
/begin CHARACTERISTIC SYNC_LOSS_CKP_CNT_RUN "Crank sync. loss  during engine run, fault decl. limit value" VALUE 0x5D8A0 SD_UBYTE 0 SC_SYNC_LOSS_CKP_CNT_RUN 0 255 /end CHARACTERISTIC
/begin COMPU_METHOD SC_SYNC_LOSS_CKP_CNT_RUN "SYNC_LOSS_CKP_CNT_RUN conversion" RAT_FUNC "%3.0" "unitless" COEFFS 0 1 0 0 0 1 /end COMPU_METHOD
/begin MEASUREMENT SYNC_LOSS_CKP_CRANK_FLT_FLG "Indicates  crank sync. loss  fault during crank" UBYTE MC_SYNC_LOSS_CKP_CRANK_FLT_FLG 0 0 0 0 ECU_ADDRESS 0x3FA648 /end MEASUREMENT
/begin COMPU_METHOD MC_SYNC_LOSS_CKP_CRANK_FLT_FLG "SYNC_LOSS_CKP_CRANK_FLT_FLG conversion" RAT_FUNC "%3.0" "Unitless" COEFFS 0 1 0 0 0 1 /end COMPU_METHOD
/begin MEASUREMENT SYNC_LOSS_CKP_RUN_FLT_FLG "Indicates  crank sync. loss  fault during engine run" UBYTE MC_SYNC_LOSS_CKP_RUN_FLT_FLG 0 0 0 0 ECU_ADDRESS 0x3FA644 /end MEASUREMENT
/begin COMPU_METHOD MC_SYNC_LOSS_CKP_RUN_FLT_FLG "SYNC_LOSS_CKP_RUN_FLT_FLG conversion" RAT_FUNC "%3.0" "Unitless" COEFFS 0 1 0 0 0 1 /end COMPU_METHOD
/begin MEASUREMENT SYNC_LOSS_CMP_CNTR_IN_NORUN "Cam sync. loss fault counter  when eng. is not running" UBYTE MC_SYNC_LOSS_CMP_CNTR_IN_NORUN 0 0 0 0 ECU_ADDRESS 0x3FA64E /end MEASUREMENT
/begin COMPU_METHOD MC_SYNC_LOSS_CMP_CNTR_IN_NORUN "SYNC_LOSS_CMP_CNTR_IN_NORUN conversion" RAT_FUNC "%3.0" "Unitless" COEFFS 0 1 0 0 0 1 /end COMPU_METHOD
/begin CHARACTERISTIC SYNC_LOSS_CMP_CNT_CRANK "Cam sync. loss during crank, fault decl. limit value" VALUE 0x5D8A6 SD_UBYTE 0 SC_SYNC_LOSS_CMP_CNT_CRANK 0 255 /end CHARACTERISTIC
/begin COMPU_METHOD SC_SYNC_LOSS_CMP_CNT_CRANK "SYNC_LOSS_CMP_CNT_CRANK conversion" RAT_FUNC "%3.0" "unitless" COEFFS 0 1 0 0 0 1 /end COMPU_METHOD
/begin CHARACTERISTIC SYNC_LOSS_CMP_CNT_RUN "Cam sync. loss during engine run, fault decl. limit value" VALUE 0x5D8A2 SD_UBYTE 0 SC_SYNC_LOSS_CMP_CNT_RUN 0 255 /end CHARACTERISTIC
/begin COMPU_METHOD SC_SYNC_LOSS_CMP_CNT_RUN "SYNC_LOSS_CMP_CNT_RUN conversion" RAT_FUNC "%3.0" "unitless" COEFFS 0 1 0 0 0 1 /end COMPU_METHOD
/begin MEASUREMENT SYNC_LOSS_CMP_CRANK_FLT_FLG "Indicates cam sync. loss during crank" UBYTE MC_SYNC_LOSS_CMP_CRANK_FLT_FLG 0 0 0 0 ECU_ADDRESS 0x3FA64A /end MEASUREMENT
/begin COMPU_METHOD MC_SYNC_LOSS_CMP_CRANK_FLT_FLG "SYNC_LOSS_CMP_CRANK_FLT_FLG conversion" RAT_FUNC "%3.0" "Unitless" COEFFS 0 1 0 0 0 1 /end COMPU_METHOD
/begin MEASUREMENT SYNC_LOSS_CMP_RUN_FLT_FLG "Indicates  cam sync. loss during engine run" UBYTE MC_SYNC_LOSS_CMP_RUN_FLT_FLG 0 0 0 0 ECU_ADDRESS 0x3FA646 /end MEASUREMENT
/begin COMPU_METHOD MC_SYNC_LOSS_CMP_RUN_FLT_FLG "SYNC_LOSS_CMP_RUN_FLT_FLG conversion" RAT_FUNC "%3.0" "Unitless" COEFFS 0 1 0 0 0 1 /end COMPU_METHOD
/begin MEASUREMENT SYNFLG "SYNCTR IN SYNC WITH SIG PIP" UBYTE MC_SYNFLG 0 0 0 0 ECU_ADDRESS 0x3F9CEA /end MEASUREMENT
/begin COMPU_METHOD MC_SYNFLG "SYNFLG conversion" RAT_FUNC "%3.0" "Unitless" COEFFS 0 1 0 0 0 1 /end COMPU_METHOD
/begin MEASUREMENT SYS_RUN "" UBYTE MC_SYS_RUN 0 0 0 0 ECU_ADDRESS 0x3FB6B4 /end MEASUREMENT
/begin COMPU_METHOD MC_SYS_RUN "SYS_RUN conversion" RAT_FUNC "%3.0" "Unitless" COEFFS 0 1 0 0 0 1 /end COMPU_METHOD
/begin MEASUREMENT TASKTIMER_16MS "" FLOAT32_IEEE MC_TASKTIMER_16MS 0 0 0 0 ECU_ADDRESS 0x3FB744 /end MEASUREMENT
/begin COMPU_METHOD MC_TASKTIMER_16MS "TASKTIMER_16MS conversion" RAT_FUNC "%10.5" "Unitless" COEFFS 0 1 0 0 0 1 /end COMPU_METHOD
/begin MEASUREMENT TASKTIMER_30MS "" FLOAT32_IEEE MC_TASKTIMER_30MS 0 0 0 0 ECU_ADDRESS 0x3FB670 /end MEASUREMENT
/begin COMPU_METHOD MC_TASKTIMER_30MS "TASKTIMER_30MS conversion" RAT_FUNC "%10.5" "Unitless" COEFFS 0 1 0 0 0 1 /end COMPU_METHOD
/begin MEASUREMENT TASKTIMER_4MS "" FLOAT32_IEEE MC_TASKTIMER_4MS 0 0 0 0 ECU_ADDRESS 0x3FB74C /end MEASUREMENT
/begin COMPU_METHOD MC_TASKTIMER_4MS "TASKTIMER_4MS conversion" RAT_FUNC "%10.5" "Unitless" COEFFS 0 1 0 0 0 1 /end COMPU_METHOD
/begin MEASUREMENT TASKTIMER_8MS "" FLOAT32_IEEE MC_TASKTIMER_8MS 0 0 0 0 ECU_ADDRESS 0x3FB748 /end MEASUREMENT
/begin COMPU_METHOD MC_TASKTIMER_8MS "TASKTIMER_8MS conversion" RAT_FUNC "%10.5" "Unitless" COEFFS 0 1 0 0 0 1 /end COMPU_METHOD
/begin MEASUREMENT TASKTIMER_BG "" FLOAT32_IEEE MC_TASKTIMER_BG 0 0 0 0 ECU_ADDRESS 0x3FB66C /end MEASUREMENT
/begin COMPU_METHOD MC_TASKTIMER_BG "TASKTIMER_BG conversion" RAT_FUNC "%10.5" "Unitless" COEFFS 0 1 0 0 0 1 /end COMPU_METHOD
/begin MEASUREMENT TASKTIMER_PIP "" FLOAT32_IEEE MC_TASKTIMER_PIP 0 0 0 0 ECU_ADDRESS 0x3F9AB4 /end MEASUREMENT
/begin COMPU_METHOD MC_TASKTIMER_PIP "TASKTIMER_PIP conversion" RAT_FUNC "%10.5" "Unitless" COEFFS 0 1 0 0 0 1 /end COMPU_METHOD
/begin CHARACTERISTIC TASKTMR_HALFPIP "" VALUE 0x5C484 SD_UBYTE 0 SC_TASKTMR_HALFPIP 0 1 /end CHARACTERISTIC
/begin COMPU_METHOD SC_TASKTMR_HALFPIP "TASKTMR_HALFPIP conversion" RAT_FUNC "%3.0" "unitless" COEFFS 0 1 0 0 0 1 /end COMPU_METHOD
/begin MEASUREMENT TCAN_BUSERRFLGS2 "TouCAN bus error flags, saved each message rx" UWORD MC_TCAN_BUSERRFLGS2 0 0 0 0 ECU_ADDRESS 0x3F9824 /end MEASUREMENT
/begin COMPU_METHOD MC_TCAN_BUSERRFLGS2 "TCAN_BUSERRFLGS2 conversion" RAT_FUNC "%5.0" "Unitless" COEFFS 0 1 0 0 0 1 /end COMPU_METHOD
/begin MEASUREMENT TCM_TQ_INC "Transmission Controller torque increase" UBYTE MC_TCM_TQ_INC 0 0 0 0 ECU_ADDRESS 0x3FA2B3 /end MEASUREMENT
/begin COMPU_METHOD MC_TCM_TQ_INC "TCM_TQ_INC conversion" RAT_FUNC "%3.0" "Unitless" COEFFS 0 1 0 0 0 1 /end COMPU_METHOD
/begin MEASUREMENT TCM_TQ_RED "Transmission Controller torque reduction" UBYTE MC_TCM_TQ_RED 0 0 0 0 ECU_ADDRESS 0x3FA2B2 /end MEASUREMENT
/begin COMPU_METHOD MC_TCM_TQ_RED "TCM_TQ_RED conversion" RAT_FUNC "%3.0" "Unitless" COEFFS 0 1 0 0 0 1 /end COMPU_METHOD
/begin MEASUREMENT TCSTRT "Coolant temperature at start." FLOAT32_IEEE MC_TCSTRT 0 0 0 0 ECU_ADDRESS 0x3F9F48 /end MEASUREMENT
/begin COMPU_METHOD MC_TCSTRT "TCSTRT conversion" RAT_FUNC "%10.5" "Unitless" COEFFS 0 1 0 0 0 1 /end COMPU_METHOD
/begin CHARACTERISTIC TC_BP_REC "Time constant for BP filter during fault recovery and during failure occurance before malf is set" VALUE 0x5CF08 SD_FLOAT32_IEEE 0 SC_TC_BP_REC 0 64 /end CHARACTERISTIC
/begin COMPU_METHOD SC_TC_BP_REC "TC_BP_REC conversion" RAT_FUNC "%10.5" "s" COEFFS 0 1 0 0 0 1 /end COMPU_METHOD
/begin CHARACTERISTIC TC_EBP_REC "Time constant for EBP filter" VALUE 0x5D5C4 SD_FLOAT32_IEEE 0 SC_TC_EBP_REC 0 65535 /end CHARACTERISTIC
/begin COMPU_METHOD SC_TC_EBP_REC "TC_EBP_REC conversion" RAT_FUNC "%10.5" "unitless" COEFFS 0 1 0 0 0 1 /end COMPU_METHOD
/begin CHARACTERISTIC TC_ECT_REC "Time constant for ECT filter." VALUE 0x5D01C SD_FLOAT32_IEEE 0 SC_TC_ECT_REC 0 64 /end CHARACTERISTIC
/begin COMPU_METHOD SC_TC_ECT_REC "TC_ECT_REC conversion" RAT_FUNC "%10.5" "s" COEFFS 0 1 0 0 0 1 /end COMPU_METHOD
/begin CHARACTERISTIC TC_EGRP_REC "Time constant for EGRP filter during fault recovery and during failure occurance before malf is set" VALUE 0x5D090 SD_FLOAT32_IEEE 0 SC_TC_EGRP_REC 0 64 /end CHARACTERISTIC
/begin COMPU_METHOD SC_TC_EGRP_REC "TC_EGRP_REC conversion" RAT_FUNC "%10.5" "s" COEFFS 0 1 0 0 0 1 /end COMPU_METHOD
/begin CHARACTERISTIC TC_EOT_REC "time constant for eot filter" VALUE 0x5CF7C SD_FLOAT32_IEEE 0 SC_TC_EOT_REC 0 64 /end CHARACTERISTIC
/begin COMPU_METHOD SC_TC_EOT_REC "TC_EOT_REC conversion" RAT_FUNC "%10.5" "s" COEFFS 0 1 0 0 0 1 /end COMPU_METHOD
/begin CHARACTERISTIC TC_FLI_EXT "Time constant for filtered fuel level with extended range" VALUE 0x5D104 SD_FLOAT32_IEEE 0 SC_TC_FLI_EXT 0 1023.98 /end CHARACTERISTIC
/begin COMPU_METHOD SC_TC_FLI_EXT "TC_FLI_EXT conversion" RAT_FUNC "%10.5" "s" COEFFS 0 1 0 0 0 1 /end COMPU_METHOD
/begin CHARACTERISTIC TC_IAT_REC "Time constant for IAT filter during fault recovery and during failure occurance before malf is set" VALUE 0x5D550 SD_FLOAT32_IEEE 0 SC_TC_IAT_REC 0 64 /end CHARACTERISTIC
/begin COMPU_METHOD SC_TC_IAT_REC "TC_IAT_REC conversion" RAT_FUNC "%10.5" "s" COEFFS 0 1 0 0 0 1 /end COMPU_METHOD
/begin CHARACTERISTIC TC_ICP_REC "time constant for icp filter" VALUE 0x5D1F8 SD_FLOAT32_IEEE 0 SC_TC_ICP_REC 0 64 /end CHARACTERISTIC
/begin COMPU_METHOD SC_TC_ICP_REC "TC_ICP_REC conversion" RAT_FUNC "%10.5" "s" COEFFS 0 1 0 0 0 1 /end COMPU_METHOD
/begin CHARACTERISTIC TC_ITHP_REC "Time constant for ITHP filter during fault recovery and during failure occurance before malf is set" VALUE 0x5D5E0 SD_FLOAT32_IEEE 0 SC_TC_ITHP_REC 0 64 /end CHARACTERISTIC
/begin COMPU_METHOD SC_TC_ITHP_REC "TC_ITHP_REC conversion" RAT_FUNC "%10.5" "s" COEFFS 0 1 0 0 0 1 /end COMPU_METHOD
/begin CHARACTERISTIC TC_IVPWR_REC "Time constant for IVPWR filter during fault recovery and during failure occurance before malf is set" VALUE 0x5D630 SD_FLOAT32_IEEE 0 SC_TC_IVPWR_REC 0 64 /end CHARACTERISTIC
/begin COMPU_METHOD SC_TC_IVPWR_REC "TC_IVPWR_REC conversion" RAT_FUNC "%10.5" "s" COEFFS 0 1 0 0 0 1 /end COMPU_METHOD
/begin CHARACTERISTIC TC_MAF "Time constant for filtering 'MAF'" VALUE 0x5D2A4 SD_FLOAT32_IEEE 0 SC_TC_MAF 0 64 /end CHARACTERISTIC
/begin COMPU_METHOD SC_TC_MAF "TC_MAF conversion" RAT_FUNC "%10.5" "s" COEFFS 0 1 0 0 0 1 /end COMPU_METHOD
/begin CHARACTERISTIC TC_MAF_REC "Time constant for MAF filter during fault recovery and during failure occurance before malf is set" VALUE 0x5D2A0 SD_FLOAT32_IEEE 0 SC_TC_MAF_REC 0 64 /end CHARACTERISTIC
/begin COMPU_METHOD SC_TC_MAF_REC "TC_MAF_REC conversion" RAT_FUNC "%10.5" "s" COEFFS 0 1 0 0 0 1 /end COMPU_METHOD
/begin CHARACTERISTIC TC_MAP_REC "Time constant for MAP filter during fault recovery and during failure occurance before malf is set" VALUE 0x5D38C SD_FLOAT32_IEEE 0 SC_TC_MAP_REC 0 64 /end CHARACTERISTIC
/begin COMPU_METHOD SC_TC_MAP_REC "TC_MAP_REC conversion" RAT_FUNC "%10.5" "s" COEFFS 0 1 0 0 0 1 /end COMPU_METHOD
/begin CHARACTERISTIC TC_MAT_REC "Time constant for MAT filter during fault recovery and during failure occurance before malf is set" VALUE 0x5D398 SD_FLOAT32_IEEE 0 SC_TC_MAT_REC 0 64 /end CHARACTERISTIC
/begin COMPU_METHOD SC_TC_MAT_REC "TC_MAT_REC conversion" RAT_FUNC "%10.5" "s" COEFFS 0 1 0 0 0 1 /end COMPU_METHOD
/begin CHARACTERISTIC TC_PPS_MAX "Pedal position filter constant" VALUE 0x5D4F0 SD_FLOAT32_IEEE 0 SC_TC_PPS_MAX 0 64 /end CHARACTERISTIC
/begin COMPU_METHOD SC_TC_PPS_MAX "TC_PPS_MAX conversion" RAT_FUNC "%10.5" "s" COEFFS 0 1 0 0 0 1 /end COMPU_METHOD
/begin CHARACTERISTIC TC_PPS_MIN "Pedal position filter constant" VALUE 0x5D4EC SD_FLOAT32_IEEE 0 SC_TC_PPS_MIN 0 64 /end CHARACTERISTIC
/begin COMPU_METHOD SC_TC_PPS_MIN "TC_PPS_MIN conversion" RAT_FUNC "%10.5" "s" COEFFS 0 1 0 0 0 1 /end COMPU_METHOD
/begin MEASUREMENT TDCENGSPDLST "Transmission Diagnostic Calculations Last Pass Engine speed (RPM)." FLOAT32_IEEE MC_TDCENGSPDLST 0 0 0 0 ECU_ADDRESS 0x3FA668 /end MEASUREMENT
/begin COMPU_METHOD MC_TDCENGSPDLST "TDCENGSPDLST conversion" RAT_FUNC "%10.5" "Unitless" COEFFS 0 1 0 0 0 1 /end COMPU_METHOD
/begin MEASUREMENT TDC_DNDTI "Transmission Diagnostics Calculations Derivitive of Engine RPM (unfiltered)" FLOAT32_IEEE MC_TDC_DNDTI 0 0 0 0 ECU_ADDRESS 0x3FA664 /end MEASUREMENT
/begin COMPU_METHOD MC_TDC_DNDTI "TDC_DNDTI conversion" RAT_FUNC "%10.5" "Unitless" COEFFS 0 1 0 0 0 1 /end COMPU_METHOD
/begin MEASUREMENT TDC_TQ_DLT_TM "Last Pass Time of the TDC Level50 task." FLOAT32_IEEE MC_TDC_TQ_DLT_TM 0 0 0 0 ECU_ADDRESS 0x3FA660 /end MEASUREMENT
/begin COMPU_METHOD MC_TDC_TQ_DLT_TM "TDC_TQ_DLT_TM conversion" RAT_FUNC "%10.5" "Unitless" COEFFS 0 1 0 0 0 1 /end COMPU_METHOD
/begin CHARACTERISTIC TEMPFB "Minimum ECT required to start ATMR2 timer." VALUE 0x5F28C SD_FLOAT32_IEEE 0 SC_TEMPFB -40 254 /end CHARACTERISTIC
/begin COMPU_METHOD SC_TEMPFB "TEMPFB conversion" RAT_FUNC "%10.5" "not appl" COEFFS 0 1 0 0 0 1 /end COMPU_METHOD
/begin MEASUREMENT TEST_REQUEST_AND_RESPONSE "IDM test request (bits 1-4) and response (bits 5-8)" UBYTE MC_TEST_REQUEST_AND_RESPONSE 0 0 0 0 ECU_ADDRESS 0x3FA29D /end MEASUREMENT
/begin COMPU_METHOD MC_TEST_REQUEST_AND_RESPONSE "TEST_REQUEST_AND_RESPONSE conversion" RAT_FUNC "%3.0" "Unitless" COEFFS 0 1 0 0 0 1 /end COMPU_METHOD
/begin MEASUREMENT TEST_REQUEST_AND_RESPONSE_RX "IDM Test request & response byte" UBYTE MC_TEST_REQUEST_AND_RESPONSE_RX 0 0 0 0 ECU_ADDRESS 0x3F995F /end MEASUREMENT
/begin COMPU_METHOD MC_TEST_REQUEST_AND_RESPONSE_RX "TEST_REQUEST_AND_RESPONSE_RX conversion" RAT_FUNC "%3.0" "Unitless" COEFFS 0 1 0 0 0 1 /end COMPU_METHOD
/begin MEASUREMENT TFMFLG "Throttle position sensor FMEM flag." UBYTE MC_TFMFLG 0 0 0 0 ECU_ADDRESS 0x3FA2B1 /end MEASUREMENT
/begin COMPU_METHOD MC_TFMFLG "TFMFLG conversion" RAT_FUNC "%3.0" "Unitless" COEFFS 0 1 0 0 0 1 /end COMPU_METHOD
/begin MEASUREMENT THEFT_STATE "State variable of the anti-theft control strategy." UBYTE MC_THEFT_STATE 0 0 0 0 ECU_ADDRESS 0x3FCC9F /end MEASUREMENT
/begin COMPU_METHOD MC_THEFT_STATE "THEFT_STATE conversion" RAT_FUNC "%3.0" "Unitless" COEFFS 0 1 0 0 0 1 /end COMPU_METHOD
/begin MEASUREMENT THEFT_TMR "Timer used in anti-theft strategy to measure time into run mode." FLOAT32_IEEE MC_THEFT_TMR 0 0 0 0 ECU_ADDRESS 0x3F9DC4 /end MEASUREMENT
/begin COMPU_METHOD MC_THEFT_TMR "THEFT_TMR conversion" RAT_FUNC "%10.5" "Unitless" COEFFS 0 1 0 0 0 1 /end COMPU_METHOD
/begin CHARACTERISTIC THRES_LOCK "Multiplier for misfire detection threshold when the torque convertor is locked." VALUE 0x5EE14 SD_FLOAT32_IEEE 0 SC_THRES_LOCK 0 1.99997 /end CHARACTERISTIC
/begin COMPU_METHOD SC_THRES_LOCK "THRES_LOCK conversion" RAT_FUNC "%10.5" "unitless" COEFFS 0 1 0 0 0 1 /end COMPU_METHOD
/begin CHARACTERISTIC THRMHP "Thermactor/super/inlet air control switch =0 DISABLES THERMACTOR, SUPERCHARGER, AND I.A.C LOGIC/OUTP" VALUE 0x5CB1C SD_UBYTE 0 SC_THRMHP 0 3 /end CHARACTERISTIC
/begin COMPU_METHOD SC_THRMHP "THRMHP conversion" RAT_FUNC "%3.0" "ENUMERATED" COEFFS 0 1 0 0 0 1 /end COMPU_METHOD
/begin CHARACTERISTIC TID_TRS_SLVL "The trs_stb_ctr value, above which, the transmission is considered to have stabalized." VALUE 0x5D960 SD_UBYTE 0 SC_TID_TRS_SLVL 0 255 /end CHARACTERISTIC
/begin COMPU_METHOD SC_TID_TRS_SLVL "TID_TRS_SLVL conversion" RAT_FUNC "%3.0" "events" COEFFS 0 1 0 0 0 1 /end COMPU_METHOD
/begin CHARACTERISTIC TIRE_REV "Tire revolutions per mile; used in conjunction with RT_AXLE to compute OSS/VSS ratio." VALUE 0x5D188 SD_FLOAT32_IEEE 0 SC_TIRE_REV 500 2000 /end CHARACTERISTIC
/begin COMPU_METHOD SC_TIRE_REV "TIRE_REV conversion" RAT_FUNC "%10.5" "rev" COEFFS 0 1 0 0 0 1 /end COMPU_METHOD
/begin CHARACTERISTIC TIRE_REV_MN "Minimum allowable tire revolutions per mile to be emission compliant." VALUE 0x5EF6C SD_ULONG 0 SC_TIRE_REV_MN 500 65535 /end CHARACTERISTIC
/begin COMPU_METHOD SC_TIRE_REV_MN "TIRE_REV_MN conversion" RAT_FUNC "%10.0" "rev" COEFFS 0 1 0 0 0 1 /end COMPU_METHOD
/begin CHARACTERISTIC TIRE_REV_MX "Maximum allowable tire revolutions per mile to be emission compliant." VALUE 0x5EF68 SD_ULONG 0 SC_TIRE_REV_MX 500 65535 /end CHARACTERISTIC
/begin COMPU_METHOD SC_TIRE_REV_MX "TIRE_REV_MX conversion" RAT_FUNC "%10.0" "rev" COEFFS 0 1 0 0 0 1 /end COMPU_METHOD
/begin CHARACTERISTIC TKYON2 "Time delay before keyon updates, seconds." VALUE 0x5D100 SD_FLOAT32_IEEE 0 SC_TKYON2 0 1 /end CHARACTERISTIC
/begin COMPU_METHOD SC_TKYON2 "TKYON2 conversion" RAT_FUNC "%10.5" "S" COEFFS 0 1 0 0 0 1 /end COMPU_METHOD
/begin MEASUREMENT TOOTHPERIOD[0] "" UWORD MC_TOOTHPERIOD 0 0 0 1 ECU_ADDRESS 0x3FB66A /end MEASUREMENT
/begin COMPU_METHOD MC_TOOTHPERIOD "TOOTHPERIOD conversion" RAT_FUNC "%5.0" "s" COEFFS 0 1 0 0 0 1 /end COMPU_METHOD
/begin MEASUREMENT TOOTHPERIOD[1] "" UWORD MC_TOOTHPERIOD 0 0 0 1 ECU_ADDRESS 0x3FB66C /end MEASUREMENT
/begin MEASUREMENT TOOTHPERIOD[2] "" UWORD MC_TOOTHPERIOD 0 0 0 1 ECU_ADDRESS 0x3FB66E /end MEASUREMENT
/begin MEASUREMENT TOOTHPERIOD[3] "" UWORD MC_TOOTHPERIOD 0 0 0 1 ECU_ADDRESS 0x3FB670 /end MEASUREMENT
/begin MEASUREMENT TOOTHPERIOD[4] "" UWORD MC_TOOTHPERIOD 0 0 0 1 ECU_ADDRESS 0x3FB672 /end MEASUREMENT
/begin MEASUREMENT TOOTHPERIOD[5] "" UWORD MC_TOOTHPERIOD 0 0 0 1 ECU_ADDRESS 0x3FB674 /end MEASUREMENT
/begin MEASUREMENT TOOTH_COUNT[0] "" UBYTE MC_TOOTH_COUNT 0 0 0 255 ECU_ADDRESS 0x3F988E /end MEASUREMENT
/begin COMPU_METHOD MC_TOOTH_COUNT "TOOTH_COUNT conversion" RAT_FUNC "%3.0" "unitless" COEFFS 0 1 0 0 0 1 /end COMPU_METHOD
/begin MEASUREMENT TOOTH_COUNT[10] "" UBYTE MC_TOOTH_COUNT 0 0 0 255 ECU_ADDRESS 0x3F9898 /end MEASUREMENT
/begin MEASUREMENT TOOTH_COUNT[11] "" UBYTE MC_TOOTH_COUNT 0 0 0 255 ECU_ADDRESS 0x3F9899 /end MEASUREMENT
/begin MEASUREMENT TOOTH_COUNT[12] "" UBYTE MC_TOOTH_COUNT 0 0 0 255 ECU_ADDRESS 0x3F989A /end MEASUREMENT
/begin MEASUREMENT TOOTH_COUNT[13] "" UBYTE MC_TOOTH_COUNT 0 0 0 255 ECU_ADDRESS 0x3F989B /end MEASUREMENT
/begin MEASUREMENT TOOTH_COUNT[14] "" UBYTE MC_TOOTH_COUNT 0 0 0 255 ECU_ADDRESS 0x3F989C /end MEASUREMENT
/begin MEASUREMENT TOOTH_COUNT[15] "" UBYTE MC_TOOTH_COUNT 0 0 0 255 ECU_ADDRESS 0x3F989D /end MEASUREMENT
/begin MEASUREMENT TOOTH_COUNT[16] "" UBYTE MC_TOOTH_COUNT 0 0 0 255 ECU_ADDRESS 0x3F989E /end MEASUREMENT
/begin MEASUREMENT TOOTH_COUNT[17] "" UBYTE MC_TOOTH_COUNT 0 0 0 255 ECU_ADDRESS 0x3F989F /end MEASUREMENT
/begin MEASUREMENT TOOTH_COUNT[18] "" UBYTE MC_TOOTH_COUNT 0 0 0 255 ECU_ADDRESS 0x3F98A0 /end MEASUREMENT
/begin MEASUREMENT TOOTH_COUNT[19] "" UBYTE MC_TOOTH_COUNT 0 0 0 255 ECU_ADDRESS 0x3F98A1 /end MEASUREMENT
/begin MEASUREMENT TOOTH_COUNT[1] "" UBYTE MC_TOOTH_COUNT 0 0 0 255 ECU_ADDRESS 0x3F988F /end MEASUREMENT
/begin MEASUREMENT TOOTH_COUNT[20] "" UBYTE MC_TOOTH_COUNT 0 0 0 255 ECU_ADDRESS 0x3F98A2 /end MEASUREMENT
/begin MEASUREMENT TOOTH_COUNT[21] "" UBYTE MC_TOOTH_COUNT 0 0 0 255 ECU_ADDRESS 0x3F98A3 /end MEASUREMENT
/begin MEASUREMENT TOOTH_COUNT[22] "" UBYTE MC_TOOTH_COUNT 0 0 0 255 ECU_ADDRESS 0x3F98A4 /end MEASUREMENT
/begin MEASUREMENT TOOTH_COUNT[23] "" UBYTE MC_TOOTH_COUNT 0 0 0 255 ECU_ADDRESS 0x3F98A5 /end MEASUREMENT
/begin MEASUREMENT TOOTH_COUNT[24] "" UBYTE MC_TOOTH_COUNT 0 0 0 255 ECU_ADDRESS 0x3F98A6 /end MEASUREMENT
/begin MEASUREMENT TOOTH_COUNT[25] "" UBYTE MC_TOOTH_COUNT 0 0 0 255 ECU_ADDRESS 0x3F98A7 /end MEASUREMENT
/begin MEASUREMENT TOOTH_COUNT[26] "" UBYTE MC_TOOTH_COUNT 0 0 0 255 ECU_ADDRESS 0x3F98A8 /end MEASUREMENT
/begin MEASUREMENT TOOTH_COUNT[27] "" UBYTE MC_TOOTH_COUNT 0 0 0 255 ECU_ADDRESS 0x3F98A9 /end MEASUREMENT
/begin MEASUREMENT TOOTH_COUNT[28] "" UBYTE MC_TOOTH_COUNT 0 0 0 255 ECU_ADDRESS 0x3F98AA /end MEASUREMENT
/begin MEASUREMENT TOOTH_COUNT[29] "" UBYTE MC_TOOTH_COUNT 0 0 0 255 ECU_ADDRESS 0x3F98AB /end MEASUREMENT
/begin MEASUREMENT TOOTH_COUNT[2] "" UBYTE MC_TOOTH_COUNT 0 0 0 255 ECU_ADDRESS 0x3F9890 /end MEASUREMENT
/begin MEASUREMENT TOOTH_COUNT[30] "" UBYTE MC_TOOTH_COUNT 0 0 0 255 ECU_ADDRESS 0x3F98AC /end MEASUREMENT
/begin MEASUREMENT TOOTH_COUNT[31] "" UBYTE MC_TOOTH_COUNT 0 0 0 255 ECU_ADDRESS 0x3F98AD /end MEASUREMENT
/begin MEASUREMENT TOOTH_COUNT[32] "" UBYTE MC_TOOTH_COUNT 0 0 0 255 ECU_ADDRESS 0x3F98AE /end MEASUREMENT
/begin MEASUREMENT TOOTH_COUNT[33] "" UBYTE MC_TOOTH_COUNT 0 0 0 255 ECU_ADDRESS 0x3F98AF /end MEASUREMENT
/begin MEASUREMENT TOOTH_COUNT[34] "" UBYTE MC_TOOTH_COUNT 0 0 0 255 ECU_ADDRESS 0x3F98B0 /end MEASUREMENT
/begin MEASUREMENT TOOTH_COUNT[35] "" UBYTE MC_TOOTH_COUNT 0 0 0 255 ECU_ADDRESS 0x3F98B1 /end MEASUREMENT
/begin MEASUREMENT TOOTH_COUNT[36] "" UBYTE MC_TOOTH_COUNT 0 0 0 255 ECU_ADDRESS 0x3F98B2 /end MEASUREMENT
/begin MEASUREMENT TOOTH_COUNT[37] "" UBYTE MC_TOOTH_COUNT 0 0 0 255 ECU_ADDRESS 0x3F98B3 /end MEASUREMENT
/begin MEASUREMENT TOOTH_COUNT[38] "" UBYTE MC_TOOTH_COUNT 0 0 0 255 ECU_ADDRESS 0x3F98B4 /end MEASUREMENT
/begin MEASUREMENT TOOTH_COUNT[39] "" UBYTE MC_TOOTH_COUNT 0 0 0 255 ECU_ADDRESS 0x3F98B5 /end MEASUREMENT
/begin MEASUREMENT TOOTH_COUNT[3] "" UBYTE MC_TOOTH_COUNT 0 0 0 255 ECU_ADDRESS 0x3F9891 /end MEASUREMENT
/begin MEASUREMENT TOOTH_COUNT[40] "" UBYTE MC_TOOTH_COUNT 0 0 0 255 ECU_ADDRESS 0x3F98B6 /end MEASUREMENT
/begin MEASUREMENT TOOTH_COUNT[41] "" UBYTE MC_TOOTH_COUNT 0 0 0 255 ECU_ADDRESS 0x3F98B7 /end MEASUREMENT
/begin MEASUREMENT TOOTH_COUNT[42] "" UBYTE MC_TOOTH_COUNT 0 0 0 255 ECU_ADDRESS 0x3F98B8 /end MEASUREMENT
/begin MEASUREMENT TOOTH_COUNT[43] "" UBYTE MC_TOOTH_COUNT 0 0 0 255 ECU_ADDRESS 0x3F98B9 /end MEASUREMENT
/begin MEASUREMENT TOOTH_COUNT[44] "" UBYTE MC_TOOTH_COUNT 0 0 0 255 ECU_ADDRESS 0x3F98BA /end MEASUREMENT
/begin MEASUREMENT TOOTH_COUNT[45] "" UBYTE MC_TOOTH_COUNT 0 0 0 255 ECU_ADDRESS 0x3F98BB /end MEASUREMENT
/begin MEASUREMENT TOOTH_COUNT[46] "" UBYTE MC_TOOTH_COUNT 0 0 0 255 ECU_ADDRESS 0x3F98BC /end MEASUREMENT
/begin MEASUREMENT TOOTH_COUNT[47] "" UBYTE MC_TOOTH_COUNT 0 0 0 255 ECU_ADDRESS 0x3F98BD /end MEASUREMENT
/begin MEASUREMENT TOOTH_COUNT[48] "" UBYTE MC_TOOTH_COUNT 0 0 0 255 ECU_ADDRESS 0x3F98BE /end MEASUREMENT
/begin MEASUREMENT TOOTH_COUNT[49] "" UBYTE MC_TOOTH_COUNT 0 0 0 255 ECU_ADDRESS 0x3F98BF /end MEASUREMENT
/begin MEASUREMENT TOOTH_COUNT[4] "" UBYTE MC_TOOTH_COUNT 0 0 0 255 ECU_ADDRESS 0x3F9892 /end MEASUREMENT
/begin MEASUREMENT TOOTH_COUNT[50] "" UBYTE MC_TOOTH_COUNT 0 0 0 255 ECU_ADDRESS 0x3F98C0 /end MEASUREMENT
/begin MEASUREMENT TOOTH_COUNT[51] "" UBYTE MC_TOOTH_COUNT 0 0 0 255 ECU_ADDRESS 0x3F98C1 /end MEASUREMENT
/begin MEASUREMENT TOOTH_COUNT[52] "" UBYTE MC_TOOTH_COUNT 0 0 0 255 ECU_ADDRESS 0x3F98C2 /end MEASUREMENT
/begin MEASUREMENT TOOTH_COUNT[53] "" UBYTE MC_TOOTH_COUNT 0 0 0 255 ECU_ADDRESS 0x3F98C3 /end MEASUREMENT
/begin MEASUREMENT TOOTH_COUNT[54] "" UBYTE MC_TOOTH_COUNT 0 0 0 255 ECU_ADDRESS 0x3F98C4 /end MEASUREMENT
/begin MEASUREMENT TOOTH_COUNT[55] "" UBYTE MC_TOOTH_COUNT 0 0 0 255 ECU_ADDRESS 0x3F98C5 /end MEASUREMENT
/begin MEASUREMENT TOOTH_COUNT[56] "" UBYTE MC_TOOTH_COUNT 0 0 0 255 ECU_ADDRESS 0x3F98C6 /end MEASUREMENT
/begin MEASUREMENT TOOTH_COUNT[57] "" UBYTE MC_TOOTH_COUNT 0 0 0 255 ECU_ADDRESS 0x3F98C7 /end MEASUREMENT
/begin MEASUREMENT TOOTH_COUNT[58] "" UBYTE MC_TOOTH_COUNT 0 0 0 255 ECU_ADDRESS 0x3F98C8 /end MEASUREMENT
/begin MEASUREMENT TOOTH_COUNT[59] "" UBYTE MC_TOOTH_COUNT 0 0 0 255 ECU_ADDRESS 0x3F98C9 /end MEASUREMENT
/begin MEASUREMENT TOOTH_COUNT[5] "" UBYTE MC_TOOTH_COUNT 0 0 0 255 ECU_ADDRESS 0x3F9893 /end MEASUREMENT
/begin MEASUREMENT TOOTH_COUNT[60] "" UBYTE MC_TOOTH_COUNT 0 0 0 255 ECU_ADDRESS 0x3F98CA /end MEASUREMENT
/begin MEASUREMENT TOOTH_COUNT[61] "" UBYTE MC_TOOTH_COUNT 0 0 0 255 ECU_ADDRESS 0x3F98CB /end MEASUREMENT
/begin MEASUREMENT TOOTH_COUNT[62] "" UBYTE MC_TOOTH_COUNT 0 0 0 255 ECU_ADDRESS 0x3F98CC /end MEASUREMENT
/begin MEASUREMENT TOOTH_COUNT[63] "" UBYTE MC_TOOTH_COUNT 0 0 0 255 ECU_ADDRESS 0x3F98CD /end MEASUREMENT
/begin MEASUREMENT TOOTH_COUNT[64] "" UBYTE MC_TOOTH_COUNT 0 0 0 255 ECU_ADDRESS 0x3F98CE /end MEASUREMENT
/begin MEASUREMENT TOOTH_COUNT[65] "" UBYTE MC_TOOTH_COUNT 0 0 0 255 ECU_ADDRESS 0x3F98CF /end MEASUREMENT
/begin MEASUREMENT TOOTH_COUNT[66] "" UBYTE MC_TOOTH_COUNT 0 0 0 255 ECU_ADDRESS 0x3F98D0 /end MEASUREMENT
/begin MEASUREMENT TOOTH_COUNT[67] "" UBYTE MC_TOOTH_COUNT 0 0 0 255 ECU_ADDRESS 0x3F98D1 /end MEASUREMENT
/begin MEASUREMENT TOOTH_COUNT[68] "" UBYTE MC_TOOTH_COUNT 0 0 0 255 ECU_ADDRESS 0x3F98D2 /end MEASUREMENT
/begin MEASUREMENT TOOTH_COUNT[69] "" UBYTE MC_TOOTH_COUNT 0 0 0 255 ECU_ADDRESS 0x3F98D3 /end MEASUREMENT
/begin MEASUREMENT TOOTH_COUNT[6] "" UBYTE MC_TOOTH_COUNT 0 0 0 255 ECU_ADDRESS 0x3F9894 /end MEASUREMENT
/begin MEASUREMENT TOOTH_COUNT[70] "" UBYTE MC_TOOTH_COUNT 0 0 0 255 ECU_ADDRESS 0x3F98D4 /end MEASUREMENT
/begin MEASUREMENT TOOTH_COUNT[71] "" UBYTE MC_TOOTH_COUNT 0 0 0 255 ECU_ADDRESS 0x3F98D5 /end MEASUREMENT
/begin MEASUREMENT TOOTH_COUNT[7] "" UBYTE MC_TOOTH_COUNT 0 0 0 255 ECU_ADDRESS 0x3F9895 /end MEASUREMENT
/begin MEASUREMENT TOOTH_COUNT[8] "" UBYTE MC_TOOTH_COUNT 0 0 0 255 ECU_ADDRESS 0x3F9896 /end MEASUREMENT
/begin MEASUREMENT TOOTH_COUNT[9] "" UBYTE MC_TOOTH_COUNT 0 0 0 255 ECU_ADDRESS 0x3F9897 /end MEASUREMENT
/begin MEASUREMENT TORQUE "Net engine torque to trans, used by output driver" FLOAT32_IEEE MC_TORQUE 0 0 0 0 ECU_ADDRESS 0x3FAA98 /end MEASUREMENT
/begin COMPU_METHOD MC_TORQUE "TORQUE conversion" RAT_FUNC "%10.5" "Unitless" COEFFS 0 1 0 0 0 1 /end COMPU_METHOD
/begin CHARACTERISTIC TORQUE_PEAK "Engine peak torque value (Net Torque), in Newton-meters for SCP. Cal with 4Nm per bit, range 0 - 1020Nm. 00h=unk." VALUE 0x5EF93 SD_UBYTE 0 SC_TORQUE_PEAK 0 1020 /end CHARACTERISTIC
/begin COMPU_METHOD SC_TORQUE_PEAK "TORQUE_PEAK conversion" RAT_FUNC "%3.0" "NM" COEFFS 0 1 0 0 0 1 /end COMPU_METHOD
/begin MEASUREMENT TOT "Transmission oil temperature, deg F." FLOAT32_IEEE MC_TOT 0 0 0 0 ECU_ADDRESS 0x3FB724 /end MEASUREMENT
/begin COMPU_METHOD MC_TOT "TOT conversion" RAT_FUNC "%10.5" "Unitless" COEFFS 0 1 0 0 0 1 /end COMPU_METHOD
/begin CHARACTERISTIC TOTAL_DISP "" VALUE 0x5E4A4 SD_FLOAT32_IEEE 0 SC_TOTAL_DISP 0 1 /end CHARACTERISTIC
/begin COMPU_METHOD SC_TOTAL_DISP "TOTAL_DISP conversion" RAT_FUNC "%10.5" "unitless" COEFFS 0 1 0 0 0 1 /end COMPU_METHOD
/begin MEASUREMENT TOTBGTOBG "Total cylinder events between misfire test background logic executions" UBYTE MC_TOTBGTOBG 0 0 0 0 ECU_ADDRESS 0x3FB3AB /end MEASUREMENT
/begin COMPU_METHOD MC_TOTBGTOBG "TOTBGTOBG conversion" RAT_FUNC "%3.0" "Unitless" COEFFS 0 1 0 0 0 1 /end COMPU_METHOD
/begin MEASUREMENT TOTEVENTS "cumulative cylinder events total carried over from previous background logic executions" ULONG MC_TOTEVENTS 0 0 0 0 ECU_ADDRESS 0x3FD040 /end MEASUREMENT
/begin COMPU_METHOD MC_TOTEVENTS "TOTEVENTS conversion" RAT_FUNC "%10.0" "Unitless" COEFFS 0 1 0 0 0 1 /end COMPU_METHOD
/begin MEASUREMENT TOTMISBGTOBG "total number of misfires between misfire test background ligic executions" UBYTE MC_TOTMISBGTOBG 0 0 0 0 ECU_ADDRESS 0x3FB3AA /end MEASUREMENT
/begin COMPU_METHOD MC_TOTMISBGTOBG "TOTMISBGTOBG conversion" RAT_FUNC "%3.0" "Unitless" COEFFS 0 1 0 0 0 1 /end COMPU_METHOD
/begin MEASUREMENT TOTMISFIL "overall misfire fault rolling average fault filter" FLOAT32_IEEE MC_TOTMISFIL 0 0 0 0 ECU_ADDRESS 0x3FB398 /end MEASUREMENT
/begin COMPU_METHOD MC_TOTMISFIL "TOTMISFIL conversion" RAT_FUNC "%10.5" "Unitless" COEFFS 0 1 0 0 0 1 /end COMPU_METHOD
/begin MEASUREMENT TOTMISLEVEL "calculated misfire threshold" FLOAT32_IEEE MC_TOTMISLEVEL 0 0 0 0 ECU_ADDRESS 0x3FB3BC /end MEASUREMENT
/begin COMPU_METHOD MC_TOTMISLEVEL "TOTMISLEVEL conversion" RAT_FUNC "%10.5" "Unitless" COEFFS 0 1 0 0 0 1 /end COMPU_METHOD
/begin MEASUREMENT TOTNOCALL "Cumulative cylinder events not tested by the misfire monitor." ULONG MC_TOTNOCALL 0 0 0 0 ECU_ADDRESS 0x3FD03C /end MEASUREMENT
/begin COMPU_METHOD MC_TOTNOCALL "TOTNOCALL conversion" RAT_FUNC "%10.0" "Unitless" COEFFS 0 1 0 0 0 1 /end COMPU_METHOD
/begin MEASUREMENT TOTNUMMIS "development register; number of misfire events tallyed (renamed from nummis to support 'C' conversion)." ULONG MC_TOTNUMMIS 0 0 0 0 ECU_ADDRESS 0x3FD044 /end MEASUREMENT
/begin COMPU_METHOD MC_TOTNUMMIS "TOTNUMMIS conversion" RAT_FUNC "%10.0" "Unitless" COEFFS 0 1 0 0 0 1 /end COMPU_METHOD
/begin MEASUREMENT TOT_DEGC "Transmission oil temperature, deg C." FLOAT32_IEEE MC_TOT_DEGC 0 0 0 0 ECU_ADDRESS 0x3FA274 /end MEASUREMENT
/begin COMPU_METHOD MC_TOT_DEGC "TOT_DEGC conversion" RAT_FUNC "%10.5" "Unitless" COEFFS 0 1 0 0 0 1 /end COMPU_METHOD
/begin CHARACTERISTIC TOT_EN_SW "TOT Control enable switch. 1-> Enabled" VALUE 0x5EC10 SD_UBYTE 0 SC_TOT_EN_SW 0 1 /end CHARACTERISTIC
/begin COMPU_METHOD SC_TOT_EN_SW "TOT_EN_SW conversion" RAT_FUNC "%3.0" "unitless" COEFFS 0 1 0 0 0 1 /end COMPU_METHOD
/begin MEASUREMENT TOT_FM_FLG "TOT failure mode flag; 1 -> TOT fmem in progress." UBYTE MC_TOT_FM_FLG 0 0 0 0 ECU_ADDRESS 0x3FA2B0 /end MEASUREMENT
/begin COMPU_METHOD MC_TOT_FM_FLG "TOT_FM_FLG conversion" RAT_FUNC "%3.0" "Unitless" COEFFS 0 1 0 0 0 1 /end COMPU_METHOD
/begin MEASUREMENT TOW_HAUL_FLG "Tow/Haul mode status" UBYTE MC_TOW_HAUL_FLG 0 0 0 0 ECU_ADDRESS 0x3FB65E /end MEASUREMENT
/begin COMPU_METHOD MC_TOW_HAUL_FLG "TOW_HAUL_FLG conversion" RAT_FUNC "%3.0" "Unitless" COEFFS 0 1 0 0 0 1 /end COMPU_METHOD
/begin MEASUREMENT TP "Throttle position, raw." FLOAT32_IEEE MC_TP 0 0 0 0 ECU_ADDRESS 0x3F9C68 /end MEASUREMENT
/begin COMPU_METHOD MC_TP "TP conversion" RAT_FUNC "%10.5" "Unitless" COEFFS 0 1 0 0 0 1 /end COMPU_METHOD
/begin CHARACTERISTIC TPLRN_OFFIM_MN "Engine off timer limit for ithp learning to start." VALUE 0x5C7C0 SD_FLOAT32_IEEE 0 SC_TPLRN_OFFIM_MN 0 200 /end CHARACTERISTIC
/begin COMPU_METHOD SC_TPLRN_OFFIM_MN "TPLRN_OFFIM_MN conversion" RAT_FUNC "%10.5" "s" COEFFS 0 1 0 0 0 1 /end COMPU_METHOD
/begin MEASUREMENT TPO_DTY "" FLOAT32_IEEE MC_TPO_DTY 0 0 0 0 ECU_ADDRESS 0x3FA320 /end MEASUREMENT
/begin COMPU_METHOD MC_TPO_DTY "TPO_DTY conversion" RAT_FUNC "%10.5" "Unitless" COEFFS 0 1 0 0 0 1 /end COMPU_METHOD
/begin CHARACTERISTIC TPO_PERIOD "Throttle position PWM output period." VALUE 0x5C3DC SD_ULONG 0 SC_TPO_PERIOD 0 65535 /end CHARACTERISTIC
/begin COMPU_METHOD SC_TPO_PERIOD "TPO_PERIOD conversion" RAT_FUNC "%10.0" "ms" COEFFS 0 1 0 0 0 1 /end COMPU_METHOD
/begin CHARACTERISTIC TP_CLS_AD "" VALUE 0x5C7BC SD_FLOAT32_IEEE 0 SC_TP_CLS_AD 0 1024 /end CHARACTERISTIC
/begin COMPU_METHOD SC_TP_CLS_AD "TP_CLS_AD conversion" RAT_FUNC "%10.5" "unitless" COEFFS 0 1 0 0 0 1 /end COMPU_METHOD
/begin MEASUREMENT TP_CLS_ADC "" FLOAT32_IEEE MC_TP_CLS_ADC 0 0 0 0 ECU_ADDRESS 0x3F9A10 /end MEASUREMENT
/begin COMPU_METHOD MC_TP_CLS_ADC "TP_CLS_ADC conversion" RAT_FUNC "%10.5" "Unitless" COEFFS 0 1 0 0 0 1 /end COMPU_METHOD
/begin MEASUREMENT TP_CLS_AD_KAM "" FLOAT32_IEEE MC_TP_CLS_AD_KAM 0 0 0 0 ECU_ADDRESS 0x3FCC78 /end MEASUREMENT
/begin COMPU_METHOD MC_TP_CLS_AD_KAM "TP_CLS_AD_KAM conversion" RAT_FUNC "%10.5" "Unitless" COEFFS 0 1 0 0 0 1 /end COMPU_METHOD
/begin MEASUREMENT TP_CNTS "A/D input for throttle position." SLONG MC_TP_CNTS 0 0 0 0 ECU_ADDRESS 0x3F9A08 /end MEASUREMENT
/begin COMPU_METHOD MC_TP_CNTS "TP_CNTS conversion" RAT_FUNC "%10.0" "Unitless" COEFFS 0 1 0 0 0 1 /end COMPU_METHOD
/begin CHARACTERISTIC TP_EN "multiplier enable/diasable switch" VALUE 0x5DE40 SD_UBYTE 0 SC_TP_EN 0 1 /end CHARACTERISTIC
/begin COMPU_METHOD SC_TP_EN "TP_EN conversion" RAT_FUNC "%3.0" "unitless" COEFFS 0 1 0 0 0 1 /end COMPU_METHOD
/begin MEASUREMENT TP_FIL "Intermittent fault filter for the TP sensor." UBYTE MC_TP_FIL 0 0 0 0 ECU_ADDRESS 0x3F9E4F /end MEASUREMENT
/begin COMPU_METHOD MC_TP_FIL "TP_FIL conversion" RAT_FUNC "%3.0" "Unitless" COEFFS 0 1 0 0 0 1 /end COMPU_METHOD
/begin MEASUREMENT TP_FIL_MAX "HIGHEST VALUE THE FAULT FILTER TP_FIL SEES." UBYTE MC_TP_FIL_MAX 0 0 0 0 ECU_ADDRESS 0x3FCCFE /end MEASUREMENT
/begin COMPU_METHOD MC_TP_FIL_MAX "TP_FIL_MAX conversion" RAT_FUNC "%3.0" "Unitless" COEFFS 0 1 0 0 0 1 /end COMPU_METHOD
/begin CHARACTERISTIC TP_HI_ER_V "TP sensor maximum voltage." VALUE 0x5C7B4 SD_FLOAT32_IEEE 0 SC_TP_HI_ER_V 0 12 /end CHARACTERISTIC
/begin COMPU_METHOD SC_TP_HI_ER_V "TP_HI_ER_V conversion" RAT_FUNC "%10.5" "V" COEFFS 0 1 0 0 0 1 /end COMPU_METHOD
/begin MEASUREMENT TP_INT "Fag set when intermittent is detected on the TP sensor." UBYTE MC_TP_INT 0 0 0 0 ECU_ADDRESS 0x3F9E4E /end MEASUREMENT
/begin COMPU_METHOD MC_TP_INT "TP_INT conversion" RAT_FUNC "%3.0" "Unitless" COEFFS 0 1 0 0 0 1 /end COMPU_METHOD
/begin CHARACTERISTIC TP_LO_ER_V "TP sensor minimum voltage." VALUE 0x5C7B0 SD_FLOAT32_IEEE 0 SC_TP_LO_ER_V 0 12 /end CHARACTERISTIC
/begin COMPU_METHOD SC_TP_LO_ER_V "TP_LO_ER_V conversion" RAT_FUNC "%10.5" "V" COEFFS 0 1 0 0 0 1 /end COMPU_METHOD
/begin CHARACTERISTIC TP_LRN_CAL_SEL "" VALUE 0x5C811 SD_UBYTE 0 SC_TP_LRN_CAL_SEL 0 1 /end CHARACTERISTIC
/begin COMPU_METHOD SC_TP_LRN_CAL_SEL "TP_LRN_CAL_SEL conversion" RAT_FUNC "%3.0" "unitless" COEFFS 0 1 0 0 0 1 /end COMPU_METHOD
/begin CHARACTERISTIC TP_LVL "Fault level for intermittent TP sensor." VALUE 0x5CE53 SD_UBYTE 0 SC_TP_LVL 0 255 /end CHARACTERISTIC
/begin COMPU_METHOD SC_TP_LVL "TP_LVL conversion" RAT_FUNC "%3.0" "LEVEL" COEFFS 0 1 0 0 0 1 /end COMPU_METHOD
/begin CHARACTERISTIC TP_OPN_AD "" VALUE 0x5C7B8 SD_FLOAT32_IEEE 0 SC_TP_OPN_AD 0 1024 /end CHARACTERISTIC
/begin COMPU_METHOD SC_TP_OPN_AD "TP_OPN_AD conversion" RAT_FUNC "%10.5" "unitless" COEFFS 0 1 0 0 0 1 /end COMPU_METHOD
/begin MEASUREMENT TP_OPN_ADC "" FLOAT32_IEEE MC_TP_OPN_ADC 0 0 0 0 ECU_ADDRESS 0x3F9A14 /end MEASUREMENT
/begin COMPU_METHOD MC_TP_OPN_ADC "TP_OPN_ADC conversion" RAT_FUNC "%10.5" "Unitless" COEFFS 0 1 0 0 0 1 /end COMPU_METHOD
/begin MEASUREMENT TP_OPN_AD_KAM "" FLOAT32_IEEE MC_TP_OPN_AD_KAM 0 0 0 0 ECU_ADDRESS 0x3FCC7C /end MEASUREMENT
/begin COMPU_METHOD MC_TP_OPN_AD_KAM "TP_OPN_AD_KAM conversion" RAT_FUNC "%10.5" "Unitless" COEFFS 0 1 0 0 0 1 /end COMPU_METHOD
/begin MEASUREMENT TP_RATE "Delta TP Counts Per BG Pass = (TP - TPBART)" FLOAT32_IEEE MC_TP_RATE 0 0 0 0 ECU_ADDRESS 0x3F9C64 /end MEASUREMENT
/begin COMPU_METHOD MC_TP_RATE "TP_RATE conversion" RAT_FUNC "%10.5" "Unitless" COEFFS 0 1 0 0 0 1 /end COMPU_METHOD
/begin MEASUREMENT TP_RAW[0] "Absolute angular position of throttle" FLOAT32_IEEE MC_TP_RAW 0 0 0 100 ECU_ADDRESS 0x3FB974 /end MEASUREMENT
/begin COMPU_METHOD MC_TP_RAW "TP_RAW conversion" RAT_FUNC "%10.5" "deg" COEFFS 0 1 0 0 0 1 /end COMPU_METHOD
/begin MEASUREMENT TP_RAW[1] "Absolute angular position of throttle" FLOAT32_IEEE MC_TP_RAW 0 0 0 100 ECU_ADDRESS 0x3FB978 /end MEASUREMENT
/begin MEASUREMENT TP_RAW[2] "Absolute angular position of throttle" FLOAT32_IEEE MC_TP_RAW 0 0 0 100 ECU_ADDRESS 0x3FB97C /end MEASUREMENT
/begin MEASUREMENT TP_STATUS[0] "Status of Throttle Position high level driver ( 0 = ok )" UBYTE MC_TP_STATUS 0 0 0 255 ECU_ADDRESS 0x3F9A02 /end MEASUREMENT
/begin COMPU_METHOD MC_TP_STATUS "TP_STATUS conversion" RAT_FUNC "%3.0" "unitless" COEFFS 0 1 0 0 0 1 /end COMPU_METHOD
/begin MEASUREMENT TP_STATUS[1] "Status of Throttle Position high level driver ( 0 = ok )" UBYTE MC_TP_STATUS 0 0 0 255 ECU_ADDRESS 0x3F9A03 /end MEASUREMENT
/begin MEASUREMENT TP_STATUS[2] "Status of Throttle Position high level driver ( 0 = ok )" UBYTE MC_TP_STATUS 0 0 0 255 ECU_ADDRESS 0x3F9A04 /end MEASUREMENT
/begin MEASUREMENT TP_VOLTS "TP sensor voltage seen at A to D input channel" FLOAT32_IEEE MC_TP_VOLTS 0 0 0 0 ECU_ADDRESS 0x3F9A0C /end MEASUREMENT
/begin COMPU_METHOD MC_TP_VOLTS "TP_VOLTS conversion" RAT_FUNC "%10.5" "Unitless" COEFFS 0 1 0 0 0 1 /end COMPU_METHOD
/begin MEASUREMENT TQEFFFMFLG "Driver demanded torque calculation failure" UBYTE MC_TQEFFFMFLG 0 0 0 0 ECU_ADDRESS 0x3FA2AF /end MEASUREMENT
/begin COMPU_METHOD MC_TQEFFFMFLG "TQEFFFMFLG conversion" RAT_FUNC "%3.0" "Unitless" COEFFS 0 1 0 0 0 1 /end COMPU_METHOD
/begin MEASUREMENT TQE_ACT_PT_NM "Actual Powertrain Torque" FLOAT32_IEEE MC_TQE_ACT_PT_NM 0 0 0 0 ECU_ADDRESS 0x3FA270 /end MEASUREMENT
/begin COMPU_METHOD MC_TQE_ACT_PT_NM "TQE_ACT_PT_NM conversion" RAT_FUNC "%10.5" "Unitless" COEFFS 0 1 0 0 0 1 /end COMPU_METHOD
/begin MEASUREMENT TQE_BRK_NM "Engine torque at flywheel" FLOAT32_IEEE MC_TQE_BRK_NM 0 0 0 0 ECU_ADDRESS 0x3FA26C /end MEASUREMENT
/begin COMPU_METHOD MC_TQE_BRK_NM "TQE_BRK_NM conversion" RAT_FUNC "%10.5" "Unitless" COEFFS 0 1 0 0 0 1 /end COMPU_METHOD
/begin MEASUREMENT TQE_FF "Feedforwared desired torque used by transmission for shift  calculations" FLOAT32_IEEE MC_TQE_FF 0 0 0 0 ECU_ADDRESS 0x3FAB48 /end MEASUREMENT
/begin COMPU_METHOD MC_TQE_FF "TQE_FF conversion" RAT_FUNC "%10.5" "Unitless" COEFFS 0 1 0 0 0 1 /end COMPU_METHOD
/begin MEASUREMENT TQE_FF_NM "Feedforwared desired torque used by transmission for shift  calculations" FLOAT32_IEEE MC_TQE_FF_NM 0 0 0 0 ECU_ADDRESS 0x3FA268 /end MEASUREMENT
/begin COMPU_METHOD MC_TQE_FF_NM "TQE_FF_NM conversion" RAT_FUNC "%10.5" "Unitless" COEFFS 0 1 0 0 0 1 /end COMPU_METHOD
/begin MEASUREMENT TQE_MAX_SFT "Maximum torque allowed during a shift requested by transmission." FLOAT32_IEEE MC_TQE_MAX_SFT 0 0 0 0 ECU_ADDRESS 0x3FA264 /end MEASUREMENT
/begin COMPU_METHOD MC_TQE_MAX_SFT "TQE_MAX_SFT conversion" RAT_FUNC "%10.5" "Unitless" COEFFS 0 1 0 0 0 1 /end COMPU_METHOD
/begin MEASUREMENT TQE_MAX_SFT_NM "Maximum torque allowed during a shift requested by transmission." FLOAT32_IEEE MC_TQE_MAX_SFT_NM 0 0 0 0 ECU_ADDRESS 0x3FB73C /end MEASUREMENT
/begin COMPU_METHOD MC_TQE_MAX_SFT_NM "TQE_MAX_SFT_NM conversion" RAT_FUNC "%10.5" "Unitless" COEFFS 0 1 0 0 0 1 /end COMPU_METHOD
/begin MEASUREMENT TQE_MAX_TRAN "Maximum allowable input torque requested by transmission (shifting and non-shifting)." FLOAT32_IEEE MC_TQE_MAX_TRAN 0 0 0 0 ECU_ADDRESS 0x3FA260 /end MEASUREMENT
/begin COMPU_METHOD MC_TQE_MAX_TRAN "TQE_MAX_TRAN conversion" RAT_FUNC "%10.5" "Unitless" COEFFS 0 1 0 0 0 1 /end COMPU_METHOD
/begin MEASUREMENT TQE_MAX_TRAN_NM "Maximum allowable input torque requested by transmission (shifting and non-shifting)." FLOAT32_IEEE MC_TQE_MAX_TRAN_NM 0 0 0 0 ECU_ADDRESS 0x3FB710 /end MEASUREMENT
/begin COMPU_METHOD MC_TQE_MAX_TRAN_NM "TQE_MAX_TRAN_NM conversion" RAT_FUNC "%10.5" "Unitless" COEFFS 0 1 0 0 0 1 /end COMPU_METHOD
/begin MEASUREMENT TQE_MIN_ALLOW "Response back to the trans controller indicating zero fuel at current speed" FLOAT32_IEEE MC_TQE_MIN_ALLOW 0 0 0 0 ECU_ADDRESS 0x3FAB44 /end MEASUREMENT
/begin COMPU_METHOD MC_TQE_MIN_ALLOW "TQE_MIN_ALLOW conversion" RAT_FUNC "%10.5" "Unitless" COEFFS 0 1 0 0 0 1 /end COMPU_METHOD
/begin MEASUREMENT TQ_AC "AC torque value." FLOAT32_IEEE MC_TQ_AC 0 0 0 0 ECU_ADDRESS 0x3FAA60 /end MEASUREMENT
/begin COMPU_METHOD MC_TQ_AC "TQ_AC conversion" RAT_FUNC "%10.5" "Unitless" COEFFS 0 1 0 0 0 1 /end COMPU_METHOD
/begin MEASUREMENT TQ_ACCESSORIES "" FLOAT32_IEEE MC_TQ_ACCESSORIES 0 0 0 0 ECU_ADDRESS 0x3FAAC0 /end MEASUREMENT
/begin COMPU_METHOD MC_TQ_ACCESSORIES "TQ_ACCESSORIES conversion" RAT_FUNC "%10.5" "Unitless" COEFFS 0 1 0 0 0 1 /end COMPU_METHOD
/begin CHARACTERISTIC TQ_ACCESS_SWCH_1 "Controls accessory load switch in current speed max torque" VALUE 0x5E1B4 SD_UBYTE 0 SC_TQ_ACCESS_SWCH_1 0 1 /end CHARACTERISTIC
/begin COMPU_METHOD SC_TQ_ACCESS_SWCH_1 "TQ_ACCESS_SWCH_1 conversion" RAT_FUNC "%3.0" "unitless" COEFFS 0 1 0 0 0 1 /end COMPU_METHOD
/begin CHARACTERISTIC TQ_ACCESS_SWCH_2 "Controls accessory load switch in predictive min torque" VALUE 0x5E1B3 SD_UBYTE 0 SC_TQ_ACCESS_SWCH_2 0 1 /end CHARACTERISTIC
/begin COMPU_METHOD SC_TQ_ACCESS_SWCH_2 "TQ_ACCESS_SWCH_2 conversion" RAT_FUNC "%3.0" "unitless" COEFFS 0 1 0 0 0 1 /end COMPU_METHOD
/begin CHARACTERISTIC TQ_ACCESS_SWCH_3 "Controls accessoty load switch in driver demand torque" VALUE 0x5E1B2 SD_UBYTE 0 SC_TQ_ACCESS_SWCH_3 0 1 /end CHARACTERISTIC
/begin COMPU_METHOD SC_TQ_ACCESS_SWCH_3 "TQ_ACCESS_SWCH_3 conversion" RAT_FUNC "%3.0" "unitless" COEFFS 0 1 0 0 0 1 /end COMPU_METHOD
/begin CHARACTERISTIC TQ_ACCESS_SWCH_4 "Controls accessory load switch in zero fuel torque" VALUE 0x5E1B1 SD_UBYTE 0 SC_TQ_ACCESS_SWCH_4 0 1 /end CHARACTERISTIC
/begin COMPU_METHOD SC_TQ_ACCESS_SWCH_4 "TQ_ACCESS_SWCH_4 conversion" RAT_FUNC "%3.0" "unitless" COEFFS 0 1 0 0 0 1 /end COMPU_METHOD
/begin CHARACTERISTIC TQ_ACCESS_SWCH_5 "Controls acessory load switch in N and PPS predicted torque" VALUE 0x5E1B0 SD_UBYTE 0 SC_TQ_ACCESS_SWCH_5 0 1 /end CHARACTERISTIC
/begin COMPU_METHOD SC_TQ_ACCESS_SWCH_5 "TQ_ACCESS_SWCH_5 conversion" RAT_FUNC "%3.0" "unitless" COEFFS 0 1 0 0 0 1 /end COMPU_METHOD
/begin MEASUREMENT TQ_ACCY1 "" FLOAT32_IEEE MC_TQ_ACCY1 0 0 0 0 ECU_ADDRESS 0x3FAACC /end MEASUREMENT
/begin COMPU_METHOD MC_TQ_ACCY1 "TQ_ACCY1 conversion" RAT_FUNC "%10.5" "Unitless" COEFFS 0 1 0 0 0 1 /end COMPU_METHOD
/begin MEASUREMENT TQ_ACCY2 "" FLOAT32_IEEE MC_TQ_ACCY2 0 0 0 0 ECU_ADDRESS 0x3FAAC8 /end MEASUREMENT
/begin COMPU_METHOD MC_TQ_ACCY2 "TQ_ACCY2 conversion" RAT_FUNC "%10.5" "Unitless" COEFFS 0 1 0 0 0 1 /end COMPU_METHOD
/begin CHARACTERISTIC TQ_AC_HIGH_PRES_TQ "AC high pressure torque" VALUE 0x5E0D4 SD_FLOAT32_IEEE 0 SC_TQ_AC_HIGH_PRES_TQ -500 1000 /end CHARACTERISTIC
/begin COMPU_METHOD SC_TQ_AC_HIGH_PRES_TQ "TQ_AC_HIGH_PRES_TQ conversion" RAT_FUNC "%10.5" "unitless" COEFFS 0 1 0 0 0 1 /end COMPU_METHOD
/begin CHARACTERISTIC TQ_AC_LOW_PRES_TQ "AC low pressure torque" VALUE 0x5E0D8 SD_FLOAT32_IEEE 0 SC_TQ_AC_LOW_PRES_TQ -500 1000 /end CHARACTERISTIC
/begin COMPU_METHOD SC_TQ_AC_LOW_PRES_TQ "TQ_AC_LOW_PRES_TQ conversion" RAT_FUNC "%10.5" "unitless" COEFFS 0 1 0 0 0 1 /end COMPU_METHOD
/begin CHARACTERISTIC TQ_ADDER_SELECT "Flag indicates bypass of the torque modifying terms in torque limiting" VALUE 0x5E1B5 SD_UBYTE 0 SC_TQ_ADDER_SELECT 0 1 /end CHARACTERISTIC
/begin COMPU_METHOD SC_TQ_ADDER_SELECT "TQ_ADDER_SELECT conversion" RAT_FUNC "%3.0" "unitless" COEFFS 0 1 0 0 0 1 /end COMPU_METHOD
/begin MEASUREMENT TQ_AIRC1 "" FLOAT32_IEEE MC_TQ_AIRC1 0 0 0 0 ECU_ADDRESS 0x3FAAD0 /end MEASUREMENT
/begin COMPU_METHOD MC_TQ_AIRC1 "TQ_AIRC1 conversion" RAT_FUNC "%10.5" "Unitless" COEFFS 0 1 0 0 0 1 /end COMPU_METHOD
/begin MEASUREMENT TQ_AIRPMP_ACT_FLG "" UBYTE MC_TQ_AIRPMP_ACT_FLG 0 0 0 0 ECU_ADDRESS 0x5E0F3 /end MEASUREMENT
/begin COMPU_METHOD MC_TQ_AIRPMP_ACT_FLG "TQ_AIRPMP_ACT_FLG conversion" RAT_FUNC "%3.0" "Unitless" COEFFS 0 1 0 0 0 1 /end COMPU_METHOD
/begin MEASUREMENT TQ_AIR_PUMP "" FLOAT32_IEEE MC_TQ_AIR_PUMP 0 0 0 0 ECU_ADDRESS 0x3FAA7C /end MEASUREMENT
/begin COMPU_METHOD MC_TQ_AIR_PUMP "TQ_AIR_PUMP conversion" RAT_FUNC "%10.5" "Unitless" COEFFS 0 1 0 0 0 1 /end COMPU_METHOD
/begin MEASUREMENT TQ_ALTRNTR_TORQUE "Alternator torque value." FLOAT32_IEEE MC_TQ_ALTRNTR_TORQUE 0 0 0 0 ECU_ADDRESS 0x3FAA5C /end MEASUREMENT
/begin COMPU_METHOD MC_TQ_ALTRNTR_TORQUE "TQ_ALTRNTR_TORQUE conversion" RAT_FUNC "%10.5" "Unitless" COEFFS 0 1 0 0 0 1 /end COMPU_METHOD
/begin MEASUREMENT TQ_BRAKE_S "Actual net torque produced by engine." FLOAT32_IEEE MC_TQ_BRAKE_S 0 0 0 0 ECU_ADDRESS 0x3F9C4C /end MEASUREMENT
/begin COMPU_METHOD MC_TQ_BRAKE_S "TQ_BRAKE_S conversion" RAT_FUNC "%10.5" "Unitless" COEFFS 0 1 0 0 0 1 /end COMPU_METHOD
/begin MEASUREMENT TQ_BRK_BOOST "Output of fn_tq_brk_boost table." FLOAT32_IEEE MC_TQ_BRK_BOOST 0 0 0 0 ECU_ADDRESS 0x3FAA70 /end MEASUREMENT
/begin COMPU_METHOD MC_TQ_BRK_BOOST "TQ_BRK_BOOST conversion" RAT_FUNC "%10.5" "Unitless" COEFFS 0 1 0 0 0 1 /end COMPU_METHOD
/begin MEASUREMENT TQ_BRK_SBAR "Filtered net torque produced by engine." FLOAT32_IEEE MC_TQ_BRK_SBAR 0 0 0 0 ECU_ADDRESS 0x3FA65C /end MEASUREMENT
/begin COMPU_METHOD MC_TQ_BRK_SBAR "TQ_BRK_SBAR conversion" RAT_FUNC "%10.5" "Unitless" COEFFS 0 1 0 0 0 1 /end COMPU_METHOD
/begin CHARACTERISTIC TQ_CK_SW "Calibration switch to enable/disable using torque as an inferred vehicle motion condition" VALUE 0x5D8C8 SD_UBYTE 0 SC_TQ_CK_SW 0 1 /end CHARACTERISTIC
/begin COMPU_METHOD SC_TQ_CK_SW "TQ_CK_SW conversion" RAT_FUNC "%3.0" "SWITCH" COEFFS 0 1 0 0 0 1 /end COMPU_METHOD
/begin CHARACTERISTIC TQ_CK_VMOV "Engine torque above which vehicle motion can be inferred" VALUE 0x5D8C0 SD_FLOAT32_IEEE 0 SC_TQ_CK_VMOV -1020 1020 /end CHARACTERISTIC
/begin COMPU_METHOD SC_TQ_CK_VMOV "TQ_CK_VMOV conversion" RAT_FUNC "%10.5" "FT-LBS" COEFFS 0 1 0 0 0 1 /end COMPU_METHOD
/begin MEASUREMENT TQ_COMB "" FLOAT32_IEEE MC_TQ_COMB 0 0 0 0 ECU_ADDRESS 0x3FAAB8 /end MEASUREMENT
/begin COMPU_METHOD MC_TQ_COMB "TQ_COMB conversion" RAT_FUNC "%10.5" "Unitless" COEFFS 0 1 0 0 0 1 /end COMPU_METHOD
/begin MEASUREMENT TQ_COMB_ACT_FLG "" UBYTE MC_TQ_COMB_ACT_FLG 0 0 0 0 ECU_ADDRESS 0x5E0F2 /end MEASUREMENT
/begin COMPU_METHOD MC_TQ_COMB_ACT_FLG "TQ_COMB_ACT_FLG conversion" RAT_FUNC "%3.0" "Unitless" COEFFS 0 1 0 0 0 1 /end COMPU_METHOD
/begin MEASUREMENT TQ_COMB_MULT "" FLOAT32_IEEE MC_TQ_COMB_MULT 0 0 0 0 ECU_ADDRESS 0x3FAAC4 /end MEASUREMENT
/begin COMPU_METHOD MC_TQ_COMB_MULT "TQ_COMB_MULT conversion" RAT_FUNC "%10.5" "Unitless" COEFFS 0 1 0 0 0 1 /end COMPU_METHOD
/begin MEASUREMENT TQ_DELTAP "" FLOAT32_IEEE MC_TQ_DELTAP 0 0 0 0 ECU_ADDRESS 0x3FAAF0 /end MEASUREMENT
/begin COMPU_METHOD MC_TQ_DELTAP "TQ_DELTAP conversion" RAT_FUNC "%10.5" "Unitless" COEFFS 0 1 0 0 0 1 /end COMPU_METHOD
/begin MEASUREMENT TQ_DELTAP_ERR "" FLOAT32_IEEE MC_TQ_DELTAP_ERR 0 0 0 0 ECU_ADDRESS 0x3FAAEC /end MEASUREMENT
/begin COMPU_METHOD MC_TQ_DELTAP_ERR "TQ_DELTAP_ERR conversion" RAT_FUNC "%10.5" "Unitless" COEFFS 0 1 0 0 0 1 /end COMPU_METHOD
/begin MEASUREMENT TQ_DELTAP_NORM "" FLOAT32_IEEE MC_TQ_DELTAP_NORM 0 0 0 0 ECU_ADDRESS 0x3FAAF4 /end MEASUREMENT
/begin COMPU_METHOD MC_TQ_DELTAP_NORM "TQ_DELTAP_NORM conversion" RAT_FUNC "%10.5" "Unitless" COEFFS 0 1 0 0 0 1 /end COMPU_METHOD
/begin MEASUREMENT TQ_DP_HIALT "" FLOAT32_IEEE MC_TQ_DP_HIALT 0 0 0 0 ECU_ADDRESS 0x3FAA88 /end MEASUREMENT
/begin COMPU_METHOD MC_TQ_DP_HIALT "TQ_DP_HIALT conversion" RAT_FUNC "%10.5" "Unitless" COEFFS 0 1 0 0 0 1 /end COMPU_METHOD
/begin MEASUREMENT TQ_DP_HIALT_TERM "" FLOAT32_IEEE MC_TQ_DP_HIALT_TERM 0 0 0 0 ECU_ADDRESS 0x3FAB00 /end MEASUREMENT
/begin COMPU_METHOD MC_TQ_DP_HIALT_TERM "TQ_DP_HIALT_TERM conversion" RAT_FUNC "%10.5" "Unitless" COEFFS 0 1 0 0 0 1 /end COMPU_METHOD
/begin MEASUREMENT TQ_DP_LOALT "" FLOAT32_IEEE MC_TQ_DP_LOALT 0 0 0 0 ECU_ADDRESS 0x3FAA80 /end MEASUREMENT
/begin COMPU_METHOD MC_TQ_DP_LOALT "TQ_DP_LOALT conversion" RAT_FUNC "%10.5" "Unitless" COEFFS 0 1 0 0 0 1 /end COMPU_METHOD
/begin MEASUREMENT TQ_DP_LOALT_TERM "" FLOAT32_IEEE MC_TQ_DP_LOALT_TERM 0 0 0 0 ECU_ADDRESS 0x3FAAF8 /end MEASUREMENT
/begin COMPU_METHOD MC_TQ_DP_LOALT_TERM "TQ_DP_LOALT_TERM conversion" RAT_FUNC "%10.5" "Unitless" COEFFS 0 1 0 0 0 1 /end COMPU_METHOD
/begin MEASUREMENT TQ_DP_MEDALT "" FLOAT32_IEEE MC_TQ_DP_MEDALT 0 0 0 0 ECU_ADDRESS 0x3FAA84 /end MEASUREMENT
/begin COMPU_METHOD MC_TQ_DP_MEDALT "TQ_DP_MEDALT conversion" RAT_FUNC "%10.5" "Unitless" COEFFS 0 1 0 0 0 1 /end COMPU_METHOD
/begin MEASUREMENT TQ_DP_MEDALT_TERM "" FLOAT32_IEEE MC_TQ_DP_MEDALT_TERM 0 0 0 0 ECU_ADDRESS 0x3FAAFC /end MEASUREMENT
/begin COMPU_METHOD MC_TQ_DP_MEDALT_TERM "TQ_DP_MEDALT_TERM conversion" RAT_FUNC "%10.5" "Unitless" COEFFS 0 1 0 0 0 1 /end COMPU_METHOD
/begin MEASUREMENT TQ_DTQ_DICP "" FLOAT32_IEEE MC_TQ_DTQ_DICP 0 0 0 0 ECU_ADDRESS 0x3FAADC /end MEASUREMENT
/begin COMPU_METHOD MC_TQ_DTQ_DICP "TQ_DTQ_DICP conversion" RAT_FUNC "%10.5" "Unitless" COEFFS 0 1 0 0 0 1 /end COMPU_METHOD
/begin CHARACTERISTIC TQ_FAN_INERTIA "Fan inertia torque multiplier" VALUE 0x5E0DC SD_FLOAT32_IEEE 0 SC_TQ_FAN_INERTIA 0 255 /end CHARACTERISTIC
/begin COMPU_METHOD SC_TQ_FAN_INERTIA "TQ_FAN_INERTIA conversion" RAT_FUNC "%10.5" "unitless" COEFFS 0 1 0 0 0 1 /end COMPU_METHOD
/begin MEASUREMENT TQ_FAN_INERTIA_TORQUE "Fan torque value due to inertia." FLOAT32_IEEE MC_TQ_FAN_INERTIA_TORQUE 0 0 0 0 ECU_ADDRESS 0x3FAA68 /end MEASUREMENT
/begin COMPU_METHOD MC_TQ_FAN_INERTIA_TORQUE "TQ_FAN_INERTIA_TORQUE conversion" RAT_FUNC "%10.5" "Unitless" COEFFS 0 1 0 0 0 1 /end COMPU_METHOD
/begin MEASUREMENT TQ_FAN_TORQUE "Fan torque value" FLOAT32_IEEE MC_TQ_FAN_TORQUE 0 0 0 0 ECU_ADDRESS 0x3FAA6C /end MEASUREMENT
/begin COMPU_METHOD MC_TQ_FAN_TORQUE "TQ_FAN_TORQUE conversion" RAT_FUNC "%10.5" "Unitless" COEFFS 0 1 0 0 0 1 /end COMPU_METHOD
/begin CHARACTERISTIC TQ_FAN_TORQUE_KP "Fan speed torque multiplier." VALUE 0x5E0E0 SD_FLOAT32_IEEE 0 SC_TQ_FAN_TORQUE_KP 0 255 /end CHARACTERISTIC
/begin COMPU_METHOD SC_TQ_FAN_TORQUE_KP "TQ_FAN_TORQUE_KP conversion" RAT_FUNC "%10.5" "unitless" COEFFS 0 1 0 0 0 1 /end COMPU_METHOD
/begin MEASUREMENT TQ_FILT "" FLOAT32_IEEE MC_TQ_FILT 0 0 0 0 ECU_ADDRESS 0x3FAB0C /end MEASUREMENT
/begin COMPU_METHOD MC_TQ_FILT "TQ_FILT conversion" RAT_FUNC "%10.5" "Unitless" COEFFS 0 1 0 0 0 1 /end COMPU_METHOD
/begin MEASUREMENT TQ_FN1020_MFMTQ "Predicted torque for driver select mode" FLOAT32_IEEE MC_TQ_FN1020_MFMTQ 0 0 0 0 ECU_ADDRESS 0x3FAB40 /end MEASUREMENT
/begin COMPU_METHOD MC_TQ_FN1020_MFMTQ "TQ_FN1020_MFMTQ conversion" RAT_FUNC "%10.5" "Unitless" COEFFS 0 1 0 0 0 1 /end COMPU_METHOD
/begin MEASUREMENT TQ_FN1020_MFMTQ_P "predicted torque for pilot mode" FLOAT32_IEEE MC_TQ_FN1020_MFMTQ_P 0 0 0 0 ECU_ADDRESS 0x3FAB3C /end MEASUREMENT
/begin COMPU_METHOD MC_TQ_FN1020_MFMTQ_P "TQ_FN1020_MFMTQ_P conversion" RAT_FUNC "%10.5" "Unitless" COEFFS 0 1 0 0 0 1 /end COMPU_METHOD
/begin MEASUREMENT TQ_FRICTION "" FLOAT32_IEEE MC_TQ_FRICTION 0 0 0 0 ECU_ADDRESS 0x3FAA78 /end MEASUREMENT
/begin COMPU_METHOD MC_TQ_FRICTION "TQ_FRICTION conversion" RAT_FUNC "%10.5" "Unitless" COEFFS 0 1 0 0 0 1 /end COMPU_METHOD
/begin MEASUREMENT TQ_HIALT_BASE "" FLOAT32_IEEE MC_TQ_HIALT_BASE 0 0 0 0 ECU_ADDRESS 0x3FAA94 /end MEASUREMENT
/begin COMPU_METHOD MC_TQ_HIALT_BASE "TQ_HIALT_BASE conversion" RAT_FUNC "%10.5" "Unitless" COEFFS 0 1 0 0 0 1 /end COMPU_METHOD
/begin MEASUREMENT TQ_HIALT_TERM "" FLOAT32_IEEE MC_TQ_HIALT_TERM 0 0 0 0 ECU_ADDRESS 0x3FAAE8 /end MEASUREMENT
/begin COMPU_METHOD MC_TQ_HIALT_TERM "TQ_HIALT_TERM conversion" RAT_FUNC "%10.5" "Unitless" COEFFS 0 1 0 0 0 1 /end COMPU_METHOD
/begin CHARACTERISTIC TQ_ICPBASE "" VALUE 0x5E0EC SD_FLOAT32_IEEE 0 SC_TQ_ICPBASE 0 40 /end CHARACTERISTIC
/begin COMPU_METHOD SC_TQ_ICPBASE "TQ_ICPBASE conversion" RAT_FUNC "%10.5" "unitless" COEFFS 0 1 0 0 0 1 /end COMPU_METHOD
/begin MEASUREMENT TQ_ICP_PUMP "" FLOAT32_IEEE MC_TQ_ICP_PUMP 0 0 0 0 ECU_ADDRESS 0x3FAAD8 /end MEASUREMENT
/begin COMPU_METHOD MC_TQ_ICP_PUMP "TQ_ICP_PUMP conversion" RAT_FUNC "%10.5" "Unitless" COEFFS 0 1 0 0 0 1 /end COMPU_METHOD
/begin CHARACTERISTIC TQ_INERTIA "" VALUE 0x5E0E4 SD_FLOAT32_IEEE 0 SC_TQ_INERTIA 0 100 /end CHARACTERISTIC
/begin COMPU_METHOD SC_TQ_INERTIA "TQ_INERTIA conversion" RAT_FUNC "%10.5" "unitless" COEFFS 0 1 0 0 0 1 /end COMPU_METHOD
/begin MEASUREMENT TQ_LOALT_BASE "" FLOAT32_IEEE MC_TQ_LOALT_BASE 0 0 0 0 ECU_ADDRESS 0x3FAA8C /end MEASUREMENT
/begin COMPU_METHOD MC_TQ_LOALT_BASE "TQ_LOALT_BASE conversion" RAT_FUNC "%10.5" "Unitless" COEFFS 0 1 0 0 0 1 /end COMPU_METHOD
/begin MEASUREMENT TQ_LOALT_TERM "" FLOAT32_IEEE MC_TQ_LOALT_TERM 0 0 0 0 ECU_ADDRESS 0x3FAAE0 /end MEASUREMENT
/begin COMPU_METHOD MC_TQ_LOALT_TERM "TQ_LOALT_TERM conversion" RAT_FUNC "%10.5" "Unitless" COEFFS 0 1 0 0 0 1 /end COMPU_METHOD
/begin MEASUREMENT TQ_LOSS_NM "Torque loss due to engine friction and ancillary loads." FLOAT32_IEEE MC_TQ_LOSS_NM 0 0 0 0 ECU_ADDRESS 0x3FA25C /end MEASUREMENT
/begin COMPU_METHOD MC_TQ_LOSS_NM "TQ_LOSS_NM conversion" RAT_FUNC "%10.5" "Unitless" COEFFS 0 1 0 0 0 1 /end COMPU_METHOD
/begin MEASUREMENT TQ_MAX_BRK_PPS_REQ "Hypothetical pedal position for predicted torque" FLOAT32_IEEE MC_TQ_MAX_BRK_PPS_REQ 0 0 0 0 ECU_ADDRESS 0x3FB734 /end MEASUREMENT
/begin COMPU_METHOD MC_TQ_MAX_BRK_PPS_REQ "TQ_MAX_BRK_PPS_REQ conversion" RAT_FUNC "%10.5" "Unitless" COEFFS 0 1 0 0 0 1 /end COMPU_METHOD
/begin MEASUREMENT TQ_MAX_BRK_REQ "Engine speed at which maximum possible torque is requested" FLOAT32_IEEE MC_TQ_MAX_BRK_REQ 0 0 0 0 ECU_ADDRESS 0x3FB72C /end MEASUREMENT
/begin COMPU_METHOD MC_TQ_MAX_BRK_REQ "TQ_MAX_BRK_REQ conversion" RAT_FUNC "%10.5" "Unitless" COEFFS 0 1 0 0 0 1 /end COMPU_METHOD
/begin MEASUREMENT TQ_MAX_BRK_RSP "Response back to the trans controller indicating max torque" FLOAT32_IEEE MC_TQ_MAX_BRK_RSP 0 0 0 0 ECU_ADDRESS 0x3FAB58 /end MEASUREMENT
/begin COMPU_METHOD MC_TQ_MAX_BRK_RSP "TQ_MAX_BRK_RSP conversion" RAT_FUNC "%10.5" "Unitless" COEFFS 0 1 0 0 0 1 /end COMPU_METHOD
/begin MEASUREMENT TQ_MAX_BRK_RSP_NM "Response back to the trans controller indicating max torque" FLOAT32_IEEE MC_TQ_MAX_BRK_RSP_NM 0 0 0 0 ECU_ADDRESS 0x3FA258 /end MEASUREMENT
/begin COMPU_METHOD MC_TQ_MAX_BRK_RSP_NM "TQ_MAX_BRK_RSP_NM conversion" RAT_FUNC "%10.5" "Unitless" COEFFS 0 1 0 0 0 1 /end COMPU_METHOD
/begin MEASUREMENT TQ_MAX_COMB_TRQ "Desired maximum combustion torque to not exceed max brake torque" FLOAT32_IEEE MC_TQ_MAX_COMB_TRQ 0 0 0 0 ECU_ADDRESS 0x3FAB68 /end MEASUREMENT
/begin COMPU_METHOD MC_TQ_MAX_COMB_TRQ "TQ_MAX_COMB_TRQ conversion" RAT_FUNC "%10.5" "Unitless" COEFFS 0 1 0 0 0 1 /end COMPU_METHOD
/begin MEASUREMENT TQ_MEDALT_BASE "" FLOAT32_IEEE MC_TQ_MEDALT_BASE 0 0 0 0 ECU_ADDRESS 0x3FAA90 /end MEASUREMENT
/begin COMPU_METHOD MC_TQ_MEDALT_BASE "TQ_MEDALT_BASE conversion" RAT_FUNC "%10.5" "Unitless" COEFFS 0 1 0 0 0 1 /end COMPU_METHOD
/begin MEASUREMENT TQ_MEDALT_TERM "" FLOAT32_IEEE MC_TQ_MEDALT_TERM 0 0 0 0 ECU_ADDRESS 0x3FAAE4 /end MEASUREMENT
/begin COMPU_METHOD MC_TQ_MEDALT_TERM "TQ_MEDALT_TERM conversion" RAT_FUNC "%10.5" "Unitless" COEFFS 0 1 0 0 0 1 /end COMPU_METHOD
/begin MEASUREMENT TQ_MFMTQ_SS_HI_ALT "Output of fn1020hi_copy" FLOAT32_IEEE MC_TQ_MFMTQ_SS_HI_ALT 0 0 0 0 ECU_ADDRESS 0x3FAB30 /end MEASUREMENT
/begin COMPU_METHOD MC_TQ_MFMTQ_SS_HI_ALT "TQ_MFMTQ_SS_HI_ALT conversion" RAT_FUNC "%10.5" "Unitless" COEFFS 0 1 0 0 0 1 /end COMPU_METHOD
/begin MEASUREMENT TQ_MFMTQ_SS_LO_ALT "Output of fn1020lo_copy" FLOAT32_IEEE MC_TQ_MFMTQ_SS_LO_ALT 0 0 0 0 ECU_ADDRESS 0x3FAB2C /end MEASUREMENT
/begin COMPU_METHOD MC_TQ_MFMTQ_SS_LO_ALT "TQ_MFMTQ_SS_LO_ALT conversion" RAT_FUNC "%10.5" "Unitless" COEFFS 0 1 0 0 0 1 /end COMPU_METHOD
/begin MEASUREMENT TQ_MIN_BRK_REQ "Engine speed at which minimum possible torque is requested" FLOAT32_IEEE MC_TQ_MIN_BRK_REQ 0 0 0 0 ECU_ADDRESS 0x3FB730 /end MEASUREMENT
/begin COMPU_METHOD MC_TQ_MIN_BRK_REQ "TQ_MIN_BRK_REQ conversion" RAT_FUNC "%10.5" "Unitless" COEFFS 0 1 0 0 0 1 /end COMPU_METHOD
/begin MEASUREMENT TQ_MIN_BRK_RSP "Response back to the trans controller indicating min torque" FLOAT32_IEEE MC_TQ_MIN_BRK_RSP 0 0 0 0 ECU_ADDRESS 0x3FAB54 /end MEASUREMENT
/begin COMPU_METHOD MC_TQ_MIN_BRK_RSP "TQ_MIN_BRK_RSP conversion" RAT_FUNC "%10.5" "Unitless" COEFFS 0 1 0 0 0 1 /end COMPU_METHOD
/begin MEASUREMENT TQ_MIN_BRK_RSP_NM "Response back to the trans controller indicating min torque" FLOAT32_IEEE MC_TQ_MIN_BRK_RSP_NM 0 0 0 0 ECU_ADDRESS 0x3FA254 /end MEASUREMENT
/begin COMPU_METHOD MC_TQ_MIN_BRK_RSP_NM "TQ_MIN_BRK_RSP_NM conversion" RAT_FUNC "%10.5" "Unitless" COEFFS 0 1 0 0 0 1 /end COMPU_METHOD
/begin CHARACTERISTIC TQ_MOD_DEFAULT "Default target torque for torque mod" VALUE 0x5E1A0 SD_FLOAT32_IEEE 0 SC_TQ_MOD_DEFAULT 100 1100 /end CHARACTERISTIC
/begin COMPU_METHOD SC_TQ_MOD_DEFAULT "TQ_MOD_DEFAULT conversion" RAT_FUNC "%10.5" "lbf*ft" COEFFS 0 1 0 0 0 1 /end COMPU_METHOD
/begin CHARACTERISTIC TQ_MOD_EN_FLG "Torque modulation enable flag (1 = enabled)" VALUE 0x5DC0C SD_UBYTE 0 SC_TQ_MOD_EN_FLG 0 1 /end CHARACTERISTIC
/begin COMPU_METHOD SC_TQ_MOD_EN_FLG "TQ_MOD_EN_FLG conversion" RAT_FUNC "%3.0" "unitless" COEFFS 0 1 0 0 0 1 /end COMPU_METHOD
/begin CHARACTERISTIC TQ_MOD_MAX_TIME "Maximum time that a single torque modulation request will be honored" VALUE 0x5E1A4 SD_FLOAT32_IEEE 0 SC_TQ_MOD_MAX_TIME 0 100 /end CHARACTERISTIC
/begin COMPU_METHOD SC_TQ_MOD_MAX_TIME "TQ_MOD_MAX_TIME conversion" RAT_FUNC "%10.5" "s" COEFFS 0 1 0 0 0 1 /end COMPU_METHOD
/begin CHARACTERISTIC TQ_MOD_MAX_TORQUE "Upper limit for torque mod requests." VALUE 0x5E1A8 SD_FLOAT32_IEEE 0 SC_TQ_MOD_MAX_TORQUE -400 1100 /end CHARACTERISTIC
/begin COMPU_METHOD SC_TQ_MOD_MAX_TORQUE "TQ_MOD_MAX_TORQUE conversion" RAT_FUNC "%10.5" "lbf*ft" COEFFS 0 1 0 0 0 1 /end COMPU_METHOD
/begin MEASUREMENT TQ_MOD_MFDES_LMX "Maximum fuel / stroke limit from torque modulation (mg/stroke)" FLOAT32_IEEE MC_TQ_MOD_MFDES_LMX 0 0 0 0 ECU_ADDRESS 0x3FAB50 /end MEASUREMENT
/begin COMPU_METHOD MC_TQ_MOD_MFDES_LMX "TQ_MOD_MFDES_LMX conversion" RAT_FUNC "%10.5" "Unitless" COEFFS 0 1 0 0 0 1 /end COMPU_METHOD
/begin MEASUREMENT TQ_MOD_TARGET "Resulting target maximum torque from torque modulation requests" FLOAT32_IEEE MC_TQ_MOD_TARGET 0 0 0 0 ECU_ADDRESS 0x3FAB64 /end MEASUREMENT
/begin COMPU_METHOD MC_TQ_MOD_TARGET "TQ_MOD_TARGET conversion" RAT_FUNC "%10.5" "Unitless" COEFFS 0 1 0 0 0 1 /end COMPU_METHOD
/begin MEASUREMENT TQ_MOD_TIMER "Output of timer that runs once torque modulation is active" FLOAT32_IEEE MC_TQ_MOD_TIMER 0 0 0 0 ECU_ADDRESS 0x3FAB74 /end MEASUREMENT
/begin COMPU_METHOD MC_TQ_MOD_TIMER "TQ_MOD_TIMER conversion" RAT_FUNC "%10.5" "Unitless" COEFFS 0 1 0 0 0 1 /end COMPU_METHOD
/begin MEASUREMENT TQ_MOTORING_TORQUE "Uncorrected motoring torque of the engine at the requested rpm" FLOAT32_IEEE MC_TQ_MOTORING_TORQUE 0 0 0 0 ECU_ADDRESS 0x3FAB6C /end MEASUREMENT
/begin COMPU_METHOD MC_TQ_MOTORING_TORQUE "TQ_MOTORING_TORQUE conversion" RAT_FUNC "%10.5" "Unitless" COEFFS 0 1 0 0 0 1 /end COMPU_METHOD
/begin MEASUREMENT TQ_ND "" FLOAT32_IEEE MC_TQ_ND 0 0 0 0 ECU_ADDRESS 0x3FAAA0 /end MEASUREMENT
/begin COMPU_METHOD MC_TQ_ND "TQ_ND conversion" RAT_FUNC "%10.5" "Unitless" COEFFS 0 1 0 0 0 1 /end COMPU_METHOD
/begin MEASUREMENT TQ_ND_RAW "" FLOAT32_IEEE MC_TQ_ND_RAW 0 0 0 0 ECU_ADDRESS 0x3FAAB0 /end MEASUREMENT
/begin COMPU_METHOD MC_TQ_ND_RAW "TQ_ND_RAW conversion" RAT_FUNC "%10.5" "Unitless" COEFFS 0 1 0 0 0 1 /end COMPU_METHOD
/begin MEASUREMENT TQ_ND_RAW_LST "" FLOAT32_IEEE MC_TQ_ND_RAW_LST 0 0 0 0 ECU_ADDRESS 0x3FAAAC /end MEASUREMENT
/begin COMPU_METHOD MC_TQ_ND_RAW_LST "TQ_ND_RAW_LST conversion" RAT_FUNC "%10.5" "Unitless" COEFFS 0 1 0 0 0 1 /end COMPU_METHOD
/begin CHARACTERISTIC TQ_ND_TAU "" VALUE 0x5E0E8 SD_FLOAT32_IEEE 0 SC_TQ_ND_TAU 0 10 /end CHARACTERISTIC
/begin COMPU_METHOD SC_TQ_ND_TAU "TQ_ND_TAU conversion" RAT_FUNC "%10.5" "unitless" COEFFS 0 1 0 0 0 1 /end COMPU_METHOD
/begin MEASUREMENT TQ_NET_DS "Net engine torque compensated (phase lagged) for engine dynamics" FLOAT32_IEEE MC_TQ_NET_DS 0 0 0 0 ECU_ADDRESS 0x3FAB08 /end MEASUREMENT
/begin COMPU_METHOD MC_TQ_NET_DS "TQ_NET_DS conversion" RAT_FUNC "%10.5" "Unitless" COEFFS 0 1 0 0 0 1 /end COMPU_METHOD
/begin MEASUREMENT TQ_PUMP "Torque losses due to the high pressure oil pump" FLOAT32_IEEE MC_TQ_PUMP 0 0 0 0 ECU_ADDRESS 0x3FAABC /end MEASUREMENT
/begin COMPU_METHOD MC_TQ_PUMP "TQ_PUMP conversion" RAT_FUNC "%10.5" "Unitless" COEFFS 0 1 0 0 0 1 /end COMPU_METHOD
/begin MEASUREMENT TQ_PWR_STEER_TORQUE "Output of fn_tq_pwr_steer table." FLOAT32_IEEE MC_TQ_PWR_STEER_TORQUE 0 0 0 0 ECU_ADDRESS 0x3FAA74 /end MEASUREMENT
/begin COMPU_METHOD MC_TQ_PWR_STEER_TORQUE "TQ_PWR_STEER_TORQUE conversion" RAT_FUNC "%10.5" "Unitless" COEFFS 0 1 0 0 0 1 /end COMPU_METHOD
/begin MEASUREMENT TQ_RAW "" FLOAT32_IEEE MC_TQ_RAW 0 0 0 0 ECU_ADDRESS 0x3FAAD4 /end MEASUREMENT
/begin COMPU_METHOD MC_TQ_RAW "TQ_RAW conversion" RAT_FUNC "%10.5" "Unitless" COEFFS 0 1 0 0 0 1 /end COMPU_METHOD
/begin CHARACTERISTIC TQ_REQ_N_MIN "Minimum engine speed queery that engine controler responds to." VALUE 0x5E1AC SD_FLOAT32_IEEE 0 SC_TQ_REQ_N_MIN 0 8000 /end CHARACTERISTIC
/begin COMPU_METHOD SC_TQ_REQ_N_MIN "TQ_REQ_N_MIN conversion" RAT_FUNC "%10.5" "RPM" COEFFS 0 1 0 0 0 1 /end COMPU_METHOD
/begin MEASUREMENT TQ_SOURCE "Identifies the source of the torque control." UBYTE MC_TQ_SOURCE 0 0 0 0 ECU_ADDRESS 0x3FA2A4 /end MEASUREMENT
/begin COMPU_METHOD MC_TQ_SOURCE "TQ_SOURCE conversion" RAT_FUNC "%3.0" "Unitless" COEFFS 0 1 0 0 0 1 /end COMPU_METHOD
/begin MEASUREMENT TQ_SSMEAN "" FLOAT32_IEEE MC_TQ_SSMEAN 0 0 0 0 ECU_ADDRESS 0x3FAAB4 /end MEASUREMENT
/begin COMPU_METHOD MC_TQ_SSMEAN "TQ_SSMEAN conversion" RAT_FUNC "%10.5" "Unitless" COEFFS 0 1 0 0 0 1 /end COMPU_METHOD
/begin MEASUREMENT TQ_TAU "First order lag time constant" FLOAT32_IEEE MC_TQ_TAU 0 0 0 0 ECU_ADDRESS 0x3FAA9C /end MEASUREMENT
/begin COMPU_METHOD MC_TQ_TAU "TQ_TAU conversion" RAT_FUNC "%10.5" "Unitless" COEFFS 0 1 0 0 0 1 /end COMPU_METHOD
/begin MEASUREMENT TQ_TORQUE_CURVE "Uncorrected maximum torque of the engine at the requested rpm" FLOAT32_IEEE MC_TQ_TORQUE_CURVE 0 0 0 0 ECU_ADDRESS 0x3FAB70 /end MEASUREMENT
/begin COMPU_METHOD MC_TQ_TORQUE_CURVE "TQ_TORQUE_CURVE conversion" RAT_FUNC "%10.5" "Unitless" COEFFS 0 1 0 0 0 1 /end COMPU_METHOD
/begin MEASUREMENT TQ_TQE_MAX_ALLOW "Response back to trans controller indicating max torque at current speed" FLOAT32_IEEE MC_TQ_TQE_MAX_ALLOW 0 0 0 0 ECU_ADDRESS 0x3FAB4C /end MEASUREMENT
/begin COMPU_METHOD MC_TQ_TQE_MAX_ALLOW "TQ_TQE_MAX_ALLOW conversion" RAT_FUNC "%10.5" "Unitless" COEFFS 0 1 0 0 0 1 /end COMPU_METHOD
/begin MEASUREMENT TQ_TQE_MAX_ALLOW_NM "Response back to trans controller indicating max torque at current speed" FLOAT32_IEEE MC_TQ_TQE_MAX_ALLOW_NM 0 0 0 0 ECU_ADDRESS 0x3FA250 /end MEASUREMENT
/begin COMPU_METHOD MC_TQ_TQE_MAX_ALLOW_NM "TQ_TQE_MAX_ALLOW_NM conversion" RAT_FUNC "%10.5" "Unitless" COEFFS 0 1 0 0 0 1 /end COMPU_METHOD
/begin MEASUREMENT TQ_TQE_MIN_ALLOW_NM "Response back to the trans controller indicating zero fuel at current speed" FLOAT32_IEEE MC_TQ_TQE_MIN_ALLOW_NM 0 0 0 0 ECU_ADDRESS 0x3FA24C /end MEASUREMENT
/begin COMPU_METHOD MC_TQ_TQE_MIN_ALLOW_NM "TQ_TQE_MIN_ALLOW_NM conversion" RAT_FUNC "%10.5" "Unitless" COEFFS 0 1 0 0 0 1 /end COMPU_METHOD
/begin MEASUREMENT TQ_TRANS "NET TORQUE INTO TORQUE CONVERTER" FLOAT32_IEEE MC_TQ_TRANS 0 0 0 0 ECU_ADDRESS 0x3FAAA8 /end MEASUREMENT
/begin COMPU_METHOD MC_TQ_TRANS "TQ_TRANS conversion" RAT_FUNC "%10.5" "Unitless" COEFFS 0 1 0 0 0 1 /end COMPU_METHOD
/begin MEASUREMENT TQ_TRGT "Target maximum torque" FLOAT32_IEEE MC_TQ_TRGT 0 0 0 0 ECU_ADDRESS 0x3FAB5C /end MEASUREMENT
/begin COMPU_METHOD MC_TQ_TRGT "TQ_TRGT conversion" RAT_FUNC "%10.5" "Unitless" COEFFS 0 1 0 0 0 1 /end COMPU_METHOD
/begin CHARACTERISTIC TQ_TRUNC_DEFAULT "Default target torque for torque truncation when a can failure is detected" VALUE 0x5E19C SD_FLOAT32_IEEE 0 SC_TQ_TRUNC_DEFAULT 100 1100 /end CHARACTERISTIC
/begin COMPU_METHOD SC_TQ_TRUNC_DEFAULT "TQ_TRUNC_DEFAULT conversion" RAT_FUNC "%10.5" "lbf*ft" COEFFS 0 1 0 0 0 1 /end COMPU_METHOD
/begin CHARACTERISTIC TQ_TRUNC_MIN "Minimum target torque allowed for torque truncation." VALUE 0x5E198 SD_FLOAT32_IEEE 0 SC_TQ_TRUNC_MIN 100 1100 /end CHARACTERISTIC
/begin COMPU_METHOD SC_TQ_TRUNC_MIN "TQ_TRUNC_MIN conversion" RAT_FUNC "%10.5" "lbf*ft" COEFFS 0 1 0 0 0 1 /end COMPU_METHOD
/begin MEASUREMENT TQ_TRUNC_TARGET "Resulting target maximum torque from torque truncation requests" FLOAT32_IEEE MC_TQ_TRUNC_TARGET 0 0 0 0 ECU_ADDRESS 0x3FAB60 /end MEASUREMENT
/begin COMPU_METHOD MC_TQ_TRUNC_TARGET "TQ_TRUNC_TARGET conversion" RAT_FUNC "%10.5" "Unitless" COEFFS 0 1 0 0 0 1 /end COMPU_METHOD
/begin CHARACTERISTIC TQ_VMOV "Transmission input torque above which vehicle motion may be inferred" VALUE 0x5D8BC SD_FLOAT32_IEEE 0 SC_TQ_VMOV -1020 1020 /end CHARACTERISTIC
/begin COMPU_METHOD SC_TQ_VMOV "TQ_VMOV conversion" RAT_FUNC "%10.5" "FT-LBS" COEFFS 0 1 0 0 0 1 /end COMPU_METHOD
/begin MEASUREMENT TRACK1_FAILED "Indicates track1 failed during this key cycle" UBYTE MC_TRACK1_FAILED 0 0 0 0 ECU_ADDRESS 0x3FA32B /end MEASUREMENT
/begin COMPU_METHOD MC_TRACK1_FAILED "TRACK1_FAILED conversion" RAT_FUNC "%3.0" "Unitless" COEFFS 0 1 0 0 0 1 /end COMPU_METHOD
/begin MEASUREMENT TRACK2_FAILED "Indicates track2 failed during this key cycle" UBYTE MC_TRACK2_FAILED 0 0 0 0 ECU_ADDRESS 0x3FA32A /end MEASUREMENT
/begin COMPU_METHOD MC_TRACK2_FAILED "TRACK2_FAILED conversion" RAT_FUNC "%3.0" "Unitless" COEFFS 0 1 0 0 0 1 /end COMPU_METHOD
/begin MEASUREMENT TRAC_CTL_STATE "Tractional control active/not active" UBYTE MC_TRAC_CTL_STATE 0 0 0 0 ECU_ADDRESS 0x3FA2A3 /end MEASUREMENT
/begin COMPU_METHOD MC_TRAC_CTL_STATE "TRAC_CTL_STATE conversion" RAT_FUNC "%3.0" "Unitless" COEFFS 0 1 0 0 0 1 /end COMPU_METHOD
/begin CHARACTERISTIC TRANS_AXLE_1 "State encoded calibration of Transmission/Axle Type information for SCP, byte." VALUE 0x5EF92 SD_UBYTE 0 SC_TRANS_AXLE_1 0 255 /end CHARACTERISTIC
/begin COMPU_METHOD SC_TRANS_AXLE_1 "TRANS_AXLE_1 conversion" RAT_FUNC "%3.0" "UNITLESS" COEFFS 0 1 0 0 0 1 /end COMPU_METHOD
/begin MEASUREMENT TRANS_CAN_F_FLG "Flag indicating a detected problem with CAN causing defaults tobe used" UBYTE MC_TRANS_CAN_F_FLG 0 0 0 0 ECU_ADDRESS 0x3FAB7C /end MEASUREMENT
/begin COMPU_METHOD MC_TRANS_CAN_F_FLG "TRANS_CAN_F_FLG conversion" RAT_FUNC "%3.0" "Unitless" COEFFS 0 1 0 0 0 1 /end COMPU_METHOD
/begin MEASUREMENT TRANS_INERTIA "" FLOAT32_IEEE MC_TRANS_INERTIA 0 0 0 0 ECU_ADDRESS 0x3FB720 /end MEASUREMENT
/begin COMPU_METHOD MC_TRANS_INERTIA "TRANS_INERTIA conversion" RAT_FUNC "%10.5" "Unitless" COEFFS 0 1 0 0 0 1 /end COMPU_METHOD
/begin MEASUREMENT TRANS_MIL_REQ "Transmission request to enable MIL" UBYTE MC_TRANS_MIL_REQ 0 0 0 0 ECU_ADDRESS 0x3FB742 /end MEASUREMENT
/begin COMPU_METHOD MC_TRANS_MIL_REQ "TRANS_MIL_REQ conversion" RAT_FUNC "%3.0" "Unitless" COEFFS 0 1 0 0 0 1 /end COMPU_METHOD
/begin MEASUREMENT TRANS_TQ_IN "Transmission input torque, used as power on/off indicator." FLOAT32_IEEE MC_TRANS_TQ_IN 0 0 0 0 ECU_ADDRESS 0x3FA658 /end MEASUREMENT
/begin COMPU_METHOD MC_TRANS_TQ_IN "TRANS_TQ_IN conversion" RAT_FUNC "%10.5" "Unitless" COEFFS 0 1 0 0 0 1 /end COMPU_METHOD
/begin MEASUREMENT TRG_N_MIN "minimum target engine speed for closed throttle mode" FLOAT32_IEEE MC_TRG_N_MIN 0 0 0 0 ECU_ADDRESS 0x3FA248 /end MEASUREMENT
/begin COMPU_METHOD MC_TRG_N_MIN "TRG_N_MIN conversion" RAT_FUNC "%10.5" "Unitless" COEFFS 0 1 0 0 0 1 /end COMPU_METHOD
/begin MEASUREMENT TRIP "Flag indicating that an obdII trip has been completed; (1 => trip completed)." UBYTE MC_TRIP 0 0 0 0 ECU_ADDRESS 0x3F9E72 /end MEASUREMENT
/begin COMPU_METHOD MC_TRIP "TRIP conversion" RAT_FUNC "%3.0" "Unitless" COEFFS 0 1 0 0 0 1 /end COMPU_METHOD
/begin MEASUREMENT TRIP_COUNT "Count of number of completed OBD-II trips." UBYTE MC_TRIP_COUNT 0 0 0 0 ECU_ADDRESS 0x3FCD0F /end MEASUREMENT
/begin COMPU_METHOD MC_TRIP_COUNT "TRIP_COUNT conversion" RAT_FUNC "%3.0" "Unitless" COEFFS 0 1 0 0 0 1 /end COMPU_METHOD
/begin MEASUREMENT TRIP_MON_LST "bit0-7:cat_mon_lst,ccm_mon_lst,purg_mon_lst,sair_mon_lst,fuel_mon_lst,ego_mon_lst,egr_mon_lst,mis_mon_lst" UBYTE MC_TRIP_MON_LST 0 0 0 0 ECU_ADDRESS 0x3F9E74 /end MEASUREMENT
/begin COMPU_METHOD MC_TRIP_MON_LST "TRIP_MON_LST conversion" RAT_FUNC "%3.0" "Unitless" COEFFS 0 1 0 0 0 1 /end COMPU_METHOD
/begin MEASUREMENT TRIP_NOT_PRG "Flag that indicates all other OBDII monitors have completed except for purge." UBYTE MC_TRIP_NOT_PRG 0 0 0 0 ECU_ADDRESS 0x3F9E73 /end MEASUREMENT
/begin COMPU_METHOD MC_TRIP_NOT_PRG "TRIP_NOT_PRG conversion" RAT_FUNC "%3.0" "Unitless" COEFFS 0 1 0 0 0 1 /end COMPU_METHOD
/begin MEASUREMENT TRNCAN_COMM_DIAG_TMR "Time since last periodic message received(Vehicle CAN)" FLOAT32_IEEE MC_TRNCAN_COMM_DIAG_TMR 0 0 0 0 ECU_ADDRESS 0x3F9938 /end MEASUREMENT
/begin COMPU_METHOD MC_TRNCAN_COMM_DIAG_TMR "TRNCAN_COMM_DIAG_TMR conversion" RAT_FUNC "%10.5" "Unitless" COEFFS 0 1 0 0 0 1 /end COMPU_METHOD
/begin MEASUREMENT TRNCAN_DIAG_CNTR "Vehicle CAN Communication diagnostic counter" SLONG MC_TRNCAN_DIAG_CNTR 0 0 0 0 ECU_ADDRESS 0x3FA44C /end MEASUREMENT
/begin COMPU_METHOD MC_TRNCAN_DIAG_CNTR "TRNCAN_DIAG_CNTR conversion" RAT_FUNC "%10.0" "Unitless" COEFFS 0 1 0 0 0 1 /end COMPU_METHOD
/begin CHARACTERISTIC TRNCAN_F_DEC "Vehicle CAN Communication diagnosis counter decrement value" VALUE 0x5D664 SD_SLONG 0 SC_TRNCAN_F_DEC 0 65536 /end CHARACTERISTIC
/begin COMPU_METHOD SC_TRNCAN_F_DEC "TRNCAN_F_DEC conversion" RAT_FUNC "%10.0" "unitless" COEFFS 0 1 0 0 0 1 /end COMPU_METHOD
/begin CHARACTERISTIC TRNCAN_F_INC "Vehicle CAN Communication diagnosis counter increment value" VALUE 0x5D660 SD_SLONG 0 SC_TRNCAN_F_INC 0 65536 /end CHARACTERISTIC
/begin COMPU_METHOD SC_TRNCAN_F_INC "TRNCAN_F_INC conversion" RAT_FUNC "%10.0" "unitless" COEFFS 0 1 0 0 0 1 /end COMPU_METHOD
/begin CHARACTERISTIC TRNCAN_IDLE_MAX_TM "Maximum time to wait for periodic message before setting communication error(Vehicle CAN)" VALUE 0x5C680 SD_FLOAT32_IEEE 0 SC_TRNCAN_IDLE_MAX_TM 0 65535 /end CHARACTERISTIC
/begin COMPU_METHOD SC_TRNCAN_IDLE_MAX_TM "TRNCAN_IDLE_MAX_TM conversion" RAT_FUNC "%10.5" "s" COEFFS 0 1 0 0 0 1 /end COMPU_METHOD
/begin MEASUREMENT TRNCAN_STATUS "Bus off status of the transmission (vehicle) CAN link" UBYTE MC_TRNCAN_STATUS 0 0 0 0 ECU_ADDRESS 0x3F9942 /end MEASUREMENT
/begin COMPU_METHOD MC_TRNCAN_STATUS "TRNCAN_STATUS conversion" RAT_FUNC "%3.0" "Unitless" COEFFS 0 1 0 0 0 1 /end COMPU_METHOD
/begin MEASUREMENT TRP_CRNK_FLG "PRNDL is in Park or Neutral" UBYTE MC_TRP_CRNK_FLG 0 0 0 0 ECU_ADDRESS 0x3FB739 /end MEASUREMENT
/begin COMPU_METHOD MC_TRP_CRNK_FLG "TRP_CRNK_FLG conversion" RAT_FUNC "%3.0" "Unitless" COEFFS 0 1 0 0 0 1 /end COMPU_METHOD
/begin MEASUREMENT TRQLST[0] "Torque data for misfire detection" FLOAT32_IEEE MC_TRQLST 0 0 0 0.999985 ECU_ADDRESS 0x3FBED8 /end MEASUREMENT
/begin COMPU_METHOD MC_TRQLST "TRQLST conversion" RAT_FUNC "%10.5" "lbf*ft" COEFFS 0 1 0 0 0 1 /end COMPU_METHOD
/begin MEASUREMENT TRQLST[10] "Torque data for misfire detection" FLOAT32_IEEE MC_TRQLST 0 0 0 0.999985 ECU_ADDRESS 0x3FBF00 /end MEASUREMENT
/begin MEASUREMENT TRQLST[11] "Torque data for misfire detection" FLOAT32_IEEE MC_TRQLST 0 0 0 0.999985 ECU_ADDRESS 0x3FBF04 /end MEASUREMENT
/begin MEASUREMENT TRQLST[12] "Torque data for misfire detection" FLOAT32_IEEE MC_TRQLST 0 0 0 0.999985 ECU_ADDRESS 0x3FBF08 /end MEASUREMENT
/begin MEASUREMENT TRQLST[13] "Torque data for misfire detection" FLOAT32_IEEE MC_TRQLST 0 0 0 0.999985 ECU_ADDRESS 0x3FBF0C /end MEASUREMENT
/begin MEASUREMENT TRQLST[14] "Torque data for misfire detection" FLOAT32_IEEE MC_TRQLST 0 0 0 0.999985 ECU_ADDRESS 0x3FBF10 /end MEASUREMENT
/begin MEASUREMENT TRQLST[15] "Torque data for misfire detection" FLOAT32_IEEE MC_TRQLST 0 0 0 0.999985 ECU_ADDRESS 0x3FBF14 /end MEASUREMENT
/begin MEASUREMENT TRQLST[16] "Torque data for misfire detection" FLOAT32_IEEE MC_TRQLST 0 0 0 0.999985 ECU_ADDRESS 0x3FBF18 /end MEASUREMENT
/begin MEASUREMENT TRQLST[17] "Torque data for misfire detection" FLOAT32_IEEE MC_TRQLST 0 0 0 0.999985 ECU_ADDRESS 0x3FBF1C /end MEASUREMENT
/begin MEASUREMENT TRQLST[18] "Torque data for misfire detection" FLOAT32_IEEE MC_TRQLST 0 0 0 0.999985 ECU_ADDRESS 0x3FBF20 /end MEASUREMENT
/begin MEASUREMENT TRQLST[19] "Torque data for misfire detection" FLOAT32_IEEE MC_TRQLST 0 0 0 0.999985 ECU_ADDRESS 0x3FBF24 /end MEASUREMENT
/begin MEASUREMENT TRQLST[1] "Torque data for misfire detection" FLOAT32_IEEE MC_TRQLST 0 0 0 0.999985 ECU_ADDRESS 0x3FBEDC /end MEASUREMENT
/begin MEASUREMENT TRQLST[20] "Torque data for misfire detection" FLOAT32_IEEE MC_TRQLST 0 0 0 0.999985 ECU_ADDRESS 0x3FBF28 /end MEASUREMENT
/begin MEASUREMENT TRQLST[21] "Torque data for misfire detection" FLOAT32_IEEE MC_TRQLST 0 0 0 0.999985 ECU_ADDRESS 0x3FBF2C /end MEASUREMENT
/begin MEASUREMENT TRQLST[22] "Torque data for misfire detection" FLOAT32_IEEE MC_TRQLST 0 0 0 0.999985 ECU_ADDRESS 0x3FBF30 /end MEASUREMENT
/begin MEASUREMENT TRQLST[23] "Torque data for misfire detection" FLOAT32_IEEE MC_TRQLST 0 0 0 0.999985 ECU_ADDRESS 0x3FBF34 /end MEASUREMENT
/begin MEASUREMENT TRQLST[24] "Torque data for misfire detection" FLOAT32_IEEE MC_TRQLST 0 0 0 0.999985 ECU_ADDRESS 0x3FBF38 /end MEASUREMENT
/begin MEASUREMENT TRQLST[25] "Torque data for misfire detection" FLOAT32_IEEE MC_TRQLST 0 0 0 0.999985 ECU_ADDRESS 0x3FBF3C /end MEASUREMENT
/begin MEASUREMENT TRQLST[26] "Torque data for misfire detection" FLOAT32_IEEE MC_TRQLST 0 0 0 0.999985 ECU_ADDRESS 0x3FBF40 /end MEASUREMENT
/begin MEASUREMENT TRQLST[27] "Torque data for misfire detection" FLOAT32_IEEE MC_TRQLST 0 0 0 0.999985 ECU_ADDRESS 0x3FBF44 /end MEASUREMENT
/begin MEASUREMENT TRQLST[28] "Torque data for misfire detection" FLOAT32_IEEE MC_TRQLST 0 0 0 0.999985 ECU_ADDRESS 0x3FBF48 /end MEASUREMENT
/begin MEASUREMENT TRQLST[29] "Torque data for misfire detection" FLOAT32_IEEE MC_TRQLST 0 0 0 0.999985 ECU_ADDRESS 0x3FBF4C /end MEASUREMENT
/begin MEASUREMENT TRQLST[2] "Torque data for misfire detection" FLOAT32_IEEE MC_TRQLST 0 0 0 0.999985 ECU_ADDRESS 0x3FBEE0 /end MEASUREMENT
/begin MEASUREMENT TRQLST[30] "Torque data for misfire detection" FLOAT32_IEEE MC_TRQLST 0 0 0 0.999985 ECU_ADDRESS 0x3FBF50 /end MEASUREMENT
/begin MEASUREMENT TRQLST[31] "Torque data for misfire detection" FLOAT32_IEEE MC_TRQLST 0 0 0 0.999985 ECU_ADDRESS 0x3FBF54 /end MEASUREMENT
/begin MEASUREMENT TRQLST[32] "Torque data for misfire detection" FLOAT32_IEEE MC_TRQLST 0 0 0 0.999985 ECU_ADDRESS 0x3FBF58 /end MEASUREMENT
/begin MEASUREMENT TRQLST[33] "Torque data for misfire detection" FLOAT32_IEEE MC_TRQLST 0 0 0 0.999985 ECU_ADDRESS 0x3FBF5C /end MEASUREMENT
/begin MEASUREMENT TRQLST[34] "Torque data for misfire detection" FLOAT32_IEEE MC_TRQLST 0 0 0 0.999985 ECU_ADDRESS 0x3FBF60 /end MEASUREMENT
/begin MEASUREMENT TRQLST[35] "Torque data for misfire detection" FLOAT32_IEEE MC_TRQLST 0 0 0 0.999985 ECU_ADDRESS 0x3FBF64 /end MEASUREMENT
/begin MEASUREMENT TRQLST[36] "Torque data for misfire detection" FLOAT32_IEEE MC_TRQLST 0 0 0 0.999985 ECU_ADDRESS 0x3FBF68 /end MEASUREMENT
/begin MEASUREMENT TRQLST[37] "Torque data for misfire detection" FLOAT32_IEEE MC_TRQLST 0 0 0 0.999985 ECU_ADDRESS 0x3FBF6C /end MEASUREMENT
/begin MEASUREMENT TRQLST[38] "Torque data for misfire detection" FLOAT32_IEEE MC_TRQLST 0 0 0 0.999985 ECU_ADDRESS 0x3FBF70 /end MEASUREMENT
/begin MEASUREMENT TRQLST[39] "Torque data for misfire detection" FLOAT32_IEEE MC_TRQLST 0 0 0 0.999985 ECU_ADDRESS 0x3FBF74 /end MEASUREMENT
/begin MEASUREMENT TRQLST[3] "Torque data for misfire detection" FLOAT32_IEEE MC_TRQLST 0 0 0 0.999985 ECU_ADDRESS 0x3FBEE4 /end MEASUREMENT
/begin MEASUREMENT TRQLST[4] "Torque data for misfire detection" FLOAT32_IEEE MC_TRQLST 0 0 0 0.999985 ECU_ADDRESS 0x3FBEE8 /end MEASUREMENT
/begin MEASUREMENT TRQLST[5] "Torque data for misfire detection" FLOAT32_IEEE MC_TRQLST 0 0 0 0.999985 ECU_ADDRESS 0x3FBEEC /end MEASUREMENT
/begin MEASUREMENT TRQLST[6] "Torque data for misfire detection" FLOAT32_IEEE MC_TRQLST 0 0 0 0.999985 ECU_ADDRESS 0x3FBEF0 /end MEASUREMENT
/begin MEASUREMENT TRQLST[7] "Torque data for misfire detection" FLOAT32_IEEE MC_TRQLST 0 0 0 0.999985 ECU_ADDRESS 0x3FBEF4 /end MEASUREMENT
/begin MEASUREMENT TRQLST[8] "Torque data for misfire detection" FLOAT32_IEEE MC_TRQLST 0 0 0 0.999985 ECU_ADDRESS 0x3FBEF8 /end MEASUREMENT
/begin MEASUREMENT TRQLST[9] "Torque data for misfire detection" FLOAT32_IEEE MC_TRQLST 0 0 0 0.999985 ECU_ADDRESS 0x3FBEFC /end MEASUREMENT
/begin MEASUREMENT TRS_STB_CTR "TRS stable counter - number of backgrounds IPDL has remained unchanged" UBYTE MC_TRS_STB_CTR 0 0 0 0 ECU_ADDRESS 0x3FA6AC /end MEASUREMENT
/begin COMPU_METHOD MC_TRS_STB_CTR "TRS_STB_CTR conversion" RAT_FUNC "%3.0" "Unitless" COEFFS 0 1 0 0 0 1 /end COMPU_METHOD
/begin MEASUREMENT TR_LOAD_FLG "Transmission load flag; 1 -> based on torque the transmission is in gear" UBYTE MC_TR_LOAD_FLG 0 0 0 0 ECU_ADDRESS 0x3FA670 /end MEASUREMENT
/begin COMPU_METHOD MC_TR_LOAD_FLG "TR_LOAD_FLG conversion" RAT_FUNC "%3.0" "Unitless" COEFFS 0 1 0 0 0 1 /end COMPU_METHOD
/begin MEASUREMENT TSCTR "Count of unrealistic changes in turbine speed" UBYTE MC_TSCTR 0 0 0 0 ECU_ADDRESS 0x3FA6A6 /end MEASUREMENT
/begin COMPU_METHOD MC_TSCTR "TSCTR conversion" RAT_FUNC "%3.0" "Unitless" COEFFS 0 1 0 0 0 1 /end COMPU_METHOD
/begin MEASUREMENT TSFMFLG "TURBINE SPEED SENSOR FMEM FLAG;  -> 1  in TSS FMEM." UBYTE MC_TSFMFLG 0 0 0 0 ECU_ADDRESS 0x3FB714 /end MEASUREMENT
/begin COMPU_METHOD MC_TSFMFLG "TSFMFLG conversion" RAT_FUNC "%3.0" "Unitless" COEFFS 0 1 0 0 0 1 /end COMPU_METHOD
/begin MEASUREMENT TSLVS_SPK "Time since last VS spike, seconds" FLOAT32_IEEE MC_TSLVS_SPK 0 0 0 0 ECU_ADDRESS 0x3FA67C /end MEASUREMENT
/begin COMPU_METHOD MC_TSLVS_SPK "TSLVS_SPK conversion" RAT_FUNC "%10.5" "Unitless" COEFFS 0 1 0 0 0 1 /end COMPU_METHOD
/begin CHARACTERISTIC TST_ECT_MIN_A "Minimum ECT to enable transmission self test if TFT fails" VALUE 0x5D938 SD_FLOAT32_IEEE 0 SC_TST_ECT_MIN_A -256 254 /end CHARACTERISTIC
/begin COMPU_METHOD SC_TST_ECT_MIN_A "TST_ECT_MIN_A conversion" RAT_FUNC "%10.5" "DEG F" COEFFS 0 1 0 0 0 1 /end COMPU_METHOD
/begin MEASUREMENT TST_ENA_FLG "Transmission self test enable flag; 1 -> TOT dependent trans. logic enabled" UBYTE MC_TST_ENA_FLG 0 0 0 0 ECU_ADDRESS 0x3FA6A3 /end MEASUREMENT
/begin COMPU_METHOD MC_TST_ENA_FLG "TST_ENA_FLG conversion" RAT_FUNC "%3.0" "Unitless" COEFFS 0 1 0 0 0 1 /end COMPU_METHOD
/begin CHARACTERISTIC TST_TOT_MIN_A "Minimum TOT to allow Transmission self test entry" VALUE 0x5D93C SD_FLOAT32_IEEE 0 SC_TST_TOT_MIN_A -20 254 /end CHARACTERISTIC
/begin COMPU_METHOD SC_TST_TOT_MIN_A "TST_TOT_MIN_A conversion" RAT_FUNC "%10.5" "DEG F" COEFFS 0 1 0 0 0 1 /end COMPU_METHOD
/begin CHARACTERISTIC TS_MOV "TURBINE SPEED ABOVE WHICH VSS TEST WILL BE EXECUTED" VALUE 0x5D8E8 SD_FLOAT32_IEEE 0 SC_TS_MOV 0 16383.8 /end CHARACTERISTIC
/begin COMPU_METHOD SC_TS_MOV "TS_MOV conversion" RAT_FUNC "%10.5" "RPM" COEFFS 0 1 0 0 0 1 /end COMPU_METHOD
/begin CHARACTERISTIC TWO_MIS_MULT "Multiply the LDR misfire detection threshold by this to get the threshold for cylinder pair misfire detection." VALUE 0x5EDE8 SD_FLOAT32_IEEE 0 SC_TWO_MIS_MULT 0 10 /end CHARACTERISTIC
/begin COMPU_METHOD SC_TWO_MIS_MULT "TWO_MIS_MULT conversion" RAT_FUNC "%10.5" "%" COEFFS 0 1 0 0 0 1 /end COMPU_METHOD
/begin CHARACTERISTIC TWO_MIS_SW "Switch to enable cylinder pair LDR misfire detection using the second median filter.  Set to 1 to enable second median filter." VALUE 0x5EDED SD_UBYTE 0 SC_TWO_MIS_SW 0 1 /end CHARACTERISTIC
/begin COMPU_METHOD SC_TWO_MIS_SW "TWO_MIS_SW conversion" RAT_FUNC "%3.0" "unitless" COEFFS 0 1 0 0 0 1 /end COMPU_METHOD
/begin MEASUREMENT TWO_MIS_THR "Deacceleration threshold for LDR misfire when using the second median filter width for cylinder pair misfire detection." FLOAT32_IEEE MC_TWO_MIS_THR 0 0 0 0 ECU_ADDRESS 0x3FB31C /end MEASUREMENT
/begin COMPU_METHOD MC_TWO_MIS_THR "TWO_MIS_THR conversion" RAT_FUNC "%10.5" "Unitless" COEFFS 0 1 0 0 0 1 /end COMPU_METHOD
/begin MEASUREMENT TW_HAUL_STAT "Tow/Haul mode status" UBYTE MC_TW_HAUL_STAT 0 0 0 0 ECU_ADDRESS 0x3F9CF6 /end MEASUREMENT
/begin COMPU_METHOD MC_TW_HAUL_STAT "TW_HAUL_STAT conversion" RAT_FUNC "%3.0" "Unitless" COEFFS 0 1 0 0 0 1 /end COMPU_METHOD
/begin CHARACTERISTIC TXPCMID_DLY "Delay before starting initial PCM-ID transfer to PATS Module." VALUE 0x5CDB0 SD_FLOAT32_IEEE 0 SC_TXPCMID_DLY 0 65535 /end CHARACTERISTIC
/begin COMPU_METHOD SC_TXPCMID_DLY "TXPCMID_DLY conversion" RAT_FUNC "%10.5" "ms" COEFFS 0 1 0 0 0 1 /end COMPU_METHOD
/begin MEASUREMENT TX_CONS_COUNT "Number of consecutive diagnostic messages transmitted" UBYTE MC_TX_CONS_COUNT 0 0 0 0 ECU_ADDRESS 0x3F983C /end MEASUREMENT
/begin COMPU_METHOD MC_TX_CONS_COUNT "TX_CONS_COUNT conversion" RAT_FUNC "%3.0" "Unitless" COEFFS 0 1 0 0 0 1 /end COMPU_METHOD
/begin MEASUREMENT TX_OUTCODE1 "First byte of outcode." UBYTE MC_TX_OUTCODE1 0 0 0 0 ECU_ADDRESS 0x3F9DB8 /end MEASUREMENT
/begin COMPU_METHOD MC_TX_OUTCODE1 "TX_OUTCODE1 conversion" RAT_FUNC "%3.0" "Unitless" COEFFS 0 1 0 0 0 1 /end COMPU_METHOD
/begin MEASUREMENT TX_OUTCODE2 "Second byte of outcode." UBYTE MC_TX_OUTCODE2 0 0 0 0 ECU_ADDRESS 0x3F9DB7 /end MEASUREMENT
/begin COMPU_METHOD MC_TX_OUTCODE2 "TX_OUTCODE2 conversion" RAT_FUNC "%3.0" "Unitless" COEFFS 0 1 0 0 0 1 /end COMPU_METHOD
/begin MEASUREMENT TX_OUTCODE3 "Third byte of outcode." UBYTE MC_TX_OUTCODE3 0 0 0 0 ECU_ADDRESS 0x3F9DB6 /end MEASUREMENT
/begin COMPU_METHOD MC_TX_OUTCODE3 "TX_OUTCODE3 conversion" RAT_FUNC "%3.0" "Unitless" COEFFS 0 1 0 0 0 1 /end COMPU_METHOD
/begin CHARACTERISTIC TYPEA_FL_MIL "Always flash MIL for type-A misfire; 1 = flash MIL." VALUE 0x5CDF0 SD_UBYTE 0 SC_TYPEA_FL_MIL 0 1 /end CHARACTERISTIC
/begin COMPU_METHOD SC_TYPEA_FL_MIL "TYPEA_FL_MIL conversion" RAT_FUNC "%3.0" "unitless" COEFFS 0 1 0 0 0 1 /end COMPU_METHOD
/begin MEASUREMENT TYPE_A_MIS "Indicates to executive which misfire criteria" UBYTE MC_TYPE_A_MIS 0 0 0 0 ECU_ADDRESS 0x3FB3E0 /end MEASUREMENT
/begin COMPU_METHOD MC_TYPE_A_MIS "TYPE_A_MIS conversion" RAT_FUNC "%3.0" "Unitless" COEFFS 0 1 0 0 0 1 /end COMPU_METHOD
/begin MEASUREMENT TYPE_B_CNT "Cumulative number of failed type B tests." UBYTE MC_TYPE_B_CNT 0 0 0 0 ECU_ADDRESS 0x3FB3F3 /end MEASUREMENT
/begin COMPU_METHOD MC_TYPE_B_CNT "TYPE_B_CNT conversion" RAT_FUNC "%3.0" "Unitless" COEFFS 0 1 0 0 0 1 /end COMPU_METHOD
/begin CHARACTERISTIC TYPE_B_MAX "Maximum allowed failed type B tests before a fault code must be set." VALUE 0x5EF60 SD_UBYTE 0 SC_TYPE_B_MAX 0 255 /end CHARACTERISTIC
/begin COMPU_METHOD SC_TYPE_B_MAX "TYPE_B_MAX conversion" RAT_FUNC "%3.0" "events" COEFFS 0 1 0 0 0 1 /end COMPU_METHOD
/begin MEASUREMENT TYPE_B_MIS "Misfire Type B fault flag, set if a Type B fault condition is present." UBYTE MC_TYPE_B_MIS 0 0 0 0 ECU_ADDRESS 0x3FB3F6 /end MEASUREMENT
/begin COMPU_METHOD MC_TYPE_B_MIS "TYPE_B_MIS conversion" RAT_FUNC "%3.0" "Unitless" COEFFS 0 1 0 0 0 1 /end COMPU_METHOD
/begin MEASUREMENT U0101MALF "malfunction flag for Lost communication with TCM" UBYTE MC_U0101MALF 0 0 0 0 ECU_ADDRESS 0x3FA4A8 /end MEASUREMENT
/begin COMPU_METHOD MC_U0101MALF "U0101MALF conversion" RAT_FUNC "%3.0" "Unitless" COEFFS 0 1 0 0 0 1 /end COMPU_METHOD
/begin CHARACTERISTIC U0101SW "Lost Communication with TCM diagnosis updation enable switch" VALUE 0x5D775 SD_UBYTE 0 SC_U0101SW 0 2 /end CHARACTERISTIC
/begin COMPU_METHOD SC_U0101SW "U0101SW conversion" RAT_FUNC "%3.0" "unitless" COEFFS 0 1 0 0 0 1 /end COMPU_METHOD
/begin MEASUREMENT U0101UPDATE "u0101 (Lost communication with TCM) malf update indication flag" UBYTE MC_U0101UPDATE 0 0 0 0 ECU_ADDRESS 0x3FA4A9 /end MEASUREMENT
/begin COMPU_METHOD MC_U0101UPDATE "U0101UPDATE conversion" RAT_FUNC "%3.0" "Unitless" COEFFS 0 1 0 0 0 1 /end COMPU_METHOD
/begin MEASUREMENT U0101UPD_CNTR "Lost communication with TCM failure update  counter" SLONG MC_U0101UPD_CNTR 0 0 0 0 ECU_ADDRESS 0x3FA480 /end MEASUREMENT
/begin COMPU_METHOD MC_U0101UPD_CNTR "U0101UPD_CNTR conversion" RAT_FUNC "%10.0" "Unitless" COEFFS 0 1 0 0 0 1 /end COMPU_METHOD
/begin MEASUREMENT U0105MALF "malfunction flag for lost communication with IDM" UBYTE MC_U0105MALF 0 0 0 0 ECU_ADDRESS 0x3FA4AA /end MEASUREMENT
/begin COMPU_METHOD MC_U0105MALF "U0105MALF conversion" RAT_FUNC "%3.0" "Unitless" COEFFS 0 1 0 0 0 1 /end COMPU_METHOD
/begin CHARACTERISTIC U0105SW "Lost  communication with IDM diagnosis updation enable switch" VALUE 0x5D776 SD_UBYTE 0 SC_U0105SW 0 2 /end CHARACTERISTIC
/begin COMPU_METHOD SC_U0105SW "U0105SW conversion" RAT_FUNC "%3.0" "unitless" COEFFS 0 1 0 0 0 1 /end COMPU_METHOD
/begin MEASUREMENT U0105UPDATE "u0105(Lost Communication with IDM) malf update indication flag" UBYTE MC_U0105UPDATE 0 0 0 0 ECU_ADDRESS 0x3FA4AB /end MEASUREMENT
/begin COMPU_METHOD MC_U0105UPDATE "U0105UPDATE conversion" RAT_FUNC "%3.0" "Unitless" COEFFS 0 1 0 0 0 1 /end COMPU_METHOD
/begin MEASUREMENT U0105UPD_CNTR "Lost communication with IDM failure update counter" SLONG MC_U0105UPD_CNTR 0 0 0 0 ECU_ADDRESS 0x3FA484 /end MEASUREMENT
/begin COMPU_METHOD MC_U0105UPD_CNTR "U0105UPD_CNTR conversion" RAT_FUNC "%10.0" "Unitless" COEFFS 0 1 0 0 0 1 /end COMPU_METHOD
/begin MEASUREMENT U0306MALF "PCM injector type mismatch failure flag" UBYTE MC_U0306MALF 0 0 0 0 ECU_ADDRESS 0x3FA4A3 /end MEASUREMENT
/begin COMPU_METHOD MC_U0306MALF "U0306MALF conversion" RAT_FUNC "%3.0" "Unitless" COEFFS 0 1 0 0 0 1 /end COMPU_METHOD
/begin CHARACTERISTIC U0306SW "0=cal_out; 1=non_mil; 2=mil" VALUE 0x5D77F SD_UBYTE 0 SC_U0306SW 0 2 /end CHARACTERISTIC
/begin COMPU_METHOD SC_U0306SW "U0306SW conversion" RAT_FUNC "%3.0" "Unitless" COEFFS 0 1 0 0 0 1 /end COMPU_METHOD
/begin MEASUREMENT U0306UPDATE "PCM injector type mismatch failure update flag" UBYTE MC_U0306UPDATE 0 0 0 0 ECU_ADDRESS 0x3FA4A2 /end MEASUREMENT
/begin COMPU_METHOD MC_U0306UPDATE "U0306UPDATE conversion" RAT_FUNC "%3.0" "Unitless" COEFFS 0 1 0 0 0 1 /end COMPU_METHOD
/begin MEASUREMENT U0306UPD_CNTR "u0306 malf update counter" SLONG MC_U0306UPD_CNTR 0 0 0 0 ECU_ADDRESS 0x3FA474 /end MEASUREMENT
/begin COMPU_METHOD MC_U0306UPD_CNTR "U0306UPD_CNTR conversion" RAT_FUNC "%10.0" "Unitless" COEFFS 0 1 0 0 0 1 /end COMPU_METHOD
/begin MEASUREMENT UNDSP "Underspeed flag." UBYTE MC_UNDSP 0 0 0 0 ECU_ADDRESS 0x3FA2AE /end MEASUREMENT
/begin COMPU_METHOD MC_UNDSP "UNDSP conversion" RAT_FUNC "%3.0" "Unitless" COEFFS 0 1 0 0 0 1 /end COMPU_METHOD
/begin MEASUREMENT UNREALISTIC_N "Captured engine speed when exceeds max (6500)" FLOAT32_IEEE MC_UNREALISTIC_N 0 0 0 0 ECU_ADDRESS 0x3FA108 /end MEASUREMENT
/begin COMPU_METHOD MC_UNREALISTIC_N "UNREALISTIC_N conversion" RAT_FUNC "%10.5" "Unitless" COEFFS 0 1 0 0 0 1 /end COMPU_METHOD
/begin MEASUREMENT USPD_RUN_TMR "Time in underspeed or run mode." FLOAT32_IEEE MC_USPD_RUN_TMR 0 0 0 0 ECU_ADDRESS 0x3FB5DC /end MEASUREMENT
/begin COMPU_METHOD MC_USPD_RUN_TMR "USPD_RUN_TMR conversion" RAT_FUNC "%10.5" "Unitless" COEFFS 0 1 0 0 0 1 /end COMPU_METHOD
/begin MEASUREMENT VBAT "Filtered battery voltage." FLOAT32_IEEE MC_VBAT 0 0 0 0 ECU_ADDRESS 0x3FA410 /end MEASUREMENT
/begin COMPU_METHOD MC_VBAT "VBAT conversion" RAT_FUNC "%10.5" "Unitless" COEFFS 0 1 0 0 0 1 /end COMPU_METHOD
/begin CHARACTERISTIC VBAT_CCM_MIN "Minimum voltage to perform OSM tests." VALUE 0x5CB14 SD_FLOAT32_IEEE 0 SC_VBAT_CCM_MIN 0 15.5 /end CHARACTERISTIC
/begin COMPU_METHOD SC_VBAT_CCM_MIN "VBAT_CCM_MIN conversion" RAT_FUNC "%10.5" "VOLTS" COEFFS 0 1 0 0 0 1 /end COMPU_METHOD
/begin MEASUREMENT VCAMERRCNT "Number of cam circuit failure indications between cam test background execution" UBYTE MC_VCAMERRCNT 0 0 0 0 ECU_ADDRESS 0x3FB297 /end MEASUREMENT
/begin COMPU_METHOD MC_VCAMERRCNT "VCAMERRCNT conversion" RAT_FUNC "%3.0" "Unitless" COEFFS 0 1 0 0 0 1 /end COMPU_METHOD
/begin MEASUREMENT VCAMFLG "1 = CID FAULT (VIP Error Flag)" UBYTE MC_VCAMFLG 0 0 0 0 ECU_ADDRESS 0x3FB2A4 /end MEASUREMENT
/begin COMPU_METHOD MC_VCAMFLG "VCAMFLG conversion" RAT_FUNC "%3.0" "Unitless" COEFFS 0 1 0 0 0 1 /end COMPU_METHOD
/begin MEASUREMENT VCAMPASCNT "Number of Cam sensor foreground evaluations without failure since last Cam test background" UBYTE MC_VCAMPASCNT 0 0 0 0 ECU_ADDRESS 0x3FB296 /end MEASUREMENT
/begin COMPU_METHOD MC_VCAMPASCNT "VCAMPASCNT conversion" RAT_FUNC "%3.0" "Unitless" COEFFS 0 1 0 0 0 1 /end COMPU_METHOD
/begin CHARACTERISTIC VCAMSW "CAM TEST SWITCH 0 = DO NOT DO CAM TEST, 1 = DO CAM TEST UNITLESS" VALUE 0x5ED00 SD_UBYTE 0 SC_VCAMSW 0 1 /end CHARACTERISTIC
/begin COMPU_METHOD SC_VCAMSW "VCAMSW conversion" RAT_FUNC "%3.0" "ENUMERATED" COEFFS 0 1 0 0 0 1 /end COMPU_METHOD
/begin MEASUREMENT VCAM_BYPS "Flag, when equal to 1 indicates that the cam test background is bypassed" UBYTE MC_VCAM_BYPS 0 0 0 0 ECU_ADDRESS 0x3FB29E /end MEASUREMENT
/begin COMPU_METHOD MC_VCAM_BYPS "VCAM_BYPS conversion" RAT_FUNC "%3.0" "Unitless" COEFFS 0 1 0 0 0 1 /end COMPU_METHOD
/begin MEASUREMENT VCIDERRCNT "Number of CID circuit failure indications since last CID test background" UBYTE MC_VCIDERRCNT 0 0 0 0 ECU_ADDRESS 0x3FB299 /end MEASUREMENT
/begin COMPU_METHOD MC_VCIDERRCNT "VCIDERRCNT conversion" RAT_FUNC "%3.0" "Unitless" COEFFS 0 1 0 0 0 1 /end COMPU_METHOD
/begin MEASUREMENT VCIDFLG "1 = CID FAULT (VIP Error Flag)" UBYTE MC_VCIDFLG 0 0 0 0 ECU_ADDRESS 0x3FB2A5 /end MEASUREMENT
/begin COMPU_METHOD MC_VCIDFLG "VCIDFLG conversion" RAT_FUNC "%3.0" "Unitless" COEFFS 0 1 0 0 0 1 /end COMPU_METHOD
/begin MEASUREMENT VCIDPASCNT "Number of CID sensor foreground evaluations without failure since last CID test background" UBYTE MC_VCIDPASCNT 0 0 0 0 ECU_ADDRESS 0x3FB298 /end MEASUREMENT
/begin COMPU_METHOD MC_VCIDPASCNT "VCIDPASCNT conversion" RAT_FUNC "%3.0" "Unitless" COEFFS 0 1 0 0 0 1 /end COMPU_METHOD
/begin CHARACTERISTIC VCIDSW "CYLINDER IDENTIFICATION TEST SWITCH 0 = DO NOT DO CID TEST, 1 = DO CID TEST UNITLESS" VALUE 0x5ED01 SD_UBYTE 0 SC_VCIDSW 0 1 /end CHARACTERISTIC
/begin COMPU_METHOD SC_VCIDSW "VCIDSW conversion" RAT_FUNC "%3.0" "ENUMERATED" COEFFS 0 1 0 0 0 1 /end COMPU_METHOD
/begin MEASUREMENT VCID_BYPS "Flag, when equal to 1 indicates that the cid test background is bypassed" UBYTE MC_VCID_BYPS 0 0 0 0 ECU_ADDRESS 0x3FB29F /end MEASUREMENT
/begin COMPU_METHOD MC_VCID_BYPS "VCID_BYPS conversion" RAT_FUNC "%3.0" "Unitless" COEFFS 0 1 0 0 0 1 /end COMPU_METHOD
/begin MEASUREMENT VCRKERRCNT "Number of crk circuit failure indications between crk test background execution" UBYTE MC_VCRKERRCNT 0 0 0 0 ECU_ADDRESS 0x3FB29B /end MEASUREMENT
/begin COMPU_METHOD MC_VCRKERRCNT "VCRKERRCNT conversion" RAT_FUNC "%3.0" "Unitless" COEFFS 0 1 0 0 0 1 /end COMPU_METHOD
/begin MEASUREMENT VCRKFLG "1 = INDICATES AN INTERMITTANT PIP WITH DP" UBYTE MC_VCRKFLG 0 0 0 0 ECU_ADDRESS 0x3FB2A6 /end MEASUREMENT
/begin COMPU_METHOD MC_VCRKFLG "VCRKFLG conversion" RAT_FUNC "%3.0" "Unitless" COEFFS 0 1 0 0 0 1 /end COMPU_METHOD
/begin MEASUREMENT VCRKPASCNT "Number of Crk sensor foreground evaluations without failure since last Crk test background" UBYTE MC_VCRKPASCNT 0 0 0 0 ECU_ADDRESS 0x3FB29A /end MEASUREMENT
/begin COMPU_METHOD MC_VCRKPASCNT "VCRKPASCNT conversion" RAT_FUNC "%3.0" "Unitless" COEFFS 0 1 0 0 0 1 /end COMPU_METHOD
/begin CHARACTERISTIC VCRKSW "CRK TEST SWITCH 0 = DO NOT DO CRK TEST, 1 = DO CRK TEST UNITLESS" VALUE 0x5ED02 SD_UBYTE 0 SC_VCRKSW 0 1 /end CHARACTERISTIC
/begin COMPU_METHOD SC_VCRKSW "VCRKSW conversion" RAT_FUNC "%3.0" "ENUMERATED" COEFFS 0 1 0 0 0 1 /end COMPU_METHOD
/begin MEASUREMENT VCRK_BYPS "Flag, when equal to 1 indicates that the crk test background is bypassed" UBYTE MC_VCRK_BYPS 0 0 0 0 ECU_ADDRESS 0x3FB2A0 /end MEASUREMENT
/begin COMPU_METHOD MC_VCRK_BYPS "VCRK_BYPS conversion" RAT_FUNC "%3.0" "Unitless" COEFFS 0 1 0 0 0 1 /end COMPU_METHOD
/begin MEASUREMENT VFD "Viscous fan speed output level." FLOAT32_IEEE MC_VFD 0 0 0 0 ECU_ADDRESS 0x3FB220 /end MEASUREMENT
/begin COMPU_METHOD MC_VFD "VFD conversion" RAT_FUNC "%10.5" "Unitless" COEFFS 0 1 0 0 0 1 /end COMPU_METHOD
/begin MEASUREMENT VFDES "Desired volumetric fuel quantity (mm**3/stroke)" FLOAT32_IEEE MC_VFDES 0 0 0 0 ECU_ADDRESS 0x3FA7DC /end MEASUREMENT
/begin COMPU_METHOD MC_VFDES "VFDES conversion" RAT_FUNC "%10.5" "Unitless" COEFFS 0 1 0 0 0 1 /end COMPU_METHOD
/begin MEASUREMENT VFDES_M "Main volumetric fuel quantity (mm**3/stroke)" FLOAT32_IEEE MC_VFDES_M 0 0 0 0 ECU_ADDRESS 0x3FA7D8 /end MEASUREMENT
/begin COMPU_METHOD MC_VFDES_M "VFDES_M conversion" RAT_FUNC "%10.5" "Unitless" COEFFS 0 1 0 0 0 1 /end COMPU_METHOD
/begin MEASUREMENT VFDES_MLT_M "Volume fuel for main shot when in pilot mode" FLOAT32_IEEE MC_VFDES_MLT_M 0 0 0 0 ECU_ADDRESS 0x3FA7C4 /end MEASUREMENT
/begin COMPU_METHOD MC_VFDES_MLT_M "VFDES_MLT_M conversion" RAT_FUNC "%10.5" "Unitless" COEFFS 0 1 0 0 0 1 /end COMPU_METHOD
/begin MEASUREMENT VFDES_P "Pilot volumetric fuel quantity (mm**3/stroke)" FLOAT32_IEEE MC_VFDES_P 0 0 0 0 ECU_ADDRESS 0x3FA7D4 /end MEASUREMENT
/begin COMPU_METHOD MC_VFDES_P "VFDES_P conversion" RAT_FUNC "%10.5" "Unitless" COEFFS 0 1 0 0 0 1 /end COMPU_METHOD
/begin MEASUREMENT VFDES_POST2 "" FLOAT32_IEEE MC_VFDES_POST2 0 0 0 0 ECU_ADDRESS 0x3F9C90 /end MEASUREMENT
/begin COMPU_METHOD MC_VFDES_POST2 "VFDES_POST2 conversion" RAT_FUNC "%10.5" "Unitless" COEFFS 0 1 0 0 0 1 /end COMPU_METHOD
/begin MEASUREMENT VFD_AC_FLG "Viscous fan demanded by A/C system." UBYTE MC_VFD_AC_FLG 0 0 0 0 ECU_ADDRESS 0x3FB1C0 /end MEASUREMENT
/begin COMPU_METHOD MC_VFD_AC_FLG "VFD_AC_FLG conversion" RAT_FUNC "%3.0" "Unitless" COEFFS 0 1 0 0 0 1 /end COMPU_METHOD
/begin CHARACTERISTIC VFD_AC_MAX "Viscous fan speed requested when high A/C head pressure detected." VALUE 0x5EB24 SD_FLOAT32_IEEE 0 SC_VFD_AC_MAX 0 7000 /end CHARACTERISTIC
/begin COMPU_METHOD SC_VFD_AC_MAX "VFD_AC_MAX conversion" RAT_FUNC "%10.5" "RPM" COEFFS 0 1 0 0 0 1 /end COMPU_METHOD
/begin MEASUREMENT VFD_AC_N "Viscous fan speed requested by airconditioning." FLOAT32_IEEE MC_VFD_AC_N 0 0 0 0 ECU_ADDRESS 0x3FB1BC /end MEASUREMENT
/begin COMPU_METHOD MC_VFD_AC_N "VFD_AC_N conversion" RAT_FUNC "%10.5" "Unitless" COEFFS 0 1 0 0 0 1 /end COMPU_METHOD
/begin CHARACTERISTIC VFD_DESECT_DEGC "Desired ECT control point for Visctronic fan." VALUE 0x5EB48 SD_FLOAT32_IEEE 0 SC_VFD_DESECT_DEGC 0 123 /end CHARACTERISTIC
/begin COMPU_METHOD SC_VFD_DESECT_DEGC "VFD_DESECT_DEGC conversion" RAT_FUNC "%10.5" "degC" COEFFS 0 1 0 0 0 1 /end COMPU_METHOD
/begin CHARACTERISTIC VFD_DESEOT_DEGC "Desired EOT control point for Visctronic fan." VALUE 0x5EC70 SD_FLOAT32_IEEE 0 SC_VFD_DESEOT_DEGC 0 123 /end CHARACTERISTIC
/begin COMPU_METHOD SC_VFD_DESEOT_DEGC "VFD_DESEOT_DEGC conversion" RAT_FUNC "%10.5" "degC" COEFFS 0 1 0 0 0 1 /end COMPU_METHOD
/begin CHARACTERISTIC VFD_DRV_RAT "Engine to fan drive ratio." VALUE 0x5EB74 SD_FLOAT32_IEEE 0 SC_VFD_DRV_RAT 0 10 /end CHARACTERISTIC
/begin COMPU_METHOD SC_VFD_DRV_RAT "VFD_DRV_RAT conversion" RAT_FUNC "%10.5" "unitless" COEFFS 0 1 0 0 0 1 /end COMPU_METHOD
/begin MEASUREMENT VFD_ECT_ER_DEGC "ECT distance from desired ECT control point" FLOAT32_IEEE MC_VFD_ECT_ER_DEGC 0 0 0 0 ECU_ADDRESS 0x3FB1C4 /end MEASUREMENT
/begin COMPU_METHOD MC_VFD_ECT_ER_DEGC "VFD_ECT_ER_DEGC conversion" RAT_FUNC "%10.5" "Unitless" COEFFS 0 1 0 0 0 1 /end COMPU_METHOD
/begin CHARACTERISTIC VFD_ECT_HI_DEGC "ECT upper temp limit for max viscous fan speed." VALUE 0x5EB90 SD_FLOAT32_IEEE 0 SC_VFD_ECT_HI_DEGC -40 123 /end CHARACTERISTIC
/begin COMPU_METHOD SC_VFD_ECT_HI_DEGC "VFD_ECT_HI_DEGC conversion" RAT_FUNC "%10.5" "degC" COEFFS 0 1 0 0 0 1 /end COMPU_METHOD
/begin CHARACTERISTIC VFD_ECT_LO_DEGC "ECT lower temp limit for min viscous fan speed." VALUE 0x5EB8C SD_FLOAT32_IEEE 0 SC_VFD_ECT_LO_DEGC -40 123 /end CHARACTERISTIC
/begin COMPU_METHOD SC_VFD_ECT_LO_DEGC "VFD_ECT_LO_DEGC conversion" RAT_FUNC "%10.5" "degC" COEFFS 0 1 0 0 0 1 /end COMPU_METHOD
/begin MEASUREMENT VFD_ECT_N "Viscous fan speed requested by ect." FLOAT32_IEEE MC_VFD_ECT_N 0 0 0 0 ECU_ADDRESS 0x3FB1CC /end MEASUREMENT
/begin COMPU_METHOD MC_VFD_ECT_N "VFD_ECT_N conversion" RAT_FUNC "%10.5" "Unitless" COEFFS 0 1 0 0 0 1 /end COMPU_METHOD
/begin CHARACTERISTIC VFD_ECT_THLD "ect threshold" VALUE 0x5EB38 SD_FLOAT32_IEEE 0 SC_VFD_ECT_THLD 0 100 /end CHARACTERISTIC
/begin COMPU_METHOD SC_VFD_ECT_THLD "VFD_ECT_THLD conversion" RAT_FUNC "%10.5" "degC" COEFFS 0 1 0 0 0 1 /end COMPU_METHOD
/begin CHARACTERISTIC VFD_ENG_BUF "Engine slip heat buffer." VALUE 0x5EB94 SD_FLOAT32_IEEE 0 SC_VFD_ENG_BUF 0 7000 /end CHARACTERISTIC
/begin COMPU_METHOD SC_VFD_ENG_BUF "VFD_ENG_BUF conversion" RAT_FUNC "%10.5" "RPM" COEFFS 0 1 0 0 0 1 /end COMPU_METHOD
/begin CHARACTERISTIC VFD_ENG_SLIP "In slip heat area above this engine RPM." VALUE 0x5EB80 SD_FLOAT32_IEEE 0 SC_VFD_ENG_SLIP 0 7000 /end CHARACTERISTIC
/begin COMPU_METHOD SC_VFD_ENG_SLIP "VFD_ENG_SLIP conversion" RAT_FUNC "%10.5" "RPM" COEFFS 0 1 0 0 0 1 /end COMPU_METHOD
/begin MEASUREMENT VFD_EOT_ER_DEGC "EOT distance from desired EOT control point" FLOAT32_IEEE MC_VFD_EOT_ER_DEGC 0 0 0 0 ECU_ADDRESS 0x3FB244 /end MEASUREMENT
/begin COMPU_METHOD MC_VFD_EOT_ER_DEGC "VFD_EOT_ER_DEGC conversion" RAT_FUNC "%10.5" "Unitless" COEFFS 0 1 0 0 0 1 /end COMPU_METHOD
/begin CHARACTERISTIC VFD_EOT_HI_DEGC "Engine oil temperature limit for slip off logic." VALUE 0x5EB88 SD_FLOAT32_IEEE 0 SC_VFD_EOT_HI_DEGC -8192 8191 /end CHARACTERISTIC
/begin COMPU_METHOD SC_VFD_EOT_HI_DEGC "VFD_EOT_HI_DEGC conversion" RAT_FUNC "%10.5" "degC" COEFFS 0 1 0 0 0 1 /end COMPU_METHOD
/begin CHARACTERISTIC VFD_EOT_IK "Viscous fan integrator gain ." VALUE 0x5EC68 SD_FLOAT32_IEEE 0 SC_VFD_EOT_IK 0 20 /end CHARACTERISTIC
/begin COMPU_METHOD SC_VFD_EOT_IK "VFD_EOT_IK conversion" RAT_FUNC "%10.5" "1/deg*s" COEFFS 0 1 0 0 0 1 /end COMPU_METHOD
/begin MEASUREMENT VFD_EOT_INTER "Integrator for VFD." FLOAT32_IEEE MC_VFD_EOT_INTER 0 0 0 0 ECU_ADDRESS 0x3FB248 /end MEASUREMENT
/begin COMPU_METHOD MC_VFD_EOT_INTER "VFD_EOT_INTER conversion" RAT_FUNC "%10.5" "Unitless" COEFFS 0 1 0 0 0 1 /end COMPU_METHOD
/begin CHARACTERISTIC VFD_EOT_INT_RPM "Base value for VFD integrator." VALUE 0x5EC64 SD_FLOAT32_IEEE 0 SC_VFD_EOT_INT_RPM 0 7000 /end CHARACTERISTIC
/begin COMPU_METHOD SC_VFD_EOT_INT_RPM "VFD_EOT_INT_RPM conversion" RAT_FUNC "%10.5" "RPM" COEFFS 0 1 0 0 0 1 /end COMPU_METHOD
/begin CHARACTERISTIC VFD_EOT_MAX_RPM "Maximum viscous fan speed demand based on eot." VALUE 0x5EC6C SD_FLOAT32_IEEE 0 SC_VFD_EOT_MAX_RPM 0 7000 /end CHARACTERISTIC
/begin COMPU_METHOD SC_VFD_EOT_MAX_RPM "VFD_EOT_MAX_RPM conversion" RAT_FUNC "%10.5" "RPM" COEFFS 0 1 0 0 0 1 /end COMPU_METHOD
/begin MEASUREMENT VFD_EOT_N "Viscous fan speed requested by eot." FLOAT32_IEEE MC_VFD_EOT_N 0 0 0 0 ECU_ADDRESS 0x3FB24C /end MEASUREMENT
/begin COMPU_METHOD MC_VFD_EOT_N "VFD_EOT_N conversion" RAT_FUNC "%10.5" "Unitless" COEFFS 0 1 0 0 0 1 /end COMPU_METHOD
/begin CHARACTERISTIC VFD_EOT_THLD "eot threshold" VALUE 0x5EC60 SD_FLOAT32_IEEE 0 SC_VFD_EOT_THLD 0 100 /end CHARACTERISTIC
/begin COMPU_METHOD SC_VFD_EOT_THLD "VFD_EOT_THLD conversion" RAT_FUNC "%10.5" "degC" COEFFS 0 1 0 0 0 1 /end COMPU_METHOD
/begin MEASUREMENT VFD_FAN_N "Viscous filtered fan speed, used in control regulator." FLOAT32_IEEE MC_VFD_FAN_N 0 0 0 0 ECU_ADDRESS 0x3F9C8C /end MEASUREMENT
/begin COMPU_METHOD MC_VFD_FAN_N "VFD_FAN_N conversion" RAT_FUNC "%10.5" "Unitless" COEFFS 0 1 0 0 0 1 /end COMPU_METHOD
/begin CHARACTERISTIC VFD_FAN_NMAX "Maximum reasonable filtered fan speed that can be expected." VALUE 0x5EC14 SD_FLOAT32_IEEE 0 SC_VFD_FAN_NMAX 0 7000 /end CHARACTERISTIC
/begin COMPU_METHOD SC_VFD_FAN_NMAX "VFD_FAN_NMAX conversion" RAT_FUNC "%10.5" "RPM" COEFFS 0 1 0 0 0 1 /end COMPU_METHOD
/begin CHARACTERISTIC VFD_FAN_SLIP "In slip heat area above this viscous fan RPM." VALUE 0x5EB7C SD_FLOAT32_IEEE 0 SC_VFD_FAN_SLIP 0 7000 /end CHARACTERISTIC
/begin COMPU_METHOD SC_VFD_FAN_SLIP "VFD_FAN_SLIP conversion" RAT_FUNC "%10.5" "RPM" COEFFS 0 1 0 0 0 1 /end COMPU_METHOD
/begin MEASUREMENT VFD_FB_ERLST "Viscous fan feedback error term last." FLOAT32_IEEE MC_VFD_FB_ERLST 0 0 0 0 ECU_ADDRESS 0x3FB218 /end MEASUREMENT
/begin COMPU_METHOD MC_VFD_FB_ERLST "VFD_FB_ERLST conversion" RAT_FUNC "%10.5" "Unitless" COEFFS 0 1 0 0 0 1 /end COMPU_METHOD
/begin MEASUREMENT VFD_FB_ERR "Viscous fan feedback error term." FLOAT32_IEEE MC_VFD_FB_ERR 0 0 0 0 ECU_ADDRESS 0x3FB21C /end MEASUREMENT
/begin COMPU_METHOD MC_VFD_FB_ERR "VFD_FB_ERR conversion" RAT_FUNC "%10.5" "Unitless" COEFFS 0 1 0 0 0 1 /end COMPU_METHOD
/begin MEASUREMENT VFD_FB_INLST "Viscous fan feedfback input control term last." FLOAT32_IEEE MC_VFD_FB_INLST 0 0 0 0 ECU_ADDRESS 0x3FB214 /end MEASUREMENT
/begin COMPU_METHOD MC_VFD_FB_INLST "VFD_FB_INLST conversion" RAT_FUNC "%10.5" "Unitless" COEFFS 0 1 0 0 0 1 /end COMPU_METHOD
/begin MEASUREMENT VFD_FFAN_N "Viscous fan filtered speed." FLOAT32_IEEE MC_VFD_FFAN_N 0 0 0 0 ECU_ADDRESS 0x3FB200 /end MEASUREMENT
/begin COMPU_METHOD MC_VFD_FFAN_N "VFD_FFAN_N conversion" RAT_FUNC "%10.5" "Unitless" COEFFS 0 1 0 0 0 1 /end COMPU_METHOD
/begin MEASUREMENT VFD_FF_ERLST "Viscous fan feedforward error term last." FLOAT32_IEEE MC_VFD_FF_ERLST 0 0 0 0 ECU_ADDRESS 0x3FB204 /end MEASUREMENT
/begin COMPU_METHOD MC_VFD_FF_ERLST "VFD_FF_ERLST conversion" RAT_FUNC "%10.5" "Unitless" COEFFS 0 1 0 0 0 1 /end COMPU_METHOD
/begin MEASUREMENT VFD_FF_ERR "Viscous fan feedforward error term." FLOAT32_IEEE MC_VFD_FF_ERR 0 0 0 0 ECU_ADDRESS 0x3FB210 /end MEASUREMENT
/begin COMPU_METHOD MC_VFD_FF_ERR "VFD_FF_ERR conversion" RAT_FUNC "%10.5" "Unitless" COEFFS 0 1 0 0 0 1 /end COMPU_METHOD
/begin MEASUREMENT VFD_FF_INLST "Viscous fan feedforward input control term last." FLOAT32_IEEE MC_VFD_FF_INLST 0 0 0 0 ECU_ADDRESS 0x3FB208 /end MEASUREMENT
/begin COMPU_METHOD MC_VFD_FF_INLST "VFD_FF_INLST conversion" RAT_FUNC "%10.5" "Unitless" COEFFS 0 1 0 0 0 1 /end COMPU_METHOD
/begin MEASUREMENT VFD_FF_INP "Viscous fan feedforward input control term." FLOAT32_IEEE MC_VFD_FF_INP 0 0 0 0 ECU_ADDRESS 0x3FB20C /end MEASUREMENT
/begin COMPU_METHOD MC_VFD_FF_INP "VFD_FF_INP conversion" RAT_FUNC "%10.5" "Unitless" COEFFS 0 1 0 0 0 1 /end COMPU_METHOD
/begin MEASUREMENT VFD_FLG "Indicates fan output fault" UBYTE MC_VFD_FLG 0 0 0 0 ECU_ADDRESS 0x3FB242 /end MEASUREMENT
/begin COMPU_METHOD MC_VFD_FLG "VFD_FLG conversion" RAT_FUNC "%3.0" "Unitless" COEFFS 0 1 0 0 0 1 /end COMPU_METHOD
/begin CHARACTERISTIC VFD_FREQ "Frequency for VFD." VALUE 0x5C3D4 SD_FLOAT32_IEEE 0 SC_VFD_FREQ 3.5 30 /end CHARACTERISTIC
/begin COMPU_METHOD SC_VFD_FREQ "VFD_FREQ conversion" RAT_FUNC "%10.5" "HZ" COEFFS 0 1 0 0 0 1 /end COMPU_METHOD
/begin CHARACTERISTIC VFD_HP "Viscous fan hardware present." VALUE 0x5EBA0 SD_UBYTE 0 SC_VFD_HP 0 1 /end CHARACTERISTIC
/begin COMPU_METHOD SC_VFD_HP "VFD_HP conversion" RAT_FUNC "%3.0" "unitless" COEFFS 0 1 0 0 0 1 /end COMPU_METHOD
/begin CHARACTERISTIC VFD_IK "Viscous fan integrator gain." VALUE 0x5EB40 SD_FLOAT32_IEEE 0 SC_VFD_IK 0 20 /end CHARACTERISTIC
/begin COMPU_METHOD SC_VFD_IK "VFD_IK conversion" RAT_FUNC "%10.5" "1/deg*s" COEFFS 0 1 0 0 0 1 /end COMPU_METHOD
/begin MEASUREMENT VFD_INTER "Integrator for VFD." FLOAT32_IEEE MC_VFD_INTER 0 0 0 0 ECU_ADDRESS 0x3FB1C8 /end MEASUREMENT
/begin COMPU_METHOD MC_VFD_INTER "VFD_INTER conversion" RAT_FUNC "%10.5" "Unitless" COEFFS 0 1 0 0 0 1 /end COMPU_METHOD
/begin CHARACTERISTIC VFD_INT_MAX "Maximum viscous fan output duty cycle integrator allowed." VALUE 0x5EB54 SD_FLOAT32_IEEE 0 SC_VFD_INT_MAX 0 1 /end CHARACTERISTIC
/begin COMPU_METHOD SC_VFD_INT_MAX "VFD_INT_MAX conversion" RAT_FUNC "%10.5" "unitless" COEFFS 0 1 0 0 0 1 /end COMPU_METHOD
/begin CHARACTERISTIC VFD_INT_RPM "Base value for VFD integrator." VALUE 0x5EB3C SD_FLOAT32_IEEE 0 SC_VFD_INT_RPM 0 7000 /end CHARACTERISTIC
/begin COMPU_METHOD SC_VFD_INT_RPM "VFD_INT_RPM conversion" RAT_FUNC "%10.5" "RPM" COEFFS 0 1 0 0 0 1 /end COMPU_METHOD
/begin CHARACTERISTIC VFD_INT_STEP "Viscous fan duty cycle integrator increment value." VALUE 0x5EB58 SD_FLOAT32_IEEE 0 SC_VFD_INT_STEP 0 1 /end CHARACTERISTIC
/begin COMPU_METHOD SC_VFD_INT_STEP "VFD_INT_STEP conversion" RAT_FUNC "%10.5" "unitless" COEFFS 0 1 0 0 0 1 /end COMPU_METHOD
/begin CHARACTERISTIC VFD_K1_NEW "Viscous fan feedback constant, K1." VALUE 0x5EC0A SD_UWORD 0 SC_VFD_K1_NEW 0 1000 /end CHARACTERISTIC
/begin COMPU_METHOD SC_VFD_K1_NEW "VFD_K1_NEW conversion" RAT_FUNC "%5.0" "unitless" COEFFS 0 1 0 0 0 1 /end COMPU_METHOD
/begin CHARACTERISTIC VFD_K2_NEW "Viscous fan feedback constant, K2." VALUE 0x5EC08 SD_UWORD 0 SC_VFD_K2_NEW 0 1000 /end CHARACTERISTIC
/begin COMPU_METHOD SC_VFD_K2_NEW "VFD_K2_NEW conversion" RAT_FUNC "%5.0" "unitless" COEFFS 0 1 0 0 0 1 /end COMPU_METHOD
/begin CHARACTERISTIC VFD_K3_NEW "Viscous fan feedback constant, K3." VALUE 0x5EC06 SD_UWORD 0 SC_VFD_K3_NEW 0 1000 /end CHARACTERISTIC
/begin COMPU_METHOD SC_VFD_K3_NEW "VFD_K3_NEW conversion" RAT_FUNC "%5.0" "unitless" COEFFS 0 1 0 0 0 1 /end COMPU_METHOD
/begin CHARACTERISTIC VFD_K4_NEW "Viscous fan feedforward constant, K4." VALUE 0x5EC04 SD_UWORD 0 SC_VFD_K4_NEW 0 1000 /end CHARACTERISTIC
/begin COMPU_METHOD SC_VFD_K4_NEW "VFD_K4_NEW conversion" RAT_FUNC "%5.0" "unitless" COEFFS 0 1 0 0 0 1 /end COMPU_METHOD
/begin CHARACTERISTIC VFD_K5_NEW "Viscous fan feedforward constant, K5." VALUE 0x5EC02 SD_UWORD 0 SC_VFD_K5_NEW 0 1000 /end CHARACTERISTIC
/begin COMPU_METHOD SC_VFD_K5_NEW "VFD_K5_NEW conversion" RAT_FUNC "%5.0" "unitless" COEFFS 0 1 0 0 0 1 /end COMPU_METHOD
/begin CHARACTERISTIC VFD_K6_NEW "Viscous fan feedforward constant, K6." VALUE 0x5EC00 SD_UWORD 0 SC_VFD_K6_NEW 0 1000 /end CHARACTERISTIC
/begin COMPU_METHOD SC_VFD_K6_NEW "VFD_K6_NEW conversion" RAT_FUNC "%5.0" "unitless" COEFFS 0 1 0 0 0 1 /end COMPU_METHOD
/begin CHARACTERISTIC VFD_KOEO_FAN_OFF "Viscous fan duty cycle when fan is requested OFF by KOEO" VALUE 0x5EBE0 SD_FLOAT32_IEEE 0 SC_VFD_KOEO_FAN_OFF 0 1 /end CHARACTERISTIC
/begin COMPU_METHOD SC_VFD_KOEO_FAN_OFF "VFD_KOEO_FAN_OFF conversion" RAT_FUNC "%10.5" "unitless" COEFFS 0 1 0 0 0 1 /end COMPU_METHOD
/begin CHARACTERISTIC VFD_KOEO_FAN_ON "Viscous fan duty cycle when fan is requested ON by KOEO" VALUE 0x5EBDC SD_FLOAT32_IEEE 0 SC_VFD_KOEO_FAN_ON 0 1 /end CHARACTERISTIC
/begin COMPU_METHOD SC_VFD_KOEO_FAN_ON "VFD_KOEO_FAN_ON conversion" RAT_FUNC "%10.5" "unitless" COEFFS 0 1 0 0 0 1 /end COMPU_METHOD
/begin CHARACTERISTIC VFD_LOW_DC "" VALUE 0x5EBEC SD_FLOAT32_IEEE 0 SC_VFD_LOW_DC 0 1.99997 /end CHARACTERISTIC
/begin COMPU_METHOD SC_VFD_LOW_DC "VFD_LOW_DC conversion" RAT_FUNC "%10.5" "unitless" COEFFS 0 1 0 0 0 1 /end COMPU_METHOD
/begin CHARACTERISTIC VFD_LOW_SPD "Instantaneous viscous fan speed low limit" VALUE 0x5EBE8 SD_FLOAT32_IEEE 0 SC_VFD_LOW_SPD 0 15000 /end CHARACTERISTIC
/begin COMPU_METHOD SC_VFD_LOW_SPD "VFD_LOW_SPD conversion" RAT_FUNC "%10.5" "RPM" COEFFS 0 1 0 0 0 1 /end COMPU_METHOD
/begin CHARACTERISTIC VFD_MAX_DTYC "Visctronic fan output duty cycle above which check for output driver fault." VALUE 0x5EC38 SD_FLOAT32_IEEE 0 SC_VFD_MAX_DTYC 0 1 /end CHARACTERISTIC
/begin COMPU_METHOD SC_VFD_MAX_DTYC "VFD_MAX_DTYC conversion" RAT_FUNC "%10.5" "LEVEL" COEFFS 0 1 0 0 0 1 /end COMPU_METHOD
/begin CHARACTERISTIC VFD_MAX_IDLE "Stoplight mode below this idle rpm." VALUE 0x5EB70 SD_FLOAT32_IEEE 0 SC_VFD_MAX_IDLE 0 7000 /end CHARACTERISTIC
/begin COMPU_METHOD SC_VFD_MAX_IDLE "VFD_MAX_IDLE conversion" RAT_FUNC "%10.5" "RPM" COEFFS 0 1 0 0 0 1 /end COMPU_METHOD
/begin CHARACTERISTIC VFD_MAX_RPM "Maximum viscous fan speed demand." VALUE 0x5EB44 SD_FLOAT32_IEEE 0 SC_VFD_MAX_RPM 0 7000 /end CHARACTERISTIC
/begin COMPU_METHOD SC_VFD_MAX_RPM "VFD_MAX_RPM conversion" RAT_FUNC "%10.5" "RPM" COEFFS 0 1 0 0 0 1 /end COMPU_METHOD
/begin CHARACTERISTIC VFD_MIN_DTYC "Visctronic fan output duty cycle below which check for output driver fault." VALUE 0x5EC34 SD_FLOAT32_IEEE 0 SC_VFD_MIN_DTYC 0 1 /end CHARACTERISTIC
/begin COMPU_METHOD SC_VFD_MIN_DTYC "VFD_MIN_DTYC conversion" RAT_FUNC "%10.5" "LEVEL" COEFFS 0 1 0 0 0 1 /end COMPU_METHOD
/begin CHARACTERISTIC VFD_MIN_RPM "Minimum viscous fan speed clip demand." VALUE 0x5EB68 SD_FLOAT32_IEEE 0 SC_VFD_MIN_RPM 0 7000 /end CHARACTERISTIC
/begin COMPU_METHOD SC_VFD_MIN_RPM "VFD_MIN_RPM conversion" RAT_FUNC "%10.5" "RPM" COEFFS 0 1 0 0 0 1 /end COMPU_METHOD
/begin MEASUREMENT VFD_NEW_FAN_N "Instantaneous Fan speed" FLOAT32_IEEE MC_VFD_NEW_FAN_N 0 0 0 0 ECU_ADDRESS 0x3F98B0 /end MEASUREMENT
/begin COMPU_METHOD MC_VFD_NEW_FAN_N "VFD_NEW_FAN_N conversion" RAT_FUNC "%10.5" "Unitless" COEFFS 0 1 0 0 0 1 /end COMPU_METHOD
/begin CHARACTERISTIC VFD_NMAX "Maximum reasonable fan speed that can be expected." VALUE 0x5C508 SD_FLOAT32_IEEE 0 SC_VFD_NMAX 0 7000 /end CHARACTERISTIC
/begin COMPU_METHOD SC_VFD_NMAX "VFD_NMAX conversion" RAT_FUNC "%10.5" "RPM" COEFFS 0 1 0 0 0 1 /end COMPU_METHOD
/begin MEASUREMENT VFD_N_ERROR "Viscous fan error (requested - filtered)." FLOAT32_IEEE MC_VFD_N_ERROR 0 0 0 0 ECU_ADDRESS 0x3FB1FC /end MEASUREMENT
/begin COMPU_METHOD MC_VFD_N_ERROR "VFD_N_ERROR conversion" RAT_FUNC "%10.5" "Unitless" COEFFS 0 1 0 0 0 1 /end COMPU_METHOD
/begin CHARACTERISTIC VFD_N_TC "Time constant for VFD_FAN_N." VALUE 0x5C504 SD_FLOAT32_IEEE 0 SC_VFD_N_TC 0 63.99 /end CHARACTERISTIC
/begin COMPU_METHOD SC_VFD_N_TC "VFD_N_TC conversion" RAT_FUNC "%10.5" "unitless" COEFFS 0 1 0 0 0 1 /end COMPU_METHOD
/begin CHARACTERISTIC VFD_OSC_CHANNEL "" VALUE 0x5EC0C SD_UBYTE 0 SC_VFD_OSC_CHANNEL 0 255 /end CHARACTERISTIC
/begin COMPU_METHOD SC_VFD_OSC_CHANNEL "VFD_OSC_CHANNEL conversion" RAT_FUNC "%3.0" "unitless" COEFFS 0 1 0 0 0 1 /end COMPU_METHOD
/begin CHARACTERISTIC VFD_REQ_CAL "Viscous fan final output speed calibration." VALUE 0x5EB50 SD_FLOAT32_IEEE 0 SC_VFD_REQ_CAL 0 7000 /end CHARACTERISTIC
/begin COMPU_METHOD SC_VFD_REQ_CAL "VFD_REQ_CAL conversion" RAT_FUNC "%10.5" "RPM" COEFFS 0 1 0 0 0 1 /end COMPU_METHOD
/begin MEASUREMENT VFD_REQ_N "Viscous fan final output speed." FLOAT32_IEEE MC_VFD_REQ_N 0 0 0 0 ECU_ADDRESS 0x3FB1F0 /end MEASUREMENT
/begin COMPU_METHOD MC_VFD_REQ_N "VFD_REQ_N conversion" RAT_FUNC "%10.5" "Unitless" COEFFS 0 1 0 0 0 1 /end COMPU_METHOD
/begin CHARACTERISTIC VFD_SEL "required fan speed selection switch" VALUE 0x5EB78 SD_UBYTE 0 SC_VFD_SEL 0 1 /end CHARACTERISTIC
/begin COMPU_METHOD SC_VFD_SEL "VFD_SEL conversion" RAT_FUNC "%3.0" "unitless" COEFFS 0 1 0 0 0 1 /end COMPU_METHOD
/begin CHARACTERISTIC VFD_SL1_DC "Stoplight mode 1 duty cycle:  phase out fan when cooling" VALUE 0x5EBE4 SD_FLOAT32_IEEE 0 SC_VFD_SL1_DC 0 1 /end CHARACTERISTIC
/begin COMPU_METHOD SC_VFD_SL1_DC "VFD_SL1_DC conversion" RAT_FUNC "%10.5" "unitless" COEFFS 0 1 0 0 0 1 /end COMPU_METHOD
/begin MEASUREMENT VFD_SLDC_INT "Extended idle viscous fan output duty cycle integrator" FLOAT32_IEEE MC_VFD_SLDC_INT 0 0 0 0 ECU_ADDRESS 0x3FB1D4 /end MEASUREMENT
/begin COMPU_METHOD MC_VFD_SLDC_INT "VFD_SLDC_INT conversion" RAT_FUNC "%10.5" "Unitless" COEFFS 0 1 0 0 0 1 /end COMPU_METHOD
/begin MEASUREMENT VFD_SLIDE_BAR "" FLOAT32_IEEE MC_VFD_SLIDE_BAR 0 0 0 0 ECU_ADDRESS 0x3FB1F8 /end MEASUREMENT
/begin COMPU_METHOD MC_VFD_SLIDE_BAR "VFD_SLIDE_BAR conversion" RAT_FUNC "%10.5" "Unitless" COEFFS 0 1 0 0 0 1 /end COMPU_METHOD
/begin MEASUREMENT VFD_SLIP_CTL "Viscous fan slip control mode; 0->off, 1->over temp., 2->under temp.." UBYTE MC_VFD_SLIP_CTL 0 0 0 0 ECU_ADDRESS 0x3FB1E4 /end MEASUREMENT
/begin COMPU_METHOD MC_VFD_SLIP_CTL "VFD_SLIP_CTL conversion" RAT_FUNC "%3.0" "Unitless" COEFFS 0 1 0 0 0 1 /end COMPU_METHOD
/begin CHARACTERISTIC VFD_SLIP_RPM "Viscous fan assumed off if fan-slip is greater than this." VALUE 0x5EB6C SD_FLOAT32_IEEE 0 SC_VFD_SLIP_RPM 0 7000 /end CHARACTERISTIC
/begin COMPU_METHOD SC_VFD_SLIP_RPM "VFD_SLIP_RPM conversion" RAT_FUNC "%10.5" "unitless" COEFFS 0 1 0 0 0 1 /end COMPU_METHOD
/begin CHARACTERISTIC VFD_SL_ECT "ECT threshold to enter viscous fan stoplight mode 2" VALUE 0x5EB60 SD_FLOAT32_IEEE 0 SC_VFD_SL_ECT -40 254 /end CHARACTERISTIC
/begin COMPU_METHOD SC_VFD_SL_ECT "VFD_SL_ECT conversion" RAT_FUNC "%10.5" "degF" COEFFS 0 1 0 0 0 1 /end COMPU_METHOD
/begin CHARACTERISTIC VFD_SL_ECT_DEGC "ECT threshold to enter viscous fan stoplight mode 2" VALUE 0x5EB64 SD_FLOAT32_IEEE 0 SC_VFD_SL_ECT_DEGC -110 254 /end CHARACTERISTIC
/begin COMPU_METHOD SC_VFD_SL_ECT_DEGC "VFD_SL_ECT_DEGC conversion" RAT_FUNC "%10.5" "degC" COEFFS 0 1 0 0 0 1 /end COMPU_METHOD
/begin CHARACTERISTIC VFD_SL_EOT "Engine oil temperature limit for vfd final logic." VALUE 0x5EB5C SD_FLOAT32_IEEE 0 SC_VFD_SL_EOT -8192 8191 /end CHARACTERISTIC
/begin COMPU_METHOD SC_VFD_SL_EOT "VFD_SL_EOT conversion" RAT_FUNC "%10.5" "degC" COEFFS 0 1 0 0 0 1 /end COMPU_METHOD
/begin MEASUREMENT VFD_SL_STATE "Stoplight mode: 0 = normal; 1 =  at idle, cooling; 2 = at  idle, high slip" UBYTE MC_VFD_SL_STATE 0 0 0 0 ECU_ADDRESS 0x3FB1E0 /end MEASUREMENT
/begin COMPU_METHOD MC_VFD_SL_STATE "VFD_SL_STATE conversion" RAT_FUNC "%3.0" "Unitless" COEFFS 0 1 0 0 0 1 /end COMPU_METHOD
/begin MEASUREMENT VFD_SL_TMR "Stop light mode timer." FLOAT32_IEEE MC_VFD_SL_TMR 0 0 0 0 ECU_ADDRESS 0x3FB1DC /end MEASUREMENT
/begin COMPU_METHOD MC_VFD_SL_TMR "VFD_SL_TMR conversion" RAT_FUNC "%10.5" "Unitless" COEFFS 0 1 0 0 0 1 /end COMPU_METHOD
/begin CHARACTERISTIC VFD_SL_WAIT "Stop light mode timer limit." VALUE 0x3FB1D8 SD_FLOAT32_IEEE 0 SC_VFD_SL_WAIT 0 255 /end CHARACTERISTIC
/begin COMPU_METHOD SC_VFD_SL_WAIT "VFD_SL_WAIT conversion" RAT_FUNC "%10.5" "s" COEFFS 0 1 0 0 0 1 /end COMPU_METHOD
/begin MEASUREMENT VFD_STATUS "Status flag for cooling fan output function in t_hld (temperature)" UBYTE MC_VFD_STATUS 0 0 0 0 ECU_ADDRESS 0x3F9CFA /end MEASUREMENT
/begin COMPU_METHOD MC_VFD_STATUS "VFD_STATUS conversion" RAT_FUNC "%3.0" "Unitless" COEFFS 0 1 0 0 0 1 /end COMPU_METHOD
/begin CHARACTERISTIC VFD_TEETH "Number of teeth on the Visctronic fan speed sensor." VALUE 0x5C50C SD_UBYTE 0 SC_VFD_TEETH 6 18 /end CHARACTERISTIC
/begin COMPU_METHOD SC_VFD_TEETH "VFD_TEETH conversion" RAT_FUNC "%3.0" "unitless" COEFFS 0 1 0 0 0 1 /end COMPU_METHOD
/begin MEASUREMENT VFD_TOT_FLG "TOT fan speed calculation required; 1=yes." UBYTE MC_VFD_TOT_FLG 0 0 0 0 ECU_ADDRESS 0x3FB22C /end MEASUREMENT
/begin COMPU_METHOD MC_VFD_TOT_FLG "VFD_TOT_FLG conversion" RAT_FUNC "%3.0" "Unitless" COEFFS 0 1 0 0 0 1 /end COMPU_METHOD
/begin MEASUREMENT VFD_TOT_N "Viscous fan speed requested by TOT." FLOAT32_IEEE MC_VFD_TOT_N 0 0 0 0 ECU_ADDRESS 0x3FB228 /end MEASUREMENT
/begin COMPU_METHOD MC_VFD_TOT_N "VFD_TOT_N conversion" RAT_FUNC "%10.5" "Unitless" COEFFS 0 1 0 0 0 1 /end COMPU_METHOD
/begin CHARACTERISTIC VFD_TOT_N_CL_DEGC "Switch viscous fan off below this TOT if not required by other sources." VALUE 0x5EB98 SD_FLOAT32_IEEE 0 SC_VFD_TOT_N_CL_DEGC -40 260 /end CHARACTERISTIC
/begin COMPU_METHOD SC_VFD_TOT_N_CL_DEGC "VFD_TOT_N_CL_DEGC conversion" RAT_FUNC "%10.5" "degC" COEFFS 0 1 0 0 0 1 /end COMPU_METHOD
/begin CHARACTERISTIC VFD_TOT_N_SH_DEGC "Switch viscous fan on above this TOT." VALUE 0x5EB9C SD_FLOAT32_IEEE 0 SC_VFD_TOT_N_SH_DEGC -40 260 /end CHARACTERISTIC
/begin COMPU_METHOD SC_VFD_TOT_N_SH_DEGC "VFD_TOT_N_SH_DEGC conversion" RAT_FUNC "%10.5" "degC" COEFFS 0 1 0 0 0 1 /end COMPU_METHOD
/begin MEASUREMENT VFS1_I_OUT "Current that the uP is supposed to deliver to VFS1." FLOAT32_IEEE MC_VFS1_I_OUT 0 0 0 0 ECU_ADDRESS 0x3F9AF0 /end MEASUREMENT
/begin COMPU_METHOD MC_VFS1_I_OUT "VFS1_I_OUT conversion" RAT_FUNC "%10.5" "Unitless" COEFFS 0 1 0 0 0 1 /end COMPU_METHOD
/begin MEASUREMENT VFS1_PRS "Final VFS1 Pressure Value" FLOAT32_IEEE MC_VFS1_PRS 0 0 0 0 ECU_ADDRESS 0x3F9AE4 /end MEASUREMENT
/begin COMPU_METHOD MC_VFS1_PRS "VFS1_PRS conversion" RAT_FUNC "%10.5" "Unitless" COEFFS 0 1 0 0 0 1 /end COMPU_METHOD
/begin MEASUREMENT VFS2_I_OUT "Current that the uP is supposed to deliver to VFS2." FLOAT32_IEEE MC_VFS2_I_OUT 0 0 0 0 ECU_ADDRESS 0x3F9AEC /end MEASUREMENT
/begin COMPU_METHOD MC_VFS2_I_OUT "VFS2_I_OUT conversion" RAT_FUNC "%10.5" "Unitless" COEFFS 0 1 0 0 0 1 /end COMPU_METHOD
/begin MEASUREMENT VFS2_PRS "Final VFS2 Pressure Value" FLOAT32_IEEE MC_VFS2_PRS 0 0 0 0 ECU_ADDRESS 0x3F9AE0 /end MEASUREMENT
/begin COMPU_METHOD MC_VFS2_PRS "VFS2_PRS conversion" RAT_FUNC "%10.5" "Unitless" COEFFS 0 1 0 0 0 1 /end COMPU_METHOD
/begin MEASUREMENT VFS_C_PRS "Commanded pressure for the transmission electronic pressure control C (EPC-C/VFS-C)" FLOAT32_IEEE MC_VFS_C_PRS 0 0 0 0 ECU_ADDRESS 0x3F9ADC /end MEASUREMENT
/begin COMPU_METHOD MC_VFS_C_PRS "VFS_C_PRS conversion" RAT_FUNC "%10.5" "Unitless" COEFFS 0 1 0 0 0 1 /end COMPU_METHOD
/begin CHARACTERISTIC VF_MAIN_CAL "Calibratable VFDES_M" VALUE 0x5DC44 SD_FLOAT32_IEEE 0 SC_VF_MAIN_CAL 0 200 /end CHARACTERISTIC
/begin COMPU_METHOD SC_VF_MAIN_CAL "VF_MAIN_CAL conversion" RAT_FUNC "%10.5" "unitless" COEFFS 0 1 0 0 0 1 /end COMPU_METHOD
/begin CHARACTERISTIC VF_MAIN_SEL "Selects source of VFDES_M" VALUE 0x5DC4C SD_UBYTE 0 SC_VF_MAIN_SEL 0 255 /end CHARACTERISTIC
/begin COMPU_METHOD SC_VF_MAIN_SEL "VF_MAIN_SEL conversion" RAT_FUNC "%3.0" "unitless" COEFFS 0 1 0 0 0 1 /end COMPU_METHOD
/begin MEASUREMENT VF_PILOT_MULTI "Volumetric fuel multiplier" FLOAT32_IEEE MC_VF_PILOT_MULTI 0 0 0 0 ECU_ADDRESS 0x3FA7D0 /end MEASUREMENT
/begin COMPU_METHOD MC_VF_PILOT_MULTI "VF_PILOT_MULTI conversion" RAT_FUNC "%10.5" "Unitless" COEFFS 0 1 0 0 0 1 /end COMPU_METHOD
/begin CHARACTERISTIC VGTAM_F_DEC "" VALUE 0x5D68C SD_SLONG 0 SC_VGTAM_F_DEC 0 65535 /end CHARACTERISTIC
/begin COMPU_METHOD SC_VGTAM_F_DEC "VGTAM_F_DEC conversion" RAT_FUNC "%10.0" "unitless" COEFFS 0 1 0 0 0 1 /end COMPU_METHOD
/begin CHARACTERISTIC VGTAM_F_INC "" VALUE 0x5D688 SD_SLONG 0 SC_VGTAM_F_INC 0 65535 /end CHARACTERISTIC
/begin COMPU_METHOD SC_VGTAM_F_INC "VGTAM_F_INC conversion" RAT_FUNC "%10.0" "unitless" COEFFS 0 1 0 0 0 1 /end COMPU_METHOD
/begin MEASUREMENT VGTAM_ORH_CNTR "" SLONG MC_VGTAM_ORH_CNTR 0 0 0 0 ECU_ADDRESS 0x3FA460 /end MEASUREMENT
/begin COMPU_METHOD MC_VGTAM_ORH_CNTR "VGTAM_ORH_CNTR conversion" RAT_FUNC "%10.0" "Unitless" COEFFS 0 1 0 0 0 1 /end COMPU_METHOD
/begin MEASUREMENT VGTAM_STATUS "" UBYTE MC_VGTAM_STATUS 0 0 0 0 ECU_ADDRESS 0x3F9CED /end MEASUREMENT
/begin COMPU_METHOD MC_VGTAM_STATUS "VGTAM_STATUS conversion" RAT_FUNC "%3.0" "Unitless" COEFFS 0 1 0 0 0 1 /end COMPU_METHOD
/begin MEASUREMENT VGTCH_EN_FLAG "VGT High side driver control (1 = High side driver enabled)" UBYTE MC_VGTCH_EN_FLAG 0 0 0 0 ECU_ADDRESS 0x3F9CEC /end MEASUREMENT
/begin COMPU_METHOD MC_VGTCH_EN_FLAG "VGTCH_EN_FLAG conversion" RAT_FUNC "%3.0" "Unitless" COEFFS 0 1 0 0 0 1 /end COMPU_METHOD
/begin CHARACTERISTIC VGTFLT_COEFA "" VALUE 0x5E918 SD_FLOAT32_IEEE 0 SC_VGTFLT_COEFA -50 50 /end CHARACTERISTIC
/begin COMPU_METHOD SC_VGTFLT_COEFA "VGTFLT_COEFA conversion" RAT_FUNC "%10.5" "unitless" COEFFS 0 1 0 0 0 1 /end COMPU_METHOD
/begin CHARACTERISTIC VGTFLT_COEFB "" VALUE 0x5E914 SD_FLOAT32_IEEE 0 SC_VGTFLT_COEFB -50 50 /end CHARACTERISTIC
/begin COMPU_METHOD SC_VGTFLT_COEFB "VGTFLT_COEFB conversion" RAT_FUNC "%10.5" "unitless" COEFFS 0 1 0 0 0 1 /end COMPU_METHOD
/begin CHARACTERISTIC VGTFLT_COEFC "" VALUE 0x5E910 SD_FLOAT32_IEEE 0 SC_VGTFLT_COEFC -50 50 /end CHARACTERISTIC
/begin COMPU_METHOD SC_VGTFLT_COEFC "VGTFLT_COEFC conversion" RAT_FUNC "%10.5" "unitless" COEFFS 0 1 0 0 0 1 /end COMPU_METHOD
/begin CHARACTERISTIC VGTFLT_COEFD "" VALUE 0x5E90C SD_FLOAT32_IEEE 0 SC_VGTFLT_COEFD -50 50 /end CHARACTERISTIC
/begin COMPU_METHOD SC_VGTFLT_COEFD "VGTFLT_COEFD conversion" RAT_FUNC "%10.5" "unitless" COEFFS 0 1 0 0 0 1 /end COMPU_METHOD
/begin CHARACTERISTIC VGTFLT_COEFE "" VALUE 0x5E908 SD_FLOAT32_IEEE 0 SC_VGTFLT_COEFE -50 50 /end CHARACTERISTIC
/begin COMPU_METHOD SC_VGTFLT_COEFE "VGTFLT_COEFE conversion" RAT_FUNC "%10.5" "unitless" COEFFS 0 1 0 0 0 1 /end COMPU_METHOD
/begin CHARACTERISTIC VGTFLT_COEFF "" VALUE 0x5E904 SD_FLOAT32_IEEE 0 SC_VGTFLT_COEFF -50 50 /end CHARACTERISTIC
/begin COMPU_METHOD SC_VGTFLT_COEFF "VGTFLT_COEFF conversion" RAT_FUNC "%10.5" "unitless" COEFFS 0 1 0 0 0 1 /end COMPU_METHOD
/begin MEASUREMENT VGT_ACF "" FLOAT32_IEEE MC_VGT_ACF 0 0 0 0 ECU_ADDRESS 0x3FB0F8 /end MEASUREMENT
/begin COMPU_METHOD MC_VGT_ACF "VGT_ACF conversion" RAT_FUNC "%10.5" "Unitless" COEFFS 0 1 0 0 0 1 /end COMPU_METHOD
/begin CHARACTERISTIC VGT_ADDR_EN_TM "VGT Cold Adder Enable Time" VALUE 0x5E998 SD_FLOAT32_IEEE 0 SC_VGT_ADDR_EN_TM 0 300 /end CHARACTERISTIC
/begin COMPU_METHOD SC_VGT_ADDR_EN_TM "VGT_ADDR_EN_TM conversion" RAT_FUNC "%10.5" "s" COEFFS 0 1 0 0 0 1 /end COMPU_METHOD
/begin MEASUREMENT VGT_ADDR_EN_TMR "VGT Cold Adder Enable Timer" FLOAT32_IEEE MC_VGT_ADDR_EN_TMR 0 0 0 0 ECU_ADDRESS 0x3FB0F4 /end MEASUREMENT
/begin COMPU_METHOD MC_VGT_ADDR_EN_TMR "VGT_ADDR_EN_TMR conversion" RAT_FUNC "%10.5" "Unitless" COEFFS 0 1 0 0 0 1 /end COMPU_METHOD
/begin CHARACTERISTIC VGT_ALT_OSP_MULT "" VALUE 0x5E994 SD_FLOAT32_IEEE 0 SC_VGT_ALT_OSP_MULT 0 2 /end CHARACTERISTIC
/begin COMPU_METHOD SC_VGT_ALT_OSP_MULT "VGT_ALT_OSP_MULT conversion" RAT_FUNC "%10.5" "unitless" COEFFS 0 1 0 0 0 1 /end COMPU_METHOD
/begin MEASUREMENT VGT_CLD_KCK_EN "Cold idle kicker enable flag" UBYTE MC_VGT_CLD_KCK_EN 0 0 0 0 ECU_ADDRESS 0x3FA708 /end MEASUREMENT
/begin COMPU_METHOD MC_VGT_CLD_KCK_EN "VGT_CLD_KCK_EN conversion" RAT_FUNC "%3.0" "Unitless" COEFFS 0 1 0 0 0 1 /end COMPU_METHOD
/begin MEASUREMENT VGT_COLD_ADDR_MLT_LATCH "VGT Cold Adder Multiplier Latch Flag" UBYTE MC_VGT_COLD_ADDR_MLT_LATCH 0 0 0 0 ECU_ADDRESS 0x3FB10C /end MEASUREMENT
/begin COMPU_METHOD MC_VGT_COLD_ADDR_MLT_LATCH "VGT_COLD_ADDR_MLT_LATCH conversion" RAT_FUNC "%3.0" "Unitless" COEFFS 0 1 0 0 0 1 /end COMPU_METHOD
/begin MEASUREMENT VGT_COLD_ADDR_MULT "" FLOAT32_IEEE MC_VGT_COLD_ADDR_MULT 0 0 0 0 ECU_ADDRESS 0x3FB0F0 /end MEASUREMENT
/begin COMPU_METHOD MC_VGT_COLD_ADDR_MULT "VGT_COLD_ADDR_MULT conversion" RAT_FUNC "%10.5" "Unitless" COEFFS 0 1 0 0 0 1 /end COMPU_METHOD
/begin MEASUREMENT VGT_DTY "VGT Duty cycle to  duce control" FLOAT32_IEEE MC_VGT_DTY 0 0 0 0 ECU_ADDRESS 0x3FB0E8 /end MEASUREMENT
/begin COMPU_METHOD MC_VGT_DTY "VGT_DTY conversion" RAT_FUNC "%10.5" "Unitless" COEFFS 0 1 0 0 0 1 /end COMPU_METHOD
/begin CHARACTERISTIC VGT_DUTY_CAL "" VALUE 0x5E988 SD_FLOAT32_IEEE 0 SC_VGT_DUTY_CAL 0 1 /end CHARACTERISTIC
/begin COMPU_METHOD SC_VGT_DUTY_CAL "VGT_DUTY_CAL conversion" RAT_FUNC "%10.5" "unitless" COEFFS 0 1 0 0 0 1 /end COMPU_METHOD
/begin CHARACTERISTIC VGT_DUTY_LMN "" VALUE 0x5E984 SD_FLOAT32_IEEE 0 SC_VGT_DUTY_LMN 0 1 /end CHARACTERISTIC
/begin COMPU_METHOD SC_VGT_DUTY_LMN "VGT_DUTY_LMN conversion" RAT_FUNC "%10.5" "unitless" COEFFS 0 1 0 0 0 1 /end COMPU_METHOD
/begin MEASUREMENT VGT_DUTY_LMX "" FLOAT32_IEEE MC_VGT_DUTY_LMX 0 0 0 0 ECU_ADDRESS 0x3FB0E4 /end MEASUREMENT
/begin COMPU_METHOD MC_VGT_DUTY_LMX "VGT_DUTY_LMX conversion" RAT_FUNC "%10.5" "Unitless" COEFFS 0 1 0 0 0 1 /end COMPU_METHOD
/begin CHARACTERISTIC VGT_DUTY_MAX "" VALUE 0x5E980 SD_FLOAT32_IEEE 0 SC_VGT_DUTY_MAX 0 1 /end CHARACTERISTIC
/begin COMPU_METHOD SC_VGT_DUTY_MAX "VGT_DUTY_MAX conversion" RAT_FUNC "%10.5" "unitless" COEFFS 0 1 0 0 0 1 /end COMPU_METHOD
/begin CHARACTERISTIC VGT_D_DTY_LMN "" VALUE 0x5E990 SD_FLOAT32_IEEE 0 SC_VGT_D_DTY_LMN -1 1 /end CHARACTERISTIC
/begin COMPU_METHOD SC_VGT_D_DTY_LMN "VGT_D_DTY_LMN conversion" RAT_FUNC "%10.5" "unitless" COEFFS 0 1 0 0 0 1 /end COMPU_METHOD
/begin CHARACTERISTIC VGT_D_DTY_LMX "" VALUE 0x5E98C SD_FLOAT32_IEEE 0 SC_VGT_D_DTY_LMX -1 1 /end CHARACTERISTIC
/begin COMPU_METHOD SC_VGT_D_DTY_LMX "VGT_D_DTY_LMX conversion" RAT_FUNC "%10.5" "unitless" COEFFS 0 1 0 0 0 1 /end COMPU_METHOD
/begin MEASUREMENT VGT_D_DUTY "" FLOAT32_IEEE MC_VGT_D_DUTY 0 0 0 0 ECU_ADDRESS 0x3FB0EC /end MEASUREMENT
/begin COMPU_METHOD MC_VGT_D_DUTY "VGT_D_DUTY conversion" RAT_FUNC "%10.5" "Unitless" COEFFS 0 1 0 0 0 1 /end COMPU_METHOD
/begin CHARACTERISTIC VGT_EBPG_CAL "" VALUE 0x5E97C SD_FLOAT32_IEEE 0 SC_VGT_EBPG_CAL -100 250 /end CHARACTERISTIC
/begin COMPU_METHOD SC_VGT_EBPG_CAL "VGT_EBPG_CAL conversion" RAT_FUNC "%10.5" "unitless" COEFFS 0 1 0 0 0 1 /end COMPU_METHOD
/begin MEASUREMENT VGT_EBPG_CLD_KCK "VGT exhaust back pressure gage cold kicker" FLOAT32_IEEE MC_VGT_EBPG_CLD_KCK 0 0 0 0 ECU_ADDRESS 0x3FA6C0 /end MEASUREMENT
/begin COMPU_METHOD MC_VGT_EBPG_CLD_KCK "VGT_EBPG_CLD_KCK conversion" RAT_FUNC "%10.5" "Unitless" COEFFS 0 1 0 0 0 1 /end COMPU_METHOD
/begin MEASUREMENT VGT_EBPG_COLD_ADDR "" FLOAT32_IEEE MC_VGT_EBPG_COLD_ADDR 0 0 0 0 ECU_ADDRESS 0x3FB0DC /end MEASUREMENT
/begin COMPU_METHOD MC_VGT_EBPG_COLD_ADDR "VGT_EBPG_COLD_ADDR conversion" RAT_FUNC "%10.5" "Unitless" COEFFS 0 1 0 0 0 1 /end COMPU_METHOD
/begin MEASUREMENT VGT_EBPG_DES "" FLOAT32_IEEE MC_VGT_EBPG_DES 0 0 0 0 ECU_ADDRESS 0x3FB0D8 /end MEASUREMENT
/begin COMPU_METHOD MC_VGT_EBPG_DES "VGT_EBPG_DES conversion" RAT_FUNC "%10.5" "Unitless" COEFFS 0 1 0 0 0 1 /end COMPU_METHOD
/begin MEASUREMENT VGT_EBPG_DES_EGR "" FLOAT32_IEEE MC_VGT_EBPG_DES_EGR 0 0 0 0 ECU_ADDRESS 0x3FB0D4 /end MEASUREMENT
/begin COMPU_METHOD MC_VGT_EBPG_DES_EGR "VGT_EBPG_DES_EGR conversion" RAT_FUNC "%10.5" "Unitless" COEFFS 0 1 0 0 0 1 /end COMPU_METHOD
/begin MEASUREMENT VGT_EBPG_DES_EGR_HI "" FLOAT32_IEEE MC_VGT_EBPG_DES_EGR_HI 0 0 0 0 ECU_ADDRESS 0x3FB0D0 /end MEASUREMENT
/begin COMPU_METHOD MC_VGT_EBPG_DES_EGR_HI "VGT_EBPG_DES_EGR_HI conversion" RAT_FUNC "%10.5" "Unitless" COEFFS 0 1 0 0 0 1 /end COMPU_METHOD
/begin MEASUREMENT VGT_EBPG_DES_EGR_LO "" FLOAT32_IEEE MC_VGT_EBPG_DES_EGR_LO 0 0 0 0 ECU_ADDRESS 0x3FB0CC /end MEASUREMENT
/begin COMPU_METHOD MC_VGT_EBPG_DES_EGR_LO "VGT_EBPG_DES_EGR_LO conversion" RAT_FUNC "%10.5" "Unitless" COEFFS 0 1 0 0 0 1 /end COMPU_METHOD
/begin CHARACTERISTIC VGT_EBPG_DES_LMN "" VALUE 0x5E978 SD_FLOAT32_IEEE 0 SC_VGT_EBPG_DES_LMN -100 250 /end CHARACTERISTIC
/begin COMPU_METHOD SC_VGT_EBPG_DES_LMN "VGT_EBPG_DES_LMN conversion" RAT_FUNC "%10.5" "unitless" COEFFS 0 1 0 0 0 1 /end COMPU_METHOD
/begin CHARACTERISTIC VGT_EBPG_DES_LMX "" VALUE 0x5E974 SD_FLOAT32_IEEE 0 SC_VGT_EBPG_DES_LMX -100 250 /end CHARACTERISTIC
/begin COMPU_METHOD SC_VGT_EBPG_DES_LMX "VGT_EBPG_DES_LMX conversion" RAT_FUNC "%10.5" "unitless" COEFFS 0 1 0 0 0 1 /end COMPU_METHOD
/begin MEASUREMENT VGT_EBPG_DES_NEGR "" FLOAT32_IEEE MC_VGT_EBPG_DES_NEGR 0 0 0 0 ECU_ADDRESS 0x3FB0C8 /end MEASUREMENT
/begin COMPU_METHOD MC_VGT_EBPG_DES_NEGR "VGT_EBPG_DES_NEGR conversion" RAT_FUNC "%10.5" "Unitless" COEFFS 0 1 0 0 0 1 /end COMPU_METHOD
/begin MEASUREMENT VGT_EBPG_DES_NEGR_HI "" FLOAT32_IEEE MC_VGT_EBPG_DES_NEGR_HI 0 0 0 0 ECU_ADDRESS 0x3FB0C4 /end MEASUREMENT
/begin COMPU_METHOD MC_VGT_EBPG_DES_NEGR_HI "VGT_EBPG_DES_NEGR_HI conversion" RAT_FUNC "%10.5" "Unitless" COEFFS 0 1 0 0 0 1 /end COMPU_METHOD
/begin MEASUREMENT VGT_EBPG_DES_NEGR_LO "" FLOAT32_IEEE MC_VGT_EBPG_DES_NEGR_LO 0 0 0 0 ECU_ADDRESS 0x3FB0C0 /end MEASUREMENT
/begin COMPU_METHOD MC_VGT_EBPG_DES_NEGR_LO "VGT_EBPG_DES_NEGR_LO conversion" RAT_FUNC "%10.5" "Unitless" COEFFS 0 1 0 0 0 1 /end COMPU_METHOD
/begin MEASUREMENT VGT_EBPG_DES_SLEW "" FLOAT32_IEEE MC_VGT_EBPG_DES_SLEW 0 0 0 0 ECU_ADDRESS 0x3FB0BC /end MEASUREMENT
/begin COMPU_METHOD MC_VGT_EBPG_DES_SLEW "VGT_EBPG_DES_SLEW conversion" RAT_FUNC "%10.5" "Unitless" COEFFS 0 1 0 0 0 1 /end COMPU_METHOD
/begin MEASUREMENT VGT_EBPG_ERR "" FLOAT32_IEEE MC_VGT_EBPG_ERR 0 0 0 0 ECU_ADDRESS 0x3FB0B8 /end MEASUREMENT
/begin COMPU_METHOD MC_VGT_EBPG_ERR "VGT_EBPG_ERR conversion" RAT_FUNC "%10.5" "Unitless" COEFFS 0 1 0 0 0 1 /end COMPU_METHOD
/begin MEASUREMENT VGT_EBPG_ERR_DER "" FLOAT32_IEEE MC_VGT_EBPG_ERR_DER 0 0 0 0 ECU_ADDRESS 0x3FB0B4 /end MEASUREMENT
/begin COMPU_METHOD MC_VGT_EBPG_ERR_DER "VGT_EBPG_ERR_DER conversion" RAT_FUNC "%10.5" "Unitless" COEFFS 0 1 0 0 0 1 /end COMPU_METHOD
/begin MEASUREMENT VGT_EBPG_ERR_DER_DIFF "" FLOAT32_IEEE MC_VGT_EBPG_ERR_DER_DIFF 0 0 0 0 ECU_ADDRESS 0x3FB0B0 /end MEASUREMENT
/begin COMPU_METHOD MC_VGT_EBPG_ERR_DER_DIFF "VGT_EBPG_ERR_DER_DIFF conversion" RAT_FUNC "%10.5" "Unitless" COEFFS 0 1 0 0 0 1 /end COMPU_METHOD
/begin MEASUREMENT VGT_EBPG_ERR_FILT "" FLOAT32_IEEE MC_VGT_EBPG_ERR_FILT 0 0 0 0 ECU_ADDRESS 0x3FB0AC /end MEASUREMENT
/begin COMPU_METHOD MC_VGT_EBPG_ERR_FILT "VGT_EBPG_ERR_FILT conversion" RAT_FUNC "%10.5" "Unitless" COEFFS 0 1 0 0 0 1 /end COMPU_METHOD
/begin CHARACTERISTIC VGT_EBPG_ERR_LMN "" VALUE 0x5E970 SD_FLOAT32_IEEE 0 SC_VGT_EBPG_ERR_LMN -350 350 /end CHARACTERISTIC
/begin COMPU_METHOD SC_VGT_EBPG_ERR_LMN "VGT_EBPG_ERR_LMN conversion" RAT_FUNC "%10.5" "unitless" COEFFS 0 1 0 0 0 1 /end COMPU_METHOD
/begin CHARACTERISTIC VGT_EBPG_ERR_LMX "" VALUE 0x5E96C SD_FLOAT32_IEEE 0 SC_VGT_EBPG_ERR_LMX -350 350 /end CHARACTERISTIC
/begin COMPU_METHOD SC_VGT_EBPG_ERR_LMX "VGT_EBPG_ERR_LMX conversion" RAT_FUNC "%10.5" "unitless" COEFFS 0 1 0 0 0 1 /end COMPU_METHOD
/begin MEASUREMENT VGT_EBPG_FF_EGR "" FLOAT32_IEEE MC_VGT_EBPG_FF_EGR 0 0 0 0 ECU_ADDRESS 0x3FB0A8 /end MEASUREMENT
/begin COMPU_METHOD MC_VGT_EBPG_FF_EGR "VGT_EBPG_FF_EGR conversion" RAT_FUNC "%10.5" "Unitless" COEFFS 0 1 0 0 0 1 /end COMPU_METHOD
/begin MEASUREMENT VGT_EBPG_FF_NEGR "" FLOAT32_IEEE MC_VGT_EBPG_FF_NEGR 0 0 0 0 ECU_ADDRESS 0x3FB0A4 /end MEASUREMENT
/begin COMPU_METHOD MC_VGT_EBPG_FF_NEGR "VGT_EBPG_FF_NEGR conversion" RAT_FUNC "%10.5" "Unitless" COEFFS 0 1 0 0 0 1 /end COMPU_METHOD
/begin MEASUREMENT VGT_EOT_COLD_MLT "" FLOAT32_IEEE MC_VGT_EOT_COLD_MLT 0 0 0 0 ECU_ADDRESS 0x3FB0A0 /end MEASUREMENT
/begin COMPU_METHOD MC_VGT_EOT_COLD_MLT "VGT_EOT_COLD_MLT conversion" RAT_FUNC "%10.5" "Unitless" COEFFS 0 1 0 0 0 1 /end COMPU_METHOD
/begin MEASUREMENT VGT_EOT_DUTY_MAX "" FLOAT32_IEEE MC_VGT_EOT_DUTY_MAX 0 0 0 0 ECU_ADDRESS 0x3FB09C /end MEASUREMENT
/begin COMPU_METHOD MC_VGT_EOT_DUTY_MAX "VGT_EOT_DUTY_MAX conversion" RAT_FUNC "%10.5" "Unitless" COEFFS 0 1 0 0 0 1 /end COMPU_METHOD
/begin MEASUREMENT VGT_FF_DUTY "" FLOAT32_IEEE MC_VGT_FF_DUTY 0 0 0 0 ECU_ADDRESS 0x3FB098 /end MEASUREMENT
/begin COMPU_METHOD MC_VGT_FF_DUTY "VGT_FF_DUTY conversion" RAT_FUNC "%10.5" "Unitless" COEFFS 0 1 0 0 0 1 /end COMPU_METHOD
/begin CHARACTERISTIC VGT_FF_SEL "VGT Feed forward option select; 1 = Do VGT FF with EGR" VALUE 0x5E9DB SD_UBYTE 0 SC_VGT_FF_SEL 0 1 /end CHARACTERISTIC
/begin COMPU_METHOD SC_VGT_FF_SEL "VGT_FF_SEL conversion" RAT_FUNC "%3.0" "unitless" COEFFS 0 1 0 0 0 1 /end COMPU_METHOD
/begin MEASUREMENT VGT_I_DUTY "" FLOAT32_IEEE MC_VGT_I_DUTY 0 0 0 0 ECU_ADDRESS 0x3FB094 /end MEASUREMENT
/begin COMPU_METHOD MC_VGT_I_DUTY "VGT_I_DUTY conversion" RAT_FUNC "%10.5" "Unitless" COEFFS 0 1 0 0 0 1 /end COMPU_METHOD
/begin CHARACTERISTIC VGT_KI_LM_MAX "" VALUE 0x5E964 SD_FLOAT32_IEEE 0 SC_VGT_KI_LM_MAX -1 1 /end CHARACTERISTIC
/begin COMPU_METHOD SC_VGT_KI_LM_MAX "VGT_KI_LM_MAX conversion" RAT_FUNC "%10.5" "unitless" COEFFS 0 1 0 0 0 1 /end COMPU_METHOD
/begin CHARACTERISTIC VGT_KI_LM_MIN "" VALUE 0x5E968 SD_FLOAT32_IEEE 0 SC_VGT_KI_LM_MIN -1 1 /end CHARACTERISTIC
/begin COMPU_METHOD SC_VGT_KI_LM_MIN "VGT_KI_LM_MIN conversion" RAT_FUNC "%10.5" "unitless" COEFFS 0 1 0 0 0 1 /end COMPU_METHOD
/begin CHARACTERISTIC VGT_LI_ACTV "" VALUE 0x5E9DA SD_UBYTE 0 SC_VGT_LI_ACTV 0 1 /end CHARACTERISTIC
/begin COMPU_METHOD SC_VGT_LI_ACTV "VGT_LI_ACTV conversion" RAT_FUNC "%3.0" "unitless" COEFFS 0 1 0 0 0 1 /end COMPU_METHOD
/begin CHARACTERISTIC VGT_LI_ACTV_TM "" VALUE 0x5E95C SD_FLOAT32_IEEE 0 SC_VGT_LI_ACTV_TM 0 300 /end CHARACTERISTIC
/begin COMPU_METHOD SC_VGT_LI_ACTV_TM "VGT_LI_ACTV_TM conversion" RAT_FUNC "%10.5" "unitless" COEFFS 0 1 0 0 0 1 /end COMPU_METHOD
/begin MEASUREMENT VGT_LI_ACTV_TMR "" FLOAT32_IEEE MC_VGT_LI_ACTV_TMR 0 0 0 0 ECU_ADDRESS 0x3FB090 /end MEASUREMENT
/begin COMPU_METHOD MC_VGT_LI_ACTV_TMR "VGT_LI_ACTV_TMR conversion" RAT_FUNC "%10.5" "Unitless" COEFFS 0 1 0 0 0 1 /end COMPU_METHOD
/begin MEASUREMENT VGT_LI_DUTY "" FLOAT32_IEEE MC_VGT_LI_DUTY 0 0 0 0 ECU_ADDRESS 0x3FB08C /end MEASUREMENT
/begin COMPU_METHOD MC_VGT_LI_DUTY "VGT_LI_DUTY conversion" RAT_FUNC "%10.5" "Unitless" COEFFS 0 1 0 0 0 1 /end COMPU_METHOD
/begin CHARACTERISTIC VGT_LI_ERR_BAND "" VALUE 0x5E960 SD_FLOAT32_IEEE 0 SC_VGT_LI_ERR_BAND 0 100 /end CHARACTERISTIC
/begin COMPU_METHOD SC_VGT_LI_ERR_BAND "VGT_LI_ERR_BAND conversion" RAT_FUNC "%10.5" "unitless" COEFFS 0 1 0 0 0 1 /end COMPU_METHOD
/begin MEASUREMENT VGT_MAP_CLIP "" FLOAT32_IEEE MC_VGT_MAP_CLIP 0 0 0 0 ECU_ADDRESS 0x3FB088 /end MEASUREMENT
/begin COMPU_METHOD MC_VGT_MAP_CLIP "VGT_MAP_CLIP conversion" RAT_FUNC "%10.5" "Unitless" COEFFS 0 1 0 0 0 1 /end COMPU_METHOD
/begin MEASUREMENT VGT_MAP_MAX "" FLOAT32_IEEE MC_VGT_MAP_MAX 0 0 0 0 ECU_ADDRESS 0x3FB084 /end MEASUREMENT
/begin COMPU_METHOD MC_VGT_MAP_MAX "VGT_MAP_MAX conversion" RAT_FUNC "%10.5" "Unitless" COEFFS 0 1 0 0 0 1 /end COMPU_METHOD
/begin CHARACTERISTIC VGT_MAX_MF_INC "" VALUE 0x5E958 SD_FLOAT32_IEEE 0 SC_VGT_MAX_MF_INC -1000 1000 /end CHARACTERISTIC
/begin COMPU_METHOD SC_VGT_MAX_MF_INC "VGT_MAX_MF_INC conversion" RAT_FUNC "%10.5" "unitless" COEFFS 0 1 0 0 0 1 /end COMPU_METHOD
/begin CHARACTERISTIC VGT_MAX_MF_TM "" VALUE 0x5E954 SD_FLOAT32_IEEE 0 SC_VGT_MAX_MF_TM 0 10 /end CHARACTERISTIC
/begin COMPU_METHOD SC_VGT_MAX_MF_TM "VGT_MAX_MF_TM conversion" RAT_FUNC "%10.5" "unitless" COEFFS 0 1 0 0 0 1 /end COMPU_METHOD
/begin MEASUREMENT VGT_MFDES_DIFF "" FLOAT32_IEEE MC_VGT_MFDES_DIFF 0 0 0 0 ECU_ADDRESS 0x3FB078 /end MEASUREMENT
/begin COMPU_METHOD MC_VGT_MFDES_DIFF "VGT_MFDES_DIFF conversion" RAT_FUNC "%10.5" "Unitless" COEFFS 0 1 0 0 0 1 /end COMPU_METHOD
/begin MEASUREMENT VGT_MFDES_FILT "" FLOAT32_IEEE MC_VGT_MFDES_FILT 0 0 0 0 ECU_ADDRESS 0x3FB074 /end MEASUREMENT
/begin COMPU_METHOD MC_VGT_MFDES_FILT "VGT_MFDES_FILT conversion" RAT_FUNC "%10.5" "Unitless" COEFFS 0 1 0 0 0 1 /end COMPU_METHOD
/begin MEASUREMENT VGT_MFL_DIFF "" FLOAT32_IEEE MC_VGT_MFL_DIFF 0 0 0 0 ECU_ADDRESS 0x3FB070 /end MEASUREMENT
/begin COMPU_METHOD MC_VGT_MFL_DIFF "VGT_MFL_DIFF conversion" RAT_FUNC "%10.5" "Unitless" COEFFS 0 1 0 0 0 1 /end COMPU_METHOD
/begin MEASUREMENT VGT_MFL_DIFF_ABS "" FLOAT32_IEEE MC_VGT_MFL_DIFF_ABS 0 0 0 0 ECU_ADDRESS 0x3FB06C /end MEASUREMENT
/begin COMPU_METHOD MC_VGT_MFL_DIFF_ABS "VGT_MFL_DIFF_ABS conversion" RAT_FUNC "%10.5" "Unitless" COEFFS 0 1 0 0 0 1 /end COMPU_METHOD
/begin MEASUREMENT VGT_MFL_DIFF_SIGN "" FLOAT32_IEEE MC_VGT_MFL_DIFF_SIGN 0 0 0 0 ECU_ADDRESS 0x3FB068 /end MEASUREMENT
/begin COMPU_METHOD MC_VGT_MFL_DIFF_SIGN "VGT_MFL_DIFF_SIGN conversion" RAT_FUNC "%10.5" "Unitless" COEFFS 0 1 0 0 0 1 /end COMPU_METHOD
/begin MEASUREMENT VGT_MFL_MULT "VGT overboost smoke limiter multiplier" FLOAT32_IEEE MC_VGT_MFL_MULT 0 0 0 0 ECU_ADDRESS 0x3FB064 /end MEASUREMENT
/begin COMPU_METHOD MC_VGT_MFL_MULT "VGT_MFL_MULT conversion" RAT_FUNC "%10.5" "Unitless" COEFFS 0 1 0 0 0 1 /end COMPU_METHOD
/begin CHARACTERISTIC VGT_MF_TRNS_KF "" VALUE 0x5E950 SD_FLOAT32_IEEE 0 SC_VGT_MF_TRNS_KF 0 10 /end CHARACTERISTIC
/begin COMPU_METHOD SC_VGT_MF_TRNS_KF "VGT_MF_TRNS_KF conversion" RAT_FUNC "%10.5" "unitless" COEFFS 0 1 0 0 0 1 /end COMPU_METHOD
/begin MEASUREMENT VGT_MF_TRNS_MULT "" FLOAT32_IEEE MC_VGT_MF_TRNS_MULT 0 0 0 0 ECU_ADDRESS 0x3FB080 /end MEASUREMENT
/begin COMPU_METHOD MC_VGT_MF_TRNS_MULT "VGT_MF_TRNS_MULT conversion" RAT_FUNC "%10.5" "Unitless" COEFFS 0 1 0 0 0 1 /end COMPU_METHOD
/begin MEASUREMENT VGT_MF_TRNS_TMR "" FLOAT32_IEEE MC_VGT_MF_TRNS_TMR 0 0 0 0 ECU_ADDRESS 0x3FB07C /end MEASUREMENT
/begin COMPU_METHOD MC_VGT_MF_TRNS_TMR "VGT_MF_TRNS_TMR conversion" RAT_FUNC "%10.5" "Unitless" COEFFS 0 1 0 0 0 1 /end COMPU_METHOD
/begin CHARACTERISTIC VGT_NERR_EN "VGT engine speed error enable for cold idle kicker" VALUE 0x5E94C SD_FLOAT32_IEEE 0 SC_VGT_NERR_EN 0 4000 /end CHARACTERISTIC
/begin COMPU_METHOD SC_VGT_NERR_EN "VGT_NERR_EN conversion" RAT_FUNC "%10.5" "RPM" COEFFS 0 1 0 0 0 1 /end COMPU_METHOD
/begin MEASUREMENT VGT_N_DUTY_LMX "" FLOAT32_IEEE MC_VGT_N_DUTY_LMX 0 0 0 0 ECU_ADDRESS 0x3FB060 /end MEASUREMENT
/begin COMPU_METHOD MC_VGT_N_DUTY_LMX "VGT_N_DUTY_LMX conversion" RAT_FUNC "%10.5" "Unitless" COEFFS 0 1 0 0 0 1 /end COMPU_METHOD
/begin CHARACTERISTIC VGT_N_OSP_LR "" VALUE 0x5E948 SD_FLOAT32_IEEE 0 SC_VGT_N_OSP_LR 0 5000 /end CHARACTERISTIC
/begin COMPU_METHOD SC_VGT_N_OSP_LR "VGT_N_OSP_LR conversion" RAT_FUNC "%10.5" "unitless" COEFFS 0 1 0 0 0 1 /end COMPU_METHOD
/begin CHARACTERISTIC VGT_N_OSP_UR "" VALUE 0x5E944 SD_FLOAT32_IEEE 0 SC_VGT_N_OSP_UR 0 5000 /end CHARACTERISTIC
/begin COMPU_METHOD SC_VGT_N_OSP_UR "VGT_N_OSP_UR conversion" RAT_FUNC "%10.5" "unitless" COEFFS 0 1 0 0 0 1 /end COMPU_METHOD
/begin MEASUREMENT VGT_OBMFL_FLG "" UBYTE MC_VGT_OBMFL_FLG 0 0 0 0 ECU_ADDRESS 0x3FB10F /end MEASUREMENT
/begin COMPU_METHOD MC_VGT_OBMFL_FLG "VGT_OBMFL_FLG conversion" RAT_FUNC "%3.0" "Unitless" COEFFS 0 1 0 0 0 1 /end COMPU_METHOD
/begin MEASUREMENT VGT_OB_CNTR "" SLONG MC_VGT_OB_CNTR 0 0 0 0 ECU_ADDRESS 0x3FB05C /end MEASUREMENT
/begin COMPU_METHOD MC_VGT_OB_CNTR "VGT_OB_CNTR conversion" RAT_FUNC "%10.0" "Unitless" COEFFS 0 1 0 0 0 1 /end COMPU_METHOD
/begin CHARACTERISTIC VGT_OB_DEC "" VALUE 0x5E940 SD_SLONG 0 SC_VGT_OB_DEC 0 65535 /end CHARACTERISTIC
/begin COMPU_METHOD SC_VGT_OB_DEC "VGT_OB_DEC conversion" RAT_FUNC "%10.0" "unitless" COEFFS 0 1 0 0 0 1 /end COMPU_METHOD
/begin CHARACTERISTIC VGT_OB_DR "" VALUE 0x5E93C SD_FLOAT32_IEEE 0 SC_VGT_OB_DR -100 100 /end CHARACTERISTIC
/begin COMPU_METHOD SC_VGT_OB_DR "VGT_OB_DR conversion" RAT_FUNC "%10.5" "unitless" COEFFS 0 1 0 0 0 1 /end COMPU_METHOD
/begin MEASUREMENT VGT_OB_DUTY_MAX "" FLOAT32_IEEE MC_VGT_OB_DUTY_MAX 0 0 0 0 ECU_ADDRESS 0x3FB058 /end MEASUREMENT
/begin COMPU_METHOD MC_VGT_OB_DUTY_MAX "VGT_OB_DUTY_MAX conversion" RAT_FUNC "%10.5" "Unitless" COEFFS 0 1 0 0 0 1 /end COMPU_METHOD
/begin MEASUREMENT VGT_OB_FLG "" UBYTE MC_VGT_OB_FLG 0 0 0 0 ECU_ADDRESS 0x3FB110 /end MEASUREMENT
/begin COMPU_METHOD MC_VGT_OB_FLG "VGT_OB_FLG conversion" RAT_FUNC "%3.0" "Unitless" COEFFS 0 1 0 0 0 1 /end COMPU_METHOD
/begin CHARACTERISTIC VGT_OB_INC "" VALUE 0x5E938 SD_SLONG 0 SC_VGT_OB_INC 0 65535 /end CHARACTERISTIC
/begin COMPU_METHOD SC_VGT_OB_INC "VGT_OB_INC conversion" RAT_FUNC "%10.0" "unitless" COEFFS 0 1 0 0 0 1 /end COMPU_METHOD
/begin MEASUREMENT VGT_OB_KPA "" FLOAT32_IEEE MC_VGT_OB_KPA 0 0 0 0 ECU_ADDRESS 0x3FB054 /end MEASUREMENT
/begin COMPU_METHOD MC_VGT_OB_KPA "VGT_OB_KPA conversion" RAT_FUNC "%10.5" "Unitless" COEFFS 0 1 0 0 0 1 /end COMPU_METHOD
/begin CHARACTERISTIC VGT_OB_LMN "" VALUE 0x5E934 SD_FLOAT32_IEEE 0 SC_VGT_OB_LMN 0 350 /end CHARACTERISTIC
/begin COMPU_METHOD SC_VGT_OB_LMN "VGT_OB_LMN conversion" RAT_FUNC "%10.5" "unitless" COEFFS 0 1 0 0 0 1 /end COMPU_METHOD
/begin CHARACTERISTIC VGT_OB_LMX "" VALUE 0x5E930 SD_FLOAT32_IEEE 0 SC_VGT_OB_LMX 0 350 /end CHARACTERISTIC
/begin COMPU_METHOD SC_VGT_OB_LMX "VGT_OB_LMX conversion" RAT_FUNC "%10.5" "unitless" COEFFS 0 1 0 0 0 1 /end COMPU_METHOD
/begin CHARACTERISTIC VGT_OB_MFLR "" VALUE 0x5E928 SD_FLOAT32_IEEE 0 SC_VGT_OB_MFLR -100 100 /end CHARACTERISTIC
/begin COMPU_METHOD SC_VGT_OB_MFLR "VGT_OB_MFLR conversion" RAT_FUNC "%10.5" "unitless" COEFFS 0 1 0 0 0 1 /end COMPU_METHOD
/begin MEASUREMENT VGT_OB_MFL_PCT "" FLOAT32_IEEE MC_VGT_OB_MFL_PCT 0 0 0 0 ECU_ADDRESS 0x3FB050 /end MEASUREMENT
/begin COMPU_METHOD MC_VGT_OB_MFL_PCT "VGT_OB_MFL_PCT conversion" RAT_FUNC "%10.5" "Unitless" COEFFS 0 1 0 0 0 1 /end COMPU_METHOD
/begin CHARACTERISTIC VGT_OB_MFL_ROC_LMX "" VALUE 0x5E92C SD_FLOAT32_IEEE 0 SC_VGT_OB_MFL_ROC_LMX -100 100 /end CHARACTERISTIC
/begin COMPU_METHOD SC_VGT_OB_MFL_ROC_LMX "VGT_OB_MFL_ROC_LMX conversion" RAT_FUNC "%10.5" "unitless" COEFFS 0 1 0 0 0 1 /end COMPU_METHOD
/begin CHARACTERISTIC VGT_OB_TM "" VALUE 0x5E924 SD_FLOAT32_IEEE 0 SC_VGT_OB_TM 0 300 /end CHARACTERISTIC
/begin COMPU_METHOD SC_VGT_OB_TM "VGT_OB_TM conversion" RAT_FUNC "%10.5" "unitless" COEFFS 0 1 0 0 0 1 /end COMPU_METHOD
/begin MEASUREMENT VGT_OB_TMR "" FLOAT32_IEEE MC_VGT_OB_TMR 0 0 0 0 ECU_ADDRESS 0x3FB04C /end MEASUREMENT
/begin COMPU_METHOD MC_VGT_OB_TMR "VGT_OB_TMR conversion" RAT_FUNC "%10.5" "Unitless" COEFFS 0 1 0 0 0 1 /end COMPU_METHOD
/begin MEASUREMENT VGT_OL_DUTY "" FLOAT32_IEEE MC_VGT_OL_DUTY 0 0 0 0 ECU_ADDRESS 0x3FB048 /end MEASUREMENT
/begin COMPU_METHOD MC_VGT_OL_DUTY "VGT_OL_DUTY conversion" RAT_FUNC "%10.5" "Unitless" COEFFS 0 1 0 0 0 1 /end COMPU_METHOD
/begin MEASUREMENT VGT_OL_FLG "Flag to use vgt open loop control." UBYTE MC_VGT_OL_FLG 0 0 0 0 ECU_ADDRESS 0x3FB10E /end MEASUREMENT
/begin COMPU_METHOD MC_VGT_OL_FLG "VGT_OL_FLG conversion" RAT_FUNC "%3.0" "Unitless" COEFFS 0 1 0 0 0 1 /end COMPU_METHOD
/begin CHARACTERISTIC VGT_OSC_CHANNEL "IOC channel assignment" VALUE 0x5E9D9 SD_UBYTE 0 SC_VGT_OSC_CHANNEL 0 255 /end CHARACTERISTIC
/begin COMPU_METHOD SC_VGT_OSC_CHANNEL "VGT_OSC_CHANNEL conversion" RAT_FUNC "%3.0" "unitless" COEFFS 0 1 0 0 0 1 /end COMPU_METHOD
/begin MEASUREMENT VGT_OSP "" FLOAT32_IEEE MC_VGT_OSP 0 0 0 0 ECU_ADDRESS 0x3FB044 /end MEASUREMENT
/begin COMPU_METHOD MC_VGT_OSP "VGT_OSP conversion" RAT_FUNC "%10.5" "Unitless" COEFFS 0 1 0 0 0 1 /end COMPU_METHOD
/begin MEASUREMENT VGT_OSP_DUTY "" FLOAT32_IEEE MC_VGT_OSP_DUTY 0 0 0 0 ECU_ADDRESS 0x3FB040 /end MEASUREMENT
/begin COMPU_METHOD MC_VGT_OSP_DUTY "VGT_OSP_DUTY conversion" RAT_FUNC "%10.5" "Unitless" COEFFS 0 1 0 0 0 1 /end COMPU_METHOD
/begin MEASUREMENT VGT_OSP_SW "" UBYTE MC_VGT_OSP_SW 0 0 0 0 ECU_ADDRESS 0x3FB10D /end MEASUREMENT
/begin COMPU_METHOD MC_VGT_OSP_SW "VGT_OSP_SW conversion" RAT_FUNC "%3.0" "Unitless" COEFFS 0 1 0 0 0 1 /end COMPU_METHOD
/begin CHARACTERISTIC VGT_OSP_SW_OFF "" VALUE 0x5E920 SD_FLOAT32_IEEE 0 SC_VGT_OSP_SW_OFF 0 200000 /end CHARACTERISTIC
/begin COMPU_METHOD SC_VGT_OSP_SW_OFF "VGT_OSP_SW_OFF conversion" RAT_FUNC "%10.5" "unitless" COEFFS 0 1 0 0 0 1 /end COMPU_METHOD
/begin CHARACTERISTIC VGT_OSP_SW_ON "" VALUE 0x5E91C SD_FLOAT32_IEEE 0 SC_VGT_OSP_SW_ON 0 200000 /end CHARACTERISTIC
/begin COMPU_METHOD SC_VGT_OSP_SW_ON "VGT_OSP_SW_ON conversion" RAT_FUNC "%10.5" "unitless" COEFFS 0 1 0 0 0 1 /end COMPU_METHOD
/begin MEASUREMENT VGT_PID_DUTY "" FLOAT32_IEEE MC_VGT_PID_DUTY 0 0 0 0 ECU_ADDRESS 0x3FB038 /end MEASUREMENT
/begin COMPU_METHOD MC_VGT_PID_DUTY "VGT_PID_DUTY conversion" RAT_FUNC "%10.5" "Unitless" COEFFS 0 1 0 0 0 1 /end COMPU_METHOD
/begin MEASUREMENT VGT_PID_KD_VAR "" FLOAT32_IEEE MC_VGT_PID_KD_VAR 0 0 0 0 ECU_ADDRESS 0x3FB034 /end MEASUREMENT
/begin COMPU_METHOD MC_VGT_PID_KD_VAR "VGT_PID_KD_VAR conversion" RAT_FUNC "%10.5" "Unitless" COEFFS 0 1 0 0 0 1 /end COMPU_METHOD
/begin MEASUREMENT VGT_PID_KI_VAR "" FLOAT32_IEEE MC_VGT_PID_KI_VAR 0 0 0 0 ECU_ADDRESS 0x3FB030 /end MEASUREMENT
/begin COMPU_METHOD MC_VGT_PID_KI_VAR "VGT_PID_KI_VAR conversion" RAT_FUNC "%10.5" "Unitless" COEFFS 0 1 0 0 0 1 /end COMPU_METHOD
/begin MEASUREMENT VGT_PID_KP_VAR "" FLOAT32_IEEE MC_VGT_PID_KP_VAR 0 0 0 0 ECU_ADDRESS 0x3FB02C /end MEASUREMENT
/begin COMPU_METHOD MC_VGT_PID_KP_VAR "VGT_PID_KP_VAR conversion" RAT_FUNC "%10.5" "Unitless" COEFFS 0 1 0 0 0 1 /end COMPU_METHOD
/begin MEASUREMENT VGT_P_DUTY "" FLOAT32_IEEE MC_VGT_P_DUTY 0 0 0 0 ECU_ADDRESS 0x3FB03C /end MEASUREMENT
/begin COMPU_METHOD MC_VGT_P_DUTY "VGT_P_DUTY conversion" RAT_FUNC "%10.5" "Unitless" COEFFS 0 1 0 0 0 1 /end COMPU_METHOD
/begin CHARACTERISTIC VGT_SEL "VGT select switch units[0-4]; Values: 0=Substitute cal for VGT_DTY, 1=Substitute cal for MAP_des, 2-4=Normal VGT operation" VALUE 0x5E9D8 SD_UBYTE 0 SC_VGT_SEL 0 4 /end CHARACTERISTIC
/begin COMPU_METHOD SC_VGT_SEL "VGT_SEL conversion" RAT_FUNC "%3.0" "unitless" COEFFS 0 1 0 0 0 1 /end COMPU_METHOD
/begin MEASUREMENT VGT_SLIDE_BAR "IOC slide bar control" FLOAT32_IEEE MC_VGT_SLIDE_BAR 0 0 0 0 ECU_ADDRESS 0x3F9CA0 /end MEASUREMENT
/begin COMPU_METHOD MC_VGT_SLIDE_BAR "VGT_SLIDE_BAR conversion" RAT_FUNC "%10.5" "Unitless" COEFFS 0 1 0 0 0 1 /end COMPU_METHOD
/begin CHARACTERISTIC VGT_SS_EBPG_ERR_LMT "EBP error limit during EGR operation" VALUE 0x5D314 SD_FLOAT32_IEEE 0 SC_VGT_SS_EBPG_ERR_LMT 0 1638.3 /end CHARACTERISTIC
/begin COMPU_METHOD SC_VGT_SS_EBPG_ERR_LMT "VGT_SS_EBPG_ERR_LMT conversion" RAT_FUNC "%10.5" "kPa" COEFFS 0 1 0 0 0 1 /end COMPU_METHOD
/begin CHARACTERISTIC VGT_SS_EBP_TM "EBP error timer value" VALUE 0x5D310 SD_FLOAT32_IEEE 0 SC_VGT_SS_EBP_TM 0 524288 /end CHARACTERISTIC
/begin COMPU_METHOD SC_VGT_SS_EBP_TM "VGT_SS_EBP_TM conversion" RAT_FUNC "%10.5" "s" COEFFS 0 1 0 0 0 1 /end COMPU_METHOD
/begin MEASUREMENT VGT_SS_EBP_TMR "EBP error timer" FLOAT32_IEEE MC_VGT_SS_EBP_TMR 0 0 0 0 ECU_ADDRESS 0x3FA16C /end MEASUREMENT
/begin COMPU_METHOD MC_VGT_SS_EBP_TMR "VGT_SS_EBP_TMR conversion" RAT_FUNC "%10.5" "Unitless" COEFFS 0 1 0 0 0 1 /end COMPU_METHOD
/begin MEASUREMENT VGT_SS_EBP_UPD_TMR "EBP error update timer" FLOAT32_IEEE MC_VGT_SS_EBP_UPD_TMR 0 0 0 0 ECU_ADDRESS 0x3FA374 /end MEASUREMENT
/begin COMPU_METHOD MC_VGT_SS_EBP_UPD_TMR "VGT_SS_EBP_UPD_TMR conversion" RAT_FUNC "%10.5" "Unitless" COEFFS 0 1 0 0 0 1 /end COMPU_METHOD
/begin MEASUREMENT VGT_TOTAL_DUTY "" FLOAT32_IEEE MC_VGT_TOTAL_DUTY 0 0 0 0 ECU_ADDRESS 0x3FB028 /end MEASUREMENT
/begin COMPU_METHOD MC_VGT_TOTAL_DUTY "VGT_TOTAL_DUTY conversion" RAT_FUNC "%10.5" "Unitless" COEFFS 0 1 0 0 0 1 /end COMPU_METHOD
/begin MEASUREMENT VGT_TSP "" FLOAT32_IEEE MC_VGT_TSP 0 0 0 0 ECU_ADDRESS 0x3FB024 /end MEASUREMENT
/begin COMPU_METHOD MC_VGT_TSP "VGT_TSP conversion" RAT_FUNC "%10.5" "Unitless" COEFFS 0 1 0 0 0 1 /end COMPU_METHOD
/begin MEASUREMENT VGT_TSP_HI "" FLOAT32_IEEE MC_VGT_TSP_HI 0 0 0 0 ECU_ADDRESS 0x3FB020 /end MEASUREMENT
/begin COMPU_METHOD MC_VGT_TSP_HI "VGT_TSP_HI conversion" RAT_FUNC "%10.5" "Unitless" COEFFS 0 1 0 0 0 1 /end COMPU_METHOD
/begin MEASUREMENT VGT_TSP_LO "" FLOAT32_IEEE MC_VGT_TSP_LO 0 0 0 0 ECU_ADDRESS 0x3FB018 /end MEASUREMENT
/begin COMPU_METHOD MC_VGT_TSP_LO "VGT_TSP_LO conversion" RAT_FUNC "%10.5" "Unitless" COEFFS 0 1 0 0 0 1 /end COMPU_METHOD
/begin MEASUREMENT VGT_TSP_MID "" FLOAT32_IEEE MC_VGT_TSP_MID 0 0 0 0 ECU_ADDRESS 0x3FB01C /end MEASUREMENT
/begin COMPU_METHOD MC_VGT_TSP_MID "VGT_TSP_MID conversion" RAT_FUNC "%10.5" "Unitless" COEFFS 0 1 0 0 0 1 /end COMPU_METHOD
/begin MEASUREMENT VGT_WARMUP_ADDR "" FLOAT32_IEEE MC_VGT_WARMUP_ADDR 0 0 0 0 ECU_ADDRESS 0x3FB014 /end MEASUREMENT
/begin COMPU_METHOD MC_VGT_WARMUP_ADDR "VGT_WARMUP_ADDR conversion" RAT_FUNC "%10.5" "Unitless" COEFFS 0 1 0 0 0 1 /end COMPU_METHOD
/begin MEASUREMENT VIDBLOCK_DIS "Flag to disable switchable calibration from the FLASH ROM vehicle ID block.  (1=> Disable, 0=> Enable)" UBYTE MC_VIDBLOCK_DIS 0 0 0 0 ECU_ADDRESS 0x3FB40A /end MEASUREMENT
/begin COMPU_METHOD MC_VIDBLOCK_DIS "VIDBLOCK_DIS conversion" RAT_FUNC "%3.0" "Unitless" COEFFS 0 1 0 0 0 1 /end COMPU_METHOD
/begin MEASUREMENT VID_RT_AXLE "" FLOAT32_IEEE MC_VID_RT_AXLE 0 0 0 0 ECU_ADDRESS 0x3FB404 /end MEASUREMENT
/begin COMPU_METHOD MC_VID_RT_AXLE "VID_RT_AXLE conversion" RAT_FUNC "%10.5" "Unitless" COEFFS 0 1 0 0 0 1 /end COMPU_METHOD
/begin MEASUREMENT VID_TIRE_REV "Tire revolutions per mile, as flashed into the Vehicle ID Block, used to compute OSS/VSS ratio." ULONG MC_VID_TIRE_REV 0 0 0 0 ECU_ADDRESS 0x3FB400 /end MEASUREMENT
/begin COMPU_METHOD MC_VID_TIRE_REV "VID_TIRE_REV conversion" RAT_FUNC "%10.0" "Unitless" COEFFS 0 1 0 0 0 1 /end COMPU_METHOD
/begin CHARACTERISTIC VMIS_NOISBND "number of firing events between a noisy event and an event that may be evaluated" VALUE 0x5EE01 SD_UBYTE 0 SC_VMIS_NOISBND 0 30 /end CHARACTERISTIC
/begin COMPU_METHOD SC_VMIS_NOISBND "VMIS_NOISBND conversion" RAT_FUNC "%3.0" "EVENTS" COEFFS 0 1 0 0 0 1 /end COMPU_METHOD
/begin MEASUREMENT VMIS_TOT1000 "total cylinder events for 1000 rotations criteria in misfire test" UWORD MC_VMIS_TOT1000 0 0 0 0 ECU_ADDRESS 0x3FB3EE /end MEASUREMENT
/begin COMPU_METHOD MC_VMIS_TOT1000 "VMIS_TOT1000 conversion" RAT_FUNC "%5.0" "Unitless" COEFFS 0 1 0 0 0 1 /end COMPU_METHOD
/begin MEASUREMENT VMIS_TOT200 "total cylinder events for 200 roatations criteria in misfire test" UWORD MC_VMIS_TOT200 0 0 0 0 ECU_ADDRESS 0x3FB3D8 /end MEASUREMENT
/begin COMPU_METHOD MC_VMIS_TOT200 "VMIS_TOT200 conversion" RAT_FUNC "%5.0" "Unitless" COEFFS 0 1 0 0 0 1 /end COMPU_METHOD
/begin MEASUREMENT VMOVING "IF = 1, VEHICLE IS MOVING" UBYTE MC_VMOVING 0 0 0 0 ECU_ADDRESS 0x3FA674 /end MEASUREMENT
/begin COMPU_METHOD MC_VMOVING "VMOVING conversion" RAT_FUNC "%3.0" "Unitless" COEFFS 0 1 0 0 0 1 /end COMPU_METHOD
/begin CHARACTERISTIC VMOV_ENG_LVL "Number of stable TRS readings (TRS_STB_CTR) used to determine an engagement is compelet for VMOVING logic" VALUE 0x5D8F1 SD_UBYTE 0 SC_VMOV_ENG_LVL 0 255 /end CHARACTERISTIC
/begin COMPU_METHOD SC_VMOV_ENG_LVL "VMOV_ENG_LVL conversion" RAT_FUNC "%3.0" "events" COEFFS 0 1 0 0 0 1 /end COMPU_METHOD
/begin CHARACTERISTIC VMOV_RUN_DLY__A "Amount of time VMOVING will be disabled after RUN mode is entered" VALUE 0x5D8E4 SD_FLOAT32_IEEE 0 SC_VMOV_RUN_DLY__A 0 65535 /end CHARACTERISTIC
/begin COMPU_METHOD SC_VMOV_RUN_DLY__A "VMOV_RUN_DLY__A conversion" RAT_FUNC "%10.5" "s" COEFFS 0 1 0 0 0 1 /end COMPU_METHOD
/begin MEASUREMENT VPIPERRCNT "Number of pip circuit failure indications between pip test background execution" UBYTE MC_VPIPERRCNT 0 0 0 0 ECU_ADDRESS 0x3FB29D /end MEASUREMENT
/begin COMPU_METHOD MC_VPIPERRCNT "VPIPERRCNT conversion" RAT_FUNC "%3.0" "Unitless" COEFFS 0 1 0 0 0 1 /end COMPU_METHOD
/begin MEASUREMENT VPIPFLG "1 = INDICATES AN INTERMITTANT PIP WITH DP" UBYTE MC_VPIPFLG 0 0 0 0 ECU_ADDRESS 0x3FB2A7 /end MEASUREMENT
/begin COMPU_METHOD MC_VPIPFLG "VPIPFLG conversion" RAT_FUNC "%3.0" "Unitless" COEFFS 0 1 0 0 0 1 /end COMPU_METHOD
/begin MEASUREMENT VPIPPASCNT "Number of pip sensor foreground evaluations with NO Failure since last pip test background" UBYTE MC_VPIPPASCNT 0 0 0 0 ECU_ADDRESS 0x3FB29C /end MEASUREMENT
/begin COMPU_METHOD MC_VPIPPASCNT "VPIPPASCNT conversion" RAT_FUNC "%3.0" "Unitless" COEFFS 0 1 0 0 0 1 /end COMPU_METHOD
/begin CHARACTERISTIC VPIPSW "PIP TEST SWITCH 0 = DO NOT DO PIP TEST, 1 = DO PIP TEST UNITLESS" VALUE 0x5ED03 SD_UBYTE 0 SC_VPIPSW 0 1 /end CHARACTERISTIC
/begin COMPU_METHOD SC_VPIPSW "VPIPSW conversion" RAT_FUNC "%3.0" "ENUMERATED" COEFFS 0 1 0 0 0 1 /end COMPU_METHOD
/begin MEASUREMENT VPIP_BYPS "Flag, when equal to 1 indicates that the pip test background is bypassed" UBYTE MC_VPIP_BYPS 0 0 0 0 ECU_ADDRESS 0x3FB2A1 /end MEASUREMENT
/begin COMPU_METHOD MC_VPIP_BYPS "VPIP_BYPS conversion" RAT_FUNC "%3.0" "Unitless" COEFFS 0 1 0 0 0 1 /end COMPU_METHOD
/begin MEASUREMENT VPWR_CNTS "System voltage in Counts" SLONG MC_VPWR_CNTS 0 0 0 0 ECU_ADDRESS 0x3F9A50 /end MEASUREMENT
/begin COMPU_METHOD MC_VPWR_CNTS "VPWR_CNTS conversion" RAT_FUNC "%10.0" "Unitless" COEFFS 0 1 0 0 0 1 /end COMPU_METHOD
/begin MEASUREMENT VPWR_ENG_IOP "System voltage engineering value" FLOAT32_IEEE MC_VPWR_ENG_IOP 0 0 0 0 ECU_ADDRESS 0x3FA40C /end MEASUREMENT
/begin COMPU_METHOD MC_VPWR_ENG_IOP "VPWR_ENG_IOP conversion" RAT_FUNC "%10.5" "Unitless" COEFFS 0 1 0 0 0 1 /end COMPU_METHOD
/begin CHARACTERISTIC VPWR_HI_ER "System voltage out of range high" VALUE 0x5C83C SD_FLOAT32_IEEE 0 SC_VPWR_HI_ER 0 25.2 /end CHARACTERISTIC
/begin COMPU_METHOD SC_VPWR_HI_ER "VPWR_HI_ER conversion" RAT_FUNC "%10.5" "V" COEFFS 0 1 0 0 0 1 /end COMPU_METHOD
/begin CHARACTERISTIC VPWR_LO_ER "System voltage out of range low" VALUE 0x5C838 SD_FLOAT32_IEEE 0 SC_VPWR_LO_ER 0 25.2 /end CHARACTERISTIC
/begin COMPU_METHOD SC_VPWR_LO_ER "VPWR_LO_ER conversion" RAT_FUNC "%10.5" "V" COEFFS 0 1 0 0 0 1 /end COMPU_METHOD
/begin MEASUREMENT VPWR_RAW "System voltage, Raw value" FLOAT32_IEEE MC_VPWR_RAW 0 0 0 0 ECU_ADDRESS 0x3F9A54 /end MEASUREMENT
/begin COMPU_METHOD MC_VPWR_RAW "VPWR_RAW conversion" RAT_FUNC "%10.5" "Unitless" COEFFS 0 1 0 0 0 1 /end COMPU_METHOD
/begin MEASUREMENT VPWR_STATUS "System voltage out of range status" UBYTE MC_VPWR_STATUS 0 0 0 0 ECU_ADDRESS 0x3F9A58 /end MEASUREMENT
/begin COMPU_METHOD MC_VPWR_STATUS "VPWR_STATUS conversion" RAT_FUNC "%3.0" "Unitless" COEFFS 0 1 0 0 0 1 /end COMPU_METHOD
/begin CHARACTERISTIC VRCM_HP "VRCm hardware present switch" VALUE 0x5C3C0 SD_UBYTE 0 SC_VRCM_HP 0 1 /end CHARACTERISTIC
/begin COMPU_METHOD SC_VRCM_HP "VRCM_HP conversion" RAT_FUNC "%3.0" "UNITLESS" COEFFS 0 1 0 0 0 1 /end COMPU_METHOD
/begin MEASUREMENT VREF "Calculated VREF voltage" FLOAT32_IEEE MC_VREF 0 0 0 0 ECU_ADDRESS 0x3F9A4C /end MEASUREMENT
/begin COMPU_METHOD MC_VREF "VREF conversion" RAT_FUNC "%10.5" "Unitless" COEFFS 0 1 0 0 0 1 /end COMPU_METHOD
/begin MEASUREMENT VS "INSTANTANEOUS VEHICLE SPEED (unverified)" FLOAT32_IEEE MC_VS 0 0 0 0 ECU_ADDRESS 0x3FA030 /end MEASUREMENT
/begin COMPU_METHOD MC_VS "VS conversion" RAT_FUNC "%10.5" "Unitless" COEFFS 0 1 0 0 0 1 /end COMPU_METHOD
/begin MEASUREMENT VSBAR "Filtered vehicle speed." FLOAT32_IEEE MC_VSBAR 0 0 0 0 ECU_ADDRESS 0x3F9B30 /end MEASUREMENT
/begin COMPU_METHOD MC_VSBAR "VSBAR conversion" RAT_FUNC "%10.5" "Unitless" COEFFS 0 1 0 0 0 1 /end COMPU_METHOD
/begin CHARACTERISTIC VSCNT "INCREMENT TO VSCTR INDICATING FAILED MHP SENSOR" VALUE 0x5D95F SD_UBYTE 0 SC_VSCNT 0 255 /end CHARACTERISTIC
/begin COMPU_METHOD SC_VSCNT "VSCNT conversion" RAT_FUNC "%3.0" "UNITLESS" COEFFS 0 1 0 0 0 1 /end COMPU_METHOD
/begin MEASUREMENT VSCTR "Count  of unrealistic changes in Vehicle Speed from the Vehicle Speed Sensor." UBYTE MC_VSCTR 0 0 0 0 ECU_ADDRESS 0x3FA6AB /end MEASUREMENT
/begin COMPU_METHOD MC_VSCTR "VSCTR conversion" RAT_FUNC "%3.0" "Unitless" COEFFS 0 1 0 0 0 1 /end COMPU_METHOD
/begin MEASUREMENT VSF "Variable speed fan level." FLOAT32_IEEE MC_VSF 0 0 0 0 ECU_ADDRESS 0x3FB1F4 /end MEASUREMENT
/begin COMPU_METHOD MC_VSF "VSF conversion" RAT_FUNC "%10.5" "Unitless" COEFFS 0 1 0 0 0 1 /end COMPU_METHOD
/begin MEASUREMENT VSFMFLG "VEHICLE SPEED ENVIRONMENT FMEM FLAG" UBYTE MC_VSFMFLG 0 0 0 0 ECU_ADDRESS 0x3FA2AD /end MEASUREMENT
/begin COMPU_METHOD MC_VSFMFLG "VSFMFLG conversion" RAT_FUNC "%3.0" "Unitless" COEFFS 0 1 0 0 0 1 /end COMPU_METHOD
/begin CHARACTERISTIC VSF_VS_CL "VS to return to normal fan control." VALUE 0x5EB20 SD_FLOAT32_IEEE 0 SC_VSF_VS_CL 0 127.5 /end CHARACTERISTIC
/begin COMPU_METHOD SC_VSF_VS_CL "VSF_VS_CL conversion" RAT_FUNC "%10.5" "MPH" COEFFS 0 1 0 0 0 1 /end COMPU_METHOD
/begin MEASUREMENT VSO_DC "" FLOAT32_IEEE MC_VSO_DC 0 0 0 0 ECU_ADDRESS 0x3F986C /end MEASUREMENT
/begin COMPU_METHOD MC_VSO_DC "VSO_DC conversion" RAT_FUNC "%10.5" "Unitless" COEFFS 0 1 0 0 0 1 /end COMPU_METHOD
/begin CHARACTERISTIC VSO_DC_INVERT "" VALUE 0x5C414 SD_UBYTE 0 SC_VSO_DC_INVERT 0 1 /end CHARACTERISTIC
/begin COMPU_METHOD SC_VSO_DC_INVERT "VSO_DC_INVERT conversion" RAT_FUNC "%3.0" "unitless" COEFFS 0 1 0 0 0 1 /end COMPU_METHOD
/begin MEASUREMENT VSO_FREQ "" FLOAT32_IEEE MC_VSO_FREQ 0 0 0 0 ECU_ADDRESS 0x3F9868 /end MEASUREMENT
/begin COMPU_METHOD MC_VSO_FREQ "VSO_FREQ conversion" RAT_FUNC "%10.5" "Unitless" COEFFS 0 1 0 0 0 1 /end COMPU_METHOD
/begin MEASUREMENT VSPD "Vehicle speed" FLOAT32_IEEE MC_VSPD 0 0 0 0 ECU_ADDRESS 0x3FA02C /end MEASUREMENT
/begin COMPU_METHOD MC_VSPD "VSPD conversion" RAT_FUNC "%10.5" "Unitless" COEFFS 0 1 0 0 0 1 /end COMPU_METHOD
/begin MEASUREMENT VSPD_FG_TM "Last time DeltaTime function was called for vspd_fg_dtm update" ULONG MC_VSPD_FG_TM 0 0 0 0 ECU_ADDRESS 0x3FA018 /end MEASUREMENT
/begin COMPU_METHOD MC_VSPD_FG_TM "VSPD_FG_TM conversion" RAT_FUNC "%10.0" "Unitless" COEFFS 0 1 0 0 0 1 /end COMPU_METHOD
/begin MEASUREMENT VSPD_PREV "Previous vehicle speed" FLOAT32_IEEE MC_VSPD_PREV 0 0 0 0 ECU_ADDRESS 0x3FA020 /end MEASUREMENT
/begin COMPU_METHOD MC_VSPD_PREV "VSPD_PREV conversion" RAT_FUNC "%10.5" "Unitless" COEFFS 0 1 0 0 0 1 /end COMPU_METHOD
/begin CHARACTERISTIC VSSFAIL_MAXMF "Max. allowed mfgov value if VSS failed" VALUE 0x5DB78 SD_FLOAT32_IEEE 0 SC_VSSFAIL_MAXMF -2048 2048 /end CHARACTERISTIC
/begin COMPU_METHOD SC_VSSFAIL_MAXMF "VSSFAIL_MAXMF conversion" RAT_FUNC "%10.5" "unitless" COEFFS 0 1 0 0 0 1 /end COMPU_METHOD
/begin CHARACTERISTIC VSSFAIL_MAXRPM "Max. Engine speed allowd if VSS fails" VALUE 0x5D980 SD_FLOAT32_IEEE 0 SC_VSSFAIL_MAXRPM 0 16383.8 /end CHARACTERISTIC
/begin COMPU_METHOD SC_VSSFAIL_MAXRPM "VSSFAIL_MAXRPM conversion" RAT_FUNC "%10.5" "RPM" COEFFS 0 1 0 0 0 1 /end COMPU_METHOD
/begin CHARACTERISTIC VSSMN1 "MAXIMUM VEHICLE SPEED TO ENTER VSS TEST" VALUE 0x5D94C SD_FLOAT32_IEEE 0 SC_VSSMN1 0 80 /end CHARACTERISTIC
/begin COMPU_METHOD SC_VSSMN1 "VSSMN1 conversion" RAT_FUNC "%10.5" "MPH" COEFFS 0 1 0 0 0 1 /end COMPU_METHOD
/begin CHARACTERISTIC VSSTIM "MINIMUM STABLIZED TIME BEFORE PERFORMING CVIP VSS TEST" VALUE 0x5D948 SD_FLOAT32_IEEE 0 SC_VSSTIM 0 31.875 /end CHARACTERISTIC
/begin COMPU_METHOD SC_VSSTIM "VSSTIM conversion" RAT_FUNC "%10.5" "S" COEFFS 0 1 0 0 0 1 /end COMPU_METHOD
/begin MEASUREMENT VSSTMR "VEHICLE SPEED SENSOR TEST TIMER" FLOAT32_IEEE MC_VSSTMR 0 0 0 0 ECU_ADDRESS 0x3FA684 /end MEASUREMENT
/begin COMPU_METHOD MC_VSSTMR "VSSTMR conversion" RAT_FUNC "%10.5" "Unitless" COEFFS 0 1 0 0 0 1 /end COMPU_METHOD
/begin MEASUREMENT VSS_ERR_CTR "VSS error counter" UBYTE MC_VSS_ERR_CTR 0 0 0 0 ECU_ADDRESS 0x3FA6AA /end MEASUREMENT
/begin COMPU_METHOD MC_VSS_ERR_CTR "VSS_ERR_CTR conversion" RAT_FUNC "%3.0" "Unitless" COEFFS 0 1 0 0 0 1 /end COMPU_METHOD
/begin CHARACTERISTIC VSS_ERR_LVL "VSS error fault threshold" VALUE 0x5D95E SD_UBYTE 0 SC_VSS_ERR_LVL 0 255 /end CHARACTERISTIC
/begin COMPU_METHOD SC_VSS_ERR_LVL "VSS_ERR_LVL conversion" RAT_FUNC "%3.0" "COUNTS" COEFFS 0 1 0 0 0 1 /end COMPU_METHOD
/begin CHARACTERISTIC VSS_ERR_UP "VSS error upcount" VALUE 0x5D95D SD_UBYTE 0 SC_VSS_ERR_UP 0 255 /end CHARACTERISTIC
/begin COMPU_METHOD SC_VSS_ERR_UP "VSS_ERR_UP conversion" RAT_FUNC "%3.0" "COUNTS" COEFFS 0 1 0 0 0 1 /end COMPU_METHOD
/begin CHARACTERISTIC VSS_HP "Veh. Spd. Sensor H/W Present (1 = VSS present)" VALUE 0x5D190 SD_UBYTE 0 SC_VSS_HP 0 1 /end CHARACTERISTIC
/begin COMPU_METHOD SC_VSS_HP "VSS_HP conversion" RAT_FUNC "%3.0" "unitless" COEFFS 0 1 0 0 0 1 /end COMPU_METHOD
/begin CHARACTERISTIC VSS_MON_TIM "Minimum amount of time the vehicle speed sensor must be observed to function to set the monitor flag" VALUE 0x5D944 SD_FLOAT32_IEEE 0 SC_VSS_MON_TIM 0 255 /end CHARACTERISTIC
/begin COMPU_METHOD SC_VSS_MON_TIM "VSS_MON_TIM conversion" RAT_FUNC "%10.5" "s" COEFFS 0 1 0 0 0 1 /end COMPU_METHOD
/begin MEASUREMENT VSS_MON_TMR "Vehicle speed sensor monitor timer." FLOAT32_IEEE MC_VSS_MON_TMR 0 0 0 0 ECU_ADDRESS 0x3FA678 /end MEASUREMENT
/begin COMPU_METHOD MC_VSS_MON_TMR "VSS_MON_TMR conversion" RAT_FUNC "%10.5" "Unitless" COEFFS 0 1 0 0 0 1 /end COMPU_METHOD
/begin CHARACTERISTIC VSS_NOBART_DLT "" VALUE 0x5D930 SD_FLOAT32_IEEE 0 SC_VSS_NOBART_DLT 0 5000 /end CHARACTERISTIC
/begin COMPU_METHOD SC_VSS_NOBART_DLT "VSS_NOBART_DLT conversion" RAT_FUNC "%10.5" "unitless" COEFFS 0 1 0 0 0 1 /end COMPU_METHOD
/begin CHARACTERISTIC VSS_NTBART_DLT "" VALUE 0x5D934 SD_FLOAT32_IEEE 0 SC_VSS_NTBART_DLT 0 5000 /end CHARACTERISTIC
/begin COMPU_METHOD SC_VSS_NTBART_DLT "VSS_NTBART_DLT conversion" RAT_FUNC "%10.5" "unitless" COEFFS 0 1 0 0 0 1 /end COMPU_METHOD
/begin CHARACTERISTIC VSS_OBD_MXDISTM_A "Maximum time trans OBD will be disabled during a TFT sensor failure" VALUE 0x5D940 SD_FLOAT32_IEEE 0 SC_VSS_OBD_MXDISTM_A 0 65535 /end CHARACTERISTIC
/begin COMPU_METHOD SC_VSS_OBD_MXDISTM_A "VSS_OBD_MXDISTM_A conversion" RAT_FUNC "%10.5" "s" COEFFS 0 1 0 0 0 1 /end COMPU_METHOD
/begin MEASUREMENT VSS_OBD_RUN_TMR "Transmission On-Board Diagnostics run timer" FLOAT32_IEEE MC_VSS_OBD_RUN_TMR 0 0 0 0 ECU_ADDRESS 0x3FA690 /end MEASUREMENT
/begin COMPU_METHOD MC_VSS_OBD_RUN_TMR "VSS_OBD_RUN_TMR conversion" RAT_FUNC "%10.5" "Unitless" COEFFS 0 1 0 0 0 1 /end COMPU_METHOD
/begin CHARACTERISTIC VSS_OS_INC "" VALUE 0x5D959 SD_UBYTE 0 SC_VSS_OS_INC 0 255 /end CHARACTERISTIC
/begin COMPU_METHOD SC_VSS_OS_INC "VSS_OS_INC conversion" RAT_FUNC "%3.0" "unitless" COEFFS 0 1 0 0 0 1 /end COMPU_METHOD
/begin CHARACTERISTIC VSS_TRS_STB_TM "" VALUE 0x5D958 SD_UBYTE 0 SC_VSS_TRS_STB_TM 0 255 /end CHARACTERISTIC
/begin COMPU_METHOD SC_VSS_TRS_STB_TM "VSS_TRS_STB_TM conversion" RAT_FUNC "%3.0" "unitless" COEFFS 0 1 0 0 0 1 /end COMPU_METHOD
/begin CHARACTERISTIC VSS_TS_INC "" VALUE 0x5D95A SD_UBYTE 0 SC_VSS_TS_INC 0 255 /end CHARACTERISTIC
/begin COMPU_METHOD SC_VSS_TS_INC "VSS_TS_INC conversion" RAT_FUNC "%3.0" "unitless" COEFFS 0 1 0 0 0 1 /end COMPU_METHOD
/begin MEASUREMENT VS_FIL "Intermittent fault filter for the VS sensor." UBYTE MC_VS_FIL 0 0 0 0 ECU_ADDRESS 0x3F9E4D /end MEASUREMENT
/begin COMPU_METHOD MC_VS_FIL "VS_FIL conversion" RAT_FUNC "%3.0" "Unitless" COEFFS 0 1 0 0 0 1 /end COMPU_METHOD
/begin MEASUREMENT VS_FIL_MAX "HIGHEST VALUE THE FAULT FILTER VS_FIL SEES." UBYTE MC_VS_FIL_MAX 0 0 0 0 ECU_ADDRESS 0x3FCCFD /end MEASUREMENT
/begin COMPU_METHOD MC_VS_FIL_MAX "VS_FIL_MAX conversion" RAT_FUNC "%3.0" "Unitless" COEFFS 0 1 0 0 0 1 /end COMPU_METHOD
/begin CHARACTERISTIC VS_HP "Switch indicating a source of vehicle speed (VSS or SCP) is present; 0 -> all vehicle speed calcs come from OSS, 1 -> VSS or SCP VS" VALUE 0x5CB1A SD_UWORD 0 SC_VS_HP 0 1 /end CHARACTERISTIC
/begin COMPU_METHOD SC_VS_HP "VS_HP conversion" RAT_FUNC "%5.0" "Unitless" COEFFS 0 1 0 0 0 1 /end COMPU_METHOD
/begin MEASUREMENT VS_INT "Flag set when intermittent is detected on the VS sensor." UBYTE MC_VS_INT 0 0 0 0 ECU_ADDRESS 0x3F9E4C /end MEASUREMENT
/begin COMPU_METHOD MC_VS_INT "VS_INT conversion" RAT_FUNC "%3.0" "Unitless" COEFFS 0 1 0 0 0 1 /end COMPU_METHOD
/begin CHARACTERISTIC VS_LVL "Fault level for intermittent VS sensor." VALUE 0x5CE52 SD_UBYTE 0 SC_VS_LVL 0 255 /end CHARACTERISTIC
/begin COMPU_METHOD SC_VS_LVL "VS_LVL conversion" RAT_FUNC "%3.0" "LEVEL" COEFFS 0 1 0 0 0 1 /end COMPU_METHOD
/begin CHARACTERISTIC VS_MOV "VEHICLE SPEED ABOVE WHICH TSS TEST WILL BE EXECUTED" VALUE 0x5D8E0 SD_FLOAT32_IEEE 0 SC_VS_MOV 0 80 /end CHARACTERISTIC
/begin COMPU_METHOD SC_VS_MOV "VS_MOV conversion" RAT_FUNC "%10.5" "MPH" COEFFS 0 1 0 0 0 1 /end COMPU_METHOD
/begin MEASUREMENT VS_NOISE_CTR "Count of unrealistic changes in vehicle speed" UBYTE MC_VS_NOISE_CTR 0 0 0 0 ECU_ADDRESS 0x3FA6A9 /end MEASUREMENT
/begin COMPU_METHOD MC_VS_NOISE_CTR "VS_NOISE_CTR conversion" RAT_FUNC "%3.0" "Unitless" COEFFS 0 1 0 0 0 1 /end COMPU_METHOD
/begin CHARACTERISTIC VS_NOISE_LVL "Fault threshold for a noisy VSS" VALUE 0x5D95C SD_UBYTE 0 SC_VS_NOISE_LVL 0 255 /end CHARACTERISTIC
/begin COMPU_METHOD SC_VS_NOISE_LVL "VS_NOISE_LVL conversion" RAT_FUNC "%3.0" "COUNTS" COEFFS 0 1 0 0 0 1 /end COMPU_METHOD
/begin MEASUREMENT VS_OK_CTR "Total number of good samples of vehicle speed signal, used to clear noisy VSS code" UBYTE MC_VS_OK_CTR 0 0 0 0 ECU_ADDRESS 0x3FA6A8 /end MEASUREMENT
/begin COMPU_METHOD MC_VS_OK_CTR "VS_OK_CTR conversion" RAT_FUNC "%3.0" "Unitless" COEFFS 0 1 0 0 0 1 /end COMPU_METHOD
/begin CHARACTERISTIC VS_OK_LVL "Vehicle speed signal O.K threshold, enough O.K VSS events for clearing p0503" VALUE 0x5D95B SD_UBYTE 0 SC_VS_OK_LVL 0 255 /end CHARACTERISTIC
/begin COMPU_METHOD SC_VS_OK_LVL "VS_OK_LVL conversion" RAT_FUNC "%3.0" "events" COEFFS 0 1 0 0 0 1 /end COMPU_METHOD
/begin MEASUREMENT VS_PRE_D "Previous background value of vehicle speed, updated in TID_VSS." FLOAT32_IEEE MC_VS_PRE_D 0 0 0 0 ECU_ADDRESS 0x3FA680 /end MEASUREMENT
/begin COMPU_METHOD MC_VS_PRE_D "VS_PRE_D conversion" RAT_FUNC "%10.5" "Unitless" COEFFS 0 1 0 0 0 1 /end COMPU_METHOD
/begin MEASUREMENT VS_SRC "Unfiltered vehicle speed from the source (SCP or VSS) - never substituted for during fmem" FLOAT32_IEEE MC_VS_SRC 0 0 0 0 ECU_ADDRESS 0x3FA244 /end MEASUREMENT
/begin COMPU_METHOD MC_VS_SRC "VS_SRC conversion" RAT_FUNC "%10.5" "Unitless" COEFFS 0 1 0 0 0 1 /end COMPU_METHOD
/begin CHARACTERISTIC V_CAMN_MAX "Upper rpm limit for running the CAM test." VALUE 0x5ECCC SD_FLOAT32_IEEE 0 SC_V_CAMN_MAX 0 16383.8 /end CHARACTERISTIC
/begin COMPU_METHOD SC_V_CAMN_MAX "V_CAMN_MAX conversion" RAT_FUNC "%10.5" "RPM" COEFFS 0 1 0 0 0 1 /end COMPU_METHOD
/begin CHARACTERISTIC V_CAMN_MIN "Lower rpm limit for running the CAM test." VALUE 0x5ECD0 SD_FLOAT32_IEEE 0 SC_V_CAMN_MIN 0 16383.8 /end CHARACTERISTIC
/begin COMPU_METHOD SC_V_CAMN_MIN "V_CAMN_MIN conversion" RAT_FUNC "%10.5" "RPM" COEFFS 0 1 0 0 0 1 /end COMPU_METHOD
/begin CHARACTERISTIC V_CIDNMAX "Upper rpm limit for running the CID test." VALUE 0x5ECD4 SD_FLOAT32_IEEE 0 SC_V_CIDNMAX 0 16383.8 /end CHARACTERISTIC
/begin COMPU_METHOD SC_V_CIDNMAX "V_CIDNMAX conversion" RAT_FUNC "%10.5" "RPM" COEFFS 0 1 0 0 0 1 /end COMPU_METHOD
/begin CHARACTERISTIC V_CIDNMIN "Lower rpm limit for running the CID test." VALUE 0x5ECD8 SD_FLOAT32_IEEE 0 SC_V_CIDNMIN 0 16383.8 /end CHARACTERISTIC
/begin COMPU_METHOD SC_V_CIDNMIN "V_CIDNMIN conversion" RAT_FUNC "%10.5" "RPM" COEFFS 0 1 0 0 0 1 /end COMPU_METHOD
/begin CHARACTERISTIC V_CRKN_MAX "Upper rpm limit for running the CRK test." VALUE 0x5ECDC SD_FLOAT32_IEEE 0 SC_V_CRKN_MAX 0 16383.8 /end CHARACTERISTIC
/begin COMPU_METHOD SC_V_CRKN_MAX "V_CRKN_MAX conversion" RAT_FUNC "%10.5" "RPM" COEFFS 0 1 0 0 0 1 /end COMPU_METHOD
/begin CHARACTERISTIC V_CRKN_MIN "Lower rpm limit for running the CRK test." VALUE 0x5ECE0 SD_FLOAT32_IEEE 0 SC_V_CRKN_MIN 0 16383.8 /end CHARACTERISTIC
/begin COMPU_METHOD SC_V_CRKN_MIN "V_CRKN_MIN conversion" RAT_FUNC "%10.5" "RPM" COEFFS 0 1 0 0 0 1 /end COMPU_METHOD
/begin MEASUREMENT V_CYL_HMIS[0] "Counters for consecutive misfires per cylinder, from non-pc accel channel, in between background passes." UBYTE MC_V_CYL_HMIS 0 0 0 255 ECU_ADDRESS 0x3FBFDC /end MEASUREMENT
/begin COMPU_METHOD MC_V_CYL_HMIS "V_CYL_HMIS conversion" RAT_FUNC "%3.0" "events" COEFFS 0 1 0 0 0 1 /end COMPU_METHOD
/begin MEASUREMENT V_CYL_HMIS[1] "Counters for consecutive misfires per cylinder, from non-pc accel channel, in between background passes." UBYTE MC_V_CYL_HMIS 0 0 0 255 ECU_ADDRESS 0x3FBFDD /end MEASUREMENT
/begin MEASUREMENT V_CYL_HMIS[2] "Counters for consecutive misfires per cylinder, from non-pc accel channel, in between background passes." UBYTE MC_V_CYL_HMIS 0 0 0 255 ECU_ADDRESS 0x3FBFDE /end MEASUREMENT
/begin MEASUREMENT V_CYL_HMIS[3] "Counters for consecutive misfires per cylinder, from non-pc accel channel, in between background passes." UBYTE MC_V_CYL_HMIS 0 0 0 255 ECU_ADDRESS 0x3FBFDF /end MEASUREMENT
/begin MEASUREMENT V_CYL_HMIS[4] "Counters for consecutive misfires per cylinder, from non-pc accel channel, in between background passes." UBYTE MC_V_CYL_HMIS 0 0 0 255 ECU_ADDRESS 0x3FBFE0 /end MEASUREMENT
/begin MEASUREMENT V_CYL_HMIS[5] "Counters for consecutive misfires per cylinder, from non-pc accel channel, in between background passes." UBYTE MC_V_CYL_HMIS 0 0 0 255 ECU_ADDRESS 0x3FBFE1 /end MEASUREMENT
/begin MEASUREMENT V_CYL_HMIS[6] "Counters for consecutive misfires per cylinder, from non-pc accel channel, in between background passes." UBYTE MC_V_CYL_HMIS 0 0 0 255 ECU_ADDRESS 0x3FBFE2 /end MEASUREMENT
/begin MEASUREMENT V_CYL_HMIS[7] "Counters for consecutive misfires per cylinder, from non-pc accel channel, in between background passes." UBYTE MC_V_CYL_HMIS 0 0 0 255 ECU_ADDRESS 0x3FBFE3 /end MEASUREMENT
/begin MEASUREMENT V_CYL_HMIS[8] "Counters for consecutive misfires per cylinder, from non-pc accel channel, in between background passes." UBYTE MC_V_CYL_HMIS 0 0 0 255 ECU_ADDRESS 0x3FBFE4 /end MEASUREMENT
/begin MEASUREMENT V_CYL_HMIS[9] "Counters for consecutive misfires per cylinder, from non-pc accel channel, in between background passes." UBYTE MC_V_CYL_HMIS 0 0 0 255 ECU_ADDRESS 0x3FBFE5 /end MEASUREMENT
/begin MEASUREMENT V_CYL_MISTOT[0] "Misfire counts per cylinder in the current driving cycle" ULONG MC_V_CYL_MISTOT 0 0 0 1.67772e+07 ECU_ADDRESS 0x3FC000 /end MEASUREMENT
/begin COMPU_METHOD MC_V_CYL_MISTOT "V_CYL_MISTOT conversion" RAT_FUNC "%10.0" "unitless" COEFFS 0 1 0 0 0 1 /end COMPU_METHOD
/begin MEASUREMENT V_CYL_MISTOT[1] "Misfire counts per cylinder in the current driving cycle" ULONG MC_V_CYL_MISTOT 0 0 0 1.67772e+07 ECU_ADDRESS 0x3FC004 /end MEASUREMENT
/begin MEASUREMENT V_CYL_MISTOT[2] "Misfire counts per cylinder in the current driving cycle" ULONG MC_V_CYL_MISTOT 0 0 0 1.67772e+07 ECU_ADDRESS 0x3FC008 /end MEASUREMENT
/begin MEASUREMENT V_CYL_MISTOT[3] "Misfire counts per cylinder in the current driving cycle" ULONG MC_V_CYL_MISTOT 0 0 0 1.67772e+07 ECU_ADDRESS 0x3FC00C /end MEASUREMENT
/begin MEASUREMENT V_CYL_MISTOT[4] "Misfire counts per cylinder in the current driving cycle" ULONG MC_V_CYL_MISTOT 0 0 0 1.67772e+07 ECU_ADDRESS 0x3FC010 /end MEASUREMENT
/begin MEASUREMENT V_CYL_MISTOT[5] "Misfire counts per cylinder in the current driving cycle" ULONG MC_V_CYL_MISTOT 0 0 0 1.67772e+07 ECU_ADDRESS 0x3FC014 /end MEASUREMENT
/begin MEASUREMENT V_CYL_MISTOT[6] "Misfire counts per cylinder in the current driving cycle" ULONG MC_V_CYL_MISTOT 0 0 0 1.67772e+07 ECU_ADDRESS 0x3FC018 /end MEASUREMENT
/begin MEASUREMENT V_CYL_MISTOT[7] "Misfire counts per cylinder in the current driving cycle" ULONG MC_V_CYL_MISTOT 0 0 0 1.67772e+07 ECU_ADDRESS 0x3FC01C /end MEASUREMENT
/begin MEASUREMENT V_CYL_MISTOT[8] "Misfire counts per cylinder in the current driving cycle" ULONG MC_V_CYL_MISTOT 0 0 0 1.67772e+07 ECU_ADDRESS 0x3FC020 /end MEASUREMENT
/begin MEASUREMENT V_CYL_MISTOT[9] "Misfire counts per cylinder in the current driving cycle" ULONG MC_V_CYL_MISTOT 0 0 0 1.67772e+07 ECU_ADDRESS 0x3FC024 /end MEASUREMENT
/begin MEASUREMENT V_CYL_MIS[0] "Counters for misfires per cylinder in between background passes." UBYTE MC_V_CYL_MIS 0 0 0 255 ECU_ADDRESS 0x3FBFC4 /end MEASUREMENT
/begin COMPU_METHOD MC_V_CYL_MIS "V_CYL_MIS conversion" RAT_FUNC "%3.0" "events" COEFFS 0 1 0 0 0 1 /end COMPU_METHOD
/begin MEASUREMENT V_CYL_MIS[1] "Counters for misfires per cylinder in between background passes." UBYTE MC_V_CYL_MIS 0 0 0 255 ECU_ADDRESS 0x3FBFC5 /end MEASUREMENT
/begin MEASUREMENT V_CYL_MIS[2] "Counters for misfires per cylinder in between background passes." UBYTE MC_V_CYL_MIS 0 0 0 255 ECU_ADDRESS 0x3FBFC6 /end MEASUREMENT
/begin MEASUREMENT V_CYL_MIS[3] "Counters for misfires per cylinder in between background passes." UBYTE MC_V_CYL_MIS 0 0 0 255 ECU_ADDRESS 0x3FBFC7 /end MEASUREMENT
/begin MEASUREMENT V_CYL_MIS[4] "Counters for misfires per cylinder in between background passes." UBYTE MC_V_CYL_MIS 0 0 0 255 ECU_ADDRESS 0x3FBFC8 /end MEASUREMENT
/begin MEASUREMENT V_CYL_MIS[5] "Counters for misfires per cylinder in between background passes." UBYTE MC_V_CYL_MIS 0 0 0 255 ECU_ADDRESS 0x3FBFC9 /end MEASUREMENT
/begin MEASUREMENT V_CYL_MIS[6] "Counters for misfires per cylinder in between background passes." UBYTE MC_V_CYL_MIS 0 0 0 255 ECU_ADDRESS 0x3FBFCA /end MEASUREMENT
/begin MEASUREMENT V_CYL_MIS[7] "Counters for misfires per cylinder in between background passes." UBYTE MC_V_CYL_MIS 0 0 0 255 ECU_ADDRESS 0x3FBFCB /end MEASUREMENT
/begin MEASUREMENT V_CYL_MIS[8] "Counters for misfires per cylinder in between background passes." UBYTE MC_V_CYL_MIS 0 0 0 255 ECU_ADDRESS 0x3FBFCC /end MEASUREMENT
/begin MEASUREMENT V_CYL_MIS[9] "Counters for misfires per cylinder in between background passes." UBYTE MC_V_CYL_MIS 0 0 0 255 ECU_ADDRESS 0x3FBFCD /end MEASUREMENT
/begin MEASUREMENT V_CYL_TOT[0] "Counters for total events tested per cylinder in between background passes" UBYTE MC_V_CYL_TOT 0 0 0 255 ECU_ADDRESS 0x3FBFD0 /end MEASUREMENT
/begin COMPU_METHOD MC_V_CYL_TOT "V_CYL_TOT conversion" RAT_FUNC "%3.0" "events" COEFFS 0 1 0 0 0 1 /end COMPU_METHOD
/begin MEASUREMENT V_CYL_TOT[1] "Counters for total events tested per cylinder in between background passes" UBYTE MC_V_CYL_TOT 0 0 0 255 ECU_ADDRESS 0x3FBFD1 /end MEASUREMENT
/begin MEASUREMENT V_CYL_TOT[2] "Counters for total events tested per cylinder in between background passes" UBYTE MC_V_CYL_TOT 0 0 0 255 ECU_ADDRESS 0x3FBFD2 /end MEASUREMENT
/begin MEASUREMENT V_CYL_TOT[3] "Counters for total events tested per cylinder in between background passes" UBYTE MC_V_CYL_TOT 0 0 0 255 ECU_ADDRESS 0x3FBFD3 /end MEASUREMENT
/begin MEASUREMENT V_CYL_TOT[4] "Counters for total events tested per cylinder in between background passes" UBYTE MC_V_CYL_TOT 0 0 0 255 ECU_ADDRESS 0x3FBFD4 /end MEASUREMENT
/begin MEASUREMENT V_CYL_TOT[5] "Counters for total events tested per cylinder in between background passes" UBYTE MC_V_CYL_TOT 0 0 0 255 ECU_ADDRESS 0x3FBFD5 /end MEASUREMENT
/begin MEASUREMENT V_CYL_TOT[6] "Counters for total events tested per cylinder in between background passes" UBYTE MC_V_CYL_TOT 0 0 0 255 ECU_ADDRESS 0x3FBFD6 /end MEASUREMENT
/begin MEASUREMENT V_CYL_TOT[7] "Counters for total events tested per cylinder in between background passes" UBYTE MC_V_CYL_TOT 0 0 0 255 ECU_ADDRESS 0x3FBFD7 /end MEASUREMENT
/begin MEASUREMENT V_CYL_TOT[8] "Counters for total events tested per cylinder in between background passes" UBYTE MC_V_CYL_TOT 0 0 0 255 ECU_ADDRESS 0x3FBFD8 /end MEASUREMENT
/begin MEASUREMENT V_CYL_TOT[9] "Counters for total events tested per cylinder in between background passes" UBYTE MC_V_CYL_TOT 0 0 0 255 ECU_ADDRESS 0x3FBFD9 /end MEASUREMENT
/begin CHARACTERISTIC V_HMIS_MIN "Minimum number of continuous hard misfires to occur before they are considered valid misfires." VALUE 0x5EE02 SD_UBYTE 0 SC_V_HMIS_MIN 0 255 /end CHARACTERISTIC
/begin COMPU_METHOD SC_V_HMIS_MIN "V_HMIS_MIN conversion" RAT_FUNC "%3.0" "-" COEFFS 0 1 0 0 0 1 /end COMPU_METHOD
/begin CHARACTERISTIC V_ISC_HI_DELAY "Time delay to allow RPM to reach minimum value for engine running on-demand test." VALUE 0x5F0A8 SD_FLOAT32_IEEE 0 SC_V_ISC_HI_DELAY 0 128 /end CHARACTERISTIC
/begin COMPU_METHOD SC_V_ISC_HI_DELAY "V_ISC_HI_DELAY conversion" RAT_FUNC "%10.5" "s" COEFFS 0 1 0 0 0 1 /end COMPU_METHOD
/begin CHARACTERISTIC V_ISC_HI_DL2 "Time delay to allow RPM to settle after EGR on demand test." VALUE 0x5F0B0 SD_FLOAT32_IEEE 0 SC_V_ISC_HI_DL2 0 31 /end CHARACTERISTIC
/begin COMPU_METHOD SC_V_ISC_HI_DL2 "V_ISC_HI_DL2 conversion" RAT_FUNC "%10.5" "s" COEFFS 0 1 0 0 0 1 /end COMPU_METHOD
/begin CHARACTERISTIC V_ISC_HI_MIN "Minimum RPM to pass High RPM portion of engine running on demand test" VALUE 0x5F0A4 SD_FLOAT32_IEEE 0 SC_V_ISC_HI_MIN 0 2500 /end CHARACTERISTIC
/begin COMPU_METHOD SC_V_ISC_HI_MIN "V_ISC_HI_MIN conversion" RAT_FUNC "%10.5" "RPM" COEFFS 0 1 0 0 0 1 /end COMPU_METHOD
/begin CHARACTERISTIC V_ISC_LO_TIME "Time delay to allow ISC to test at low rpm." VALUE 0x5F0AC SD_FLOAT32_IEEE 0 SC_V_ISC_LO_TIME 0 128 /end CHARACTERISTIC
/begin COMPU_METHOD SC_V_ISC_LO_TIME "V_ISC_LO_TIME conversion" RAT_FUNC "%10.5" "s" COEFFS 0 1 0 0 0 1 /end COMPU_METHOD
/begin MEASUREMENT V_MIS1000_[0] "Running counts of misfires accumulated per cylinder of the current 1000 rev test" UWORD MC_V_MIS1000_ 0 0 0 65535 ECU_ADDRESS 0x3FC03C /end MEASUREMENT
/begin COMPU_METHOD MC_V_MIS1000_ "V_MIS1000_ conversion" RAT_FUNC "%5.0" "events" COEFFS 0 1 0 0 0 1 /end COMPU_METHOD
/begin MEASUREMENT V_MIS1000_[1] "Running counts of misfires accumulated per cylinder of the current 1000 rev test" UWORD MC_V_MIS1000_ 0 0 0 65535 ECU_ADDRESS 0x3FC03E /end MEASUREMENT
/begin MEASUREMENT V_MIS1000_[2] "Running counts of misfires accumulated per cylinder of the current 1000 rev test" UWORD MC_V_MIS1000_ 0 0 0 65535 ECU_ADDRESS 0x3FC040 /end MEASUREMENT
/begin MEASUREMENT V_MIS1000_[3] "Running counts of misfires accumulated per cylinder of the current 1000 rev test" UWORD MC_V_MIS1000_ 0 0 0 65535 ECU_ADDRESS 0x3FC042 /end MEASUREMENT
/begin MEASUREMENT V_MIS1000_[4] "Running counts of misfires accumulated per cylinder of the current 1000 rev test" UWORD MC_V_MIS1000_ 0 0 0 65535 ECU_ADDRESS 0x3FC044 /end MEASUREMENT
/begin MEASUREMENT V_MIS1000_[5] "Running counts of misfires accumulated per cylinder of the current 1000 rev test" UWORD MC_V_MIS1000_ 0 0 0 65535 ECU_ADDRESS 0x3FC046 /end MEASUREMENT
/begin MEASUREMENT V_MIS1000_[6] "Running counts of misfires accumulated per cylinder of the current 1000 rev test" UWORD MC_V_MIS1000_ 0 0 0 65535 ECU_ADDRESS 0x3FC048 /end MEASUREMENT
/begin MEASUREMENT V_MIS1000_[7] "Running counts of misfires accumulated per cylinder of the current 1000 rev test" UWORD MC_V_MIS1000_ 0 0 0 65535 ECU_ADDRESS 0x3FC04A /end MEASUREMENT
/begin MEASUREMENT V_MIS1000_[8] "Running counts of misfires accumulated per cylinder of the current 1000 rev test" UWORD MC_V_MIS1000_ 0 0 0 65535 ECU_ADDRESS 0x3FC04C /end MEASUREMENT
/begin MEASUREMENT V_MIS1000_[9] "Running counts of misfires accumulated per cylinder of the current 1000 rev test" UWORD MC_V_MIS1000_ 0 0 0 65535 ECU_ADDRESS 0x3FC04E /end MEASUREMENT
/begin MEASUREMENT V_MIS200_UNK "total misfires with unknown cylinder number (cyl id disabled) for 200 rotations criteria in misfire test" UWORD MC_V_MIS200_UNK 0 0 0 0 ECU_ADDRESS 0x3FB3D6 /end MEASUREMENT
/begin COMPU_METHOD MC_V_MIS200_UNK "V_MIS200_UNK conversion" RAT_FUNC "%5.0" "Unitless" COEFFS 0 1 0 0 0 1 /end COMPU_METHOD
/begin MEASUREMENT V_MIS200_[0] "Running counts of misfires accumulated per cylinder of the current 200 rev test" UWORD MC_V_MIS200_ 0 0 0 65535 ECU_ADDRESS 0x3FC028 /end MEASUREMENT
/begin COMPU_METHOD MC_V_MIS200_ "V_MIS200_ conversion" RAT_FUNC "%5.0" "events" COEFFS 0 1 0 0 0 1 /end COMPU_METHOD
/begin MEASUREMENT V_MIS200_[1] "Running counts of misfires accumulated per cylinder of the current 200 rev test" UWORD MC_V_MIS200_ 0 0 0 65535 ECU_ADDRESS 0x3FC02A /end MEASUREMENT
/begin MEASUREMENT V_MIS200_[2] "Running counts of misfires accumulated per cylinder of the current 200 rev test" UWORD MC_V_MIS200_ 0 0 0 65535 ECU_ADDRESS 0x3FC02C /end MEASUREMENT
/begin MEASUREMENT V_MIS200_[3] "Running counts of misfires accumulated per cylinder of the current 200 rev test" UWORD MC_V_MIS200_ 0 0 0 65535 ECU_ADDRESS 0x3FC02E /end MEASUREMENT
/begin MEASUREMENT V_MIS200_[4] "Running counts of misfires accumulated per cylinder of the current 200 rev test" UWORD MC_V_MIS200_ 0 0 0 65535 ECU_ADDRESS 0x3FC030 /end MEASUREMENT
/begin MEASUREMENT V_MIS200_[5] "Running counts of misfires accumulated per cylinder of the current 200 rev test" UWORD MC_V_MIS200_ 0 0 0 65535 ECU_ADDRESS 0x3FC032 /end MEASUREMENT
/begin MEASUREMENT V_MIS200_[6] "Running counts of misfires accumulated per cylinder of the current 200 rev test" UWORD MC_V_MIS200_ 0 0 0 65535 ECU_ADDRESS 0x3FC034 /end MEASUREMENT
/begin MEASUREMENT V_MIS200_[7] "Running counts of misfires accumulated per cylinder of the current 200 rev test" UWORD MC_V_MIS200_ 0 0 0 65535 ECU_ADDRESS 0x3FC036 /end MEASUREMENT
/begin MEASUREMENT V_MIS200_[8] "Running counts of misfires accumulated per cylinder of the current 200 rev test" UWORD MC_V_MIS200_ 0 0 0 65535 ECU_ADDRESS 0x3FC038 /end MEASUREMENT
/begin MEASUREMENT V_MIS200_[9] "Running counts of misfires accumulated per cylinder of the current 200 rev test" UWORD MC_V_MIS200_ 0 0 0 65535 ECU_ADDRESS 0x3FC03A /end MEASUREMENT
/begin MEASUREMENT V_MIS_LOOPS "number of misfire test foreground events to assure a complete set of data" UBYTE MC_V_MIS_LOOPS 0 0 0 0 ECU_ADDRESS 0x3FB358 /end MEASUREMENT
/begin COMPU_METHOD MC_V_MIS_LOOPS "V_MIS_LOOPS conversion" RAT_FUNC "%3.0" "Unitless" COEFFS 0 1 0 0 0 1 /end COMPU_METHOD
/begin CHARACTERISTIC V_MIS_MONCNT "number of firing events consecutively tested to qualify as a monitoring of misfire" VALUE 0x5EED4 SD_UWORD 0 SC_V_MIS_MONCNT 0 65535 /end CHARACTERISTIC
/begin COMPU_METHOD SC_V_MIS_MONCNT "V_MIS_MONCNT conversion" RAT_FUNC "%5.0" "EVENTS" COEFFS 0 1 0 0 0 1 /end COMPU_METHOD
/begin CHARACTERISTIC V_MIS_NHYS "Hysterisis value for misfire hi-rpm disablement, to prevent excessive jumping of bg loop times." VALUE 0x5EE6C SD_FLOAT32_IEEE 0 SC_V_MIS_NHYS 0 16383.8 /end CHARACTERISTIC
/begin COMPU_METHOD SC_V_MIS_NHYS "V_MIS_NHYS conversion" RAT_FUNC "%10.5" "RPM" COEFFS 0 1 0 0 0 1 /end COMPU_METHOD
/begin CHARACTERISTIC V_MIS_NMAX "maximum rpm to do misfire background" VALUE 0x5EE74 SD_FLOAT32_IEEE 0 SC_V_MIS_NMAX 0 16383.8 /end CHARACTERISTIC
/begin COMPU_METHOD SC_V_MIS_NMAX "V_MIS_NMAX conversion" RAT_FUNC "%10.5" "RPM" COEFFS 0 1 0 0 0 1 /end COMPU_METHOD
/begin CHARACTERISTIC V_MIS_NMIN "minimum rpm to do misfire background" VALUE 0x5EE70 SD_FLOAT32_IEEE 0 SC_V_MIS_NMIN 0 16383.8 /end CHARACTERISTIC
/begin COMPU_METHOD SC_V_MIS_NMIN "V_MIS_NMIN conversion" RAT_FUNC "%10.5" "RPM" COEFFS 0 1 0 0 0 1 /end COMPU_METHOD
/begin MEASUREMENT V_MIS_THR1 "calculated threshold for misfire test above which V_DELT_ACCEL is considered a misfire" FLOAT32_IEEE MC_V_MIS_THR1 0 0 0 0 ECU_ADDRESS 0x3FB328 /end MEASUREMENT
/begin COMPU_METHOD MC_V_MIS_THR1 "V_MIS_THR1 conversion" RAT_FUNC "%10.5" "Unitless" COEFFS 0 1 0 0 0 1 /end COMPU_METHOD
/begin MEASUREMENT V_MIS_THR2 "calculated threshold for misifre test below which V_DELT_ACCEL is considered noise" FLOAT32_IEEE MC_V_MIS_THR2 0 0 0 0 ECU_ADDRESS 0x3FB324 /end MEASUREMENT
/begin COMPU_METHOD MC_V_MIS_THR2 "V_MIS_THR2 conversion" RAT_FUNC "%10.5" "Unitless" COEFFS 0 1 0 0 0 1 /end COMPU_METHOD
/begin MEASUREMENT V_MIS_TSTCNT "register containing number of misfire test testable events" UWORD MC_V_MIS_TSTCNT 0 0 0 0 ECU_ADDRESS 0x3FB3A6 /end MEASUREMENT
/begin COMPU_METHOD MC_V_MIS_TSTCNT "V_MIS_TSTCNT conversion" RAT_FUNC "%5.0" "Unitless" COEFFS 0 1 0 0 0 1 /end COMPU_METHOD
/begin CHARACTERISTIC V_PIPN_MAX "Upper rpm limit for running the PIP test." VALUE 0x5ECE4 SD_FLOAT32_IEEE 0 SC_V_PIPN_MAX 0 16383.8 /end CHARACTERISTIC
/begin COMPU_METHOD SC_V_PIPN_MAX "V_PIPN_MAX conversion" RAT_FUNC "%10.5" "RPM" COEFFS 0 1 0 0 0 1 /end COMPU_METHOD
/begin CHARACTERISTIC V_PIPN_MIN "Lower rpm limit for running the PIP test." VALUE 0x5ECE8 SD_FLOAT32_IEEE 0 SC_V_PIPN_MIN 0 16383.8 /end CHARACTERISTIC
/begin COMPU_METHOD SC_V_PIPN_MIN "V_PIPN_MIN conversion" RAT_FUNC "%10.5" "RPM" COEFFS 0 1 0 0 0 1 /end COMPU_METHOD
/begin CHARACTERISTIC V_VSS_MULT "Multiplier for FN689V when in 4x4 mode" VALUE 0x5D8F0 SD_UBYTE 0 SC_V_VSS_MULT 0 3 /end CHARACTERISTIC
/begin COMPU_METHOD SC_V_VSS_MULT "V_VSS_MULT conversion" RAT_FUNC "%3.0" "unitless" COEFFS 0 1 0 0 0 1 /end COMPU_METHOD
/begin CHARACTERISTIC V_VSS_NRHI "High eng. speed for load range to infer vehicle movement" VALUE 0x5D904 SD_FLOAT32_IEEE 0 SC_V_VSS_NRHI 0 6000 /end CHARACTERISTIC
/begin COMPU_METHOD SC_V_VSS_NRHI "V_VSS_NRHI conversion" RAT_FUNC "%10.5" "RPM" COEFFS 0 1 0 0 0 1 /end COMPU_METHOD
/begin CHARACTERISTIC V_VSS_NRLO "Low eng. sped for load range to infer vehicle movement" VALUE 0x5D900 SD_FLOAT32_IEEE 0 SC_V_VSS_NRLO 0 6000 /end CHARACTERISTIC
/begin COMPU_METHOD SC_V_VSS_NRLO "V_VSS_NRLO conversion" RAT_FUNC "%10.5" "RPM" COEFFS 0 1 0 0 0 1 /end COMPU_METHOD
/begin MEASUREMENT WDOG_RESET "Flag indicating last reset was a watchdog timeout. (Is a copy of 'HSO Used Slot Reg.', b6 taken immediately on power-up)." UBYTE MC_WDOG_RESET 0 0 0 0 ECU_ADDRESS 0x3F9D99 /end MEASUREMENT
/begin COMPU_METHOD MC_WDOG_RESET "WDOG_RESET conversion" RAT_FUNC "%3.0" "Unitless" COEFFS 0 1 0 0 0 1 /end COMPU_METHOD
/begin CHARACTERISTIC WIFEN_FLG "Water in fuel processing enabled flag" VALUE 0x5D45C SD_UBYTE 0 SC_WIFEN_FLG 0 1 /end CHARACTERISTIC
/begin COMPU_METHOD SC_WIFEN_FLG "WIFEN_FLG conversion" RAT_FUNC "%3.0" "unitless" COEFFS 0 1 0 0 0 1 /end COMPU_METHOD
/begin MEASUREMENT WIF_F "Water In Fuel failure flag" UBYTE MC_WIF_F 0 0 0 0 ECU_ADDRESS 0x3FA2D0 /end MEASUREMENT
/begin COMPU_METHOD MC_WIF_F "WIF_F conversion" RAT_FUNC "%3.0" "Unitless" COEFFS 0 1 0 0 0 1 /end COMPU_METHOD
/begin CHARACTERISTIC WIF_F_INC "WIF failure counter increment value" VALUE 0x5D454 SD_SLONG 0 SC_WIF_F_INC 0 32767 /end CHARACTERISTIC
/begin COMPU_METHOD SC_WIF_F_INC "WIF_F_INC conversion" RAT_FUNC "%10.0" "unitless" COEFFS 0 1 0 0 0 1 /end COMPU_METHOD
/begin MEASUREMENT WIF_ORH_CNTR "Water in Fuel out of range high counter" SLONG MC_WIF_ORH_CNTR 0 0 0 0 ECU_ADDRESS 0x3FA2CC /end MEASUREMENT
/begin COMPU_METHOD MC_WIF_ORH_CNTR "WIF_ORH_CNTR conversion" RAT_FUNC "%10.0" "Unitless" COEFFS 0 1 0 0 0 1 /end COMPU_METHOD
/begin CHARACTERISTIC WIF_R_DEC "WIF failure counter decrement value" VALUE 0x5D450 SD_SLONG 0 SC_WIF_R_DEC 0 65535 /end CHARACTERISTIC
/begin COMPU_METHOD SC_WIF_R_DEC "WIF_R_DEC conversion" RAT_FUNC "%10.0" "unitless" COEFFS 0 1 0 0 0 1 /end COMPU_METHOD
/begin CHARACTERISTIC WIF_THRESH "Water in fuel voltage threshold (0-5V) , below which water is detected" VALUE 0x5D458 SD_FLOAT32_IEEE 0 SC_WIF_THRESH 0 5 /end CHARACTERISTIC
/begin COMPU_METHOD SC_WIF_THRESH "WIF_THRESH conversion" RAT_FUNC "%10.5" "V" COEFFS 0 1 0 0 0 1 /end COMPU_METHOD
/begin MEASUREMENT WIF_VOLTS "If wif_volts is more than 4.46V, pure desel is in fuel bowel. If wif_volts is less than 3.36V, pure water is in fuel bowel" FLOAT32_IEEE MC_WIF_VOLTS 0 0 0 0 ECU_ADDRESS 0x3F9898 /end MEASUREMENT
/begin COMPU_METHOD MC_WIF_VOLTS "WIF_VOLTS conversion" RAT_FUNC "%10.5" "Unitless" COEFFS 0 1 0 0 0 1 /end COMPU_METHOD
/begin MEASUREMENT XCPTN_CNT "Copy of exception counter from RTOS Exception logs" ULONG MC_XCPTN_CNT 0 0 0 0 ECU_ADDRESS 0x3FB790 /end MEASUREMENT
/begin COMPU_METHOD MC_XCPTN_CNT "XCPTN_CNT conversion" RAT_FUNC "%10.0" "Unitless" COEFFS 0 1 0 0 0 1 /end COMPU_METHOD
/begin MEASUREMENT XCPTN_TYPE "Copy of excetpion types from RTOS exception log" ULONG MC_XCPTN_TYPE 0 0 0 0 ECU_ADDRESS 0x3FB794 /end MEASUREMENT
/begin COMPU_METHOD MC_XCPTN_TYPE "XCPTN_TYPE conversion" RAT_FUNC "%10.0" "Unitless" COEFFS 0 1 0 0 0 1 /end COMPU_METHOD
/begin CHARACTERISTIC YDIT "Use Calibratable Direct Injection Desired value (DITOFST)" VALUE 0x5DE18 SD_FLOAT32_IEEE 0 SC_YDIT 0 255 /end CHARACTERISTIC
/begin COMPU_METHOD SC_YDIT "YDIT conversion" RAT_FUNC "%10.5" "unitless" COEFFS 0 1 0 0 0 1 /end COMPU_METHOD
/begin MEASUREMENT ZERO_FLT "Floating point value of zero to be used as a constant." FLOAT32_IEEE MC_ZERO_FLT 0 0 0 0 ECU_ADDRESS 0x3F9C88 /end MEASUREMENT
/begin COMPU_METHOD MC_ZERO_FLT "ZERO_FLT conversion" RAT_FUNC "%10.5" "Unitless" COEFFS 0 1 0 0 0 1 /end COMPU_METHOD
/begin RECORD_LAYOUT SD_UBYTE FNC_VALUES 1 UBYTE ROW_DIR DIRECT /end RECORD_LAYOUT
/begin RECORD_LAYOUT SD_UWORD FNC_VALUES 1 UWORD ROW_DIR DIRECT /end RECORD_LAYOUT
/begin RECORD_LAYOUT SD_ULONG FNC_VALUES 1 ULONG ROW_DIR DIRECT /end RECORD_LAYOUT
/begin RECORD_LAYOUT SD_SLONG FNC_VALUES 1 SLONG ROW_DIR DIRECT /end RECORD_LAYOUT
/begin RECORD_LAYOUT SD_FLOAT32_IEEE FNC_VALUES 1 FLOAT32_IEEE ROW_DIR DIRECT /end RECORD_LAYOUT
/end MODULE
/end PROJECT
