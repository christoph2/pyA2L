/begin PROJECT DPU-2XX "Visteon Diesel"
/begin HEADER " " VERSION "1" PROJECT_NO Global /end HEADER
/begin MODULE ENGINE "International Engine Controller"
/begin MOD_COMMON " " BYTE_ORDER MSB_FIRST /end MOD_COMMON
/begin MEASUREMENT ITHP_OPN_TOTAL "" FLOAT32_IEEE MC_ITHP_OPN_TOTAL 0 0 0 0 ECU_ADDRESS 0x3F9A20 /end MEASUREMENT
/begin COMPU_METHOD MC_ITHP_OPN_TOTAL "ITHP_OPN_TOTAL conversion" RAT_FUNC "%10.5" "Unitless" COEFFS 0 1 0 0 0 1 /end COMPU_METHOD
/begin MEASUREMENT ITHP_ORH_CNTR "Intake Throttle Position out of range high counter" SLONG MC_ITHP_ORH_CNTR 0 0 0 0 ECU_ADDRESS 0x3FA3D8 /end MEASUREMENT
/begin COMPU_METHOD MC_ITHP_ORH_CNTR "ITHP_ORH_CNTR conversion" RAT_FUNC "%10.0" "Unitless" COEFFS 0 1 0 0 0 1 /end COMPU_METHOD
/begin MEASUREMENT ITHP_ORL_CNTR "Intake Throttle Position out of range low counter" SLONG MC_ITHP_ORL_CNTR 0 0 0 0 ECU_ADDRESS 0x3FA3D4 /end MEASUREMENT
/begin COMPU_METHOD MC_ITHP_ORL_CNTR "ITHP_ORL_CNTR conversion" RAT_FUNC "%10.0" "Unitless" COEFFS 0 1 0 0 0 1 /end COMPU_METHOD
/begin CHARACTERISTIC ITHP_REC_INC "ITHP fault recovery counter increment value" VALUE 0x5D5E8 SD_SLONG 0 SC_ITHP_REC_INC 0 65535 /end CHARACTERISTIC
/begin COMPU_METHOD SC_ITHP_REC_INC "ITHP_REC_INC conversion" RAT_FUNC "%10.0" "unitless" COEFFS 0 1 0 0 0 1 /end COMPU_METHOD
/begin CHARACTERISTIC ITHP_ROC_MX "" VALUE 0x5C7E0 SD_FLOAT32_IEEE 0 SC_ITHP_ROC_MX -1024 1024 /end CHARACTERISTIC
/begin COMPU_METHOD SC_ITHP_ROC_MX "ITHP_ROC_MX conversion" RAT_FUNC "%10.5" "unitless" COEFFS 0 1 0 0 0 1 /end COMPU_METHOD
/begin CHARACTERISTIC ITHP_TCREC_SEL "Switch to select ITHP filter time constant during fault recovery and during fault occurance before malf is set" VALUE 0x5D5F0 SD_UBYTE 0 SC_ITHP_TCREC_SEL 0 1 /end CHARACTERISTIC
/begin COMPU_METHOD SC_ITHP_TCREC_SEL "ITHP_TCREC_SEL conversion" RAT_FUNC "%3.0" "unitless" COEFFS 0 1 0 0 0 1 /end COMPU_METHOD
/begin MEASUREMENT ITH_ANTI_FOUL_MULT "" FLOAT32_IEEE MC_ITH_ANTI_FOUL_MULT 0 0 0 0 ECU_ADDRESS 0x3FACD8 /end MEASUREMENT
/begin COMPU_METHOD MC_ITH_ANTI_FOUL_MULT "ITH_ANTI_FOUL_MULT conversion" RAT_FUNC "%10.5" "Unitless" COEFFS 0 1 0 0 0 1 /end COMPU_METHOD
/begin MEASUREMENT ITH_CMD "ITH Position PID & Feed Forward output value" FLOAT32_IEEE MC_ITH_CMD 0 0 0 0 ECU_ADDRESS 0x3FACD4 /end MEASUREMENT
/begin COMPU_METHOD MC_ITH_CMD "ITH_CMD conversion" RAT_FUNC "%10.5" "Unitless" COEFFS 0 1 0 0 0 1 /end COMPU_METHOD
/begin MEASUREMENT ITH_COLD_MULT "" FLOAT32_IEEE MC_ITH_COLD_MULT 0 0 0 0 ECU_ADDRESS 0x3FACD0 /end MEASUREMENT
/begin COMPU_METHOD MC_ITH_COLD_MULT "ITH_COLD_MULT conversion" RAT_FUNC "%10.5" "Unitless" COEFFS 0 1 0 0 0 1 /end COMPU_METHOD
/begin CHARACTERISTIC ITH_COND_CAL "" VALUE 0x5E490 SD_FLOAT32_IEEE 0 SC_ITH_COND_CAL 0 1 /end CHARACTERISTIC
/begin COMPU_METHOD SC_ITH_COND_CAL "ITH_COND_CAL conversion" RAT_FUNC "%10.5" "unitless" COEFFS 0 1 0 0 0 1 /end COMPU_METHOD
/begin MEASUREMENT ITH_COND_MULT "" FLOAT32_IEEE MC_ITH_COND_MULT 0 0 0 0 ECU_ADDRESS 0x3FACCC /end MEASUREMENT
/begin COMPU_METHOD MC_ITH_COND_MULT "ITH_COND_MULT conversion" RAT_FUNC "%10.5" "Unitless" COEFFS 0 1 0 0 0 1 /end COMPU_METHOD
/begin MEASUREMENT ITH_D "" FLOAT32_IEEE MC_ITH_D 0 0 0 0 ECU_ADDRESS 0x3FACC4 /end MEASUREMENT
/begin COMPU_METHOD MC_ITH_D "ITH_D conversion" RAT_FUNC "%10.5" "Unitless" COEFFS 0 1 0 0 0 1 /end COMPU_METHOD
/begin MEASUREMENT ITH_DD "" FLOAT32_IEEE MC_ITH_DD 0 0 0 0 ECU_ADDRESS 0x3FACC0 /end MEASUREMENT
/begin COMPU_METHOD MC_ITH_DD "ITH_DD conversion" RAT_FUNC "%10.5" "Unitless" COEFFS 0 1 0 0 0 1 /end COMPU_METHOD
/begin MEASUREMENT ITH_DES "ITH Position Desired" FLOAT32_IEEE MC_ITH_DES 0 0 0 0 ECU_ADDRESS 0x3FACBC /end MEASUREMENT
/begin COMPU_METHOD MC_ITH_DES "ITH_DES conversion" RAT_FUNC "%10.5" "Unitless" COEFFS 0 1 0 0 0 1 /end COMPU_METHOD
/begin CHARACTERISTIC ITH_DES_DEF "ITH Desired Default Position" VALUE 0x5E484 SD_FLOAT32_IEEE 0 SC_ITH_DES_DEF 0 1 /end CHARACTERISTIC
/begin COMPU_METHOD SC_ITH_DES_DEF "ITH_DES_DEF conversion" RAT_FUNC "%10.5" "unitless" COEFFS 0 1 0 0 0 1 /end COMPU_METHOD
/begin CHARACTERISTIC ITH_DES_LMN "Minimum position for Position Desired" VALUE 0x5E480 SD_FLOAT32_IEEE 0 SC_ITH_DES_LMN 0 1 /end CHARACTERISTIC
/begin COMPU_METHOD SC_ITH_DES_LMN "ITH_DES_LMN conversion" RAT_FUNC "%10.5" "unitless" COEFFS 0 1 0 0 0 1 /end COMPU_METHOD
/begin CHARACTERISTIC ITH_DES_LMX "Maximum Limit for Position Desired" VALUE 0x5E47C SD_FLOAT32_IEEE 0 SC_ITH_DES_LMX 0 1 /end CHARACTERISTIC
/begin COMPU_METHOD SC_ITH_DES_LMX "ITH_DES_LMX conversion" RAT_FUNC "%10.5" "unitless" COEFFS 0 1 0 0 0 1 /end COMPU_METHOD
/begin MEASUREMENT ITH_DI "" FLOAT32_IEEE MC_ITH_DI 0 0 0 0 ECU_ADDRESS 0x3FACB8 /end MEASUREMENT
/begin COMPU_METHOD MC_ITH_DI "ITH_DI conversion" RAT_FUNC "%10.5" "Unitless" COEFFS 0 1 0 0 0 1 /end COMPU_METHOD
/begin MEASUREMENT ITH_DISABLE "H-bridge disable flag: 1= H-bridge enabled (V8 AP3.2+)" UBYTE MC_ITH_DISABLE 0 0 0 0 ECU_ADDRESS 0x3F9D07 /end MEASUREMENT
/begin COMPU_METHOD MC_ITH_DISABLE "ITH_DISABLE conversion" RAT_FUNC "%3.0" "Unitless" COEFFS 0 1 0 0 0 1 /end COMPU_METHOD
/begin CHARACTERISTIC ITH_DTC "" VALUE 0x5E478 SD_FLOAT32_IEEE 0 SC_ITH_DTC 0 1000 /end CHARACTERISTIC
/begin COMPU_METHOD SC_ITH_DTC "ITH_DTC conversion" RAT_FUNC "%10.5" "unitless" COEFFS 0 1 0 0 0 1 /end COMPU_METHOD
/begin CHARACTERISTIC ITH_DTS "ITH Position PID Loop Derivative term Time Step" VALUE 0x5E474 SD_FLOAT32_IEEE 0 SC_ITH_DTS 0 1 /end CHARACTERISTIC
/begin COMPU_METHOD SC_ITH_DTS "ITH_DTS conversion" RAT_FUNC "%10.5" "s" COEFFS 0 1 0 0 0 1 /end COMPU_METHOD
/begin MEASUREMENT ITH_DTY "" FLOAT32_IEEE MC_ITH_DTY 0 0 0 0 ECU_ADDRESS 0x3FACB4 /end MEASUREMENT
/begin COMPU_METHOD MC_ITH_DTY "ITH_DTY conversion" RAT_FUNC "%10.5" "Unitless" COEFFS 0 1 0 0 0 1 /end COMPU_METHOD
/begin CHARACTERISTIC ITH_DTY_CAL "Calibration Mode ITH Duty Commanded" VALUE 0x5E470 SD_FLOAT32_IEEE 0 SC_ITH_DTY_CAL -1 1 /end CHARACTERISTIC
/begin COMPU_METHOD SC_ITH_DTY_CAL "ITH_DTY_CAL conversion" RAT_FUNC "%10.5" "unitless" COEFFS 0 1 0 0 0 1 /end COMPU_METHOD
/begin MEASUREMENT ITH_DTY_DIR "ITH Direction Duty Value" FLOAT32_IEEE MC_ITH_DTY_DIR 0 0 0 0 ECU_ADDRESS 0x3FACB0 /end MEASUREMENT
/begin COMPU_METHOD MC_ITH_DTY_DIR "ITH_DTY_DIR conversion" RAT_FUNC "%10.5" "Unitless" COEFFS 0 1 0 0 0 1 /end COMPU_METHOD
/begin CHARACTERISTIC ITH_DTY_DIR1 "ITH Direction Desired for Opening" VALUE 0x5E464 SD_FLOAT32_IEEE 0 SC_ITH_DTY_DIR1 0 1 /end CHARACTERISTIC
/begin COMPU_METHOD SC_ITH_DTY_DIR1 "ITH_DTY_DIR1 conversion" RAT_FUNC "%10.5" "unitless" COEFFS 0 1 0 0 0 1 /end COMPU_METHOD
/begin CHARACTERISTIC ITH_DTY_DIR2 "ITH Direction desired for closing" VALUE 0x5E460 SD_FLOAT32_IEEE 0 SC_ITH_DTY_DIR2 0 1 /end CHARACTERISTIC
/begin COMPU_METHOD SC_ITH_DTY_DIR2 "ITH_DTY_DIR2 conversion" RAT_FUNC "%10.5" "unitless" COEFFS 0 1 0 0 0 1 /end COMPU_METHOD
/begin CHARACTERISTIC ITH_DTY_LMN "ITH Actuator Torque / Duty Minimum Limit" VALUE 0x5E46C SD_FLOAT32_IEEE 0 SC_ITH_DTY_LMN -1 1 /end CHARACTERISTIC
/begin COMPU_METHOD SC_ITH_DTY_LMN "ITH_DTY_LMN conversion" RAT_FUNC "%10.5" "unitless" COEFFS 0 1 0 0 0 1 /end COMPU_METHOD
/begin CHARACTERISTIC ITH_DTY_LMX "ITH Actuator Torque / Duty Maximum Limit" VALUE 0x5E468 SD_FLOAT32_IEEE 0 SC_ITH_DTY_LMX -1 1 /end CHARACTERISTIC
/begin COMPU_METHOD SC_ITH_DTY_LMX "ITH_DTY_LMX conversion" RAT_FUNC "%10.5" "unitless" COEFFS 0 1 0 0 0 1 /end COMPU_METHOD
/begin MEASUREMENT ITH_DTY_MAG "ITH magnitude Duty Value" FLOAT32_IEEE MC_ITH_DTY_MAG 0 0 0 0 ECU_ADDRESS 0x3FACAC /end MEASUREMENT
/begin COMPU_METHOD MC_ITH_DTY_MAG "ITH_DTY_MAG conversion" RAT_FUNC "%10.5" "Unitless" COEFFS 0 1 0 0 0 1 /end COMPU_METHOD
/begin CHARACTERISTIC ITH_D_LMN "" VALUE 0x5E48C SD_FLOAT32_IEEE 0 SC_ITH_D_LMN -100 100 /end CHARACTERISTIC
/begin COMPU_METHOD SC_ITH_D_LMN "ITH_D_LMN conversion" RAT_FUNC "%10.5" "unitless" COEFFS 0 1 0 0 0 1 /end COMPU_METHOD
/begin CHARACTERISTIC ITH_D_LMX "" VALUE 0x5E488 SD_FLOAT32_IEEE 0 SC_ITH_D_LMX -100 100 /end CHARACTERISTIC
/begin COMPU_METHOD SC_ITH_D_LMX "ITH_D_LMX conversion" RAT_FUNC "%10.5" "unitless" COEFFS 0 1 0 0 0 1 /end COMPU_METHOD
/begin MEASUREMENT ITH_ERR "ITH Position Desired - Actual Error" FLOAT32_IEEE MC_ITH_ERR 0 0 0 0 ECU_ADDRESS 0x3FACA8 /end MEASUREMENT
/begin COMPU_METHOD MC_ITH_ERR "ITH_ERR conversion" RAT_FUNC "%10.5" "Unitless" COEFFS 0 1 0 0 0 1 /end COMPU_METHOD
/begin CHARACTERISTIC ITH_ERR_SS "" VALUE 0x5D614 SD_FLOAT32_IEEE 0 SC_ITH_ERR_SS 0 10000 /end CHARACTERISTIC
/begin COMPU_METHOD SC_ITH_ERR_SS "ITH_ERR_SS conversion" RAT_FUNC "%10.5" "unitless" COEFFS 0 1 0 0 0 1 /end COMPU_METHOD
/begin MEASUREMENT ITH_FF "ITH Position Feed Forward Contribution" FLOAT32_IEEE MC_ITH_FF 0 0 0 0 ECU_ADDRESS 0x3FACA4 /end MEASUREMENT
/begin COMPU_METHOD MC_ITH_FF "ITH_FF conversion" RAT_FUNC "%10.5" "Unitless" COEFFS 0 1 0 0 0 1 /end COMPU_METHOD
/begin MEASUREMENT ITH_F_SS "ITH Position steady state Fault Flag" UBYTE MC_ITH_F_SS 0 0 0 0 ECU_ADDRESS 0x3FA408 /end MEASUREMENT
/begin COMPU_METHOD MC_ITH_F_SS "ITH_F_SS conversion" RAT_FUNC "%3.0" "Unitless" COEFFS 0 1 0 0 0 1 /end COMPU_METHOD
/begin MEASUREMENT ITH_HIALT_SP "" FLOAT32_IEEE MC_ITH_HIALT_SP 0 0 0 0 ECU_ADDRESS 0x3FACA0 /end MEASUREMENT
/begin COMPU_METHOD MC_ITH_HIALT_SP "ITH_HIALT_SP conversion" RAT_FUNC "%10.5" "Unitless" COEFFS 0 1 0 0 0 1 /end COMPU_METHOD
/begin MEASUREMENT ITH_I "" FLOAT32_IEEE MC_ITH_I 0 0 0 0 ECU_ADDRESS 0x3FAC9C /end MEASUREMENT
/begin COMPU_METHOD MC_ITH_I "ITH_I conversion" RAT_FUNC "%10.5" "Unitless" COEFFS 0 1 0 0 0 1 /end COMPU_METHOD
/begin MEASUREMENT ITH_IVP_MLT "ITH Ignition Voltage multiplier" FLOAT32_IEEE MC_ITH_IVP_MLT 0 0 0 0 ECU_ADDRESS 0x3FAC98 /end MEASUREMENT
/begin COMPU_METHOD MC_ITH_IVP_MLT "ITH_IVP_MLT conversion" RAT_FUNC "%10.5" "Unitless" COEFFS 0 1 0 0 0 1 /end COMPU_METHOD
/begin CHARACTERISTIC ITH_I_LMN "ITH Control Minimum Limit for Integral Term" VALUE 0x5E45C SD_FLOAT32_IEEE 0 SC_ITH_I_LMN -1 1 /end CHARACTERISTIC
/begin COMPU_METHOD SC_ITH_I_LMN "ITH_I_LMN conversion" RAT_FUNC "%10.5" "unitless" COEFFS 0 1 0 0 0 1 /end COMPU_METHOD
/begin CHARACTERISTIC ITH_I_LMX "ITH Conrtol Maximum Limit for Integral term" VALUE 0x5E458 SD_FLOAT32_IEEE 0 SC_ITH_I_LMX -1 1 /end CHARACTERISTIC
/begin COMPU_METHOD SC_ITH_I_LMX "ITH_I_LMX conversion" RAT_FUNC "%10.5" "unitless" COEFFS 0 1 0 0 0 1 /end COMPU_METHOD
/begin CHARACTERISTIC ITH_KD "" VALUE 0x5E454 SD_FLOAT32_IEEE 0 SC_ITH_KD -2048 2048 /end CHARACTERISTIC
/begin COMPU_METHOD SC_ITH_KD "ITH_KD conversion" RAT_FUNC "%10.5" "unitless" COEFFS 0 1 0 0 0 1 /end COMPU_METHOD
/begin CHARACTERISTIC ITH_KI "ITH Position PID Loop Integral Gain" VALUE 0x5E450 SD_FLOAT32_IEEE 0 SC_ITH_KI 0 1 /end CHARACTERISTIC
/begin COMPU_METHOD SC_ITH_KI "ITH_KI conversion" RAT_FUNC "%10.5" "unitless" COEFFS 0 1 0 0 0 1 /end COMPU_METHOD
/begin CHARACTERISTIC ITH_KOER_HI "" VALUE 0x5E44C SD_FLOAT32_IEEE 0 SC_ITH_KOER_HI -1000 1000 /end CHARACTERISTIC
/begin COMPU_METHOD SC_ITH_KOER_HI "ITH_KOER_HI conversion" RAT_FUNC "%10.5" "unitless" COEFFS 0 1 0 0 0 1 /end COMPU_METHOD
/begin CHARACTERISTIC ITH_KOER_LO "" VALUE 0x5E448 SD_FLOAT32_IEEE 0 SC_ITH_KOER_LO -1000 1000 /end CHARACTERISTIC
/begin COMPU_METHOD SC_ITH_KOER_LO "ITH_KOER_LO conversion" RAT_FUNC "%10.5" "unitless" COEFFS 0 1 0 0 0 1 /end COMPU_METHOD
/begin CHARACTERISTIC ITH_KOER_OFF "" VALUE 0x5E444 SD_FLOAT32_IEEE 0 SC_ITH_KOER_OFF -1000 1000 /end CHARACTERISTIC
/begin COMPU_METHOD SC_ITH_KOER_OFF "ITH_KOER_OFF conversion" RAT_FUNC "%10.5" "unitless" COEFFS 0 1 0 0 0 1 /end COMPU_METHOD
/begin CHARACTERISTIC ITH_KP "" VALUE 0x5E440 SD_FLOAT32_IEEE 0 SC_ITH_KP -1000 1000 /end CHARACTERISTIC
/begin COMPU_METHOD SC_ITH_KP "ITH_KP conversion" RAT_FUNC "%10.5" "unitless" COEFFS 0 1 0 0 0 1 /end COMPU_METHOD
/begin MEASUREMENT ITH_LOALT_SP "" FLOAT32_IEEE MC_ITH_LOALT_SP 0 0 0 0 ECU_ADDRESS 0x3FAC94 /end MEASUREMENT
/begin COMPU_METHOD MC_ITH_LOALT_SP "ITH_LOALT_SP conversion" RAT_FUNC "%10.5" "Unitless" COEFFS 0 1 0 0 0 1 /end COMPU_METHOD
/begin MEASUREMENT ITH_MAT_MULT "" FLOAT32_IEEE MC_ITH_MAT_MULT 0 0 0 0 ECU_ADDRESS 0x3FAC8C /end MEASUREMENT
/begin COMPU_METHOD MC_ITH_MAT_MULT "ITH_MAT_MULT conversion" RAT_FUNC "%10.5" "Unitless" COEFFS 0 1 0 0 0 1 /end COMPU_METHOD
/begin CHARACTERISTIC ITH_MAX_MF_INC "" VALUE 0x5E43C SD_FLOAT32_IEEE 0 SC_ITH_MAX_MF_INC 0 2000 /end CHARACTERISTIC
/begin COMPU_METHOD SC_ITH_MAX_MF_INC "ITH_MAX_MF_INC conversion" RAT_FUNC "%10.5" "unitless" COEFFS 0 1 0 0 0 1 /end COMPU_METHOD
/begin CHARACTERISTIC ITH_MAX_MF_TM "" VALUE 0x5E434 SD_FLOAT32_IEEE 0 SC_ITH_MAX_MF_TM 0 3000 /end CHARACTERISTIC
/begin COMPU_METHOD SC_ITH_MAX_MF_TM "ITH_MAX_MF_TM conversion" RAT_FUNC "%10.5" "unitless" COEFFS 0 1 0 0 0 1 /end COMPU_METHOD
/begin MEASUREMENT ITH_MAX_MF_TMR "" FLOAT32_IEEE MC_ITH_MAX_MF_TMR 0 0 0 0 ECU_ADDRESS 0x3FAC90 /end MEASUREMENT
/begin COMPU_METHOD MC_ITH_MAX_MF_TMR "ITH_MAX_MF_TMR conversion" RAT_FUNC "%10.5" "Unitless" COEFFS 0 1 0 0 0 1 /end COMPU_METHOD
/begin CHARACTERISTIC ITH_MAX_MN_INC "" VALUE 0x5E438 SD_FLOAT32_IEEE 0 SC_ITH_MAX_MN_INC -350 350 /end CHARACTERISTIC
/begin COMPU_METHOD SC_ITH_MAX_MN_INC "ITH_MAX_MN_INC conversion" RAT_FUNC "%10.5" "g" COEFFS 0 1 0 0 0 1 /end COMPU_METHOD
/begin MEASUREMENT ITH_MFDES_DIFF "" FLOAT32_IEEE MC_ITH_MFDES_DIFF 0 0 0 0 ECU_ADDRESS 0x3FAC80 /end MEASUREMENT
/begin COMPU_METHOD MC_ITH_MFDES_DIFF "ITH_MFDES_DIFF conversion" RAT_FUNC "%10.5" "Unitless" COEFFS 0 1 0 0 0 1 /end COMPU_METHOD
/begin MEASUREMENT ITH_MFDES_FILT "" FLOAT32_IEEE MC_ITH_MFDES_FILT 0 0 0 0 ECU_ADDRESS 0x3FAC7C /end MEASUREMENT
/begin COMPU_METHOD MC_ITH_MFDES_FILT "ITH_MFDES_FILT conversion" RAT_FUNC "%10.5" "Unitless" COEFFS 0 1 0 0 0 1 /end COMPU_METHOD
/begin CHARACTERISTIC ITH_MFDES_TRNS_KF "Mass Fuel Desired Transient filter constant" VALUE 0x5E430 SD_FLOAT32_IEEE 0 SC_ITH_MFDES_TRNS_KF 0 1 /end CHARACTERISTIC
/begin COMPU_METHOD SC_ITH_MFDES_TRNS_KF "ITH_MFDES_TRNS_KF conversion" RAT_FUNC "%10.5" "unitless" COEFFS 0 1 0 0 0 1 /end COMPU_METHOD
/begin MEASUREMENT ITH_MF_TRNS_FILT "" FLOAT32_IEEE MC_ITH_MF_TRNS_FILT 0 0 0 0 ECU_ADDRESS 0x3FAC88 /end MEASUREMENT
/begin COMPU_METHOD MC_ITH_MF_TRNS_FILT "ITH_MF_TRNS_FILT conversion" RAT_FUNC "%10.5" "Unitless" COEFFS 0 1 0 0 0 1 /end COMPU_METHOD
/begin MEASUREMENT ITH_MF_TRNS_MULT "" FLOAT32_IEEE MC_ITH_MF_TRNS_MULT 0 0 0 0 ECU_ADDRESS 0x3FAC84 /end MEASUREMENT
/begin COMPU_METHOD MC_ITH_MF_TRNS_MULT "ITH_MF_TRNS_MULT conversion" RAT_FUNC "%10.5" "Unitless" COEFFS 0 1 0 0 0 1 /end COMPU_METHOD
/begin MEASUREMENT ITH_P "" FLOAT32_IEEE MC_ITH_P 0 0 0 0 ECU_ADDRESS 0x3FAC78 /end MEASUREMENT
/begin COMPU_METHOD MC_ITH_P "ITH_P conversion" RAT_FUNC "%10.5" "Unitless" COEFFS 0 1 0 0 0 1 /end COMPU_METHOD
/begin CHARACTERISTIC ITH_P_CAL "Calibration Mode Position Desired" VALUE 0x5E420 SD_FLOAT32_IEEE 0 SC_ITH_P_CAL 0 1 /end CHARACTERISTIC
/begin COMPU_METHOD SC_ITH_P_CAL "ITH_P_CAL conversion" RAT_FUNC "%10.5" "unitless" COEFFS 0 1 0 0 0 1 /end COMPU_METHOD
/begin CHARACTERISTIC ITH_P_LMN "ITH Control Minimum Limit for Proportional term" VALUE 0x5E41C SD_FLOAT32_IEEE 0 SC_ITH_P_LMN -1 1 /end CHARACTERISTIC
/begin COMPU_METHOD SC_ITH_P_LMN "ITH_P_LMN conversion" RAT_FUNC "%10.5" "unitless" COEFFS 0 1 0 0 0 1 /end COMPU_METHOD
/begin CHARACTERISTIC ITH_P_LMX "ITH Control Maximum limit for Proportional term" VALUE 0x5E418 SD_FLOAT32_IEEE 0 SC_ITH_P_LMX -1 1 /end CHARACTERISTIC
/begin COMPU_METHOD SC_ITH_P_LMX "ITH_P_LMX conversion" RAT_FUNC "%10.5" "unitless" COEFFS 0 1 0 0 0 1 /end COMPU_METHOD
/begin CHARACTERISTIC ITH_SEL "ITH Calibration Development Mode Selector" VALUE 0x5E608 SD_UBYTE 0 SC_ITH_SEL 0 10 /end CHARACTERISTIC
/begin COMPU_METHOD SC_ITH_SEL "ITH_SEL conversion" RAT_FUNC "%3.0" "unitless" COEFFS 0 1 0 0 0 1 /end COMPU_METHOD
/begin MEASUREMENT ITH_SP "" FLOAT32_IEEE MC_ITH_SP 0 0 0 0 ECU_ADDRESS 0x3FAC74 /end MEASUREMENT
/begin COMPU_METHOD MC_ITH_SP "ITH_SP conversion" RAT_FUNC "%10.5" "Unitless" COEFFS 0 1 0 0 0 1 /end COMPU_METHOD
/begin CHARACTERISTIC ITH_SS_DT "Fault Flag Set time" VALUE 0x5D610 SD_FLOAT32_IEEE 0 SC_ITH_SS_DT 0 600 /end CHARACTERISTIC
/begin COMPU_METHOD SC_ITH_SS_DT "ITH_SS_DT conversion" RAT_FUNC "%10.5" "s" COEFFS 0 1 0 0 0 1 /end COMPU_METHOD
/begin MEASUREMENT ITH_SS_DTR "Detection Timer for steady state ITHP failure diagnostics" FLOAT32_IEEE MC_ITH_SS_DTR 0 0 0 0 ECU_ADDRESS 0x3FA3F8 /end MEASUREMENT
/begin COMPU_METHOD MC_ITH_SS_DTR "ITH_SS_DTR conversion" RAT_FUNC "%10.5" "Unitless" COEFFS 0 1 0 0 0 1 /end COMPU_METHOD
/begin CHARACTERISTIC ITH_SS_RT "" VALUE 0x5D60C SD_FLOAT32_IEEE 0 SC_ITH_SS_RT 0 10000 /end CHARACTERISTIC
/begin COMPU_METHOD SC_ITH_SS_RT "ITH_SS_RT conversion" RAT_FUNC "%10.5" "unitless" COEFFS 0 1 0 0 0 1 /end COMPU_METHOD
/begin MEASUREMENT ITH_SS_RTR "Recovery timer for steady state ITHP failure diagnostics" FLOAT32_IEEE MC_ITH_SS_RTR 0 0 0 0 ECU_ADDRESS 0x3FA3F4 /end MEASUREMENT
/begin COMPU_METHOD MC_ITH_SS_RTR "ITH_SS_RTR conversion" RAT_FUNC "%10.5" "Unitless" COEFFS 0 1 0 0 0 1 /end COMPU_METHOD
/begin CHARACTERISTIC ITH_VEA_TM "" VALUE 0x5E410 SD_FLOAT32_IEEE 0 SC_ITH_VEA_TM 0 3000 /end CHARACTERISTIC
/begin COMPU_METHOD SC_ITH_VEA_TM "ITH_VEA_TM conversion" RAT_FUNC "%10.5" "unitless" COEFFS 0 1 0 0 0 1 /end COMPU_METHOD
/begin CHARACTERISTIC ITH_VEW_TM "" VALUE 0x5E40C SD_FLOAT32_IEEE 0 SC_ITH_VEW_TM 0 3000 /end CHARACTERISTIC
/begin COMPU_METHOD SC_ITH_VEW_TM "ITH_VEW_TM conversion" RAT_FUNC "%10.5" "unitless" COEFFS 0 1 0 0 0 1 /end COMPU_METHOD
/begin MEASUREMENT ITH_VE_ACTV "" UBYTE MC_ITH_VE_ACTV 0 0 0 0 ECU_ADDRESS 0x3FAE10 /end MEASUREMENT
/begin COMPU_METHOD MC_ITH_VE_ACTV "ITH_VE_ACTV conversion" RAT_FUNC "%3.0" "Unitless" COEFFS 0 1 0 0 0 1 /end COMPU_METHOD
/begin CHARACTERISTIC ITH_VE_DES "" VALUE 0x5E414 SD_FLOAT32_IEEE 0 SC_ITH_VE_DES 0 1 /end CHARACTERISTIC
/begin COMPU_METHOD SC_ITH_VE_DES "ITH_VE_DES conversion" RAT_FUNC "%10.5" "unitless" COEFFS 0 1 0 0 0 1 /end COMPU_METHOD
/begin MEASUREMENT ITH_VE_TMR "" FLOAT32_IEEE MC_ITH_VE_TMR 0 0 0 0 ECU_ADDRESS 0x3FAC70 /end MEASUREMENT
/begin COMPU_METHOD MC_ITH_VE_TMR "ITH_VE_TMR conversion" RAT_FUNC "%10.5" "Unitless" COEFFS 0 1 0 0 0 1 /end COMPU_METHOD
/begin MEASUREMENT IVPWR "" FLOAT32_IEEE MC_IVPWR 0 0 0 0 ECU_ADDRESS 0x3FA414 /end MEASUREMENT
/begin COMPU_METHOD MC_IVPWR "IVPWR conversion" RAT_FUNC "%10.5" "Unitless" COEFFS 0 1 0 0 0 1 /end COMPU_METHOD
/begin CHARACTERISTIC IVPWR_AD_TC "System Battery Voltage  filter time constant" VALUE 0x5D634 SD_FLOAT32_IEEE 0 SC_IVPWR_AD_TC 0 64 /end CHARACTERISTIC
/begin COMPU_METHOD SC_IVPWR_AD_TC "IVPWR_AD_TC conversion" RAT_FUNC "%10.5" "s" COEFFS 0 1 0 0 0 1 /end COMPU_METHOD
/begin CHARACTERISTIC IVPWR_CCM_MIN "minimum voltage required to perform OSM tests." VALUE 0x5EAC0 SD_FLOAT32_IEEE 0 SC_IVPWR_CCM_MIN 0 25.2 /end CHARACTERISTIC
/begin COMPU_METHOD SC_IVPWR_CCM_MIN "IVPWR_CCM_MIN conversion" RAT_FUNC "%10.5" "V" COEFFS 0 1 0 0 0 1 /end COMPU_METHOD
/begin CHARACTERISTIC IVPWR_DEF "Default FMEM value for System voltage" VALUE 0x5D638 SD_FLOAT32_IEEE 0 SC_IVPWR_DEF 0 25.2 /end CHARACTERISTIC
/begin COMPU_METHOD SC_IVPWR_DEF "IVPWR_DEF conversion" RAT_FUNC "%10.5" "V" COEFFS 0 1 0 0 0 1 /end COMPU_METHOD
/begin MEASUREMENT IVPWR_DIAG_EN "IVPWR diagnostic enable flag." UBYTE MC_IVPWR_DIAG_EN 0 0 0 0 ECU_ADDRESS 0x3F9E99 /end MEASUREMENT
/begin COMPU_METHOD MC_IVPWR_DIAG_EN "IVPWR_DIAG_EN conversion" RAT_FUNC "%3.0" "Unitless" COEFFS 0 1 0 0 0 1 /end COMPU_METHOD
/begin MEASUREMENT IVPWR_FILT_TIME_CONST "IVPWR filter time constant" FLOAT32_IEEE MC_IVPWR_FILT_TIME_CONST 0 0 0 0 ECU_ADDRESS 0x3FA418 /end MEASUREMENT
/begin COMPU_METHOD MC_IVPWR_FILT_TIME_CONST "IVPWR_FILT_TIME_CONST conversion" RAT_FUNC "%10.5" "Unitless" COEFFS 0 1 0 0 0 1 /end COMPU_METHOD
/begin MEASUREMENT IVPWR_FLT_RECOVERY_CNTR "IVPWR fault recovery counter" SLONG MC_IVPWR_FLT_RECOVERY_CNTR 0 0 0 0 ECU_ADDRESS 0x3FA41C /end MEASUREMENT
/begin COMPU_METHOD MC_IVPWR_FLT_RECOVERY_CNTR "IVPWR_FLT_RECOVERY_CNTR conversion" RAT_FUNC "%10.0" "Unitless" COEFFS 0 1 0 0 0 1 /end COMPU_METHOD
/begin MEASUREMENT IVPWR_FLT_RECOVERY_FLG "1-> Indicates System Voltage fault recovery is occuring" UBYTE MC_IVPWR_FLT_RECOVERY_FLG 0 0 0 0 ECU_ADDRESS 0x3FA430 /end MEASUREMENT
/begin COMPU_METHOD MC_IVPWR_FLT_RECOVERY_FLG "IVPWR_FLT_RECOVERY_FLG conversion" RAT_FUNC "%3.0" "Unitless" COEFFS 0 1 0 0 0 1 /end COMPU_METHOD
/begin CHARACTERISTIC IVPWR_F_DEC "IVPWR malf failure/update counter decrement value" VALUE 0x5D628 SD_SLONG 0 SC_IVPWR_F_DEC 0 65535 /end CHARACTERISTIC
/begin COMPU_METHOD SC_IVPWR_F_DEC "IVPWR_F_DEC conversion" RAT_FUNC "%10.0" "unitless" COEFFS 0 1 0 0 0 1 /end COMPU_METHOD
/begin CHARACTERISTIC IVPWR_F_INC "IVPWR ORH/ORL failure counter increment value" VALUE 0x5D62C SD_SLONG 0 SC_IVPWR_F_INC 0 65535 /end CHARACTERISTIC
/begin COMPU_METHOD SC_IVPWR_F_INC "IVPWR_F_INC conversion" RAT_FUNC "%10.0" "unitless" COEFFS 0 1 0 0 0 1 /end COMPU_METHOD
/begin MEASUREMENT IVPWR_MALF_SET "Indicate system voltage malf  high or low failure" UBYTE MC_IVPWR_MALF_SET 0 0 0 0 ECU_ADDRESS 0x3FA432 /end MEASUREMENT
/begin COMPU_METHOD MC_IVPWR_MALF_SET "IVPWR_MALF_SET conversion" RAT_FUNC "%3.0" "Unitless" COEFFS 0 1 0 0 0 1 /end COMPU_METHOD
/begin MEASUREMENT IVPWR_MLFUPD_EN "IVPWR diagnostic update enable flag." UBYTE MC_IVPWR_MLFUPD_EN 0 0 0 0 ECU_ADDRESS 0x3F9E98 /end MEASUREMENT
/begin COMPU_METHOD MC_IVPWR_MLFUPD_EN "IVPWR_MLFUPD_EN conversion" RAT_FUNC "%3.0" "Unitless" COEFFS 0 1 0 0 0 1 /end COMPU_METHOD
/begin MEASUREMENT IVPWR_ORH_CNTR "System voltage out of range high counter" SLONG MC_IVPWR_ORH_CNTR 0 0 0 0 ECU_ADDRESS 0x3FA424 /end MEASUREMENT
/begin COMPU_METHOD MC_IVPWR_ORH_CNTR "IVPWR_ORH_CNTR conversion" RAT_FUNC "%10.0" "Unitless" COEFFS 0 1 0 0 0 1 /end COMPU_METHOD
/begin MEASUREMENT IVPWR_ORL_CNTR "System voltage out of range low counter" SLONG MC_IVPWR_ORL_CNTR 0 0 0 0 ECU_ADDRESS 0x3FA420 /end MEASUREMENT
/begin COMPU_METHOD MC_IVPWR_ORL_CNTR "IVPWR_ORL_CNTR conversion" RAT_FUNC "%10.0" "Unitless" COEFFS 0 1 0 0 0 1 /end COMPU_METHOD
/begin CHARACTERISTIC IVPWR_REC_INC "IVPWR fault recovery counter increment value" VALUE 0x5D624 SD_SLONG 0 SC_IVPWR_REC_INC 0 65535 /end CHARACTERISTIC
/begin COMPU_METHOD SC_IVPWR_REC_INC "IVPWR_REC_INC conversion" RAT_FUNC "%10.0" "unitless" COEFFS 0 1 0 0 0 1 /end COMPU_METHOD
/begin CHARACTERISTIC IVPWR_TCREC_SEL "Switch to select IVPWR filter time constant during fault recovery and during fault occurance before malf is set" VALUE 0x5D63C SD_UBYTE 0 SC_IVPWR_TCREC_SEL 0 1 /end CHARACTERISTIC
/begin COMPU_METHOD SC_IVPWR_TCREC_SEL "IVPWR_TCREC_SEL conversion" RAT_FUNC "%3.0" "unitless" COEFFS 0 1 0 0 0 1 /end COMPU_METHOD
/begin MEASUREMENT J1979_01_00D "Double word (4 bytes) register containing the data for SCP J1979 Mode $01 PID ^00. (MSB is Data A, ... LSB is Data D.)" ULONG MC_J1979_01_00D 0 0 0 0 ECU_ADDRESS 0x3F9E24 /end MEASUREMENT
/begin COMPU_METHOD MC_J1979_01_00D "J1979_01_00D conversion" RAT_FUNC "%10.0" "Unitless" COEFFS 0 1 0 0 0 1 /end COMPU_METHOD
/begin MEASUREMENT J1979_01_01 "Double word (4 bytes) register containing the data for SCP J1979 Mode $01 PID ^01. (MSB is Data A, ... LSB is Data D.)" ULONG MC_J1979_01_01 0 0 0 0 ECU_ADDRESS 0x3F9E28 /end MEASUREMENT
/begin COMPU_METHOD MC_J1979_01_01 "J1979_01_01 conversion" RAT_FUNC "%10.0" "Unitless" COEFFS 0 1 0 0 0 1 /end COMPU_METHOD
/begin MEASUREMENT J1979_01_03 "Word register containing the data for SCP J1979 Mode $01 PID ^03. More signif icant byte (Data A) is bitmap of fuel system status." UWORD MC_J1979_01_03 0 0 0 0 ECU_ADDRESS 0x3F9CB0 /end MEASUREMENT
/begin COMPU_METHOD MC_J1979_01_03 "J1979_01_03 conversion" RAT_FUNC "%5.0" "Unitless" COEFFS 0 1 0 0 0 1 /end COMPU_METHOD
/begin MEASUREMENT J1979_01_05 "ECT" UBYTE MC_J1979_01_05 0 0 0 0 ECU_ADDRESS 0x3F9F8C /end MEASUREMENT
/begin COMPU_METHOD MC_J1979_01_05 "J1979_01_05 conversion" RAT_FUNC "%3.0" "Unitless" COEFFS 0 1 0 0 0 1 /end COMPU_METHOD
/begin MEASUREMENT J1979_01_06 "Bank1 short term fuel trim" UBYTE MC_J1979_01_06 0 0 0 0 ECU_ADDRESS 0x3F9CC5 /end MEASUREMENT
/begin COMPU_METHOD MC_J1979_01_06 "J1979_01_06 conversion" RAT_FUNC "%3.0" "Unitless" COEFFS 0 1 0 0 0 1 /end COMPU_METHOD
/begin MEASUREMENT J1979_01_07 "Bank1 long term fuel trim" UBYTE MC_J1979_01_07 0 0 0 0 ECU_ADDRESS 0x3F9CC4 /end MEASUREMENT
/begin COMPU_METHOD MC_J1979_01_07 "J1979_01_07 conversion" RAT_FUNC "%3.0" "Unitless" COEFFS 0 1 0 0 0 1 /end COMPU_METHOD
/begin MEASUREMENT J1979_01_08 "Bank2 short term fuel trim" UBYTE MC_J1979_01_08 0 0 0 0 ECU_ADDRESS 0x3F9CC3 /end MEASUREMENT
/begin COMPU_METHOD MC_J1979_01_08 "J1979_01_08 conversion" RAT_FUNC "%3.0" "Unitless" COEFFS 0 1 0 0 0 1 /end COMPU_METHOD
/begin MEASUREMENT J1979_01_09 "Bank2 long term fuel trim" UBYTE MC_J1979_01_09 0 0 0 0 ECU_ADDRESS 0x3F9CC2 /end MEASUREMENT
/begin COMPU_METHOD MC_J1979_01_09 "J1979_01_09 conversion" RAT_FUNC "%3.0" "Unitless" COEFFS 0 1 0 0 0 1 /end COMPU_METHOD
/begin MEASUREMENT J1979_01_0B "MAP value conditioned for pid support" UBYTE MC_J1979_01_0B 0 0 0 0 ECU_ADDRESS 0x3FB760 /end MEASUREMENT
/begin COMPU_METHOD MC_J1979_01_0B "J1979_01_0B conversion" RAT_FUNC "%3.0" "Unitless" COEFFS 0 1 0 0 0 1 /end COMPU_METHOD
/begin MEASUREMENT J1979_01_0D "Vehicle Speed" UBYTE MC_J1979_01_0D 0 0 0 0 ECU_ADDRESS 0x3FA040 /end MEASUREMENT
/begin COMPU_METHOD MC_J1979_01_0D "J1979_01_0D conversion" RAT_FUNC "%3.0" "Unitless" COEFFS 0 1 0 0 0 1 /end COMPU_METHOD
/begin MEASUREMENT J1979_01_0F "Inlet air temperature." UBYTE MC_J1979_01_0F 0 0 0 0 ECU_ADDRESS 0x3FA368 /end MEASUREMENT
/begin COMPU_METHOD MC_J1979_01_0F "J1979_01_0F conversion" RAT_FUNC "%3.0" "Unitless" COEFFS 0 1 0 0 0 1 /end COMPU_METHOD
/begin MEASUREMENT J1979_01_11 "TP_ENG / 4,  for SAE J1979" UBYTE MC_J1979_01_11 0 0 0 0 ECU_ADDRESS 0x3F9CC0 /end MEASUREMENT
/begin COMPU_METHOD MC_J1979_01_11 "J1979_01_11 conversion" RAT_FUNC "%3.0" "Unitless" COEFFS 0 1 0 0 0 1 /end COMPU_METHOD
/begin MEASUREMENT J1979_01_12 "Bitmap of commanded SAIR system." UBYTE MC_J1979_01_12 0 0 0 0 ECU_ADDRESS 0x3F9CBF /end MEASUREMENT
/begin COMPU_METHOD MC_J1979_01_12 "J1979_01_12 conversion" RAT_FUNC "%3.0" "Unitless" COEFFS 0 1 0 0 0 1 /end COMPU_METHOD
/begin MEASUREMENT J1979_01_13 "Bitmap of oxygen sensor locations" UBYTE MC_J1979_01_13 0 0 0 0 ECU_ADDRESS 0x3F9CBE /end MEASUREMENT
/begin COMPU_METHOD MC_J1979_01_13 "J1979_01_13 conversion" RAT_FUNC "%3.0" "Unitless" COEFFS 0 1 0 0 0 1 /end COMPU_METHOD
/begin MEASUREMENT J1979_01_14W "Word (2 bytes) register containing the data for SCP J1979 Mode $01 PID ^14. (MSB is Data A(voltage), LSB is Data B(fuel trim).)" UWORD MC_J1979_01_14W 0 0 0 0 ECU_ADDRESS 0x3F9CAE /end MEASUREMENT
/begin COMPU_METHOD MC_J1979_01_14W "J1979_01_14W conversion" RAT_FUNC "%5.0" "Unitless" COEFFS 0 1 0 0 0 1 /end COMPU_METHOD
/begin MEASUREMENT J1979_01_15W "Word (2 bytes) register containing the data for SCP J1979 Mode $01 PID ^15. (MSB is Data A(voltage), LSB is Data B(fuel trim).)" UWORD MC_J1979_01_15W 0 0 0 0 ECU_ADDRESS 0x3F9CAC /end MEASUREMENT
/begin COMPU_METHOD MC_J1979_01_15W "J1979_01_15W conversion" RAT_FUNC "%5.0" "Unitless" COEFFS 0 1 0 0 0 1 /end COMPU_METHOD
/begin MEASUREMENT J1979_01_18W "Word (2 bytes) register containing the data for SCP J1979 Mode $01 PID ^18. (MSB is Data A(voltage), LSB is Data B(fuel trim).)" UWORD MC_J1979_01_18W 0 0 0 0 ECU_ADDRESS 0x3F9CAA /end MEASUREMENT
/begin COMPU_METHOD MC_J1979_01_18W "J1979_01_18W conversion" RAT_FUNC "%5.0" "Unitless" COEFFS 0 1 0 0 0 1 /end COMPU_METHOD
/begin MEASUREMENT J1979_01_19W "Word (2 bytes) register containing the data for SCP J1979 Mode $01 PID ^19. (MSB is Data A(voltage), LSB is Data B(fuel trim).)" UWORD MC_J1979_01_19W 0 0 0 0 ECU_ADDRESS 0x3F9CA8 /end MEASUREMENT
/begin COMPU_METHOD MC_J1979_01_19W "J1979_01_19W conversion" RAT_FUNC "%5.0" "Unitless" COEFFS 0 1 0 0 0 1 /end COMPU_METHOD
/begin CHARACTERISTIC J1979_01_1C "OBD req'ments to which vehicle is designed: 1=OBDII(CARB),2=OBD(FedEPA),3=OBD&OBDII,4=OBDI,5=none" VALUE 0x5CDE8 SD_UBYTE 0 SC_J1979_01_1C 0 255 /end CHARACTERISTIC
/begin COMPU_METHOD SC_J1979_01_1C "J1979_01_1C conversion" RAT_FUNC "%3.0" "unitless" COEFFS 0 1 0 0 0 1 /end COMPU_METHOD
/begin MEASUREMENT J1979_02_00 "PID's Supported.  0= PID not supported, 1= PID supported" ULONG MC_J1979_02_00 0 0 0 0 ECU_ADDRESS 0x3FCCC8 /end MEASUREMENT
/begin COMPU_METHOD MC_J1979_02_00 "J1979_02_00 conversion" RAT_FUNC "%10.0" "Unitless" COEFFS 0 1 0 0 0 1 /end COMPU_METHOD
/begin MEASUREMENT J1979_02_00D "Double word (4 bytes) register containing the data for SCP J1979 Mode $02 PID #00. (MSB is Data A, ... LSB is Data D.)" ULONG MC_J1979_02_00D 0 0 0 0 ECU_ADDRESS 0x3F9E20 /end MEASUREMENT
/begin COMPU_METHOD MC_J1979_02_00D "J1979_02_00D conversion" RAT_FUNC "%10.0" "Unitless" COEFFS 0 1 0 0 0 1 /end COMPU_METHOD
/begin MEASUREMENT J1979_02_01 "PID's Supported.  0= PID not supported, 1= PID supported" ULONG MC_J1979_02_01 0 0 0 0 ECU_ADDRESS 0x3FCCC4 /end MEASUREMENT
/begin COMPU_METHOD MC_J1979_02_01 "J1979_02_01 conversion" RAT_FUNC "%10.0" "Unitless" COEFFS 0 1 0 0 0 1 /end COMPU_METHOD
/begin MEASUREMENT J1979_02_03 "Word register containing the data for SCP J1979 Mode $02 PID ^03. More signif icant byte (Data A) is bitmap of fuel system status." UWORD MC_J1979_02_03 0 0 0 0 ECU_ADDRESS 0x3F9E18 /end MEASUREMENT
/begin COMPU_METHOD MC_J1979_02_03 "J1979_02_03 conversion" RAT_FUNC "%5.0" "Unitless" COEFFS 0 1 0 0 0 1 /end COMPU_METHOD
/begin MEASUREMENT J1979_02_05 "Freeze frame ECT (°C + 40)" UBYTE MC_J1979_02_05 0 0 0 0 ECU_ADDRESS 0x3F9E1E /end MEASUREMENT
/begin COMPU_METHOD MC_J1979_02_05 "J1979_02_05 conversion" RAT_FUNC "%3.0" "Unitless" COEFFS 0 1 0 0 0 1 /end COMPU_METHOD
/begin MEASUREMENT J1979_02_06 "Short term freeze frame fuel trim adjustment for bank 1." UBYTE MC_J1979_02_06 0 0 0 0 ECU_ADDRESS 0x3F9E1D /end MEASUREMENT
/begin COMPU_METHOD MC_J1979_02_06 "J1979_02_06 conversion" RAT_FUNC "%3.0" "Unitless" COEFFS 0 1 0 0 0 1 /end COMPU_METHOD
/begin MEASUREMENT J1979_02_07 "Long term freeze frame fuel trim adjustment for bank 1." UBYTE MC_J1979_02_07 0 0 0 0 ECU_ADDRESS 0x3F9E1C /end MEASUREMENT
/begin COMPU_METHOD MC_J1979_02_07 "J1979_02_07 conversion" RAT_FUNC "%3.0" "Unitless" COEFFS 0 1 0 0 0 1 /end COMPU_METHOD
/begin MEASUREMENT J1979_02_08 "Short term freeze frame fuel trim adjustment for bank 2." UBYTE MC_J1979_02_08 0 0 0 0 ECU_ADDRESS 0x3F9E1B /end MEASUREMENT
/begin COMPU_METHOD MC_J1979_02_08 "J1979_02_08 conversion" RAT_FUNC "%3.0" "Unitless" COEFFS 0 1 0 0 0 1 /end COMPU_METHOD
/begin MEASUREMENT J1979_02_09 "Long term freeze frame fuel trim adjustment for bank 2." UBYTE MC_J1979_02_09 0 0 0 0 ECU_ADDRESS 0x3F9E1A /end MEASUREMENT
/begin COMPU_METHOD MC_J1979_02_09 "J1979_02_09 conversion" RAT_FUNC "%3.0" "Unitless" COEFFS 0 1 0 0 0 1 /end COMPU_METHOD
/begin MEASUREMENT J1979_02_0B "MAP value conditioned to support pid" UBYTE MC_J1979_02_0B 0 0 0 0 ECU_ADDRESS 0x3FCCD0 /end MEASUREMENT
/begin COMPU_METHOD MC_J1979_02_0B "J1979_02_0B conversion" RAT_FUNC "%3.0" "Unitless" COEFFS 0 1 0 0 0 1 /end COMPU_METHOD
/begin MEASUREMENT J1979_02_0D "Freeze frame vehicle speed." UBYTE MC_J1979_02_0D 0 0 0 0 ECU_ADDRESS 0x3FCCD8 /end MEASUREMENT
/begin COMPU_METHOD MC_J1979_02_0D "J1979_02_0D conversion" RAT_FUNC "%3.0" "Unitless" COEFFS 0 1 0 0 0 1 /end COMPU_METHOD
/begin MEASUREMENT J1979_02_0F "IAT value conditioned to support PID" UBYTE MC_J1979_02_0F 0 0 0 0 ECU_ADDRESS 0x3FCCD9 /end MEASUREMENT
/begin COMPU_METHOD MC_J1979_02_0F "J1979_02_0F conversion" RAT_FUNC "%3.0" "Unitless" COEFFS 0 1 0 0 0 1 /end COMPU_METHOD
/begin MEASUREMENT J1979_02_1C "OBD requirements to which vehicle is designed" UBYTE MC_J1979_02_1C 0 0 0 0 ECU_ADDRESS 0x3FCCDA /end MEASUREMENT
/begin COMPU_METHOD MC_J1979_02_1C "J1979_02_1C conversion" RAT_FUNC "%3.0" "Unitless" COEFFS 0 1 0 0 0 1 /end COMPU_METHOD
/begin MEASUREMENT J1979_1_10 "Current mass air flow rate, for SAE J1979" UWORD MC_J1979_1_10 0 0 0 0 ECU_ADDRESS 0x3FA154 /end MEASUREMENT
/begin COMPU_METHOD MC_J1979_1_10 "J1979_1_10 conversion" RAT_FUNC "%5.0" "Unitless" COEFFS 0 1 0 0 0 1 /end COMPU_METHOD
/begin MEASUREMENT J1979_2_10 "MAF value conditioned to support pid" UWORD MC_J1979_2_10 0 0 0 0 ECU_ADDRESS 0x3FCCCC /end MEASUREMENT
/begin COMPU_METHOD MC_J1979_2_10 "J1979_2_10 conversion" RAT_FUNC "%5.0" "Unitless" COEFFS 0 1 0 0 0 1 /end COMPU_METHOD
/begin MEASUREMENT JGATE_POS3 "EPRNDL J-Gate position code 3" UBYTE MC_JGATE_POS3 0 0 0 0 ECU_ADDRESS 0x3F9CB8 /end MEASUREMENT
/begin COMPU_METHOD MC_JGATE_POS3 "JGATE_POS3 conversion" RAT_FUNC "%3.0" "Unitless" COEFFS 0 1 0 0 0 1 /end COMPU_METHOD
/begin MEASUREMENT KAMM_FL "Flag indicating that KAM voltage is below hardware defined threshold. (Controlled in HWINT_IO Chapter - see URD 21298)" UBYTE MC_KAMM_FL 0 0 0 0 ECU_ADDRESS 0x3FB752 /end MEASUREMENT
/begin COMPU_METHOD MC_KAMM_FL "KAMM_FL conversion" RAT_FUNC "%3.0" "Unitless" COEFFS 0 1 0 0 0 1 /end COMPU_METHOD
/begin MEASUREMENT KAMM_FL_TMR "Timer indicating time since kamm_fl flag set, i.e low KAM voltage." FLOAT32_IEEE MC_KAMM_FL_TMR 0 0 0 0 ECU_ADDRESS 0x3FB780 /end MEASUREMENT
/begin COMPU_METHOD MC_KAMM_FL_TMR "KAMM_FL_TMR conversion" RAT_FUNC "%10.5" "Unitless" COEFFS 0 1 0 0 0 1 /end COMPU_METHOD
/begin MEASUREMENT KAMRF[0] "Adaptive fuel-air ratio correction factor" FLOAT32_IEEE MC_KAMRF 0 0 0 255.99 ECU_ADDRESS 0x3F9ACC /end MEASUREMENT
/begin COMPU_METHOD MC_KAMRF "KAMRF conversion" RAT_FUNC "%10.5" "UNITLESS" COEFFS 0 1 0 0 0 1 /end COMPU_METHOD
/begin MEASUREMENT KAMRF[1] "Adaptive fuel-air ratio correction factor" FLOAT32_IEEE MC_KAMRF 0 0 0 255.99 ECU_ADDRESS 0x3F9AD0 /end MEASUREMENT
/begin MEASUREMENT KAM_ERROR "Indicates keep alive RAM invalid." UBYTE MC_KAM_ERROR 0 0 0 0 ECU_ADDRESS 0x3FB1B4 /end MEASUREMENT
/begin COMPU_METHOD MC_KAM_ERROR "KAM_ERROR conversion" RAT_FUNC "%3.0" "Unitless" COEFFS 0 1 0 0 0 1 /end COMPU_METHOD
/begin CHARACTERISTIC KAM_ROM_SW "KAM/ROM test switch; 0 = No KAM/ROM test; 1 = KAM/ROM test" VALUE 0x5F0E7 SD_UBYTE 0 SC_KAM_ROM_SW 0 1 /end CHARACTERISTIC
/begin COMPU_METHOD SC_KAM_ROM_SW "KAM_ROM_SW conversion" RAT_FUNC "%3.0" "unitless" COEFFS 0 1 0 0 0 1 /end COMPU_METHOD
/begin MEASUREMENT KICKDN_REQ "" UBYTE MC_KICKDN_REQ 0 0 0 0 ECU_ADDRESS 0x3FA2BD /end MEASUREMENT
/begin COMPU_METHOD MC_KICKDN_REQ "KICKDN_REQ conversion" RAT_FUNC "%3.0" "Unitless" COEFFS 0 1 0 0 0 1 /end COMPU_METHOD
/begin MEASUREMENT KL15_F_ORH "" UBYTE MC_KL15_F_ORH 0 0 0 0 ECU_ADDRESS 0x3FB6EA /end MEASUREMENT
/begin COMPU_METHOD MC_KL15_F_ORH "KL15_F_ORH conversion" RAT_FUNC "%3.0" "Unitless" COEFFS 0 1 0 0 0 1 /end COMPU_METHOD
/begin MEASUREMENT KL15_F_ORL "" UBYTE MC_KL15_F_ORL 0 0 0 0 ECU_ADDRESS 0x3FB6EB /end MEASUREMENT
/begin COMPU_METHOD MC_KL15_F_ORL "KL15_F_ORL conversion" RAT_FUNC "%3.0" "Unitless" COEFFS 0 1 0 0 0 1 /end COMPU_METHOD
/begin MEASUREMENT KL87_F_ORH "" UBYTE MC_KL87_F_ORH 0 0 0 0 ECU_ADDRESS 0x3FB6EC /end MEASUREMENT
/begin COMPU_METHOD MC_KL87_F_ORH "KL87_F_ORH conversion" RAT_FUNC "%3.0" "Unitless" COEFFS 0 1 0 0 0 1 /end COMPU_METHOD
/begin MEASUREMENT KL87_F_ORL "" UBYTE MC_KL87_F_ORL 0 0 0 0 ECU_ADDRESS 0x3FB6ED /end MEASUREMENT
/begin COMPU_METHOD MC_KL87_F_ORL "KL87_F_ORL conversion" RAT_FUNC "%3.0" "Unitless" COEFFS 0 1 0 0 0 1 /end COMPU_METHOD
/begin CHARACTERISTIC KNCRANK "Run to Crank Mode transition speed (RPM)" VALUE 0x5DD88 SD_FLOAT32_IEEE 0 SC_KNCRANK 0 650 /end CHARACTERISTIC
/begin COMPU_METHOD SC_KNCRANK "KNCRANK conversion" RAT_FUNC "%10.5" "RPM" COEFFS 0 1 0 0 0 1 /end COMPU_METHOD
/begin CHARACTERISTIC KNNOSTART "Run to No-Start Mode transition speed (RPM)" VALUE 0x5DD84 SD_FLOAT32_IEEE 0 SC_KNNOSTART 0 650 /end CHARACTERISTIC
/begin COMPU_METHOD SC_KNNOSTART "KNNOSTART conversion" RAT_FUNC "%10.5" "RPM" COEFFS 0 1 0 0 0 1 /end COMPU_METHOD
/begin CHARACTERISTIC KOEO_MINMPH_1 "" VALUE 0x5F26C SD_FLOAT32_IEEE 0 SC_KOEO_MINMPH_1 0 150 /end CHARACTERISTIC
/begin COMPU_METHOD SC_KOEO_MINMPH_1 "KOEO_MINMPH_1 conversion" RAT_FUNC "%10.5" "MPH" COEFFS 0 1 0 0 0 1 /end COMPU_METHOD
/begin MEASUREMENT KOEO_MODE "KOEO  mode register." UBYTE MC_KOEO_MODE 0 0 0 0 ECU_ADDRESS 0x3F9CFC /end MEASUREMENT
/begin COMPU_METHOD MC_KOEO_MODE "KOEO_MODE conversion" RAT_FUNC "%3.0" "Unitless" COEFFS 0 1 0 0 0 1 /end COMPU_METHOD
/begin MEASUREMENT KOER_FIRST_TIME "" UBYTE MC_KOER_FIRST_TIME 0 0 0 0 ECU_ADDRESS 0x3FB58D /end MEASUREMENT
/begin COMPU_METHOD MC_KOER_FIRST_TIME "KOER_FIRST_TIME conversion" RAT_FUNC "%3.0" "Unitless" COEFFS 0 1 0 0 0 1 /end COMPU_METHOD
/begin CHARACTERISTIC KOER_MINMPH "Minimum vehicle speed to conduct KOER self test." VALUE 0x5F0B6 SD_UBYTE 0 SC_KOER_MINMPH 0 120 /end CHARACTERISTIC
/begin COMPU_METHOD SC_KOER_MINMPH "KOER_MINMPH conversion" RAT_FUNC "%3.0" "MPH" COEFFS 0 1 0 0 0 1 /end COMPU_METHOD
/begin MEASUREMENT KOER_MODE "KOER Mode Selector" UBYTE MC_KOER_MODE 0 0 0 0 ECU_ADDRESS 0x3FAE18 /end MEASUREMENT
/begin COMPU_METHOD MC_KOER_MODE "KOER_MODE conversion" RAT_FUNC "%3.0" "Unitless" COEFFS 0 1 0 0 0 1 /end COMPU_METHOD
/begin MEASUREMENT KOER_TST_ENA_STD "" UBYTE MC_KOER_TST_ENA_STD 0 0 0 0 ECU_ADDRESS 0x3FB5B3 /end MEASUREMENT
/begin COMPU_METHOD MC_KOER_TST_ENA_STD "KOER_TST_ENA_STD conversion" RAT_FUNC "%3.0" "Unitless" COEFFS 0 1 0 0 0 1 /end COMPU_METHOD
/begin CHARACTERISTIC KOER_TST_TM "Maximum amount of time that KOER can run." VALUE 0x5F0B7 SD_UBYTE 0 SC_KOER_TST_TM 0 255 /end CHARACTERISTIC
/begin COMPU_METHOD SC_KOER_TST_TM "KOER_TST_TM conversion" RAT_FUNC "%3.0" "s" COEFFS 0 1 0 0 0 1 /end COMPU_METHOD
/begin MEASUREMENT KOER_TST_TMR "Amount of time that key on engine running has been executing." FLOAT32_IEEE MC_KOER_TST_TMR 0 0 0 0 ECU_ADDRESS 0x3FB4EC /end MEASUREMENT
/begin COMPU_METHOD MC_KOER_TST_TMR "KOER_TST_TMR conversion" RAT_FUNC "%10.5" "Unitless" COEFFS 0 1 0 0 0 1 /end COMPU_METHOD
/begin CHARACTERISTIC KSF "Keypower scaling factor, reciprocal." VALUE 0x5C818 SD_FLOAT32_IEEE 0 SC_KSF 0 7.99988 /end CHARACTERISTIC
/begin COMPU_METHOD SC_KSF "KSF conversion" RAT_FUNC "%10.5" "UNITLESS" COEFFS 0 1 0 0 0 1 /end COMPU_METHOD
/begin CHARACTERISTIC K_TQCVT_ULK "" VALUE 0x5DB90 SD_FLOAT32_IEEE 0 SC_K_TQCVT_ULK 0 6 /end CHARACTERISTIC
/begin COMPU_METHOD SC_K_TQCVT_ULK "K_TQCVT_ULK conversion" RAT_FUNC "%10.5" "unitless" COEFFS 0 1 0 0 0 1 /end COMPU_METHOD
/begin MEASUREMENT LAMBSE[0] "Commanded Equivalence Ratio." FLOAT32_IEEE MC_LAMBSE 0 0 0 1.99997 ECU_ADDRESS 0x3F9AD4 /end MEASUREMENT
/begin COMPU_METHOD MC_LAMBSE "LAMBSE conversion" RAT_FUNC "%10.5" "unitless" COEFFS 0 1 0 0 0 1 /end COMPU_METHOD
/begin MEASUREMENT LAMBSE[1] "Commanded Equivalence Ratio." FLOAT32_IEEE MC_LAMBSE 0 0 0 1.99997 ECU_ADDRESS 0x3F9AD8 /end MEASUREMENT
/begin MEASUREMENT LAST_MODE "Last valid engine mode at camp sync loss" UBYTE MC_LAST_MODE 0 0 0 0 ECU_ADDRESS 0x3FA8B6 /end MEASUREMENT
/begin COMPU_METHOD MC_LAST_MODE "LAST_MODE conversion" RAT_FUNC "%3.0" "Unitless" COEFFS 0 1 0 0 0 1 /end COMPU_METHOD
/begin MEASUREMENT LDR_ACCEL "Low Data Rate misfire crankshaft acceleration measurement." FLOAT32_IEEE MC_LDR_ACCEL 0 0 0 0 ECU_ADDRESS 0x3FB308 /end MEASUREMENT
/begin COMPU_METHOD MC_LDR_ACCEL "LDR_ACCEL conversion" RAT_FUNC "%10.5" "Unitless" COEFFS 0 1 0 0 0 1 /end COMPU_METHOD
/begin MEASUREMENT LDR_CF[0] "Low Data Rate profile correction factors." FLOAT32_IEEE MC_LDR_CF 0 0 0 1.99997 ECU_ADDRESS 0x3FCC40 /end MEASUREMENT
/begin COMPU_METHOD MC_LDR_CF "LDR_CF conversion" RAT_FUNC "%10.5" "unitless" COEFFS 0 1 0 0 0 1 /end COMPU_METHOD
/begin MEASUREMENT LDR_CF[1] "Low Data Rate profile correction factors." FLOAT32_IEEE MC_LDR_CF 0 0 0 1.99997 ECU_ADDRESS 0x3FCC44 /end MEASUREMENT
/begin MEASUREMENT LDR_CF[2] "Low Data Rate profile correction factors." FLOAT32_IEEE MC_LDR_CF 0 0 0 1.99997 ECU_ADDRESS 0x3FCC48 /end MEASUREMENT
/begin MEASUREMENT LDR_CF[3] "Low Data Rate profile correction factors." FLOAT32_IEEE MC_LDR_CF 0 0 0 1.99997 ECU_ADDRESS 0x3FCC4C /end MEASUREMENT
/begin MEASUREMENT LDR_CF[4] "Low Data Rate profile correction factors." FLOAT32_IEEE MC_LDR_CF 0 0 0 1.99997 ECU_ADDRESS 0x3FCC50 /end MEASUREMENT
/begin MEASUREMENT LDR_CF[5] "Low Data Rate profile correction factors." FLOAT32_IEEE MC_LDR_CF 0 0 0 1.99997 ECU_ADDRESS 0x3FCC54 /end MEASUREMENT
/begin MEASUREMENT LDR_CF[6] "Low Data Rate profile correction factors." FLOAT32_IEEE MC_LDR_CF 0 0 0 1.99997 ECU_ADDRESS 0x3FCC58 /end MEASUREMENT
/begin MEASUREMENT LDR_CF[7] "Low Data Rate profile correction factors." FLOAT32_IEEE MC_LDR_CF 0 0 0 1.99997 ECU_ADDRESS 0x3FCC5C /end MEASUREMENT
/begin MEASUREMENT LDR_CF[8] "Low Data Rate profile correction factors." FLOAT32_IEEE MC_LDR_CF 0 0 0 1.99997 ECU_ADDRESS 0x3FCC60 /end MEASUREMENT
/begin MEASUREMENT LDR_CF[9] "Low Data Rate profile correction factors." FLOAT32_IEEE MC_LDR_CF 0 0 0 1.99997 ECU_ADDRESS 0x3FCC64 /end MEASUREMENT
/begin MEASUREMENT LDR_DELTA "Low Dat a Rate misfire delta time interval." FLOAT32_IEEE MC_LDR_DELTA 0 0 0 0 ECU_ADDRESS 0x3FB318 /end MEASUREMENT
/begin COMPU_METHOD MC_LDR_DELTA "LDR_DELTA conversion" RAT_FUNC "%10.5" "Unitless" COEFFS 0 1 0 0 0 1 /end COMPU_METHOD
/begin MEASUREMENT LDR_NEW_CF[0] "Low Data Rate new profile correction factors, these get averaged to calculate final cfs." FLOAT32_IEEE MC_LDR_NEW_CF 0 0 0 1.99997 ECU_ADDRESS 0x3FBE50 /end MEASUREMENT
/begin COMPU_METHOD MC_LDR_NEW_CF "LDR_NEW_CF conversion" RAT_FUNC "%10.5" "unitless" COEFFS 0 1 0 0 0 1 /end COMPU_METHOD
/begin MEASUREMENT LDR_NEW_CF[1] "Low Data Rate new profile correction factors, these get averaged to calculate final cfs." FLOAT32_IEEE MC_LDR_NEW_CF 0 0 0 1.99997 ECU_ADDRESS 0x3FBE54 /end MEASUREMENT
/begin MEASUREMENT LDR_NEW_CF[2] "Low Data Rate new profile correction factors, these get averaged to calculate final cfs." FLOAT32_IEEE MC_LDR_NEW_CF 0 0 0 1.99997 ECU_ADDRESS 0x3FBE58 /end MEASUREMENT
/begin MEASUREMENT LDR_NEW_CF[3] "Low Data Rate new profile correction factors, these get averaged to calculate final cfs." FLOAT32_IEEE MC_LDR_NEW_CF 0 0 0 1.99997 ECU_ADDRESS 0x3FBE5C /end MEASUREMENT
/begin MEASUREMENT LDR_NEW_CF[4] "Low Data Rate new profile correction factors, these get averaged to calculate final cfs." FLOAT32_IEEE MC_LDR_NEW_CF 0 0 0 1.99997 ECU_ADDRESS 0x3FBE60 /end MEASUREMENT
/begin MEASUREMENT LDR_NEW_CF[5] "Low Data Rate new profile correction factors, these get averaged to calculate final cfs." FLOAT32_IEEE MC_LDR_NEW_CF 0 0 0 1.99997 ECU_ADDRESS 0x3FBE64 /end MEASUREMENT
/begin MEASUREMENT LDR_NEW_CF[6] "Low Data Rate new profile correction factors, these get averaged to calculate final cfs." FLOAT32_IEEE MC_LDR_NEW_CF 0 0 0 1.99997 ECU_ADDRESS 0x3FBE68 /end MEASUREMENT
/begin MEASUREMENT LDR_NEW_CF[7] "Low Data Rate new profile correction factors, these get averaged to calculate final cfs." FLOAT32_IEEE MC_LDR_NEW_CF 0 0 0 1.99997 ECU_ADDRESS 0x3FBE6C /end MEASUREMENT
/begin MEASUREMENT LDR_NEW_CF[8] "Low Data Rate new profile correction factors, these get averaged to calculate final cfs." FLOAT32_IEEE MC_LDR_NEW_CF 0 0 0 1.99997 ECU_ADDRESS 0x3FBE70 /end MEASUREMENT
/begin MEASUREMENT LDR_NEW_CF[9] "Low Data Rate new profile correction factors, these get averaged to calculate final cfs." FLOAT32_IEEE MC_LDR_NEW_CF 0 0 0 1.99997 ECU_ADDRESS 0x3FBE74 /end MEASUREMENT
/begin MEASUREMENT LDR_PERIOD[0] "Low Data Rate profile acquisition delta times." FLOAT32_IEEE MC_LDR_PERIOD 0 0 0 0.25 ECU_ADDRESS 0x3FBF78 /end MEASUREMENT
/begin COMPU_METHOD MC_LDR_PERIOD "LDR_PERIOD conversion" RAT_FUNC "%10.5" "s" COEFFS 0 1 0 0 0 1 /end COMPU_METHOD
/begin MEASUREMENT LDR_PERIOD[10] "Low Data Rate profile acquisition delta times." FLOAT32_IEEE MC_LDR_PERIOD 0 0 0 0.25 ECU_ADDRESS 0x3FBFA0 /end MEASUREMENT
/begin MEASUREMENT LDR_PERIOD[11] "Low Data Rate profile acquisition delta times." FLOAT32_IEEE MC_LDR_PERIOD 0 0 0 0.25 ECU_ADDRESS 0x3FBFA4 /end MEASUREMENT
/begin MEASUREMENT LDR_PERIOD[12] "Low Data Rate profile acquisition delta times." FLOAT32_IEEE MC_LDR_PERIOD 0 0 0 0.25 ECU_ADDRESS 0x3FBFA8 /end MEASUREMENT
/begin MEASUREMENT LDR_PERIOD[13] "Low Data Rate profile acquisition delta times." FLOAT32_IEEE MC_LDR_PERIOD 0 0 0 0.25 ECU_ADDRESS 0x3FBFAC /end MEASUREMENT
/begin MEASUREMENT LDR_PERIOD[14] "Low Data Rate profile acquisition delta times." FLOAT32_IEEE MC_LDR_PERIOD 0 0 0 0.25 ECU_ADDRESS 0x3FBFB0 /end MEASUREMENT
/begin MEASUREMENT LDR_PERIOD[15] "Low Data Rate profile acquisition delta times." FLOAT32_IEEE MC_LDR_PERIOD 0 0 0 0.25 ECU_ADDRESS 0x3FBFB4 /end MEASUREMENT
/begin MEASUREMENT LDR_PERIOD[16] "Low Data Rate profile acquisition delta times." FLOAT32_IEEE MC_LDR_PERIOD 0 0 0 0.25 ECU_ADDRESS 0x3FBFB8 /end MEASUREMENT
/begin MEASUREMENT LDR_PERIOD[17] "Low Data Rate profile acquisition delta times." FLOAT32_IEEE MC_LDR_PERIOD 0 0 0 0.25 ECU_ADDRESS 0x3FBFBC /end MEASUREMENT
/begin MEASUREMENT LDR_PERIOD[18] "Low Data Rate profile acquisition delta times." FLOAT32_IEEE MC_LDR_PERIOD 0 0 0 0.25 ECU_ADDRESS 0x3FBFC0 /end MEASUREMENT
/begin MEASUREMENT LDR_PERIOD[1] "Low Data Rate profile acquisition delta times." FLOAT32_IEEE MC_LDR_PERIOD 0 0 0 0.25 ECU_ADDRESS 0x3FBF7C /end MEASUREMENT
/begin MEASUREMENT LDR_PERIOD[2] "Low Data Rate profile acquisition delta times." FLOAT32_IEEE MC_LDR_PERIOD 0 0 0 0.25 ECU_ADDRESS 0x3FBF80 /end MEASUREMENT
/begin MEASUREMENT LDR_PERIOD[3] "Low Data Rate profile acquisition delta times." FLOAT32_IEEE MC_LDR_PERIOD 0 0 0 0.25 ECU_ADDRESS 0x3FBF84 /end MEASUREMENT
/begin MEASUREMENT LDR_PERIOD[4] "Low Data Rate profile acquisition delta times." FLOAT32_IEEE MC_LDR_PERIOD 0 0 0 0.25 ECU_ADDRESS 0x3FBF88 /end MEASUREMENT
/begin MEASUREMENT LDR_PERIOD[5] "Low Data Rate profile acquisition delta times." FLOAT32_IEEE MC_LDR_PERIOD 0 0 0 0.25 ECU_ADDRESS 0x3FBF8C /end MEASUREMENT
/begin MEASUREMENT LDR_PERIOD[6] "Low Data Rate profile acquisition delta times." FLOAT32_IEEE MC_LDR_PERIOD 0 0 0 0.25 ECU_ADDRESS 0x3FBF90 /end MEASUREMENT
/begin MEASUREMENT LDR_PERIOD[7] "Low Data Rate profile acquisition delta times." FLOAT32_IEEE MC_LDR_PERIOD 0 0 0 0.25 ECU_ADDRESS 0x3FBF94 /end MEASUREMENT
/begin MEASUREMENT LDR_PERIOD[8] "Low Data Rate profile acquisition delta times." FLOAT32_IEEE MC_LDR_PERIOD 0 0 0 0.25 ECU_ADDRESS 0x3FBF98 /end MEASUREMENT
/begin MEASUREMENT LDR_PERIOD[9] "Low Data Rate profile acquisition delta times." FLOAT32_IEEE MC_LDR_PERIOD 0 0 0 0.25 ECU_ADDRESS 0x3FBF9C /end MEASUREMENT
/begin MEASUREMENT LDR_PIP_RAW "Low data rate misfire delta time measurement." FLOAT32_IEEE MC_LDR_PIP_RAW 0 0 0 0 ECU_ADDRESS 0x3FB2B4 /end MEASUREMENT
/begin COMPU_METHOD MC_LDR_PIP_RAW "LDR_PIP_RAW conversion" RAT_FUNC "%10.5" "Unitless" COEFFS 0 1 0 0 0 1 /end COMPU_METHOD
/begin CHARACTERISTIC LDR_SYNC_DLY "Offset from sync counter, used to align Low Data Rate misfire tallies to correct cylinder number." VALUE 0x5EE00 SD_UBYTE 0 SC_LDR_SYNC_DLY 0 255 /end CHARACTERISTIC
/begin COMPU_METHOD SC_LDR_SYNC_DLY "LDR_SYNC_DLY conversion" RAT_FUNC "%3.0" "events" COEFFS 0 1 0 0 0 1 /end COMPU_METHOD
/begin MEASUREMENT LDR_VELOC "Low Data Rate misfire crankshaft velocity measurement." FLOAT32_IEEE MC_LDR_VELOC 0 0 0 0 ECU_ADDRESS 0x3FB310 /end MEASUREMENT
/begin COMPU_METHOD MC_LDR_VELOC "LDR_VELOC conversion" RAT_FUNC "%10.5" "Unitless" COEFFS 0 1 0 0 0 1 /end COMPU_METHOD
/begin MEASUREMENT LDR_VELOCO "Last pass value for Low Data Rate misfire crankshaft velocity." FLOAT32_IEEE MC_LDR_VELOCO 0 0 0 0 ECU_ADDRESS 0x3FB30C /end MEASUREMENT
/begin COMPU_METHOD MC_LDR_VELOCO "LDR_VELOCO conversion" RAT_FUNC "%10.5" "Unitless" COEFFS 0 1 0 0 0 1 /end COMPU_METHOD
/begin CHARACTERISTIC LDR_WIDTH "Angular interval for the Low Data Rate misfire delta time measurement." VALUE 0x5EDE4 SD_FLOAT32_IEEE 0 SC_LDR_WIDTH 0 720 /end CHARACTERISTIC
/begin COMPU_METHOD SC_LDR_WIDTH "LDR_WIDTH conversion" RAT_FUNC "%10.5" "deg" COEFFS 0 1 0 0 0 1 /end COMPU_METHOD
/begin MEASUREMENT LOAD "Normalized cylinder air charge." FLOAT32_IEEE MC_LOAD 0 0 0 0 ECU_ADDRESS 0x3F9C70 /end MEASUREMENT
/begin COMPU_METHOD MC_LOAD "LOAD conversion" RAT_FUNC "%10.5" "Unitless" COEFFS 0 1 0 0 0 1 /end COMPU_METHOD
/begin CHARACTERISTIC LOAD_INJ_OFF_LMT "Engine load limit for the injector OFF test" VALUE 0x5CEE0 SD_FLOAT32_IEEE 0 SC_LOAD_INJ_OFF_LMT 0 1000 /end CHARACTERISTIC
/begin COMPU_METHOD SC_LOAD_INJ_OFF_LMT "LOAD_INJ_OFF_LMT conversion" RAT_FUNC "%10.5" "unitless" COEFFS 0 1 0 0 0 1 /end COMPU_METHOD
/begin MEASUREMENT LOAD_PCT "Engine load" FLOAT32_IEEE MC_LOAD_PCT 0 0 0 0 ECU_ADDRESS 0x3FA89C /end MEASUREMENT
/begin COMPU_METHOD MC_LOAD_PCT "LOAD_PCT conversion" RAT_FUNC "%10.5" "Unitless" COEFFS 0 1 0 0 0 1 /end COMPU_METHOD
/begin MEASUREMENT LOAD_PCT_PID "Load value in pid transfer format" UBYTE MC_LOAD_PCT_PID 0 0 0 0 ECU_ADDRESS 0x3FA8AC /end MEASUREMENT
/begin COMPU_METHOD MC_LOAD_PCT_PID "LOAD_PCT_PID conversion" RAT_FUNC "%3.0" "Unitless" COEFFS 0 1 0 0 0 1 /end COMPU_METHOD
/begin CHARACTERISTIC LOST_SYNC_CAMMAX "" VALUE 0x5C8AD SD_UBYTE 0 SC_LOST_SYNC_CAMMAX 0 200 /end CHARACTERISTIC
/begin COMPU_METHOD SC_LOST_SYNC_CAMMAX "LOST_SYNC_CAMMAX conversion" RAT_FUNC "%3.0" "unitless" COEFFS 0 1 0 0 0 1 /end COMPU_METHOD
/begin CHARACTERISTIC LOST_SYNC_MAX "" VALUE 0x5C8AE SD_UBYTE 0 SC_LOST_SYNC_MAX 0 20 /end CHARACTERISTIC
/begin COMPU_METHOD SC_LOST_SYNC_MAX "LOST_SYNC_MAX conversion" RAT_FUNC "%3.0" "unitless" COEFFS 0 1 0 0 0 1 /end COMPU_METHOD
/begin MEASUREMENT LOW_FUEL_LVL "Low fuel status flag based upon fuel level input; 1 -> fuel level is low." UBYTE MC_LOW_FUEL_LVL 0 0 0 0 ECU_ADDRESS 0x3FA00D /end MEASUREMENT
/begin COMPU_METHOD MC_LOW_FUEL_LVL "LOW_FUEL_LVL conversion" RAT_FUNC "%3.0" "Unitless" COEFFS 0 1 0 0 0 1 /end COMPU_METHOD
/begin MEASUREMENT LO_ALT_BP_MULT "Low altitude Barometric Pressure Multiplier" FLOAT32_IEEE MC_LO_ALT_BP_MULT 0 0 0 0 ECU_ADDRESS 0x3F9ED8 /end MEASUREMENT
/begin COMPU_METHOD MC_LO_ALT_BP_MULT "LO_ALT_BP_MULT conversion" RAT_FUNC "%10.5" "Unitless" COEFFS 0 1 0 0 0 1 /end COMPU_METHOD
/begin MEASUREMENT LO_ALT_DITBP_MULT "Low altitude barometric multiplier." FLOAT32_IEEE MC_LO_ALT_DITBP_MULT 0 0 0 0 ECU_ADDRESS 0x3FA920 /end MEASUREMENT
/begin COMPU_METHOD MC_LO_ALT_DITBP_MULT "LO_ALT_DITBP_MULT conversion" RAT_FUNC "%10.5" "Unitless" COEFFS 0 1 0 0 0 1 /end COMPU_METHOD
/begin MEASUREMENT M6_TABLE_PTR "Index indicating current position within MODE 06 table." UBYTE MC_M6_TABLE_PTR 0 0 0 0 ECU_ADDRESS 0x3FB4C6 /end MEASUREMENT
/begin COMPU_METHOD MC_M6_TABLE_PTR "M6_TABLE_PTR conversion" RAT_FUNC "%3.0" "Unitless" COEFFS 0 1 0 0 0 1 /end COMPU_METHOD
/begin MEASUREMENT M6_TEST_ID "Test ID requested by MODE 06 command." UBYTE MC_M6_TEST_ID 0 0 0 0 ECU_ADDRESS 0x3FB446 /end MEASUREMENT
/begin COMPU_METHOD MC_M6_TEST_ID "M6_TEST_ID conversion" RAT_FUNC "%3.0" "Unitless" COEFFS 0 1 0 0 0 1 /end COMPU_METHOD
/begin MEASUREMENT M9_STATE "State of MODE 09 state machine (0=Initial, 1= VIN request, 2= CAL ID request, 4= CAL verification request." UBYTE MC_M9_STATE 0 0 0 0 ECU_ADDRESS 0x3FB445 /end MEASUREMENT
/begin COMPU_METHOD MC_M9_STATE "M9_STATE conversion" RAT_FUNC "%3.0" "Unitless" COEFFS 0 1 0 0 0 1 /end COMPU_METHOD
/begin CHARACTERISTIC MAFNMAX_F_DEC "MAF out of range fault decrement value" VALUE 0x5D2B0 SD_SLONG 0 SC_MAFNMAX_F_DEC 0 65535 /end CHARACTERISTIC
/begin COMPU_METHOD SC_MAFNMAX_F_DEC "MAFNMAX_F_DEC conversion" RAT_FUNC "%10.0" "unitless" COEFFS 0 1 0 0 0 1 /end COMPU_METHOD
/begin CHARACTERISTIC MAFNMAX_F_INC "MAF signal our of range fault increment value" VALUE 0x5D2B4 SD_SLONG 0 SC_MAFNMAX_F_INC 0 65535 /end CHARACTERISTIC
/begin COMPU_METHOD SC_MAFNMAX_F_INC "MAFNMAX_F_INC conversion" RAT_FUNC "%10.0" "unitless" COEFFS 0 1 0 0 0 1 /end COMPU_METHOD
/begin MEASUREMENT MAF_AATMULT "Mass Air Flow temperature compensation multiplier" FLOAT32_IEEE MC_MAF_AATMULT 0 0 0 0 ECU_ADDRESS 0x3FA140 /end MEASUREMENT
/begin COMPU_METHOD MC_MAF_AATMULT "MAF_AATMULT conversion" RAT_FUNC "%10.5" "Unitless" COEFFS 0 1 0 0 0 1 /end COMPU_METHOD
/begin MEASUREMENT MAF_CNTS "Mass Air Flow sensor A/D counts" SLONG MC_MAF_CNTS 0 0 0 0 ECU_ADDRESS 0x3F99B4 /end MEASUREMENT
/begin COMPU_METHOD MC_MAF_CNTS "MAF_CNTS conversion" RAT_FUNC "%10.0" "Unitless" COEFFS 0 1 0 0 0 1 /end COMPU_METHOD
/begin CHARACTERISTIC MAF_DEF "MAF default value" VALUE 0x5D2A8 SD_FLOAT32_IEEE 0 SC_MAF_DEF 0 750 /end CHARACTERISTIC
/begin COMPU_METHOD SC_MAF_DEF "MAF_DEF conversion" RAT_FUNC "%10.5" "g/s" COEFFS 0 1 0 0 0 1 /end COMPU_METHOD
/begin MEASUREMENT MAF_ENG_UNITS "Mass air flow in grams/sec (from input driver)" FLOAT32_IEEE MC_MAF_ENG_UNITS 0 0 0 0 ECU_ADDRESS 0x3F99B0 /end MEASUREMENT
/begin COMPU_METHOD MC_MAF_ENG_UNITS "MAF_ENG_UNITS conversion" RAT_FUNC "%10.5" "Unitless" COEFFS 0 1 0 0 0 1 /end COMPU_METHOD
/begin MEASUREMENT MAF_FIL "Intermittent fault filter for the MAF sensor." UBYTE MC_MAF_FIL 0 0 0 0 ECU_ADDRESS 0x3F9E53 /end MEASUREMENT
/begin COMPU_METHOD MC_MAF_FIL "MAF_FIL conversion" RAT_FUNC "%3.0" "Unitless" COEFFS 0 1 0 0 0 1 /end COMPU_METHOD
/begin MEASUREMENT MAF_FILT_TIME_CONST "MAF filter time constant" FLOAT32_IEEE MC_MAF_FILT_TIME_CONST 0 0 0 0 ECU_ADDRESS 0x3FA150 /end MEASUREMENT
/begin COMPU_METHOD MC_MAF_FILT_TIME_CONST "MAF_FILT_TIME_CONST conversion" RAT_FUNC "%10.5" "Unitless" COEFFS 0 1 0 0 0 1 /end COMPU_METHOD
/begin MEASUREMENT MAF_FIL_MAX "HIGHEST VALUE THE FUALT FILTER MAF_FIL SEES" UBYTE MC_MAF_FIL_MAX 0 0 0 0 ECU_ADDRESS 0x3FCCFF /end MEASUREMENT
/begin COMPU_METHOD MC_MAF_FIL_MAX "MAF_FIL_MAX conversion" RAT_FUNC "%3.0" "Unitless" COEFFS 0 1 0 0 0 1 /end COMPU_METHOD
/begin MEASUREMENT MAF_FLT_RECOVERY_CNTR "MAF fault recovery counter" SLONG MC_MAF_FLT_RECOVERY_CNTR 0 0 0 0 ECU_ADDRESS 0x3FA12C /end MEASUREMENT
/begin COMPU_METHOD MC_MAF_FLT_RECOVERY_CNTR "MAF_FLT_RECOVERY_CNTR conversion" RAT_FUNC "%10.0" "Unitless" COEFFS 0 1 0 0 0 1 /end COMPU_METHOD
/begin MEASUREMENT MAF_FLT_RECOVERY_FLG "1-> Indicates MAF fault recovery is occuring" UBYTE MC_MAF_FLT_RECOVERY_FLG 0 0 0 0 ECU_ADDRESS 0x3FA158 /end MEASUREMENT
/begin COMPU_METHOD MC_MAF_FLT_RECOVERY_FLG "MAF_FLT_RECOVERY_FLG conversion" RAT_FUNC "%3.0" "Unitless" COEFFS 0 1 0 0 0 1 /end COMPU_METHOD
/begin CHARACTERISTIC MAF_F_DEC "MAF malf failure/update counter decrement value" VALUE 0x5D2B8 SD_SLONG 0 SC_MAF_F_DEC 0 65535 /end CHARACTERISTIC
/begin COMPU_METHOD SC_MAF_F_DEC "MAF_F_DEC conversion" RAT_FUNC "%10.0" "unitless" COEFFS 0 1 0 0 0 1 /end COMPU_METHOD
/begin CHARACTERISTIC MAF_F_INC "MAF out of range failure increment value" VALUE 0x5D2BC SD_SLONG 0 SC_MAF_F_INC 0 65535 /end CHARACTERISTIC
/begin COMPU_METHOD SC_MAF_F_INC "MAF_F_INC conversion" RAT_FUNC "%10.0" "unitless" COEFFS 0 1 0 0 0 1 /end COMPU_METHOD
/begin MEASUREMENT MAF_F_ORH "MAF out of range high fault" UBYTE MC_MAF_F_ORH 0 0 0 0 ECU_ADDRESS 0x3FA15E /end MEASUREMENT
/begin COMPU_METHOD MC_MAF_F_ORH "MAF_F_ORH conversion" RAT_FUNC "%3.0" "Unitless" COEFFS 0 1 0 0 0 1 /end COMPU_METHOD
/begin MEASUREMENT MAF_F_ORL "MAF out of range low fault" UBYTE MC_MAF_F_ORL 0 0 0 0 ECU_ADDRESS 0x3FA15D /end MEASUREMENT
/begin COMPU_METHOD MC_MAF_F_ORL "MAF_F_ORL conversion" RAT_FUNC "%3.0" "Unitless" COEFFS 0 1 0 0 0 1 /end COMPU_METHOD
/begin MEASUREMENT MAF_GMS "Filtered Mass Air Flow, in grams/second" FLOAT32_IEEE MC_MAF_GMS 0 0 0 0 ECU_ADDRESS 0x3FA148 /end MEASUREMENT
/begin COMPU_METHOD MC_MAF_GMS "MAF_GMS conversion" RAT_FUNC "%10.5" "Unitless" COEFFS 0 1 0 0 0 1 /end COMPU_METHOD
/begin MEASUREMENT MAF_GMS_COMP "Mass Air Flow compensated for air temperature, in grams/second" FLOAT32_IEEE MC_MAF_GMS_COMP 0 0 0 0 ECU_ADDRESS 0x3FA144 /end MEASUREMENT
/begin COMPU_METHOD MC_MAF_GMS_COMP "MAF_GMS_COMP conversion" RAT_FUNC "%10.5" "Unitless" COEFFS 0 1 0 0 0 1 /end COMPU_METHOD
/begin CHARACTERISTIC MAF_HI_ER_DS "MAFS test upper limit" VALUE 0x5C700 SD_FLOAT32_IEEE 0 SC_MAF_HI_ER_DS 0 1023 /end CHARACTERISTIC
/begin COMPU_METHOD SC_MAF_HI_ER_DS "MAF_HI_ER_DS conversion" RAT_FUNC "%10.5" "COUNTS" COEFFS 0 1 0 0 0 1 /end COMPU_METHOD
/begin MEASUREMENT MAF_INT "Flag set when intermittent is detected on the MAF sensor." UBYTE MC_MAF_INT 0 0 0 0 ECU_ADDRESS 0x3F9E50 /end MEASUREMENT
/begin COMPU_METHOD MC_MAF_INT "MAF_INT conversion" RAT_FUNC "%3.0" "Unitless" COEFFS 0 1 0 0 0 1 /end COMPU_METHOD
/begin MEASUREMENT MAF_LO_LMN " mass air flow limit value to update maf_status" FLOAT32_IEEE MC_MAF_LO_LMN 0 0 0 0 ECU_ADDRESS 0x3F99A8 /end MEASUREMENT
/begin COMPU_METHOD MC_MAF_LO_LMN "MAF_LO_LMN conversion" RAT_FUNC "%10.5" "Unitless" COEFFS 0 1 0 0 0 1 /end COMPU_METHOD
/begin CHARACTERISTIC MAF_LVL "Fault level for intermittent MAF sensor." VALUE 0x5CE55 SD_UBYTE 0 SC_MAF_LVL 0 255 /end CHARACTERISTIC
/begin COMPU_METHOD SC_MAF_LVL "MAF_LVL conversion" RAT_FUNC "%3.0" "LEVEL" COEFFS 0 1 0 0 0 1 /end COMPU_METHOD
/begin MEASUREMENT MAF_MALF_SET "Indicate MAF malf  high or low failure" UBYTE MC_MAF_MALF_SET 0 0 0 0 ECU_ADDRESS 0x3FA15A /end MEASUREMENT
/begin COMPU_METHOD MC_MAF_MALF_SET "MAF_MALF_SET conversion" RAT_FUNC "%3.0" "Unitless" COEFFS 0 1 0 0 0 1 /end COMPU_METHOD
/begin MEASUREMENT MAF_MG_STK "Mass air flow, in mg/stk" FLOAT32_IEEE MC_MAF_MG_STK 0 0 0 0 ECU_ADDRESS 0x3FA14C /end MEASUREMENT
/begin COMPU_METHOD MC_MAF_MG_STK "MAF_MG_STK conversion" RAT_FUNC "%10.5" "Unitless" COEFFS 0 1 0 0 0 1 /end COMPU_METHOD
/begin MEASUREMENT MAF_MULTLOOKUP "Mass Air Flow temperature compensation multiplier" FLOAT32_IEEE MC_MAF_MULTLOOKUP 0 0 0 0 ECU_ADDRESS 0x3FA128 /end MEASUREMENT
/begin COMPU_METHOD MC_MAF_MULTLOOKUP "MAF_MULTLOOKUP conversion" RAT_FUNC "%10.5" "Unitless" COEFFS 0 1 0 0 0 1 /end COMPU_METHOD
/begin MEASUREMENT MAF_NMAX_UPD_CNTR "MAF rpm maximum update counter" SLONG MC_MAF_NMAX_UPD_CNTR 0 0 0 0 ECU_ADDRESS 0x3FA120 /end MEASUREMENT
/begin COMPU_METHOD MC_MAF_NMAX_UPD_CNTR "MAF_NMAX_UPD_CNTR conversion" RAT_FUNC "%10.0" "Unitless" COEFFS 0 1 0 0 0 1 /end COMPU_METHOD
/begin MEASUREMENT MAF_N_MAX "MAF rpm maximum" FLOAT32_IEEE MC_MAF_N_MAX 0 0 0 0 ECU_ADDRESS 0x3FA11C /end MEASUREMENT
/begin COMPU_METHOD MC_MAF_N_MAX "MAF_N_MAX conversion" RAT_FUNC "%10.5" "Unitless" COEFFS 0 1 0 0 0 1 /end COMPU_METHOD
/begin MEASUREMENT MAF_N_MAX_CNTR "MAF rpm maximum counter" SLONG MC_MAF_N_MAX_CNTR 0 0 0 0 ECU_ADDRESS 0x3FA124 /end MEASUREMENT
/begin COMPU_METHOD MC_MAF_N_MAX_CNTR "MAF_N_MAX_CNTR conversion" RAT_FUNC "%10.0" "Unitless" COEFFS 0 1 0 0 0 1 /end COMPU_METHOD
/begin MEASUREMENT MAF_ORH_CNTR "Mass Air Flow out of range high counter" SLONG MC_MAF_ORH_CNTR 0 0 0 0 ECU_ADDRESS 0x3FA13C /end MEASUREMENT
/begin COMPU_METHOD MC_MAF_ORH_CNTR "MAF_ORH_CNTR conversion" RAT_FUNC "%10.0" "Unitless" COEFFS 0 1 0 0 0 1 /end COMPU_METHOD
/begin MEASUREMENT MAF_ORL_CNTR "Mass Air Flow out of range low counter" SLONG MC_MAF_ORL_CNTR 0 0 0 0 ECU_ADDRESS 0x3FA138 /end MEASUREMENT
/begin COMPU_METHOD MC_MAF_ORL_CNTR "MAF_ORL_CNTR conversion" RAT_FUNC "%10.0" "Unitless" COEFFS 0 1 0 0 0 1 /end COMPU_METHOD
/begin MEASUREMENT MAF_RAW "Sampled air mass flow rate, lbm/min" FLOAT32_IEEE MC_MAF_RAW 0 0 0 0 ECU_ADDRESS 0x3F99AC /end MEASUREMENT
/begin COMPU_METHOD MC_MAF_RAW "MAF_RAW conversion" RAT_FUNC "%10.5" "Unitless" COEFFS 0 1 0 0 0 1 /end COMPU_METHOD
/begin CHARACTERISTIC MAF_REC_INC "MAF fault recovery counter increment value" VALUE 0x5D2AC SD_SLONG 0 SC_MAF_REC_INC 0 65535 /end CHARACTERISTIC
/begin COMPU_METHOD SC_MAF_REC_INC "MAF_REC_INC conversion" RAT_FUNC "%10.0" "unitless" COEFFS 0 1 0 0 0 1 /end COMPU_METHOD
/begin MEASUREMENT MAF_STATUS "Status of Mass Air Flow high level driver ( 0 = ok )" UBYTE MC_MAF_STATUS 0 0 0 0 ECU_ADDRESS 0x3F99B8 /end MEASUREMENT
/begin COMPU_METHOD MC_MAF_STATUS "MAF_STATUS conversion" RAT_FUNC "%3.0" "Unitless" COEFFS 0 1 0 0 0 1 /end COMPU_METHOD
/begin CHARACTERISTIC MAF_TCREC_SEL "Switch to select MAF filter time constant during fault recovery and during fault occurance before malf is set" VALUE 0x5D2C0 SD_UBYTE 0 SC_MAF_TCREC_SEL 0 1 /end CHARACTERISTIC
/begin COMPU_METHOD SC_MAF_TCREC_SEL "MAF_TCREC_SEL conversion" RAT_FUNC "%3.0" "unitless" COEFFS 0 1 0 0 0 1 /end COMPU_METHOD
/begin CHARACTERISTIC MAIN_CLOSE "" VALUE 0x5D430 SD_FLOAT32_IEEE 0 SC_MAIN_CLOSE 0 65535 /end CHARACTERISTIC
/begin COMPU_METHOD SC_MAIN_CLOSE "MAIN_CLOSE conversion" RAT_FUNC "%10.5" "unitless" COEFFS 0 1 0 0 0 1 /end COMPU_METHOD
/begin CHARACTERISTIC MAIN_DURATION "" VALUE 0x5D434 SD_FLOAT32_IEEE 0 SC_MAIN_DURATION 0 65535 /end CHARACTERISTIC
/begin COMPU_METHOD SC_MAIN_DURATION "MAIN_DURATION conversion" RAT_FUNC "%10.5" "unitless" COEFFS 0 1 0 0 0 1 /end COMPU_METHOD
/begin CHARACTERISTIC MAIN_OPEN "" VALUE 0x5D438 SD_FLOAT32_IEEE 0 SC_MAIN_OPEN 0 65535 /end CHARACTERISTIC
/begin COMPU_METHOD SC_MAIN_OPEN "MAIN_OPEN conversion" RAT_FUNC "%10.5" "unitless" COEFFS 0 1 0 0 0 1 /end COMPU_METHOD
/begin MEASUREMENT MAIN_PW "" UWORD MC_MAIN_PW 0 0 0 0 ECU_ADDRESS 0x3FB6D0 /end MEASUREMENT
/begin COMPU_METHOD MC_MAIN_PW "MAIN_PW conversion" RAT_FUNC "%5.0" "Unitless" COEFFS 0 1 0 0 0 1 /end COMPU_METHOD
/begin CHARACTERISTIC MAPBP_TOLERR "Differential limit of MAP and BP  for ARA FMEM" VALUE 0x5D6EC SD_FLOAT32_IEEE 0 SC_MAPBP_TOLERR 0 100 /end CHARACTERISTIC
/begin COMPU_METHOD SC_MAPBP_TOLERR "MAPBP_TOLERR conversion" RAT_FUNC "%10.5" "kPa" COEFFS 0 1 0 0 0 1 /end COMPU_METHOD
/begin CHARACTERISTIC MAPEBP_TOLERR "Differential limit of MAP and EBP for ARA FMEM" VALUE 0x5D6F4 SD_FLOAT32_IEEE 0 SC_MAPEBP_TOLERR 0 100 /end CHARACTERISTIC
/begin COMPU_METHOD SC_MAPEBP_TOLERR "MAPEBP_TOLERR conversion" RAT_FUNC "%10.5" "kPa" COEFFS 0 1 0 0 0 1 /end COMPU_METHOD
/begin CHARACTERISTIC MAPTURB_TM "Timer value for connection hose off test" VALUE 0x5D328 SD_FLOAT32_IEEE 0 SC_MAPTURB_TM 0 500 /end CHARACTERISTIC
/begin COMPU_METHOD SC_MAPTURB_TM "MAPTURB_TM conversion" RAT_FUNC "%10.5" "s" COEFFS 0 1 0 0 0 1 /end COMPU_METHOD
/begin CHARACTERISTIC MAPTURB_UPD_TM "Update  Timer value for connection hose off test" VALUE 0x5D324 SD_FLOAT32_IEEE 0 SC_MAPTURB_UPD_TM 0 500 /end CHARACTERISTIC
/begin COMPU_METHOD SC_MAPTURB_UPD_TM "MAPTURB_UPD_TM conversion" RAT_FUNC "%10.5" "s" COEFFS 0 1 0 0 0 1 /end COMPU_METHOD
/begin MEASUREMENT MAP_ACQ_TMR "MAP acquire timer" FLOAT32_IEEE MC_MAP_ACQ_TMR 0 0 0 0 ECU_ADDRESS 0x3FA190 /end MEASUREMENT
/begin COMPU_METHOD MC_MAP_ACQ_TMR "MAP_ACQ_TMR conversion" RAT_FUNC "%10.5" "Unitless" COEFFS 0 1 0 0 0 1 /end COMPU_METHOD
/begin CHARACTERISTIC MAP_AD_TC "Manifold pressure filter time constant" VALUE 0x5D390 SD_FLOAT32_IEEE 0 SC_MAP_AD_TC 0 64 /end CHARACTERISTIC
/begin COMPU_METHOD SC_MAP_AD_TC "MAP_AD_TC conversion" RAT_FUNC "%10.5" "s" COEFFS 0 1 0 0 0 1 /end COMPU_METHOD
/begin CHARACTERISTIC MAP_BP_DELTA "Bp In-Range Threshold" VALUE 0x5D360 SD_FLOAT32_IEEE 0 SC_MAP_BP_DELTA 0 500 /end CHARACTERISTIC
/begin COMPU_METHOD SC_MAP_BP_DELTA "MAP_BP_DELTA conversion" RAT_FUNC "%10.5" "kPa" COEFFS 0 1 0 0 0 1 /end COMPU_METHOD
/begin MEASUREMENT MAP_BP_POWER_UP "Power Up init flag" UBYTE MC_MAP_BP_POWER_UP 0 0 0 0 ECU_ADDRESS 0x3FA1DE /end MEASUREMENT
/begin COMPU_METHOD MC_MAP_BP_POWER_UP "MAP_BP_POWER_UP conversion" RAT_FUNC "%3.0" "Unitless" COEFFS 0 1 0 0 0 1 /end COMPU_METHOD
/begin MEASUREMENT MAP_BP_SENSOR_NO_MALF "Enable flag for capturing bp and map KOEO values" UBYTE MC_MAP_BP_SENSOR_NO_MALF 0 0 0 0 ECU_ADDRESS 0x3FA1DC /end MEASUREMENT
/begin COMPU_METHOD MC_MAP_BP_SENSOR_NO_MALF "MAP_BP_SENSOR_NO_MALF conversion" RAT_FUNC "%3.0" "Unitless" COEFFS 0 1 0 0 0 1 /end COMPU_METHOD
/begin CHARACTERISTIC MAP_DEL_EGRP_MX "" VALUE 0x5D318 SD_FLOAT32_IEEE 0 SC_MAP_DEL_EGRP_MX 0 1 /end CHARACTERISTIC
/begin COMPU_METHOD SC_MAP_DEL_EGRP_MX "MAP_DEL_EGRP_MX conversion" RAT_FUNC "%10.5" "unitless" COEFFS 0 1 0 0 0 1 /end COMPU_METHOD
/begin CHARACTERISTIC MAP_DLY_TM "Min. Time for enabling in range after desired rpm and mfdes condn. met" VALUE 0x5D368 SD_FLOAT32_IEEE 0 SC_MAP_DLY_TM 0 255 /end CHARACTERISTIC
/begin COMPU_METHOD SC_MAP_DLY_TM "MAP_DLY_TM conversion" RAT_FUNC "%10.5" "s" COEFFS 0 1 0 0 0 1 /end COMPU_METHOD
/begin MEASUREMENT MAP_DLY_TMR "Timer used for turbo delay timing" FLOAT32_IEEE MC_MAP_DLY_TMR 0 0 0 0 ECU_ADDRESS 0x3FA19C /end MEASUREMENT
/begin COMPU_METHOD MC_MAP_DLY_TMR "MAP_DLY_TMR conversion" RAT_FUNC "%10.5" "Unitless" COEFFS 0 1 0 0 0 1 /end COMPU_METHOD
/begin MEASUREMENT MAP_ENG_KPA "MAP engineering Value" FLOAT32_IEEE MC_MAP_ENG_KPA 0 0 0 0 ECU_ADDRESS 0x3FA1D4 /end MEASUREMENT
/begin COMPU_METHOD MC_MAP_ENG_KPA "MAP_ENG_KPA conversion" RAT_FUNC "%10.5" "Unitless" COEFFS 0 1 0 0 0 1 /end COMPU_METHOD
/begin MEASUREMENT MAP_ENG_KPA_OFFS "Engineering value with pdif_map_ref_add" FLOAT32_IEEE MC_MAP_ENG_KPA_OFFS 0 0 0 0 ECU_ADDRESS 0x3FA1D0 /end MEASUREMENT
/begin COMPU_METHOD MC_MAP_ENG_KPA_OFFS "MAP_ENG_KPA_OFFS conversion" RAT_FUNC "%10.5" "Unitless" COEFFS 0 1 0 0 0 1 /end COMPU_METHOD
/begin MEASUREMENT MAP_FIL "Intermittent fault filter for the MAP sensor." UBYTE MC_MAP_FIL 0 0 0 0 ECU_ADDRESS 0x3F9E51 /end MEASUREMENT
/begin COMPU_METHOD MC_MAP_FIL "MAP_FIL conversion" RAT_FUNC "%3.0" "Unitless" COEFFS 0 1 0 0 0 1 /end COMPU_METHOD
/begin MEASUREMENT MAP_FILT_TIME_CONST "MAP  filter time constant" FLOAT32_IEEE MC_MAP_FILT_TIME_CONST 0 0 0 0 ECU_ADDRESS 0x3FA1B4 /end MEASUREMENT
/begin COMPU_METHOD MC_MAP_FILT_TIME_CONST "MAP_FILT_TIME_CONST conversion" RAT_FUNC "%10.5" "Unitless" COEFFS 0 1 0 0 0 1 /end COMPU_METHOD
/begin MEASUREMENT MAP_FIL_MAX "HIGHEST VALUE THE FUALT FILTER MAP_FIL SEES" UBYTE MC_MAP_FIL_MAX 0 0 0 0 ECU_ADDRESS 0x3FCCFC /end MEASUREMENT
/begin COMPU_METHOD MC_MAP_FIL_MAX "MAP_FIL_MAX conversion" RAT_FUNC "%3.0" "Unitless" COEFFS 0 1 0 0 0 1 /end COMPU_METHOD
/begin MEASUREMENT MAP_FLT_RECOVERY_CNTR "MAP fault recovery counter" SLONG MC_MAP_FLT_RECOVERY_CNTR 0 0 0 0 ECU_ADDRESS 0x3FA1B8 /end MEASUREMENT
/begin COMPU_METHOD MC_MAP_FLT_RECOVERY_CNTR "MAP_FLT_RECOVERY_CNTR conversion" RAT_FUNC "%10.0" "Unitless" COEFFS 0 1 0 0 0 1 /end COMPU_METHOD
/begin MEASUREMENT MAP_FLT_RECOVERY_FLG "1-> Indicates MAP fault recovery is occuring" UBYTE MC_MAP_FLT_RECOVERY_FLG 0 0 0 0 ECU_ADDRESS 0x3FA1E5 /end MEASUREMENT
/begin COMPU_METHOD MC_MAP_FLT_RECOVERY_FLG "MAP_FLT_RECOVERY_FLG conversion" RAT_FUNC "%3.0" "Unitless" COEFFS 0 1 0 0 0 1 /end COMPU_METHOD
/begin CHARACTERISTIC MAP_F_DEC "MAP malf failure/update counter decrement value" VALUE 0x5D384 SD_SLONG 0 SC_MAP_F_DEC 0 65535 /end CHARACTERISTIC
/begin COMPU_METHOD SC_MAP_F_DEC "MAP_F_DEC conversion" RAT_FUNC "%10.0" "unitless" COEFFS 0 1 0 0 0 1 /end COMPU_METHOD
/begin CHARACTERISTIC MAP_F_INC "MAP ORH/ORL failure counter increment value" VALUE 0x5D388 SD_SLONG 0 SC_MAP_F_INC 0 65535 /end CHARACTERISTIC
/begin COMPU_METHOD SC_MAP_F_INC "MAP_F_INC conversion" RAT_FUNC "%10.0" "unitless" COEFFS 0 1 0 0 0 1 /end COMPU_METHOD
/begin MEASUREMENT MAP_F_ORH "Manifold Absolute Pressure out of range high fail" UBYTE MC_MAP_F_ORH 0 0 0 0 ECU_ADDRESS 0x3FA1EB /end MEASUREMENT
/begin COMPU_METHOD MC_MAP_F_ORH "MAP_F_ORH conversion" RAT_FUNC "%3.0" "Unitless" COEFFS 0 1 0 0 0 1 /end COMPU_METHOD
/begin MEASUREMENT MAP_F_ORL "Manifold Absolute Pressure out of range low fail" UBYTE MC_MAP_F_ORL 0 0 0 0 ECU_ADDRESS 0x3FA1EA /end MEASUREMENT
/begin COMPU_METHOD MC_MAP_F_ORL "MAP_F_ORL conversion" RAT_FUNC "%3.0" "Unitless" COEFFS 0 1 0 0 0 1 /end COMPU_METHOD
/begin CHARACTERISTIC MAP_HI_VOLTS "MAP sensor over  voltage test  limit" VALUE 0x5C588 SD_FLOAT32_IEEE 0 SC_MAP_HI_VOLTS 0 5 /end CHARACTERISTIC
/begin COMPU_METHOD SC_MAP_HI_VOLTS "MAP_HI_VOLTS conversion" RAT_FUNC "%10.5" "V" COEFFS 0 1 0 0 0 1 /end COMPU_METHOD
/begin CHARACTERISTIC MAP_HOSE_DEL "MAP threshold value to declare turbo charger hose off" VALUE 0x5D348 SD_FLOAT32_IEEE 0 SC_MAP_HOSE_DEL 0 500 /end CHARACTERISTIC
/begin COMPU_METHOD SC_MAP_HOSE_DEL "MAP_HOSE_DEL conversion" RAT_FUNC "%10.5" "kPa" COEFFS 0 1 0 0 0 1 /end COMPU_METHOD
/begin CHARACTERISTIC MAP_IDL_RATE "Idle RPM rate" VALUE 0x5D34C SD_FLOAT32_IEEE 0 SC_MAP_IDL_RATE 0 8000 /end CHARACTERISTIC
/begin COMPU_METHOD SC_MAP_IDL_RATE "MAP_IDL_RATE conversion" RAT_FUNC "%10.5" "RPM" COEFFS 0 1 0 0 0 1 /end COMPU_METHOD
/begin CHARACTERISTIC MAP_IDL_SAMP "Idle RPM threshold for in-range monitor" VALUE 0x5D350 SD_FLOAT32_IEEE 0 SC_MAP_IDL_SAMP 0 8000 /end CHARACTERISTIC
/begin COMPU_METHOD SC_MAP_IDL_SAMP "MAP_IDL_SAMP conversion" RAT_FUNC "%10.5" "RPM" COEFFS 0 1 0 0 0 1 /end COMPU_METHOD
/begin MEASUREMENT MAP_INT "--" UBYTE MC_MAP_INT 0 0 0 0 ECU_ADDRESS 0x3F9E52 /end MEASUREMENT
/begin COMPU_METHOD MC_MAP_INT "MAP_INT conversion" RAT_FUNC "%3.0" "Unitless" COEFFS 0 1 0 0 0 1 /end COMPU_METHOD
/begin MEASUREMENT MAP_IR_CNTR "MAP Sensor In-Range fault counter" SLONG MC_MAP_IR_CNTR 0 0 0 0 ECU_ADDRESS 0x3FA198 /end MEASUREMENT
/begin COMPU_METHOD MC_MAP_IR_CNTR "MAP_IR_CNTR conversion" RAT_FUNC "%10.0" "Unitless" COEFFS 0 1 0 0 0 1 /end COMPU_METHOD
/begin CHARACTERISTIC MAP_IR_F_INC "In-Range increment counter" VALUE 0x5D35C SD_SLONG 0 SC_MAP_IR_F_INC 0 65535 /end CHARACTERISTIC
/begin COMPU_METHOD SC_MAP_IR_F_INC "MAP_IR_F_INC conversion" RAT_FUNC "%10.0" "unitless" COEFFS 0 1 0 0 0 1 /end COMPU_METHOD
/begin CHARACTERISTIC MAP_IR_R_DEC "In-Range decrement counter" VALUE 0x5D358 SD_SLONG 0 SC_MAP_IR_R_DEC 0 65535 /end CHARACTERISTIC
/begin COMPU_METHOD SC_MAP_IR_R_DEC "MAP_IR_R_DEC conversion" RAT_FUNC "%10.0" "unitless" COEFFS 0 1 0 0 0 1 /end COMPU_METHOD
/begin CHARACTERISTIC MAP_IR_THLD "MAP In-Range Threshold" VALUE 0x5D364 SD_FLOAT32_IEEE 0 SC_MAP_IR_THLD 0 500 /end CHARACTERISTIC
/begin COMPU_METHOD SC_MAP_IR_THLD "MAP_IR_THLD conversion" RAT_FUNC "%10.5" "kPa" COEFFS 0 1 0 0 0 1 /end COMPU_METHOD
/begin MEASUREMENT MAP_IR_UPDATE_CNTR "MAP Sensor In-Range fault update counter" SLONG MC_MAP_IR_UPDATE_CNTR 0 0 0 0 ECU_ADDRESS 0x3FA194 /end MEASUREMENT
/begin COMPU_METHOD MC_MAP_IR_UPDATE_CNTR "MAP_IR_UPDATE_CNTR conversion" RAT_FUNC "%10.0" "Unitless" COEFFS 0 1 0 0 0 1 /end COMPU_METHOD
/begin CHARACTERISTIC MAP_KOEO_RPM "N Threshold for capturing bp and map key on value" VALUE 0x5D31C SD_FLOAT32_IEEE 0 SC_MAP_KOEO_RPM 0 8000 /end CHARACTERISTIC
/begin COMPU_METHOD SC_MAP_KOEO_RPM "MAP_KOEO_RPM conversion" RAT_FUNC "%10.5" "RPM" COEFFS 0 1 0 0 0 1 /end COMPU_METHOD
/begin CHARACTERISTIC MAP_KOEO_TM "Min. Time after which KOEO map and bp value are recorded" VALUE 0x5D354 SD_FLOAT32_IEEE 0 SC_MAP_KOEO_TM 0 255 /end CHARACTERISTIC
/begin COMPU_METHOD SC_MAP_KOEO_TM "MAP_KOEO_TM conversion" RAT_FUNC "%10.5" "s" COEFFS 0 1 0 0 0 1 /end COMPU_METHOD
/begin MEASUREMENT MAP_KPA "Manifold Absolute Pressure (in KPA)" FLOAT32_IEEE MC_MAP_KPA 0 0 0 0 ECU_ADDRESS 0x3FA1D8 /end MEASUREMENT
/begin COMPU_METHOD MC_MAP_KPA "MAP_KPA conversion" RAT_FUNC "%10.5" "Unitless" COEFFS 0 1 0 0 0 1 /end COMPU_METHOD
/begin MEASUREMENT MAP_KPA_KON "MAP (kPa) at key on" FLOAT32_IEEE MC_MAP_KPA_KON 0 0 0 0 ECU_ADDRESS 0x3FA18C /end MEASUREMENT
/begin COMPU_METHOD MC_MAP_KPA_KON "MAP_KPA_KON conversion" RAT_FUNC "%10.5" "Unitless" COEFFS 0 1 0 0 0 1 /end COMPU_METHOD
/begin MEASUREMENT MAP_KPA_KYO "MAP(Kpa) at key on" FLOAT32_IEEE MC_MAP_KPA_KYO 0 0 0 0 ECU_ADDRESS 0x3FA1A8 /end MEASUREMENT
/begin COMPU_METHOD MC_MAP_KPA_KYO "MAP_KPA_KYO conversion" RAT_FUNC "%10.5" "Unitless" COEFFS 0 1 0 0 0 1 /end COMPU_METHOD
/begin CHARACTERISTIC MAP_LO_VOLTS "MAP sensor under voltage test  limit" VALUE 0x5C58C SD_FLOAT32_IEEE 0 SC_MAP_LO_VOLTS 0 5 /end CHARACTERISTIC
/begin COMPU_METHOD SC_MAP_LO_VOLTS "MAP_LO_VOLTS conversion" RAT_FUNC "%10.5" "V" COEFFS 0 1 0 0 0 1 /end COMPU_METHOD
/begin CHARACTERISTIC MAP_LVL_CAL "Fault level for intermittent MAP sensor." VALUE 0x5CE54 SD_UBYTE 0 SC_MAP_LVL_CAL 0 255 /end CHARACTERISTIC
/begin COMPU_METHOD SC_MAP_LVL_CAL "MAP_LVL_CAL conversion" RAT_FUNC "%3.0" "LEVEL" COEFFS 0 1 0 0 0 1 /end COMPU_METHOD
/begin MEASUREMENT MAP_MALF_SET "Indicate MAP malf  high or low failure" UBYTE MC_MAP_MALF_SET 0 0 0 0 ECU_ADDRESS 0x3FA1E7 /end MEASUREMENT
/begin COMPU_METHOD MC_MAP_MALF_SET "MAP_MALF_SET conversion" RAT_FUNC "%3.0" "Unitless" COEFFS 0 1 0 0 0 1 /end COMPU_METHOD
/begin CHARACTERISTIC MAP_MF_LO "MFDES below which MAP in range test  disabled in mg/s" VALUE 0x5D36C SD_FLOAT32_IEEE 0 SC_MAP_MF_LO 0 100 /end CHARACTERISTIC
/begin COMPU_METHOD SC_MAP_MF_LO "MAP_MF_LO conversion" RAT_FUNC "%10.5" "unitless" COEFFS 0 1 0 0 0 1 /end COMPU_METHOD
/begin CHARACTERISTIC MAP_N_LO "N below which MAP in-range test disabled" VALUE 0x5D370 SD_FLOAT32_IEEE 0 SC_MAP_N_LO 0 5000 /end CHARACTERISTIC
/begin COMPU_METHOD SC_MAP_N_LO "MAP_N_LO conversion" RAT_FUNC "%10.5" "RPM" COEFFS 0 1 0 0 0 1 /end COMPU_METHOD
/begin CHARACTERISTIC MAP_OFFIDLE "N threshold for turbocharger /hose off test" VALUE 0x5D344 SD_FLOAT32_IEEE 0 SC_MAP_OFFIDLE 0 8000 /end CHARACTERISTIC
/begin COMPU_METHOD SC_MAP_OFFIDLE "MAP_OFFIDLE conversion" RAT_FUNC "%10.5" "RPM" COEFFS 0 1 0 0 0 1 /end COMPU_METHOD
/begin MEASUREMENT MAP_ORH_CNTR "Manifold Pressure out of range high counter" SLONG MC_MAP_ORH_CNTR 0 0 0 0 ECU_ADDRESS 0x3FA1C8 /end MEASUREMENT
/begin COMPU_METHOD MC_MAP_ORH_CNTR "MAP_ORH_CNTR conversion" RAT_FUNC "%10.0" "Unitless" COEFFS 0 1 0 0 0 1 /end COMPU_METHOD
/begin MEASUREMENT MAP_ORL_CNTR "Manifold Pressure out of range low counter" SLONG MC_MAP_ORL_CNTR 0 0 0 0 ECU_ADDRESS 0x3FA1C4 /end MEASUREMENT
/begin COMPU_METHOD MC_MAP_ORL_CNTR "MAP_ORL_CNTR conversion" RAT_FUNC "%10.0" "Unitless" COEFFS 0 1 0 0 0 1 /end COMPU_METHOD
/begin MEASUREMENT MAP_RAW_KPA "Manifold Pressure, without any FMEM correction, kPA" FLOAT32_IEEE MC_MAP_RAW_KPA 0 0 0 0 ECU_ADDRESS 0x3F98E0 /end MEASUREMENT
/begin COMPU_METHOD MC_MAP_RAW_KPA "MAP_RAW_KPA conversion" RAT_FUNC "%10.5" "Unitless" COEFFS 0 1 0 0 0 1 /end COMPU_METHOD
/begin CHARACTERISTIC MAP_REC_INC "MAP fault recovery counter increment value" VALUE 0x5D380 SD_SLONG 0 SC_MAP_REC_INC 0 65535 /end CHARACTERISTIC
/begin COMPU_METHOD SC_MAP_REC_INC "MAP_REC_INC conversion" RAT_FUNC "%10.0" "unitless" COEFFS 0 1 0 0 0 1 /end COMPU_METHOD
/begin MEASUREMENT MAP_STATUS "Status of Manifold Pressure high level driver ( 0 = ok )" UBYTE MC_MAP_STATUS 0 0 0 0 ECU_ADDRESS 0x3F98EC /end MEASUREMENT
/begin COMPU_METHOD MC_MAP_STATUS "MAP_STATUS conversion" RAT_FUNC "%3.0" "Unitless" COEFFS 0 1 0 0 0 1 /end COMPU_METHOD
/begin CHARACTERISTIC MAP_TCREC_SEL "Switch to select MAP filter time constant during fault recovery and during fault occurance before malf is set" VALUE 0x5D394 SD_UBYTE 0 SC_MAP_TCREC_SEL 0 1 /end CHARACTERISTIC
/begin COMPU_METHOD SC_MAP_TCREC_SEL "MAP_TCREC_SEL conversion" RAT_FUNC "%3.0" "unitless" COEFFS 0 1 0 0 0 1 /end COMPU_METHOD
/begin CHARACTERISTIC MAP_TM "Timer value for turbo charger hose off test" VALUE 0x5D33C SD_FLOAT32_IEEE 0 SC_MAP_TM 0 100 /end CHARACTERISTIC
/begin COMPU_METHOD SC_MAP_TM "MAP_TM conversion" RAT_FUNC "%10.5" "s" COEFFS 0 1 0 0 0 1 /end COMPU_METHOD
/begin CHARACTERISTIC MAP_TURBRPM "RPM value for connection hose off test" VALUE 0x5D330 SD_FLOAT32_IEEE 0 SC_MAP_TURBRPM 0 8000 /end CHARACTERISTIC
/begin COMPU_METHOD SC_MAP_TURBRPM "MAP_TURBRPM conversion" RAT_FUNC "%10.5" "RPM" COEFFS 0 1 0 0 0 1 /end COMPU_METHOD
/begin CHARACTERISTIC MAP_TURB_DEL "MAP threshold value to declare turbo charger hose off" VALUE 0x5D334 SD_FLOAT32_IEEE 0 SC_MAP_TURB_DEL 0 500 /end CHARACTERISTIC
/begin COMPU_METHOD SC_MAP_TURB_DEL "MAP_TURB_DEL conversion" RAT_FUNC "%10.5" "kPa" COEFFS 0 1 0 0 0 1 /end COMPU_METHOD
/begin CHARACTERISTIC MAP_UPD_TM "Update Timer value for turbo charger hose off test" VALUE 0x5D338 SD_FLOAT32_IEEE 0 SC_MAP_UPD_TM 0 100 /end CHARACTERISTIC
/begin COMPU_METHOD SC_MAP_UPD_TM "MAP_UPD_TM conversion" RAT_FUNC "%10.5" "s" COEFFS 0 1 0 0 0 1 /end COMPU_METHOD
/begin CHARACTERISTIC MAP_VF_HOSE "VFDES threshold for turbo charger hose off test" VALUE 0x5D340 SD_FLOAT32_IEEE 0 SC_MAP_VF_HOSE 0 4095 /end CHARACTERISTIC
/begin COMPU_METHOD SC_MAP_VF_HOSE "MAP_VF_HOSE conversion" RAT_FUNC "%10.5" "(mm)3" COEFFS 0 1 0 0 0 1 /end COMPU_METHOD
/begin CHARACTERISTIC MAP_VF_TURB "vfdes threshold for connection hose off test" VALUE 0x5D32C SD_FLOAT32_IEEE 0 SC_MAP_VF_TURB 0 4095 /end CHARACTERISTIC
/begin COMPU_METHOD SC_MAP_VF_TURB "MAP_VF_TURB conversion" RAT_FUNC "%10.5" "(mm)3" COEFFS 0 1 0 0 0 1 /end COMPU_METHOD
/begin MEASUREMENT MAP_VOLTAGE "MAP sensor voltage seen at A to D input channel" FLOAT32_IEEE MC_MAP_VOLTAGE 0 0 0 0 ECU_ADDRESS 0x3F98E4 /end MEASUREMENT
/begin COMPU_METHOD MC_MAP_VOLTAGE "MAP_VOLTAGE conversion" RAT_FUNC "%10.5" "Unitless" COEFFS 0 1 0 0 0 1 /end COMPU_METHOD
/begin MEASUREMENT MAP_VOLTS "MAP sensor voltage seen at A to D input channel" FLOAT32_IEEE MC_MAP_VOLTS 0 0 0 0 ECU_ADDRESS 0x3F98E8 /end MEASUREMENT
/begin COMPU_METHOD MC_MAP_VOLTS "MAP_VOLTS conversion" RAT_FUNC "%10.5" "Unitless" COEFFS 0 1 0 0 0 1 /end COMPU_METHOD
/begin MEASUREMENT MAT "Manifold Absolute Temperature. (DEGREES C)" FLOAT32_IEEE MC_MAT 0 0 0 0 ECU_ADDRESS 0x3FA210 /end MEASUREMENT
/begin COMPU_METHOD MC_MAT "MAT conversion" RAT_FUNC "%10.5" "Unitless" COEFFS 0 1 0 0 0 1 /end COMPU_METHOD
/begin CHARACTERISTIC MATEOTCLDENG "cold engine oil temperature limit . (DEGREES C)" VALUE 0x5D754 SD_FLOAT32_IEEE 0 SC_MATEOTCLDENG -8192 8191 /end CHARACTERISTIC
/begin COMPU_METHOD SC_MATEOTCLDENG "MATEOTCLDENG conversion" RAT_FUNC "%10.5" "degC" COEFFS 0 1 0 0 0 1 /end COMPU_METHOD
/begin CHARACTERISTIC MATEOTWRMENG "warm engine oil temperature limit . (DEGREES C)" VALUE 0x5D750 SD_FLOAT32_IEEE 0 SC_MATEOTWRMENG -8192 8191 /end CHARACTERISTIC
/begin COMPU_METHOD SC_MATEOTWRMENG "MATEOTWRMENG conversion" RAT_FUNC "%10.5" "degC" COEFFS 0 1 0 0 0 1 /end COMPU_METHOD
/begin CHARACTERISTIC MATWARMUPCNT "p0096 malfunction count limit." VALUE 0x5D76C SD_UBYTE 0 SC_MATWARMUPCNT 0 255 /end CHARACTERISTIC
/begin COMPU_METHOD SC_MATWARMUPCNT "MATWARMUPCNT conversion" RAT_FUNC "%3.0" "unitless" COEFFS 0 1 0 0 0 1 /end COMPU_METHOD
/begin CHARACTERISTIC MAT_AC_OFF "MAT above which cutoff is active" VALUE 0x5CBC4 SD_FLOAT32_IEEE 0 SC_MAT_AC_OFF -110 110 /end CHARACTERISTIC
/begin COMPU_METHOD SC_MAT_AC_OFF "MAT_AC_OFF conversion" RAT_FUNC "%10.5" "degC" COEFFS 0 1 0 0 0 1 /end COMPU_METHOD
/begin CHARACTERISTIC MAT_AD_TC "Manifold temperature filter time constant" VALUE 0x5D39C SD_FLOAT32_IEEE 0 SC_MAT_AD_TC 0 64 /end CHARACTERISTIC
/begin COMPU_METHOD SC_MAT_AD_TC "MAT_AD_TC conversion" RAT_FUNC "%10.5" "s" COEFFS 0 1 0 0 0 1 /end COMPU_METHOD
/begin CHARACTERISTIC MAT_CHANGE "mat tolerence value to determine sensor failure." VALUE 0x5D758 SD_FLOAT32_IEEE 0 SC_MAT_CHANGE 0 1000 /end CHARACTERISTIC
/begin COMPU_METHOD SC_MAT_CHANGE "MAT_CHANGE conversion" RAT_FUNC "%10.5" "degC" COEFFS 0 1 0 0 0 1 /end COMPU_METHOD
/begin MEASUREMENT MAT_CNTS "Manifold Air Temperature A/D input." SLONG MC_MAT_CNTS 0 0 0 0 ECU_ADDRESS 0x3F98B4 /end MEASUREMENT
/begin COMPU_METHOD MC_MAT_CNTS "MAT_CNTS conversion" RAT_FUNC "%10.0" "Unitless" COEFFS 0 1 0 0 0 1 /end COMPU_METHOD
/begin CHARACTERISTIC MAT_DEF "Default FMEM value for manifold temperature" VALUE 0x5D3A4 SD_FLOAT32_IEEE 0 SC_MAT_DEF -40 150 /end CHARACTERISTIC
/begin COMPU_METHOD SC_MAT_DEF "MAT_DEF conversion" RAT_FUNC "%10.5" "degC" COEFFS 0 1 0 0 0 1 /end COMPU_METHOD
/begin MEASUREMENT MAT_ENG_C "Engine Coolant Temperature without any FMEM modifications, degrees C" FLOAT32_IEEE MC_MAT_ENG_C 0 0 0 0 ECU_ADDRESS 0x3F98B8 /end MEASUREMENT
/begin COMPU_METHOD MC_MAT_ENG_C "MAT_ENG_C conversion" RAT_FUNC "%10.5" "Unitless" COEFFS 0 1 0 0 0 1 /end COMPU_METHOD
/begin MEASUREMENT MAT_FILT_TIME_CONST "MAT filter time constant" FLOAT32_IEEE MC_MAT_FILT_TIME_CONST 0 0 0 0 ECU_ADDRESS 0x3FA204 /end MEASUREMENT
/begin COMPU_METHOD MC_MAT_FILT_TIME_CONST "MAT_FILT_TIME_CONST conversion" RAT_FUNC "%10.5" "Unitless" COEFFS 0 1 0 0 0 1 /end COMPU_METHOD
/begin MEASUREMENT MAT_FLT_RECOVERY_CNTR "MAT fault recovery counter" SLONG MC_MAT_FLT_RECOVERY_CNTR 0 0 0 0 ECU_ADDRESS 0x3FA1F0 /end MEASUREMENT
/begin COMPU_METHOD MC_MAT_FLT_RECOVERY_CNTR "MAT_FLT_RECOVERY_CNTR conversion" RAT_FUNC "%10.0" "Unitless" COEFFS 0 1 0 0 0 1 /end COMPU_METHOD
/begin MEASUREMENT MAT_FLT_RECOVERY_FLG "1-> Indicates MAT fault recovery is occuring" UBYTE MC_MAT_FLT_RECOVERY_FLG 0 0 0 0 ECU_ADDRESS 0x3FA214 /end MEASUREMENT
/begin COMPU_METHOD MC_MAT_FLT_RECOVERY_FLG "MAT_FLT_RECOVERY_FLG conversion" RAT_FUNC "%3.0" "Unitless" COEFFS 0 1 0 0 0 1 /end COMPU_METHOD
/begin CHARACTERISTIC MAT_F_DEC "MAT malf failure/update counter decrement value" VALUE 0x5D3D4 SD_SLONG 0 SC_MAT_F_DEC 0 65535 /end CHARACTERISTIC
/begin COMPU_METHOD SC_MAT_F_DEC "MAT_F_DEC conversion" RAT_FUNC "%10.0" "unitless" COEFFS 0 1 0 0 0 1 /end COMPU_METHOD
/begin CHARACTERISTIC MAT_F_INC "MAT ORH/ORL failure counter increment value" VALUE 0x5D3D8 SD_SLONG 0 SC_MAT_F_INC 0 65535 /end CHARACTERISTIC
/begin COMPU_METHOD SC_MAT_F_INC "MAT_F_INC conversion" RAT_FUNC "%10.0" "unitless" COEFFS 0 1 0 0 0 1 /end COMPU_METHOD
/begin CHARACTERISTIC MAT_HI_VOLTS "Maximum acceptable voltage for MAT sensor" VALUE 0x5C528 SD_FLOAT32_IEEE 0 SC_MAT_HI_VOLTS 0 5 /end CHARACTERISTIC
/begin COMPU_METHOD SC_MAT_HI_VOLTS "MAT_HI_VOLTS conversion" RAT_FUNC "%10.5" "V" COEFFS 0 1 0 0 0 1 /end COMPU_METHOD
/begin MEASUREMENT MAT_KAM "Manifold Absolute Temperature stored in KAM." FLOAT32_IEEE MC_MAT_KAM 0 0 0 0 ECU_ADDRESS 0x3FCDA4 /end MEASUREMENT
/begin COMPU_METHOD MC_MAT_KAM "MAT_KAM conversion" RAT_FUNC "%10.5" "Unitless" COEFFS 0 1 0 0 0 1 /end COMPU_METHOD
/begin CHARACTERISTIC MAT_LO_VOLTS "Minimum acceptable voltage for MAT sensor" VALUE 0x5C52C SD_FLOAT32_IEEE 0 SC_MAT_LO_VOLTS 0 5 /end CHARACTERISTIC
/begin COMPU_METHOD SC_MAT_LO_VOLTS "MAT_LO_VOLTS conversion" RAT_FUNC "%10.5" "V" COEFFS 0 1 0 0 0 1 /end COMPU_METHOD
/begin MEASUREMENT MAT_MALF_SET "Indicate MAT malf  high or low failure" UBYTE MC_MAT_MALF_SET 0 0 0 0 ECU_ADDRESS 0x3FA216 /end MEASUREMENT
/begin COMPU_METHOD MC_MAT_MALF_SET "MAT_MALF_SET conversion" RAT_FUNC "%3.0" "Unitless" COEFFS 0 1 0 0 0 1 /end COMPU_METHOD
/begin MEASUREMENT MAT_ORH_CNTR "Manifold Temperature out of range high counter" SLONG MC_MAT_ORH_CNTR 0 0 0 0 ECU_ADDRESS 0x3FA200 /end MEASUREMENT
/begin COMPU_METHOD MC_MAT_ORH_CNTR "MAT_ORH_CNTR conversion" RAT_FUNC "%10.0" "Unitless" COEFFS 0 1 0 0 0 1 /end COMPU_METHOD
/begin MEASUREMENT MAT_ORL_CNTR "Manifold Temperature out of range low counter" SLONG MC_MAT_ORL_CNTR 0 0 0 0 ECU_ADDRESS 0x3FA1FC /end MEASUREMENT
/begin COMPU_METHOD MC_MAT_ORL_CNTR "MAT_ORL_CNTR conversion" RAT_FUNC "%10.0" "Unitless" COEFFS 0 1 0 0 0 1 /end COMPU_METHOD
/begin CHARACTERISTIC MAT_PU_TM "Diagnostic enable time for EO EOT/MAT rationale test." VALUE 0x5D74C SD_FLOAT32_IEEE 0 SC_MAT_PU_TM 0 63.999 /end CHARACTERISTIC
/begin COMPU_METHOD SC_MAT_PU_TM "MAT_PU_TM conversion" RAT_FUNC "%10.5" "s" COEFFS 0 1 0 0 0 1 /end COMPU_METHOD
/begin CHARACTERISTIC MAT_REC_INC "MAT fault recovery counter increment value" VALUE 0x5D3A0 SD_SLONG 0 SC_MAT_REC_INC 0 65535 /end CHARACTERISTIC
/begin COMPU_METHOD SC_MAT_REC_INC "MAT_REC_INC conversion" RAT_FUNC "%10.0" "unitless" COEFFS 0 1 0 0 0 1 /end COMPU_METHOD
/begin MEASUREMENT MAT_STATUS "Status of the manifold temperature high level driver" UBYTE MC_MAT_STATUS 0 0 0 0 ECU_ADDRESS 0x3F98BC /end MEASUREMENT
/begin COMPU_METHOD MC_MAT_STATUS "MAT_STATUS conversion" RAT_FUNC "%3.0" "Unitless" COEFFS 0 1 0 0 0 1 /end COMPU_METHOD
/begin CHARACTERISTIC MAT_TCREC_SEL "Switch to select MAT filter time constant during fault recovery and during fault occurance before malf is set" VALUE 0x5D3A8 SD_UBYTE 0 SC_MAT_TCREC_SEL 0 1 /end CHARACTERISTIC
/begin COMPU_METHOD SC_MAT_TCREC_SEL "MAT_TCREC_SEL conversion" RAT_FUNC "%3.0" "unitless" COEFFS 0 1 0 0 0 1 /end COMPU_METHOD
/begin MEASUREMENT MAT_WCCK "EO EOT/MAT rationale fault warm up cycle counter." UBYTE MC_MAT_WCCK 0 0 0 0 ECU_ADDRESS 0x3FCDA8 /end MEASUREMENT
/begin COMPU_METHOD MC_MAT_WCCK "MAT_WCCK conversion" RAT_FUNC "%3.0" "Unitless" COEFFS 0 1 0 0 0 1 /end COMPU_METHOD
/begin MEASUREMENT MAT_WCCK_FLG "MAT sensor fault flag." UBYTE MC_MAT_WCCK_FLG 0 0 0 0 ECU_ADDRESS 0x3FA53C /end MEASUREMENT
/begin COMPU_METHOD MC_MAT_WCCK_FLG "MAT_WCCK_FLG conversion" RAT_FUNC "%3.0" "Unitless" COEFFS 0 1 0 0 0 1 /end COMPU_METHOD
/begin CHARACTERISTIC MAX_15 "Maximum tolerance of 15 ms Glow Plug Diagnostic pulse" VALUE 0x5E244 SD_FLOAT32_IEEE 0 SC_MAX_15 0 200 /end CHARACTERISTIC
/begin COMPU_METHOD SC_MAX_15 "MAX_15 conversion" RAT_FUNC "%10.5" "ms" COEFFS 0 1 0 0 0 1 /end COMPU_METHOD
/begin CHARACTERISTIC MAX_150 "Maximum tolerance of 150 ms Glow Plug Diagnostic pulse" VALUE 0x5E234 SD_FLOAT32_IEEE 0 SC_MAX_150 0 200 /end CHARACTERISTIC
/begin COMPU_METHOD SC_MAX_150 "MAX_150 conversion" RAT_FUNC "%10.5" "ms" COEFFS 0 1 0 0 0 1 /end COMPU_METHOD
/begin CHARACTERISTIC MAX_35 "Maximum tolerance of 35 ms Glow Plug Diagnostic pulse" VALUE 0x5E240 SD_FLOAT32_IEEE 0 SC_MAX_35 0 200 /end CHARACTERISTIC
/begin COMPU_METHOD SC_MAX_35 "MAX_35 conversion" RAT_FUNC "%10.5" "ms" COEFFS 0 1 0 0 0 1 /end COMPU_METHOD
/begin CHARACTERISTIC MAX_50 "Maximum tolerance of 50 ms Glow Plug Diagnostic pulse" VALUE 0x5E23C SD_FLOAT32_IEEE 0 SC_MAX_50 0 200 /end CHARACTERISTIC
/begin COMPU_METHOD SC_MAX_50 "MAX_50 conversion" RAT_FUNC "%10.5" "ms" COEFFS 0 1 0 0 0 1 /end COMPU_METHOD
/begin CHARACTERISTIC MAX_75 "Maximum tolerance of 75 ms Glow Plug Diagnostic pulse" VALUE 0x5E238 SD_FLOAT32_IEEE 0 SC_MAX_75 0 200 /end CHARACTERISTIC
/begin COMPU_METHOD SC_MAX_75 "MAX_75 conversion" RAT_FUNC "%10.5" "ms" COEFFS 0 1 0 0 0 1 /end COMPU_METHOD
/begin MEASUREMENT MAX_PCT_MIS "contains most recent value from the table FNMAXMISPCT" FLOAT32_IEEE MC_MAX_PCT_MIS 0 0 0 0 ECU_ADDRESS 0x3FB3C0 /end MEASUREMENT
/begin COMPU_METHOD MC_MAX_PCT_MIS "MAX_PCT_MIS conversion" RAT_FUNC "%10.5" "Unitless" COEFFS 0 1 0 0 0 1 /end COMPU_METHOD
/begin CHARACTERISTIC MAX_VSDELT "Maximum change in VS between succesive edges to signal noise for contol of FFG_VS." VALUE 0x5D954 SD_FLOAT32_IEEE 0 SC_MAX_VSDELT 0 255.996 /end CHARACTERISTIC
/begin COMPU_METHOD SC_MAX_VSDELT "MAX_VSDELT conversion" RAT_FUNC "%10.5" "MPH" COEFFS 0 1 0 0 0 1 /end COMPU_METHOD
/begin CHARACTERISTIC MEDIAN_WIDTH "in misfire test, number of events used to calculate median acceleration" VALUE 0x5EDEC SD_UBYTE 0 SC_MEDIAN_WIDTH 3 15 /end CHARACTERISTIC
/begin COMPU_METHOD SC_MEDIAN_WIDTH "MEDIAN_WIDTH conversion" RAT_FUNC "%3.0" "EVENTS" COEFFS 0 1 0 0 0 1 /end COMPU_METHOD
/begin MEASUREMENT MED_ALT_BP_MULT "Medium Altitude Barometric Pressure Multiplier." FLOAT32_IEEE MC_MED_ALT_BP_MULT 0 0 0 0 ECU_ADDRESS 0x3F9ED4 /end MEASUREMENT
/begin COMPU_METHOD MC_MED_ALT_BP_MULT "MED_ALT_BP_MULT conversion" RAT_FUNC "%10.5" "Unitless" COEFFS 0 1 0 0 0 1 /end COMPU_METHOD
/begin MEASUREMENT MFBLK "Smoke limited mass fuel quantity (mg/stroke)" FLOAT32_IEEE MC_MFBLK 0 0 0 0 ECU_ADDRESS 0x3FA818 /end MEASUREMENT
/begin COMPU_METHOD MC_MFBLK "MFBLK conversion" RAT_FUNC "%10.5" "Unitless" COEFFS 0 1 0 0 0 1 /end COMPU_METHOD
/begin MEASUREMENT MFBLKFL "Smoke limited fuel quantity(mg/stroke)" FLOAT32_IEEE MC_MFBLKFL 0 0 0 0 ECU_ADDRESS 0x3FA814 /end MEASUREMENT
/begin COMPU_METHOD MC_MFBLKFL "MFBLKFL conversion" RAT_FUNC "%10.5" "Unitless" COEFFS 0 1 0 0 0 1 /end COMPU_METHOD
/begin MEASUREMENT MFBLK_AFR "" FLOAT32_IEEE MC_MFBLK_AFR 0 0 0 0 ECU_ADDRESS 0x3FA820 /end MEASUREMENT
/begin COMPU_METHOD MC_MFBLK_AFR "MFBLK_AFR conversion" RAT_FUNC "%10.5" "Unitless" COEFFS 0 1 0 0 0 1 /end COMPU_METHOD
/begin MEASUREMENT MFBLK_MGP "" FLOAT32_IEEE MC_MFBLK_MGP 0 0 0 0 ECU_ADDRESS 0x3FA81C /end MEASUREMENT
/begin COMPU_METHOD MC_MFBLK_MGP "MFBLK_MGP conversion" RAT_FUNC "%10.5" "Unitless" COEFFS 0 1 0 0 0 1 /end COMPU_METHOD
/begin MEASUREMENT MFBLK_PI "" FLOAT32_IEEE MC_MFBLK_PI 0 0 0 0 ECU_ADDRESS 0x3FA830 /end MEASUREMENT
/begin COMPU_METHOD MC_MFBLK_PI "MFBLK_PI conversion" RAT_FUNC "%10.5" "Unitless" COEFFS 0 1 0 0 0 1 /end COMPU_METHOD
/begin MEASUREMENT MFBLK_PI_HI_ALT "Output of table fn1120ph" FLOAT32_IEEE MC_MFBLK_PI_HI_ALT 0 0 0 0 ECU_ADDRESS 0x3FA7EC /end MEASUREMENT
/begin COMPU_METHOD MC_MFBLK_PI_HI_ALT "MFBLK_PI_HI_ALT conversion" RAT_FUNC "%10.5" "Unitless" COEFFS 0 1 0 0 0 1 /end COMPU_METHOD
/begin MEASUREMENT MFBLK_PI_LO_ALT "" FLOAT32_IEEE MC_MFBLK_PI_LO_ALT 0 0 0 0 ECU_ADDRESS 0x3FA84C /end MEASUREMENT
/begin COMPU_METHOD MC_MFBLK_PI_LO_ALT "MFBLK_PI_LO_ALT conversion" RAT_FUNC "%10.5" "Unitless" COEFFS 0 1 0 0 0 1 /end COMPU_METHOD
/begin CHARACTERISTIC MFBLK_SEL "" VALUE 0x5DC58 SD_UBYTE 0 SC_MFBLK_SEL 0 4 /end CHARACTERISTIC
/begin COMPU_METHOD SC_MFBLK_SEL "MFBLK_SEL conversion" RAT_FUNC "%3.0" "unitless" COEFFS 0 1 0 0 0 1 /end COMPU_METHOD
/begin MEASUREMENT MFBLK_SS "" FLOAT32_IEEE MC_MFBLK_SS 0 0 0 0 ECU_ADDRESS 0x3FA834 /end MEASUREMENT
/begin COMPU_METHOD MC_MFBLK_SS "MFBLK_SS conversion" RAT_FUNC "%10.5" "Unitless" COEFFS 0 1 0 0 0 1 /end COMPU_METHOD
/begin MEASUREMENT MFBLK_SS_HI_ALT "" FLOAT32_IEEE MC_MFBLK_SS_HI_ALT 0 0 0 0 ECU_ADDRESS 0x3FA854 /end MEASUREMENT
/begin COMPU_METHOD MC_MFBLK_SS_HI_ALT "MFBLK_SS_HI_ALT conversion" RAT_FUNC "%10.5" "Unitless" COEFFS 0 1 0 0 0 1 /end COMPU_METHOD
/begin MEASUREMENT MFBLK_SS_LO_ALT "" FLOAT32_IEEE MC_MFBLK_SS_LO_ALT 0 0 0 0 ECU_ADDRESS 0x3FA850 /end MEASUREMENT
/begin COMPU_METHOD MC_MFBLK_SS_LO_ALT "MFBLK_SS_LO_ALT conversion" RAT_FUNC "%10.5" "Unitless" COEFFS 0 1 0 0 0 1 /end COMPU_METHOD
/begin MEASUREMENT MFCRANK "Crank Timed Govenor mass fuel (mg/stroke)" FLOAT32_IEEE MC_MFCRANK 0 0 0 0 ECU_ADDRESS 0x3FA760 /end MEASUREMENT
/begin COMPU_METHOD MC_MFCRANK "MFCRANK conversion" RAT_FUNC "%10.5" "Unitless" COEFFS 0 1 0 0 0 1 /end COMPU_METHOD
/begin CHARACTERISTIC MFCRANK_LMX "Maximum timer based fuel adder (mg/stroke)" VALUE 0x5DBD4 SD_FLOAT32_IEEE 0 SC_MFCRANK_LMX 0 160 /end CHARACTERISTIC
/begin COMPU_METHOD SC_MFCRANK_LMX "MFCRANK_LMX conversion" RAT_FUNC "%10.5" "unitless" COEFFS 0 1 0 0 0 1 /end COMPU_METHOD
/begin MEASUREMENT MFDES "Desired mass fuel quantity (mg/stroke)" FLOAT32_IEEE MC_MFDES 0 0 0 0 ECU_ADDRESS 0x3FA8A8 /end MEASUREMENT
/begin COMPU_METHOD MC_MFDES "MFDES conversion" RAT_FUNC "%10.5" "Unitless" COEFFS 0 1 0 0 0 1 /end COMPU_METHOD
/begin MEASUREMENT MFDES_NORM "" FLOAT32_IEEE MC_MFDES_NORM 0 0 0 0 ECU_ADDRESS 0x3FB100 /end MEASUREMENT
/begin COMPU_METHOD MC_MFDES_NORM "MFDES_NORM conversion" RAT_FUNC "%10.5" "Unitless" COEFFS 0 1 0 0 0 1 /end COMPU_METHOD
/begin CHARACTERISTIC MFDES_VGT_WARMUP "" VALUE 0x5E9A0 SD_FLOAT32_IEEE 0 SC_MFDES_VGT_WARMUP 0 100 /end CHARACTERISTIC
/begin COMPU_METHOD SC_MFDES_VGT_WARMUP "MFDES_VGT_WARMUP conversion" RAT_FUNC "%10.5" "unitless" COEFFS 0 1 0 0 0 1 /end COMPU_METHOD
/begin MEASUREMENT MFF_ACT "Misfire ""freeze frame"" data, air temperature at the time of highest misfire rate." FLOAT32_IEEE MC_MFF_ACT 0 0 0 0 ECU_ADDRESS 0x3FD000 /end MEASUREMENT
/begin COMPU_METHOD MC_MFF_ACT "MFF_ACT conversion" RAT_FUNC "%10.5" "Unitless" COEFFS 0 1 0 0 0 1 /end COMPU_METHOD
/begin MEASUREMENT MFF_EGR "Misfire ""freeze frame"" data, egr sensor input at the time of highest misfire rate." FLOAT32_IEEE MC_MFF_EGR 0 0 0 0 ECU_ADDRESS 0x3FD004 /end MEASUREMENT
/begin COMPU_METHOD MC_MFF_EGR "MFF_EGR conversion" RAT_FUNC "%10.5" "Unitless" COEFFS 0 1 0 0 0 1 /end COMPU_METHOD
/begin MEASUREMENT MFF_HOLD_FLG "MFlag set to 1 when a misfire code is stored to lock in misfire freeze frame data" UBYTE MC_MFF_HOLD_FLG 0 0 0 0 ECU_ADDRESS 0x3FB2D1 /end MEASUREMENT
/begin COMPU_METHOD MC_MFF_HOLD_FLG "MFF_HOLD_FLG conversion" RAT_FUNC "%3.0" "Unitless" COEFFS 0 1 0 0 0 1 /end COMPU_METHOD
/begin MEASUREMENT MFF_LOAD "Misfire ""freeze frame"" data, load at the time of highest misfire rate." FLOAT32_IEEE MC_MFF_LOAD 0 0 0 0 ECU_ADDRESS 0x3FD00C /end MEASUREMENT
/begin COMPU_METHOD MC_MFF_LOAD "MFF_LOAD conversion" RAT_FUNC "%10.5" "Unitless" COEFFS 0 1 0 0 0 1 /end COMPU_METHOD
/begin CHARACTERISTIC MFF_MIN_LIMIT "Misfire rate minimum rate for the Mode $06" VALUE 0x5EED0 SD_FLOAT32_IEEE 0 SC_MFF_MIN_LIMIT 0 255 /end CHARACTERISTIC
/begin COMPU_METHOD SC_MFF_MIN_LIMIT "MFF_MIN_LIMIT conversion" RAT_FUNC "%10.5" "%" COEFFS 0 1 0 0 0 1 /end COMPU_METHOD
/begin MEASUREMENT MFF_N "Misfire ""freeze frame"" data, rpm at the time of highest misfire rate." FLOAT32_IEEE MC_MFF_N 0 0 0 0 ECU_ADDRESS 0x3FD010 /end MEASUREMENT
/begin COMPU_METHOD MC_MFF_N "MFF_N conversion" RAT_FUNC "%10.5" "Unitless" COEFFS 0 1 0 0 0 1 /end COMPU_METHOD
/begin MEASUREMENT MFF_NDSFLG "Misfire freeze frame data, saves value of ndsflg." UBYTE MC_MFF_NDSFLG 0 0 0 0 ECU_ADDRESS 0x3FD02C /end MEASUREMENT
/begin COMPU_METHOD MC_MFF_NDSFLG "MFF_NDSFLG conversion" RAT_FUNC "%3.0" "Unitless" COEFFS 0 1 0 0 0 1 /end COMPU_METHOD
/begin MEASUREMENT MFF_PRET_FLG "Misfire freeze frame pre trigger flag, set when the 200 block misfire rate reaches a record high level." UBYTE MC_MFF_PRET_FLG 0 0 0 0 ECU_ADDRESS 0x3FB2D2 /end MEASUREMENT
/begin COMPU_METHOD MC_MFF_PRET_FLG "MFF_PRET_FLG conversion" RAT_FUNC "%3.0" "Unitless" COEFFS 0 1 0 0 0 1 /end COMPU_METHOD
/begin MEASUREMENT MFF_RATE1000 "Misfire ""freeze frame"" data, highest recorded misfire rate by the 1000 block test." FLOAT32_IEEE MC_MFF_RATE1000 0 0 0 0 ECU_ADDRESS 0x3FD024 /end MEASUREMENT
/begin COMPU_METHOD MC_MFF_RATE1000 "MFF_RATE1000 conversion" RAT_FUNC "%10.5" "Unitless" COEFFS 0 1 0 0 0 1 /end COMPU_METHOD
/begin MEASUREMENT MFF_RATE200 "Misfire ""freeze frame"" data, highest recorded misfire rate by the 200 block test." FLOAT32_IEEE MC_MFF_RATE200 0 0 0 0 ECU_ADDRESS 0x3FD01C /end MEASUREMENT
/begin COMPU_METHOD MC_MFF_RATE200 "MFF_RATE200 conversion" RAT_FUNC "%10.5" "Unitless" COEFFS 0 1 0 0 0 1 /end COMPU_METHOD
/begin MEASUREMENT MFF_RATE_[0] "Misfire ""freeze frame"" data, rates per cylinder recorded at the time of highest misfire rate." FLOAT32_IEEE MC_MFF_RATE_ 0 0 0 0.999985 ECU_ADDRESS 0x3FCC18 /end MEASUREMENT
/begin COMPU_METHOD MC_MFF_RATE_ "MFF_RATE_ conversion" RAT_FUNC "%10.5" "%" COEFFS 0 1 0 0 0 1 /end COMPU_METHOD
/begin MEASUREMENT MFF_RATE_[1] "Misfire ""freeze frame"" data, rates per cylinder recorded at the time of highest misfire rate." FLOAT32_IEEE MC_MFF_RATE_ 0 0 0 0.999985 ECU_ADDRESS 0x3FCC1C /end MEASUREMENT
/begin MEASUREMENT MFF_RATE_[2] "Misfire ""freeze frame"" data, rates per cylinder recorded at the time of highest misfire rate." FLOAT32_IEEE MC_MFF_RATE_ 0 0 0 0.999985 ECU_ADDRESS 0x3FCC20 /end MEASUREMENT
/begin MEASUREMENT MFF_RATE_[3] "Misfire ""freeze frame"" data, rates per cylinder recorded at the time of highest misfire rate." FLOAT32_IEEE MC_MFF_RATE_ 0 0 0 0.999985 ECU_ADDRESS 0x3FCC24 /end MEASUREMENT
/begin MEASUREMENT MFF_RATE_[4] "Misfire ""freeze frame"" data, rates per cylinder recorded at the time of highest misfire rate." FLOAT32_IEEE MC_MFF_RATE_ 0 0 0 0.999985 ECU_ADDRESS 0x3FCC28 /end MEASUREMENT
/begin MEASUREMENT MFF_RATE_[5] "Misfire ""freeze frame"" data, rates per cylinder recorded at the time of highest misfire rate." FLOAT32_IEEE MC_MFF_RATE_ 0 0 0 0.999985 ECU_ADDRESS 0x3FCC2C /end MEASUREMENT
/begin MEASUREMENT MFF_RATE_[6] "Misfire ""freeze frame"" data, rates per cylinder recorded at the time of highest misfire rate." FLOAT32_IEEE MC_MFF_RATE_ 0 0 0 0.999985 ECU_ADDRESS 0x3FCC30 /end MEASUREMENT
/begin MEASUREMENT MFF_RATE_[7] "Misfire ""freeze frame"" data, rates per cylinder recorded at the time of highest misfire rate." FLOAT32_IEEE MC_MFF_RATE_ 0 0 0 0.999985 ECU_ADDRESS 0x3FCC34 /end MEASUREMENT
/begin MEASUREMENT MFF_RATE_[8] "Misfire ""freeze frame"" data, rates per cylinder recorded at the time of highest misfire rate." FLOAT32_IEEE MC_MFF_RATE_ 0 0 0 0.999985 ECU_ADDRESS 0x3FCC38 /end MEASUREMENT
/begin MEASUREMENT MFF_RATE_[9] "Misfire ""freeze frame"" data, rates per cylinder recorded at the time of highest misfire rate." FLOAT32_IEEE MC_MFF_RATE_ 0 0 0 0.999985 ECU_ADDRESS 0x3FCC3C /end MEASUREMENT
/begin MEASUREMENT MFF_RUNTIME "Misfire ""freeze frame"" data, time after startup at the time of highest misfire rate." UWORD MC_MFF_RUNTIME 0 0 0 0 ECU_ADDRESS 0x3FD02A /end MEASUREMENT
/begin COMPU_METHOD MC_MFF_RUNTIME "MFF_RUNTIME conversion" RAT_FUNC "%5.0" "Unitless" COEFFS 0 1 0 0 0 1 /end COMPU_METHOD
/begin MEASUREMENT MFF_SOAKTIME "Misfire ""freeze frame"" data, soak time at the time of highest misfire rate." FLOAT32_IEEE MC_MFF_SOAKTIME 0 0 0 0 ECU_ADDRESS 0x3FCFF8 /end MEASUREMENT
/begin COMPU_METHOD MC_MFF_SOAKTIME "MFF_SOAKTIME conversion" RAT_FUNC "%10.5" "Unitless" COEFFS 0 1 0 0 0 1 /end COMPU_METHOD
/begin MEASUREMENT MFF_THRESH "Misfire ""freeze frame""data, misfire rate threshold from type A or B test which stores the first code." FLOAT32_IEEE MC_MFF_THRESH 0 0 0 0 ECU_ADDRESS 0x3FD014 /end MEASUREMENT
/begin COMPU_METHOD MC_MFF_THRESH "MFF_THRESH conversion" RAT_FUNC "%10.5" "Unitless" COEFFS 0 1 0 0 0 1 /end COMPU_METHOD
/begin MEASUREMENT MFF_THRS1000 "Misfire ""freeze frame"" data, type B threshold at the time of highest 1000 test misfire rate." FLOAT32_IEEE MC_MFF_THRS1000 0 0 0 0 ECU_ADDRESS 0x3FD020 /end MEASUREMENT
/begin COMPU_METHOD MC_MFF_THRS1000 "MFF_THRS1000 conversion" RAT_FUNC "%10.5" "Unitless" COEFFS 0 1 0 0 0 1 /end COMPU_METHOD
/begin MEASUREMENT MFF_THRS200 "Misfire ""freeze frame"" data, type A threshold at the time of highest misfire rate." FLOAT32_IEEE MC_MFF_THRS200 0 0 0 0 ECU_ADDRESS 0x3FD018 /end MEASUREMENT
/begin COMPU_METHOD MC_MFF_THRS200 "MFF_THRS200 conversion" RAT_FUNC "%10.5" "Unitless" COEFFS 0 1 0 0 0 1 /end COMPU_METHOD
/begin MEASUREMENT MFF_TP "Misfire freeze frame data, saves value of tp." FLOAT32_IEEE MC_MFF_TP 0 0 0 0 ECU_ADDRESS 0x3FCFFC /end MEASUREMENT
/begin COMPU_METHOD MC_MFF_TP "MFF_TP conversion" RAT_FUNC "%10.5" "Unitless" COEFFS 0 1 0 0 0 1 /end COMPU_METHOD
/begin MEASUREMENT MFF_TRIP_CNT "Number of trips which have elapsed since last update to misfire freeze frame data." UWORD MC_MFF_TRIP_CNT 0 0 0 0 ECU_ADDRESS 0x3FD028 /end MEASUREMENT
/begin COMPU_METHOD MC_MFF_TRIP_CNT "MFF_TRIP_CNT conversion" RAT_FUNC "%5.0" "Unitless" COEFFS 0 1 0 0 0 1 /end COMPU_METHOD
/begin MEASUREMENT MFF_TRIP_FLG "Flag used to capture rising edge of ""mis_mon"" flag, and increment the mff trip count." UBYTE MC_MFF_TRIP_FLG 0 0 0 0 ECU_ADDRESS 0x3FB2D0 /end MEASUREMENT
/begin COMPU_METHOD MC_MFF_TRIP_FLG "MFF_TRIP_FLG conversion" RAT_FUNC "%3.0" "Unitless" COEFFS 0 1 0 0 0 1 /end COMPU_METHOD
/begin CHARACTERISTIC MFF_TRIP_MAX "Maximum number of trips to keep misfire freeze frame data, before clearing them." VALUE 0x5ED78 SD_UWORD 0 SC_MFF_TRIP_MAX 0 65535 /end CHARACTERISTIC
/begin COMPU_METHOD SC_MFF_TRIP_MAX "MFF_TRIP_MAX conversion" RAT_FUNC "%5.0" "events" COEFFS 0 1 0 0 0 1 /end COMPU_METHOD
/begin MEASUREMENT MFF_VSBAR "Misfire ""freeze frame"" data, vehicle speed at the time of highest misfire rate." FLOAT32_IEEE MC_MFF_VSBAR 0 0 0 0 ECU_ADDRESS 0x3FD008 /end MEASUREMENT
/begin COMPU_METHOD MC_MFF_VSBAR "MFF_VSBAR conversion" RAT_FUNC "%10.5" "Unitless" COEFFS 0 1 0 0 0 1 /end COMPU_METHOD
/begin MEASUREMENT MFGOV "Governor mass fuel quantity (mg/stroke)" FLOAT32_IEEE MC_MFGOV 0 0 0 0 ECU_ADDRESS 0x3FA780 /end MEASUREMENT
/begin COMPU_METHOD MC_MFGOV "MFGOV conversion" RAT_FUNC "%10.5" "Unitless" COEFFS 0 1 0 0 0 1 /end COMPU_METHOD
/begin MEASUREMENT MFGOV_ARC "PI gov. fuel command  (mg/stroke)" FLOAT32_IEEE MC_MFGOV_ARC 0 0 0 0 ECU_ADDRESS 0x3FA738 /end MEASUREMENT
/begin COMPU_METHOD MC_MFGOV_ARC "MFGOV_ARC conversion" RAT_FUNC "%10.5" "Unitless" COEFFS 0 1 0 0 0 1 /end COMPU_METHOD
/begin MEASUREMENT MFGOV_FF_AC "" FLOAT32_IEEE MC_MFGOV_FF_AC 0 0 0 0 ECU_ADDRESS 0x3FA76C /end MEASUREMENT
/begin COMPU_METHOD MC_MFGOV_FF_AC "MFGOV_FF_AC conversion" RAT_FUNC "%10.5" "Unitless" COEFFS 0 1 0 0 0 1 /end COMPU_METHOD
/begin MEASUREMENT MFGOV_FF_ADD "Governor Adder for Drv/Neutral engagements" FLOAT32_IEEE MC_MFGOV_FF_ADD 0 0 0 0 ECU_ADDRESS 0x3FA7A0 /end MEASUREMENT
/begin COMPU_METHOD MC_MFGOV_FF_ADD "MFGOV_FF_ADD conversion" RAT_FUNC "%10.5" "Unitless" COEFFS 0 1 0 0 0 1 /end COMPU_METHOD
/begin MEASUREMENT MFGOV_FF_DN "Governor Adder for Drv/Neutral engagements" FLOAT32_IEEE MC_MFGOV_FF_DN 0 0 0 0 ECU_ADDRESS 0x3FA79C /end MEASUREMENT
/begin COMPU_METHOD MC_MFGOV_FF_DN "MFGOV_FF_DN conversion" RAT_FUNC "%10.5" "Unitless" COEFFS 0 1 0 0 0 1 /end COMPU_METHOD
/begin MEASUREMENT MFGOV_FF_ND "Governor Adder for Neutral/Drv engagements" FLOAT32_IEEE MC_MFGOV_FF_ND 0 0 0 0 ECU_ADDRESS 0x3FA798 /end MEASUREMENT
/begin COMPU_METHOD MC_MFGOV_FF_ND "MFGOV_FF_ND conversion" RAT_FUNC "%10.5" "Unitless" COEFFS 0 1 0 0 0 1 /end COMPU_METHOD
/begin MEASUREMENT MFGOV_I "PI governor integral term value (mg/stroke)" FLOAT32_IEEE MC_MFGOV_I 0 0 0 0 ECU_ADDRESS 0x3FA77C /end MEASUREMENT
/begin COMPU_METHOD MC_MFGOV_I "MFGOV_I conversion" RAT_FUNC "%10.5" "Unitless" COEFFS 0 1 0 0 0 1 /end COMPU_METHOD
/begin MEASUREMENT MFGOV_P "PI governor proportional term value (mg/stroke)" FLOAT32_IEEE MC_MFGOV_P 0 0 0 0 ECU_ADDRESS 0x3FA778 /end MEASUREMENT
/begin COMPU_METHOD MC_MFGOV_P "MFGOV_P conversion" RAT_FUNC "%10.5" "Unitless" COEFFS 0 1 0 0 0 1 /end COMPU_METHOD
/begin MEASUREMENT MFGOV_PI "PI governor fuel command (mg/stroke)" FLOAT32_IEEE MC_MFGOV_PI 0 0 0 0 ECU_ADDRESS 0x3FA774 /end MEASUREMENT
/begin COMPU_METHOD MC_MFGOV_PI "MFGOV_PI conversion" RAT_FUNC "%10.5" "Unitless" COEFFS 0 1 0 0 0 1 /end COMPU_METHOD
/begin CHARACTERISTIC MFGOV_P_LMN "Minimum mfgov_p value" VALUE 0x5DBD0 SD_FLOAT32_IEEE 0 SC_MFGOV_P_LMN -250 0 /end CHARACTERISTIC
/begin COMPU_METHOD SC_MFGOV_P_LMN "MFGOV_P_LMN conversion" RAT_FUNC "%10.5" "unitless" COEFFS 0 1 0 0 0 1 /end COMPU_METHOD
/begin CHARACTERISTIC MFGOV_P_LMX "Maximum mfgov_p value" VALUE 0x5DBCC SD_FLOAT32_IEEE 0 SC_MFGOV_P_LMX 0 250 /end CHARACTERISTIC
/begin COMPU_METHOD SC_MFGOV_P_LMX "MFGOV_P_LMX conversion" RAT_FUNC "%10.5" "unitless" COEFFS 0 1 0 0 0 1 /end COMPU_METHOD
/begin MEASUREMENT MFGOV_TBL "Table gov fuel quantity (mg/stroke)" FLOAT32_IEEE MC_MFGOV_TBL 0 0 0 0 ECU_ADDRESS 0x3FA768 /end MEASUREMENT
/begin COMPU_METHOD MC_MFGOV_TBL "MFGOV_TBL conversion" RAT_FUNC "%10.5" "Unitless" COEFFS 0 1 0 0 0 1 /end COMPU_METHOD
/begin MEASUREMENT MFGOV_TBL_ACTV "Table gov fuel quantity (mg/stroke)" FLOAT32_IEEE MC_MFGOV_TBL_ACTV 0 0 0 0 ECU_ADDRESS 0x3FA764 /end MEASUREMENT
/begin COMPU_METHOD MC_MFGOV_TBL_ACTV "MFGOV_TBL_ACTV conversion" RAT_FUNC "%10.5" "Unitless" COEFFS 0 1 0 0 0 1 /end COMPU_METHOD
/begin MEASUREMENT MFLMX "Mass fuel quantity maximum limit (mg/stroke)" FLOAT32_IEEE MC_MFLMX 0 0 0 0 ECU_ADDRESS 0x3FA8A4 /end MEASUREMENT
/begin COMPU_METHOD MC_MFLMX "MFLMX conversion" RAT_FUNC "%10.5" "Unitless" COEFFS 0 1 0 0 0 1 /end COMPU_METHOD
/begin CHARACTERISTIC MFL_MLT_LMN "" VALUE 0x5DC54 SD_FLOAT32_IEEE 0 SC_MFL_MLT_LMN 0 200 /end CHARACTERISTIC
/begin COMPU_METHOD SC_MFL_MLT_LMN "MFL_MLT_LMN conversion" RAT_FUNC "%10.5" "unitless" COEFFS 0 1 0 0 0 1 /end COMPU_METHOD
/begin CHARACTERISTIC MFL_MLT_LMX "" VALUE 0x5DC50 SD_FLOAT32_IEEE 0 SC_MFL_MLT_LMX 0 200 /end CHARACTERISTIC
/begin COMPU_METHOD SC_MFL_MLT_LMX "MFL_MLT_LMX conversion" RAT_FUNC "%10.5" "unitless" COEFFS 0 1 0 0 0 1 /end COMPU_METHOD
/begin MEASUREMENT MFMFLG "Flag indicating a mass air flow sensor failure" UBYTE MC_MFMFLG 0 0 0 0 ECU_ADDRESS 0x3FA2BB /end MEASUREMENT
/begin COMPU_METHOD MC_MFMFLG "MFMFLG conversion" RAT_FUNC "%3.0" "Unitless" COEFFS 0 1 0 0 0 1 /end COMPU_METHOD
/begin MEASUREMENT MFMTQ "Maximum torque limited fuel (mg/stroke)" FLOAT32_IEEE MC_MFMTQ 0 0 0 0 ECU_ADDRESS 0x3FA8A0 /end MEASUREMENT
/begin COMPU_METHOD MC_MFMTQ "MFMTQ conversion" RAT_FUNC "%10.5" "Unitless" COEFFS 0 1 0 0 0 1 /end COMPU_METHOD
/begin CHARACTERISTIC MFMTQ_LMN "Minimum max torque value" VALUE 0x5DD5C SD_FLOAT32_IEEE 0 SC_MFMTQ_LMN 0 50 /end CHARACTERISTIC
/begin COMPU_METHOD SC_MFMTQ_LMN "MFMTQ_LMN conversion" RAT_FUNC "%10.5" "unitless" COEFFS 0 1 0 0 0 1 /end COMPU_METHOD
/begin CHARACTERISTIC MFMTQ_LMX "Max torque fuel clipped" VALUE 0x5DD58 SD_FLOAT32_IEEE 0 SC_MFMTQ_LMX 50 127 /end CHARACTERISTIC
/begin COMPU_METHOD SC_MFMTQ_LMX "MFMTQ_LMX conversion" RAT_FUNC "%10.5" "unitless" COEFFS 0 1 0 0 0 1 /end COMPU_METHOD
/begin CHARACTERISTIC MFMTQ_OFST "Maximum torque curve offset" VALUE 0x5DD54 SD_FLOAT32_IEEE 0 SC_MFMTQ_OFST -100 100 /end CHARACTERISTIC
/begin COMPU_METHOD SC_MFMTQ_OFST "MFMTQ_OFST conversion" RAT_FUNC "%10.5" "unitless" COEFFS 0 1 0 0 0 1 /end COMPU_METHOD
/begin MEASUREMENT MFMTQ_PI_HI_ALT "Output of table fn1020ph_a" FLOAT32_IEEE MC_MFMTQ_PI_HI_ALT 0 0 0 0 ECU_ADDRESS 0x3FA7F4 /end MEASUREMENT
/begin COMPU_METHOD MC_MFMTQ_PI_HI_ALT "MFMTQ_PI_HI_ALT conversion" RAT_FUNC "%10.5" "Unitless" COEFFS 0 1 0 0 0 1 /end COMPU_METHOD
/begin MEASUREMENT MFMTQ_PI_LO_ALT "" FLOAT32_IEEE MC_MFMTQ_PI_LO_ALT 0 0 0 0 ECU_ADDRESS 0x3FA840 /end MEASUREMENT
/begin COMPU_METHOD MC_MFMTQ_PI_LO_ALT "MFMTQ_PI_LO_ALT conversion" RAT_FUNC "%10.5" "Unitless" COEFFS 0 1 0 0 0 1 /end COMPU_METHOD
/begin MEASUREMENT MFMTQ_SS_HI_ALT "" FLOAT32_IEEE MC_MFMTQ_SS_HI_ALT 0 0 0 0 ECU_ADDRESS 0x3FA848 /end MEASUREMENT
/begin COMPU_METHOD MC_MFMTQ_SS_HI_ALT "MFMTQ_SS_HI_ALT conversion" RAT_FUNC "%10.5" "Unitless" COEFFS 0 1 0 0 0 1 /end COMPU_METHOD
/begin MEASUREMENT MFMTQ_SS_LO_ALT "" FLOAT32_IEEE MC_MFMTQ_SS_LO_ALT 0 0 0 0 ECU_ADDRESS 0x3FA844 /end MEASUREMENT
/begin COMPU_METHOD MC_MFMTQ_SS_LO_ALT "MFMTQ_SS_LO_ALT conversion" RAT_FUNC "%10.5" "Unitless" COEFFS 0 1 0 0 0 1 /end COMPU_METHOD
/begin MEASUREMENT MFREF "Iso mass fuel ref quantity (mg/stroke)" FLOAT32_IEEE MC_MFREF 0 0 0 0 ECU_ADDRESS 0x3FA758 /end MEASUREMENT
/begin COMPU_METHOD MC_MFREF "MFREF conversion" RAT_FUNC "%10.5" "Unitless" COEFFS 0 1 0 0 0 1 /end COMPU_METHOD
/begin MEASUREMENT MFTQMOD "Maximum torque limited fuel (mg/stroke)" FLOAT32_IEEE MC_MFTQMOD 0 0 0 0 ECU_ADDRESS 0x3FA810 /end MEASUREMENT
/begin COMPU_METHOD MC_MFTQMOD "MFTQMOD conversion" RAT_FUNC "%10.5" "Unitless" COEFFS 0 1 0 0 0 1 /end COMPU_METHOD
/begin MEASUREMENT MF_CLAMP "Crank Timed Govenor mass fuel (mg/stroke)" FLOAT32_IEEE MC_MF_CLAMP 0 0 0 0 ECU_ADDRESS 0x3FA75C /end MEASUREMENT
/begin COMPU_METHOD MC_MF_CLAMP "MF_CLAMP conversion" RAT_FUNC "%10.5" "Unitless" COEFFS 0 1 0 0 0 1 /end COMPU_METHOD
/begin MEASUREMENT MF_FF_DN_TM "Drv/Neutral engagement time" FLOAT32_IEEE MC_MF_FF_DN_TM 0 0 0 0 ECU_ADDRESS 0x3FA794 /end MEASUREMENT
/begin COMPU_METHOD MC_MF_FF_DN_TM "MF_FF_DN_TM conversion" RAT_FUNC "%10.5" "Unitless" COEFFS 0 1 0 0 0 1 /end COMPU_METHOD
/begin MEASUREMENT MF_FF_DN_TMR "timer for Drive/Neutral engagement" ULONG MC_MF_FF_DN_TMR 0 0 0 0 ECU_ADDRESS 0x3FA8DC /end MEASUREMENT
/begin COMPU_METHOD MC_MF_FF_DN_TMR "MF_FF_DN_TMR conversion" RAT_FUNC "%10.0" "Unitless" COEFFS 0 1 0 0 0 1 /end COMPU_METHOD
/begin MEASUREMENT MF_FF_ND_TM "Neutral/Drv engagement time" FLOAT32_IEEE MC_MF_FF_ND_TM 0 0 0 0 ECU_ADDRESS 0x3FA790 /end MEASUREMENT
/begin COMPU_METHOD MC_MF_FF_ND_TM "MF_FF_ND_TM conversion" RAT_FUNC "%10.5" "Unitless" COEFFS 0 1 0 0 0 1 /end COMPU_METHOD
/begin MEASUREMENT MF_FF_ND_TMR "timer for Neutral/Drive engagement" ULONG MC_MF_FF_ND_TMR 0 0 0 0 ECU_ADDRESS 0x3FA8E0 /end MEASUREMENT
/begin COMPU_METHOD MC_MF_FF_ND_TMR "MF_FF_ND_TMR conversion" RAT_FUNC "%10.0" "Unitless" COEFFS 0 1 0 0 0 1 /end COMPU_METHOD
/begin MEASUREMENT MGP "Manifold Gage Pressure (in KPA)" FLOAT32_IEEE MC_MGP 0 0 0 0 ECU_ADDRESS 0x3FA1CC /end MEASUREMENT
/begin COMPU_METHOD MC_MGP "MGP conversion" RAT_FUNC "%10.5" "Unitless" COEFFS 0 1 0 0 0 1 /end COMPU_METHOD
/begin CHARACTERISTIC MID_MAP[0] "Mode 06 Module identifier bit maps" VALUE 0x5A63C SD_UWORD 0 SC_MID_MAP 0 65535 /end CHARACTERISTIC
/begin COMPU_METHOD SC_MID_MAP "MID_MAP conversion" RAT_FUNC "%5.0" "unitless" COEFFS 0 1 0 0 0 1 /end COMPU_METHOD
/begin CHARACTERISTIC MID_MAP[10] "Mode 06 Module identifier bit maps" VALUE 0x5A650 SD_UWORD 0 SC_MID_MAP 0 65535 /end CHARACTERISTIC
/begin CHARACTERISTIC MID_MAP[11] "Mode 06 Module identifier bit maps" VALUE 0x5A652 SD_UWORD 0 SC_MID_MAP 0 65535 /end CHARACTERISTIC
/begin CHARACTERISTIC MID_MAP[1] "Mode 06 Module identifier bit maps" VALUE 0x5A63E SD_UWORD 0 SC_MID_MAP 0 65535 /end CHARACTERISTIC
/begin CHARACTERISTIC MID_MAP[2] "Mode 06 Module identifier bit maps" VALUE 0x5A640 SD_UWORD 0 SC_MID_MAP 0 65535 /end CHARACTERISTIC
/begin CHARACTERISTIC MID_MAP[3] "Mode 06 Module identifier bit maps" VALUE 0x5A642 SD_UWORD 0 SC_MID_MAP 0 65535 /end CHARACTERISTIC
/begin CHARACTERISTIC MID_MAP[4] "Mode 06 Module identifier bit maps" VALUE 0x5A644 SD_UWORD 0 SC_MID_MAP 0 65535 /end CHARACTERISTIC
/begin CHARACTERISTIC MID_MAP[5] "Mode 06 Module identifier bit maps" VALUE 0x5A646 SD_UWORD 0 SC_MID_MAP 0 65535 /end CHARACTERISTIC
/begin CHARACTERISTIC MID_MAP[6] "Mode 06 Module identifier bit maps" VALUE 0x5A648 SD_UWORD 0 SC_MID_MAP 0 65535 /end CHARACTERISTIC
/begin CHARACTERISTIC MID_MAP[7] "Mode 06 Module identifier bit maps" VALUE 0x5A64A SD_UWORD 0 SC_MID_MAP 0 65535 /end CHARACTERISTIC
/begin CHARACTERISTIC MID_MAP[8] "Mode 06 Module identifier bit maps" VALUE 0x5A64C SD_UWORD 0 SC_MID_MAP 0 65535 /end CHARACTERISTIC
/begin CHARACTERISTIC MID_MAP[9] "Mode 06 Module identifier bit maps" VALUE 0x5A64E SD_UWORD 0 SC_MID_MAP 0 65535 /end CHARACTERISTIC
/begin MEASUREMENT MIL1000FLGS "Misfire Type B fault flags, bits 0-9 indicate whether or not a misfire fault is present on cylinders 1-10." UWORD MC_MIL1000FLGS 0 0 0 0 ECU_ADDRESS 0x3FB3F0 /end MEASUREMENT
/begin COMPU_METHOD MC_MIL1000FLGS "MIL1000FLGS conversion" RAT_FUNC "%5.0" "Unitless" COEFFS 0 1 0 0 0 1 /end COMPU_METHOD
/begin MEASUREMENT MIL200FLGS "Misfire Type A fault flags, bits 0-9 indicate whether or not a misfire fault is present on cylinders 1-10." UWORD MC_MIL200FLGS 0 0 0 0 ECU_ADDRESS 0x3FB3DC /end MEASUREMENT
/begin COMPU_METHOD MC_MIL200FLGS "MIL200FLGS conversion" RAT_FUNC "%5.0" "Unitless" COEFFS 0 1 0 0 0 1 /end COMPU_METHOD
/begin CHARACTERISTIC MILLIM "SWITCH TO CAL IN/OUT THE MIL BULB CHECK UNITLESS" VALUE 0x5CDF1 SD_UBYTE 0 SC_MILLIM 0 1 /end CHARACTERISTIC
/begin COMPU_METHOD SC_MILLIM "MILLIM conversion" RAT_FUNC "%3.0" "unitless" COEFFS 0 1 0 0 0 1 /end COMPU_METHOD
/begin MEASUREMENT MIL_CTRL "MIL light control state encoded register. 0=OFF, 1=ON, 2=FLASHING." UBYTE MC_MIL_CTRL 0 0 0 0 ECU_ADDRESS 0x3F9E2C /end MEASUREMENT
/begin COMPU_METHOD MC_MIL_CTRL "MIL_CTRL conversion" RAT_FUNC "%3.0" "Unitless" COEFFS 0 1 0 0 0 1 /end COMPU_METHOD
/begin MEASUREMENT MIL_ODO "Distance traveled since MIL is illuminated." UWORD MC_MIL_ODO 0 0 0 0 ECU_ADDRESS 0x3FCD14 /end MEASUREMENT
/begin COMPU_METHOD MC_MIL_ODO "MIL_ODO conversion" RAT_FUNC "%5.0" "Unitless" COEFFS 0 1 0 0 0 1 /end COMPU_METHOD
/begin CHARACTERISTIC MIL_ODO_SW "Distance traveled since MIL illumination switch." VALUE 0x5CEA0 SD_UBYTE 0 SC_MIL_ODO_SW 0 1 /end CHARACTERISTIC
/begin COMPU_METHOD SC_MIL_ODO_SW "MIL_ODO_SW conversion" RAT_FUNC "%3.0" "unitless" COEFFS 0 1 0 0 0 1 /end COMPU_METHOD
/begin MEASUREMENT MIL_ON "OBDII MIL status flag. (bit 7 of READY_FLAGS; 1 => MIL is on)" UBYTE MC_MIL_ON 0 0 0 0 ECU_ADDRESS 0x3FCCDD /end MEASUREMENT
/begin COMPU_METHOD MC_MIL_ON "MIL_ON conversion" RAT_FUNC "%3.0" "Unitless" COEFFS 0 1 0 0 0 1 /end COMPU_METHOD
/begin CHARACTERISTIC MIL_SW "MIL enable switch" VALUE 0x5CDF2 SD_UBYTE 0 SC_MIL_SW 0 2 /end CHARACTERISTIC
/begin COMPU_METHOD SC_MIL_SW "MIL_SW conversion" RAT_FUNC "%3.0" "group_of_bits" COEFFS 0 1 0 0 0 1 /end COMPU_METHOD
/begin CHARACTERISTIC MIN_15 "Minimum tolerance of 15 ms Glow Plug Diagnostic pulse" VALUE 0x5E248 SD_FLOAT32_IEEE 0 SC_MIN_15 0 200 /end CHARACTERISTIC
/begin COMPU_METHOD SC_MIN_15 "MIN_15 conversion" RAT_FUNC "%10.5" "ms" COEFFS 0 1 0 0 0 1 /end COMPU_METHOD
/begin CHARACTERISTIC MIN_ON_TIM_D "Minimum A/C  on time before cutout logic can reactivate" VALUE 0x5CBB4 SD_FLOAT32_IEEE 0 SC_MIN_ON_TIM_D 0 63.999 /end CHARACTERISTIC
/begin COMPU_METHOD SC_MIN_ON_TIM_D "MIN_ON_TIM_D conversion" RAT_FUNC "%10.5" "s" COEFFS 0 1 0 0 0 1 /end COMPU_METHOD
/begin MEASUREMENT MIS1000FIRST "Flag set upon completion of the first 1000 rev misfire test." UBYTE MC_MIS1000FIRST 0 0 0 0 ECU_ADDRESS 0x3FB3F2 /end MEASUREMENT
/begin COMPU_METHOD MC_MIS1000FIRST "MIS1000FIRST conversion" RAT_FUNC "%3.0" "Unitless" COEFFS 0 1 0 0 0 1 /end COMPU_METHOD
/begin CHARACTERISTIC MIS1000_EWMA "Scalar which sets the duration of the type B misfire test to this many 200 rev blocks." VALUE 0x5EF61 SD_UBYTE 0 SC_MIS1000_EWMA 0 255 /end CHARACTERISTIC
/begin COMPU_METHOD SC_MIS1000_EWMA "MIS1000_EWMA conversion" RAT_FUNC "%3.0" "unitless" COEFFS 0 1 0 0 0 1 /end COMPU_METHOD
/begin MEASUREMENT MIS1000_FLG "Flag set upon completion of a 1000 event misfire test." UBYTE MC_MIS1000_FLG 0 0 0 0 ECU_ADDRESS 0x3FB3F5 /end MEASUREMENT
/begin COMPU_METHOD MC_MIS1000_FLG "MIS1000_FLG conversion" RAT_FUNC "%3.0" "Unitless" COEFFS 0 1 0 0 0 1 /end COMPU_METHOD
/begin MEASUREMENT MIS200FLGS "Misfire Type A fault flags, bits 0-9 indicate whether or not a misfire fault is present on cylinders 1-10." UWORD MC_MIS200FLGS 0 0 0 0 ECU_ADDRESS 0x3FB3DA /end MEASUREMENT
/begin COMPU_METHOD MC_MIS200FLGS "MIS200FLGS conversion" RAT_FUNC "%5.0" "Unitless" COEFFS 0 1 0 0 0 1 /end COMPU_METHOD
/begin CHARACTERISTIC MIS200_EWMA "Scalar which sets the duration of the type A misfire test to this many 200 rev blocks." VALUE 0x5EF44 SD_UBYTE 0 SC_MIS200_EWMA 0 255 /end CHARACTERISTIC
/begin COMPU_METHOD SC_MIS200_EWMA "MIS200_EWMA conversion" RAT_FUNC "%3.0" "unitless" COEFFS 0 1 0 0 0 1 /end COMPU_METHOD
/begin MEASUREMENT MIS200_FLG "Flag set upon completion of a 200 event misfire test." UBYTE MC_MIS200_FLG 0 0 0 0 ECU_ADDRESS 0x3FB3DF /end MEASUREMENT
/begin COMPU_METHOD MC_MIS200_FLG "MIS200_FLG conversion" RAT_FUNC "%3.0" "Unitless" COEFFS 0 1 0 0 0 1 /end COMPU_METHOD
/begin MEASUREMENT MISBGTOBG[0] "Holds the value of the ""v_cyl_mis"" counters for each bg pass." UBYTE MC_MISBGTOBG 0 0 0 255 ECU_ADDRESS 0x3FBFE8 /end MEASUREMENT
/begin COMPU_METHOD MC_MISBGTOBG "MISBGTOBG conversion" RAT_FUNC "%3.0" "events" COEFFS 0 1 0 0 0 1 /end COMPU_METHOD
/begin MEASUREMENT MISBGTOBG[1] "Holds the value of the ""v_cyl_mis"" counters for each bg pass." UBYTE MC_MISBGTOBG 0 0 0 255 ECU_ADDRESS 0x3FBFE9 /end MEASUREMENT
/begin MEASUREMENT MISBGTOBG[2] "Holds the value of the ""v_cyl_mis"" counters for each bg pass." UBYTE MC_MISBGTOBG 0 0 0 255 ECU_ADDRESS 0x3FBFEA /end MEASUREMENT
/begin MEASUREMENT MISBGTOBG[3] "Holds the value of the ""v_cyl_mis"" counters for each bg pass." UBYTE MC_MISBGTOBG 0 0 0 255 ECU_ADDRESS 0x3FBFEB /end MEASUREMENT
/begin MEASUREMENT MISBGTOBG[4] "Holds the value of the ""v_cyl_mis"" counters for each bg pass." UBYTE MC_MISBGTOBG 0 0 0 255 ECU_ADDRESS 0x3FBFEC /end MEASUREMENT
/begin MEASUREMENT MISBGTOBG[5] "Holds the value of the ""v_cyl_mis"" counters for each bg pass." UBYTE MC_MISBGTOBG 0 0 0 255 ECU_ADDRESS 0x3FBFED /end MEASUREMENT
/begin MEASUREMENT MISBGTOBG[6] "Holds the value of the ""v_cyl_mis"" counters for each bg pass." UBYTE MC_MISBGTOBG 0 0 0 255 ECU_ADDRESS 0x3FBFEE /end MEASUREMENT
/begin MEASUREMENT MISBGTOBG[7] "Holds the value of the ""v_cyl_mis"" counters for each bg pass." UBYTE MC_MISBGTOBG 0 0 0 255 ECU_ADDRESS 0x3FBFEF /end MEASUREMENT
/begin MEASUREMENT MISBGTOBG[8] "Holds the value of the ""v_cyl_mis"" counters for each bg pass." UBYTE MC_MISBGTOBG 0 0 0 255 ECU_ADDRESS 0x3FBFF0 /end MEASUREMENT
/begin MEASUREMENT MISBGTOBG[9] "Holds the value of the ""v_cyl_mis"" counters for each bg pass." UBYTE MC_MISBGTOBG 0 0 0 255 ECU_ADDRESS 0x3FBFF1 /end MEASUREMENT
/begin MEASUREMENT MISBG_BYPS "misfire test flag indicating conditions present to bypass test" UBYTE MC_MISBG_BYPS 0 0 0 0 ECU_ADDRESS 0x3FB387 /end MEASUREMENT
/begin COMPU_METHOD MC_MISBG_BYPS "MISBG_BYPS conversion" RAT_FUNC "%3.0" "Unitless" COEFFS 0 1 0 0 0 1 /end COMPU_METHOD
/begin MEASUREMENT MISBG_ENA "Flag set to enable misfire test counters, and which will reset misfire test counters when cleared." UBYTE MC_MISBG_ENA 0 0 0 0 ECU_ADDRESS 0x3FB388 /end MEASUREMENT
/begin COMPU_METHOD MC_MISBG_ENA "MISBG_ENA conversion" RAT_FUNC "%3.0" "Unitless" COEFFS 0 1 0 0 0 1 /end COMPU_METHOD
/begin MEASUREMENT MISBYPSCTR "cumulative cylinder events bypassed by the misfire test foreground logic" ULONG MC_MISBYPSCTR 0 0 0 0 ECU_ADDRESS 0x3FB350 /end MEASUREMENT
/begin COMPU_METHOD MC_MISBYPSCTR "MISBYPSCTR conversion" RAT_FUNC "%10.0" "Unitless" COEFFS 0 1 0 0 0 1 /end COMPU_METHOD
/begin MEASUREMENT MISBYPSCTRO "Last pass value of ""misbypsctro""." ULONG MC_MISBYPSCTRO 0 0 0 0 ECU_ADDRESS 0x3FB390 /end MEASUREMENT
/begin COMPU_METHOD MC_MISBYPSCTRO "MISBYPSCTRO conversion" RAT_FUNC "%10.0" "Unitless" COEFFS 0 1 0 0 0 1 /end COMPU_METHOD
/begin MEASUREMENT MISDLYFLG "Flag which enables a one time calculation of the time delay after startup before enabling misfire." UBYTE MC_MISDLYFLG 0 0 0 0 ECU_ADDRESS 0x3FB36C /end MEASUREMENT
/begin COMPU_METHOD MC_MISDLYFLG "MISDLYFLG conversion" RAT_FUNC "%3.0" "Unitless" COEFFS 0 1 0 0 0 1 /end COMPU_METHOD
/begin MEASUREMENT MISFCOFLGS "Misfire fmem flags, bits 0-9 will be toggled for one bg loop to trigger fuel cutout fmem on cylinders with gross misfire." UWORD MC_MISFCOFLGS 0 0 0 0 ECU_ADDRESS 0x3FB2A8 /end MEASUREMENT
/begin COMPU_METHOD MC_MISFCOFLGS "MISFCOFLGS conversion" RAT_FUNC "%5.0" "Unitless" COEFFS 0 1 0 0 0 1 /end COMPU_METHOD
/begin MEASUREMENT MISFG_BYPS "Flag set to bypass all misfire foreground processing (chronometric thrift at hi rpms)" UBYTE MC_MISFG_BYPS 0 0 0 0 ECU_ADDRESS 0x3FB386 /end MEASUREMENT
/begin COMPU_METHOD MC_MISFG_BYPS "MISFG_BYPS conversion" RAT_FUNC "%3.0" "Unitless" COEFFS 0 1 0 0 0 1 /end COMPU_METHOD
/begin MEASUREMENT MISFILALPHA "Progressively weighted filter constant used for average misfire rate calculations." FLOAT32_IEEE MC_MISFILALPHA 0 0 0 0 ECU_ADDRESS 0x3FB394 /end MEASUREMENT
/begin COMPU_METHOD MC_MISFILALPHA "MISFILALPHA conversion" RAT_FUNC "%10.5" "Unitless" COEFFS 0 1 0 0 0 1 /end COMPU_METHOD
/begin MEASUREMENT MISFILCOUNT "Counter for # of cyl events tested by misfire monitor, used to calculate a weighted filter constant for averaging misfire rate." UWORD MC_MISFILCOUNT 0 0 0 0 ECU_ADDRESS 0x3FB3A4 /end MEASUREMENT
/begin COMPU_METHOD MC_MISFILCOUNT "MISFILCOUNT conversion" RAT_FUNC "%5.0" "Unitless" COEFFS 0 1 0 0 0 1 /end COMPU_METHOD
/begin MEASUREMENT MISFIRES1000 "Accumulated misfires over 1000 revolutions" UWORD MC_MISFIRES1000 0 0 0 0 ECU_ADDRESS 0x3FB3EC /end MEASUREMENT
/begin COMPU_METHOD MC_MISFIRES1000 "MISFIRES1000 conversion" RAT_FUNC "%5.0" "Unitless" COEFFS 0 1 0 0 0 1 /end COMPU_METHOD
/begin MEASUREMENT MISFIRES200 "Accumulated misfires over 200 revolutions" UWORD MC_MISFIRES200 0 0 0 0 ECU_ADDRESS 0x3FB3D4 /end MEASUREMENT
/begin COMPU_METHOD MC_MISFIRES200 "MISFIRES200 conversion" RAT_FUNC "%5.0" "Unitless" COEFFS 0 1 0 0 0 1 /end COMPU_METHOD
/begin MEASUREMENT MISFIRING "Misfire status flag. (1 => misfire currently occurring)" UBYTE MC_MISFIRING 0 0 0 0 ECU_ADDRESS 0x3FB2AB /end MEASUREMENT
/begin COMPU_METHOD MC_MISFIRING "MISFIRING conversion" RAT_FUNC "%3.0" "Unitless" COEFFS 0 1 0 0 0 1 /end COMPU_METHOD
/begin CHARACTERISTIC MISFMEM_DSRD "Calibration switch to select/deselect FMEM due to misfire. 0 -> deselect, 1 -> select." VALUE 0x5CB31 SD_UBYTE 0 SC_MISFMEM_DSRD 0 1 /end CHARACTERISTIC
/begin COMPU_METHOD SC_MISFMEM_DSRD "MISFMEM_DSRD conversion" RAT_FUNC "%3.0" "unitless" COEFFS 0 1 0 0 0 1 /end COMPU_METHOD
/begin CHARACTERISTIC MISFMEM_RATE "During type A misfire fault, misfire rate must be above this limit to initiate fuel cutout fmem." VALUE 0x5EF34 SD_FLOAT32_IEEE 0 SC_MISFMEM_RATE 0 0.999985 /end CHARACTERISTIC
/begin COMPU_METHOD SC_MISFMEM_RATE "MISFMEM_RATE conversion" RAT_FUNC "%10.5" "%" COEFFS 0 1 0 0 0 1 /end COMPU_METHOD
/begin CHARACTERISTIC MISHOT1000 "De-sensitised type B misfire rate threshold, for hot starts." VALUE 0x5EF54 SD_FLOAT32_IEEE 0 SC_MISHOT1000 0 0.999985 /end CHARACTERISTIC
/begin COMPU_METHOD SC_MISHOT1000 "MISHOT1000 conversion" RAT_FUNC "%10.5" "%" COEFFS 0 1 0 0 0 1 /end COMPU_METHOD
/begin CHARACTERISTIC MISHOT200 "Offset added to type A misfire rate threshold to de-sensitize the monitor for hot starts." VALUE 0x5EF38 SD_FLOAT32_IEEE 0 SC_MISHOT200 0 0.999985 /end CHARACTERISTIC
/begin COMPU_METHOD SC_MISHOT200 "MISHOT200 conversion" RAT_FUNC "%10.5" "%" COEFFS 0 1 0 0 0 1 /end COMPU_METHOD
/begin MEASUREMENT MISHOTSTART "Flag which is set at startup if either ect or act exceeds hot start criteria for misfire." UBYTE MC_MISHOTSTART 0 0 0 0 ECU_ADDRESS 0x3FB384 /end MEASUREMENT
/begin COMPU_METHOD MC_MISHOTSTART "MISHOTSTART conversion" RAT_FUNC "%3.0" "Unitless" COEFFS 0 1 0 0 0 1 /end COMPU_METHOD
/begin MEASUREMENT MISID_BYPS "Flag set under conditions when the misfire monitor is not able to identify misfiring cylinder number." UBYTE MC_MISID_BYPS 0 0 0 0 ECU_ADDRESS 0x3FB385 /end MEASUREMENT
/begin COMPU_METHOD MC_MISID_BYPS "MISID_BYPS conversion" RAT_FUNC "%3.0" "Unitless" COEFFS 0 1 0 0 0 1 /end COMPU_METHOD
/begin CHARACTERISTIC MISID_NMAX "RPM limit at which to disable misfire cylinder id, if known to be inaccurate at hi-rpms." VALUE 0x5EE78 SD_FLOAT32_IEEE 0 SC_MISID_NMAX 0 16383.8 /end CHARACTERISTIC
/begin COMPU_METHOD SC_MISID_NMAX "MISID_NMAX conversion" RAT_FUNC "%10.5" "RPM" COEFFS 0 1 0 0 0 1 /end COMPU_METHOD
/begin CHARACTERISTIC MISLEVEL1000 "percent misfire threshold for emissions" VALUE 0x5EF5C SD_FLOAT32_IEEE 0 SC_MISLEVEL1000 0 0.999985 /end CHARACTERISTIC
/begin COMPU_METHOD SC_MISLEVEL1000 "MISLEVEL1000 conversion" RAT_FUNC "%10.5" "%" COEFFS 0 1 0 0 0 1 /end COMPU_METHOD
/begin CHARACTERISTIC MISLEVELSMLR "Percent misfire threshold for similar conditions check" VALUE 0x5EF58 SD_FLOAT32_IEEE 0 SC_MISLEVELSMLR 0 0.999985 /end CHARACTERISTIC
/begin COMPU_METHOD SC_MISLEVELSMLR "MISLEVELSMLR conversion" RAT_FUNC "%10.5" "%" COEFFS 0 1 0 0 0 1 /end COMPU_METHOD
/begin CHARACTERISTIC MISLVLEXP "Misfire rate threshold for control of FFG_MISFIRE" VALUE 0x5ED50 SD_FLOAT32_IEEE 0 SC_MISLVLEXP 0 0.999985 /end CHARACTERISTIC
/begin COMPU_METHOD SC_MISLVLEXP "MISLVLEXP conversion" RAT_FUNC "%10.5" "%" COEFFS 0 1 0 0 0 1 /end COMPU_METHOD
/begin MEASUREMENT MISMATCH_FAULT "IDM Mismatch Fault message" UBYTE MC_MISMATCH_FAULT 0 0 0 0 ECU_ADDRESS 0x3FB682 /end MEASUREMENT
/begin COMPU_METHOD MC_MISMATCH_FAULT "MISMATCH_FAULT conversion" RAT_FUNC "%3.0" "Unitless" COEFFS 0 1 0 0 0 1 /end COMPU_METHOD
/begin MEASUREMENT MISTHRES1000 "Misfire rate per 1000 revs threshold, based on emissions." FLOAT32_IEEE MC_MISTHRES1000 0 0 0 0 ECU_ADDRESS 0x3FB3E4 /end MEASUREMENT
/begin COMPU_METHOD MC_MISTHRES1000 "MISTHRES1000 conversion" RAT_FUNC "%10.5" "Unitless" COEFFS 0 1 0 0 0 1 /end COMPU_METHOD
/begin MEASUREMENT MISTHRES200 "Misfire rate per 200 revs threshold, based on catalyst damage criteria." FLOAT32_IEEE MC_MISTHRES200 0 0 0 0 ECU_ADDRESS 0x3FB3CC /end MEASUREMENT
/begin COMPU_METHOD MC_MISTHRES200 "MISTHRES200 conversion" RAT_FUNC "%10.5" "Unitless" COEFFS 0 1 0 0 0 1 /end COMPU_METHOD
/begin CHARACTERISTIC MISTHRESPCT "multiplier (normally < 1) for lower (noise) devient acceleration threshold" VALUE 0x5EE1C SD_FLOAT32_IEEE 0 SC_MISTHRESPCT 0 1.99219 /end CHARACTERISTIC
/begin COMPU_METHOD SC_MISTHRESPCT "MISTHRESPCT conversion" RAT_FUNC "%10.5" "fraction" COEFFS 0 1 0 0 0 1 /end COMPU_METHOD
/begin MEASUREMENT MISTOTDLY "Total time delay after startup before enabling misfire." UWORD MC_MISTOTDLY 0 0 0 0 ECU_ADDRESS 0x3FB37C /end MEASUREMENT
/begin COMPU_METHOD MC_MISTOTDLY "MISTOTDLY conversion" RAT_FUNC "%5.0" "Unitless" COEFFS 0 1 0 0 0 1 /end COMPU_METHOD
/begin CHARACTERISTIC MIS_AAT_MAX "Max AAT in order to detect misfire" VALUE 0x5EE58 SD_FLOAT32_IEEE 0 SC_MIS_AAT_MAX -8192 8191 /end CHARACTERISTIC
/begin COMPU_METHOD SC_MIS_AAT_MAX "MIS_AAT_MAX conversion" RAT_FUNC "%10.5" "degC" COEFFS 0 1 0 0 0 1 /end COMPU_METHOD
/begin CHARACTERISTIC MIS_AAT_MIN "Minuimum AAT value to detect misfire" VALUE 0x5EE54 SD_FLOAT32_IEEE 0 SC_MIS_AAT_MIN -8192 8191 /end CHARACTERISTIC
/begin COMPU_METHOD SC_MIS_AAT_MIN "MIS_AAT_MIN conversion" RAT_FUNC "%10.5" "degC" COEFFS 0 1 0 0 0 1 /end COMPU_METHOD
/begin MEASUREMENT MIS_ACCS_OLD "Last pass value of accflg, used by misfire." UBYTE MC_MIS_ACCS_OLD 0 0 0 0 ECU_ADDRESS 0x3FB383 /end MEASUREMENT
/begin COMPU_METHOD MC_MIS_ACCS_OLD "MIS_ACCS_OLD conversion" RAT_FUNC "%3.0" "Unitless" COEFFS 0 1 0 0 0 1 /end COMPU_METHOD
/begin MEASUREMENT MIS_ACC_FLG "Flag toggled to 1 when accessories are turned on/off.  Feeds into misfire test ready logic." UBYTE MC_MIS_ACC_FLG 0 0 0 0 ECU_ADDRESS 0x3FB381 /end MEASUREMENT
/begin COMPU_METHOD MC_MIS_ACC_FLG "MIS_ACC_FLG conversion" RAT_FUNC "%3.0" "Unitless" COEFFS 0 1 0 0 0 1 /end COMPU_METHOD
/begin CHARACTERISTIC MIS_BG_SW "" VALUE 0x5C880 SD_UBYTE 0 SC_MIS_BG_SW 0 1 /end CHARACTERISTIC
/begin COMPU_METHOD SC_MIS_BG_SW "MIS_BG_SW conversion" RAT_FUNC "%3.0" "unitless" COEFFS 0 1 0 0 0 1 /end COMPU_METHOD
/begin CHARACTERISTIC MIS_CAT_CONF "Catalyst configuration for misfire detection purposes, 0 -> both cylinder banks into one cat; 1 -> A" VALUE 0x5EF45 SD_UBYTE 0 SC_MIS_CAT_CONF 0 1 /end CHARACTERISTIC
/begin COMPU_METHOD SC_MIS_CAT_CONF "MIS_CAT_CONF conversion" RAT_FUNC "%3.0" "COUNTS" COEFFS 0 1 0 0 0 1 /end COMPU_METHOD
/begin MEASUREMENT MIS_CF "current profile correction factor is assigned to this register which is then applied to the velocity" FLOAT32_IEEE MC_MIS_CF 0 0 0 0 ECU_ADDRESS 0x3FB314 /end MEASUREMENT
/begin COMPU_METHOD MC_MIS_CF "MIS_CF conversion" RAT_FUNC "%10.5" "Unitless" COEFFS 0 1 0 0 0 1 /end COMPU_METHOD
/begin CHARACTERISTIC MIS_CSSRE_CM "Cat midbed temperature limit, below which misfire thresholds will be compensated for loss of amplitude due to CSSRE." VALUE 0x5EE0C SD_FLOAT32_IEEE 0 SC_MIS_CSSRE_CM -4095 4095.88 /end CHARACTERISTIC
/begin COMPU_METHOD SC_MIS_CSSRE_CM "MIS_CSSRE_CM conversion" RAT_FUNC "%10.5" "degF" COEFFS 0 1 0 0 0 1 /end COMPU_METHOD
/begin CHARACTERISTIC MIS_CSSRE_TM "Time period after startup in which misfire thresholds may be compensated for loss of amplitude due to CSSRE." VALUE 0x5EE24 SD_UBYTE 0 SC_MIS_CSSRE_TM 0 255 /end CHARACTERISTIC
/begin COMPU_METHOD SC_MIS_CSSRE_TM "MIS_CSSRE_TM conversion" RAT_FUNC "%3.0" "s" COEFFS 0 1 0 0 0 1 /end COMPU_METHOD
/begin CHARACTERISTIC MIS_CYL_CAL "Controls whether cylinder faults disable misfire detection" VALUE 0x5EE9D SD_UBYTE 0 SC_MIS_CYL_CAL 0 1 /end CHARACTERISTIC
/begin COMPU_METHOD SC_MIS_CYL_CAL "MIS_CYL_CAL conversion" RAT_FUNC "%3.0" "unitless" COEFFS 0 1 0 0 0 1 /end COMPU_METHOD
/begin CHARACTERISTIC MIS_EBP_ENA "Max EBP in order to detect misfire" VALUE 0x5EE5C SD_FLOAT32_IEEE 0 SC_MIS_EBP_ENA 0 16383 /end CHARACTERISTIC
/begin COMPU_METHOD SC_MIS_EBP_ENA "MIS_EBP_ENA conversion" RAT_FUNC "%10.5" "kPa" COEFFS 0 1 0 0 0 1 /end COMPU_METHOD
/begin CHARACTERISTIC MIS_EDGE_SEL "Switch which selects which pip edge to run misfire detection, 0 -> pip down, 1 -> pip up." VALUE 0x5ED61 SD_UBYTE 0 SC_MIS_EDGE_SEL 0 1 /end CHARACTERISTIC
/begin COMPU_METHOD SC_MIS_EDGE_SEL "MIS_EDGE_SEL conversion" RAT_FUNC "%3.0" "unitless" COEFFS 0 1 0 0 0 1 /end COMPU_METHOD
/begin MEASUREMENT MIS_ENA_FRST "indicated first background of misfire after enable has taken place" UBYTE MC_MIS_ENA_FRST 0 0 0 0 ECU_ADDRESS 0x3FB3A8 /end MEASUREMENT
/begin COMPU_METHOD MC_MIS_ENA_FRST "MIS_ENA_FRST conversion" RAT_FUNC "%3.0" "Unitless" COEFFS 0 1 0 0 0 1 /end COMPU_METHOD
/begin CHARACTERISTIC MIS_EOTMAX "" VALUE 0x5EE94 SD_FLOAT32_IEEE 0 SC_MIS_EOTMAX 0 150 /end CHARACTERISTIC
/begin COMPU_METHOD SC_MIS_EOTMAX "MIS_EOTMAX conversion" RAT_FUNC "%10.5" "degC" COEFFS 0 1 0 0 0 1 /end COMPU_METHOD
/begin CHARACTERISTIC MIS_EOTMIN "" VALUE 0x5EE90 SD_FLOAT32_IEEE 0 SC_MIS_EOTMIN 0 150 /end CHARACTERISTIC
/begin COMPU_METHOD SC_MIS_EOTMIN "MIS_EOTMIN conversion" RAT_FUNC "%10.5" "degC" COEFFS 0 1 0 0 0 1 /end COMPU_METHOD
/begin MEASUREMENT MIS_ER_ENA "Flag to signal the Misfire test to do engine running on demand test." UBYTE MC_MIS_ER_ENA 0 0 0 0 ECU_ADDRESS 0x3FB4FB /end MEASUREMENT
/begin COMPU_METHOD MC_MIS_ER_ENA "MIS_ER_ENA conversion" RAT_FUNC "%3.0" "Unitless" COEFFS 0 1 0 0 0 1 /end COMPU_METHOD
/begin MEASUREMENT MIS_FCO_FLG "Flag indicating FMEM action is being taken during type A misfire." UBYTE MC_MIS_FCO_FLG 0 0 0 0 ECU_ADDRESS 0x3FB2AA /end MEASUREMENT
/begin COMPU_METHOD MC_MIS_FCO_FLG "MIS_FCO_FLG conversion" RAT_FUNC "%3.0" "Unitless" COEFFS 0 1 0 0 0 1 /end COMPU_METHOD
/begin CHARACTERISTIC MIS_FG_SW "" VALUE 0x5C8AC SD_UBYTE 0 SC_MIS_FG_SW 0 1 /end CHARACTERISTIC
/begin COMPU_METHOD SC_MIS_FG_SW "MIS_FG_SW conversion" RAT_FUNC "%3.0" "unitless" COEFFS 0 1 0 0 0 1 /end COMPU_METHOD
/begin MEASUREMENT MIS_FMEM "MIS system FMEM flag.  1 -> don't run MIS monitor due to FMEM." UBYTE MC_MIS_FMEM 0 0 0 0 ECU_ADDRESS 0x3F9E58 /end MEASUREMENT
/begin COMPU_METHOD MC_MIS_FMEM "MIS_FMEM conversion" RAT_FUNC "%3.0" "Unitless" COEFFS 0 1 0 0 0 1 /end COMPU_METHOD
/begin MEASUREMENT MIS_HW_FM "Misfire hw fault flag, set if AICE I/C is in continuous overflow mode, or cannot be initialized by SW." UBYTE MC_MIS_HW_FM 0 0 0 0 ECU_ADDRESS 0x3FB33C /end MEASUREMENT
/begin COMPU_METHOD MC_MIS_HW_FM "MIS_HW_FM conversion" RAT_FUNC "%3.0" "Unitless" COEFFS 0 1 0 0 0 1 /end COMPU_METHOD
/begin MEASUREMENT MIS_HW_RDY "Misfire hw status flag, set to 1 when hw is ok for misfire detection." UBYTE MC_MIS_HW_RDY 0 0 0 0 ECU_ADDRESS 0x3FB33D /end MEASUREMENT
/begin COMPU_METHOD MC_MIS_HW_RDY "MIS_HW_RDY conversion" RAT_FUNC "%3.0" "Unitless" COEFFS 0 1 0 0 0 1 /end COMPU_METHOD
/begin CHARACTERISTIC MIS_ICPDTYMX "Minimum ICP_DTY at which to detect misfire" VALUE 0x5EE4C SD_FLOAT32_IEEE 0 SC_MIS_ICPDTYMX 0 1 /end CHARACTERISTIC
/begin COMPU_METHOD SC_MIS_ICPDTYMX "MIS_ICPDTYMX conversion" RAT_FUNC "%10.5" "unitless" COEFFS 0 1 0 0 0 1 /end COMPU_METHOD
/begin CHARACTERISTIC MIS_LOCK_ON "If the ""bcsdc"" exceeds this duty cycle threshold, then infer the torque convertor is locked and use alt misfire threshold scalars." VALUE 0x5EE18 SD_FLOAT32_IEEE 0 SC_MIS_LOCK_ON 0 1.99997 /end CHARACTERISTIC
/begin COMPU_METHOD SC_MIS_LOCK_ON "MIS_LOCK_ON conversion" RAT_FUNC "%10.5" "FRAC" COEFFS 0 1 0 0 0 1 /end COMPU_METHOD
/begin CHARACTERISTIC MIS_MF_MAX "" VALUE 0x5EE50 SD_FLOAT32_IEEE 0 SC_MIS_MF_MAX -2048 2047.94 /end CHARACTERISTIC
/begin COMPU_METHOD SC_MIS_MF_MAX "MIS_MF_MAX conversion" RAT_FUNC "%10.5" "unitless" COEFFS 0 1 0 0 0 1 /end COMPU_METHOD
/begin CHARACTERISTIC MIS_MIN_TQ "Minimum net torque required to allow misfire testing." VALUE 0x5EE8C SD_FLOAT32_IEEE 0 SC_MIS_MIN_TQ -1024 1023 /end CHARACTERISTIC
/begin COMPU_METHOD SC_MIS_MIN_TQ "MIS_MIN_TQ conversion" RAT_FUNC "%10.5" "lbf*ft" COEFFS 0 1 0 0 0 1 /end COMPU_METHOD
/begin MEASUREMENT MIS_MON "obdII misfire test monior complete for trip indication" UBYTE MC_MIS_MON 0 0 0 0 ECU_ADDRESS 0x3FB2AD /end MEASUREMENT
/begin COMPU_METHOD MC_MIS_MON "MIS_MON conversion" RAT_FUNC "%3.0" "Unitless" COEFFS 0 1 0 0 0 1 /end COMPU_METHOD
/begin MEASUREMENT MIS_MON_KAM "same as MIS_MON but stored in KAM" UBYTE MC_MIS_MON_KAM 0 0 0 0 ECU_ADDRESS 0x3FCFEC /end MEASUREMENT
/begin COMPU_METHOD MC_MIS_MON_KAM "MIS_MON_KAM conversion" RAT_FUNC "%3.0" "Unitless" COEFFS 0 1 0 0 0 1 /end COMPU_METHOD
/begin CHARACTERISTIC MIS_MPH_ENA "Max vehicle speed to run misfire detection" VALUE 0x5EE60 SD_FLOAT32_IEEE 0 SC_MIS_MPH_ENA 0 127.998 /end CHARACTERISTIC
/begin COMPU_METHOD SC_MIS_MPH_ENA "MIS_MPH_ENA conversion" RAT_FUNC "%10.5" "MPH" COEFFS 0 1 0 0 0 1 /end COMPU_METHOD
/begin MEASUREMENT MIS_NEU_FLG "Flag set when rpm exceeds neutral rpm limit for misfire testing (prior to hitting fuel cutout)." UBYTE MC_MIS_NEU_FLG 0 0 0 0 ECU_ADDRESS 0x3FB37F /end MEASUREMENT
/begin COMPU_METHOD MC_MIS_NEU_FLG "MIS_NEU_FLG conversion" RAT_FUNC "%3.0" "Unitless" COEFFS 0 1 0 0 0 1 /end COMPU_METHOD
/begin MEASUREMENT MIS_NMAX_FLG "Flag set if rpm exceeds hi rpm limit for misfire testing." UBYTE MC_MIS_NMAX_FLG 0 0 0 0 ECU_ADDRESS 0x3FB37E /end MEASUREMENT
/begin COMPU_METHOD MC_MIS_NMAX_FLG "MIS_NMAX_FLG conversion" RAT_FUNC "%3.0" "Unitless" COEFFS 0 1 0 0 0 1 /end COMPU_METHOD
/begin CHARACTERISTIC MIS_NMAX_NEU "Neutral rpm limit for misfire, disables monitor prior to hitting neutral fuel cutout." VALUE 0x5EE68 SD_FLOAT32_IEEE 0 SC_MIS_NMAX_NEU 0 16383.8 /end CHARACTERISTIC
/begin COMPU_METHOD SC_MIS_NMAX_NEU "MIS_NMAX_NEU conversion" RAT_FUNC "%10.5" "RPM" COEFFS 0 1 0 0 0 1 /end COMPU_METHOD
/begin MEASUREMENT MIS_NOCALL "development register; number of firings not assessed" ULONG MC_MIS_NOCALL 0 0 0 0 ECU_ADDRESS 0x3FB354 /end MEASUREMENT
/begin COMPU_METHOD MC_MIS_NOCALL "MIS_NOCALL conversion" RAT_FUNC "%10.0" "Unitless" COEFFS 0 1 0 0 0 1 /end COMPU_METHOD
/begin MEASUREMENT MIS_NOCALLO "Last pass value of ""mis_nocall""." ULONG MC_MIS_NOCALLO 0 0 0 0 ECU_ADDRESS 0x3FB38C /end MEASUREMENT
/begin COMPU_METHOD MC_MIS_NOCALLO "MIS_NOCALLO conversion" RAT_FUNC "%10.0" "Unitless" COEFFS 0 1 0 0 0 1 /end COMPU_METHOD
/begin CHARACTERISTIC MIS_NTQ_DEL "If delta engine torque value exceeds this lower limit (decel), disable misfire testing." VALUE 0x5EE88 SD_FLOAT32_IEEE 0 SC_MIS_NTQ_DEL -1024 1023 /end CHARACTERISTIC
/begin COMPU_METHOD SC_MIS_NTQ_DEL "MIS_NTQ_DEL conversion" RAT_FUNC "%10.5" "lbf*ft" COEFFS 0 1 0 0 0 1 /end COMPU_METHOD
/begin MEASUREMENT MIS_NTQ_FLG "Flag set to 1 when engine torque falls below misfire testing threshold.  Feeds into misfire test ready logic." UBYTE MC_MIS_NTQ_FLG 0 0 0 0 ECU_ADDRESS 0x3FB380 /end MEASUREMENT
/begin COMPU_METHOD MC_MIS_NTQ_FLG "MIS_NTQ_FLG conversion" RAT_FUNC "%3.0" "Unitless" COEFFS 0 1 0 0 0 1 /end COMPU_METHOD
/begin CHARACTERISTIC MIS_OT_MAX "If cat midbed temperature exceeds this damage threshold, allow the type A misfire test to set fault codes if misfiring." VALUE 0x5EF3C SD_FLOAT32_IEEE 0 SC_MIS_OT_MAX -4095 4096 /end CHARACTERISTIC
/begin COMPU_METHOD SC_MIS_OT_MAX "MIS_OT_MAX conversion" RAT_FUNC "%10.5" "degF" COEFFS 0 1 0 0 0 1 /end COMPU_METHOD
/begin CHARACTERISTIC MIS_PDL_CAL "1 = misfire detection disabled for Park,Neutral.  2 = detection disabled for drive" VALUE 0x5EE9C SD_UBYTE 0 SC_MIS_PDL_CAL 0 2 /end CHARACTERISTIC
/begin COMPU_METHOD SC_MIS_PDL_CAL "MIS_PDL_CAL conversion" RAT_FUNC "%3.0" "unitless" COEFFS 0 1 0 0 0 1 /end COMPU_METHOD
/begin CHARACTERISTIC MIS_PTQ_DEL "If delta engine torque value exceeds this upper limit (heavy tip-in), disable misfire testing." VALUE 0x5EE84 SD_FLOAT32_IEEE 0 SC_MIS_PTQ_DEL -1024 1023 /end CHARACTERISTIC
/begin COMPU_METHOD SC_MIS_PTQ_DEL "MIS_PTQ_DEL conversion" RAT_FUNC "%10.5" "lbf*ft" COEFFS 0 1 0 0 0 1 /end COMPU_METHOD
/begin MEASUREMENT MIS_RATE1000 "Misfire rate calculation used by the 1000 rev test, sum of all cylinder rates." FLOAT32_IEEE MC_MIS_RATE1000 0 0 0 0 ECU_ADDRESS 0x3FB3E8 /end MEASUREMENT
/begin COMPU_METHOD MC_MIS_RATE1000 "MIS_RATE1000 conversion" RAT_FUNC "%10.5" "Unitless" COEFFS 0 1 0 0 0 1 /end COMPU_METHOD
/begin MEASUREMENT MIS_RATE200 "Misfire rate calculation used by the 200 rev test, sum of all cylinder rates per bank or engine depening on cat config." FLOAT32_IEEE MC_MIS_RATE200 0 0 0 0 ECU_ADDRESS 0x3FB3D0 /end MEASUREMENT
/begin COMPU_METHOD MC_MIS_RATE200 "MIS_RATE200 conversion" RAT_FUNC "%10.5" "Unitless" COEFFS 0 1 0 0 0 1 /end COMPU_METHOD
/begin MEASUREMENT MIS_SMLR_ENA "When non-misfiring conditions are present, this flag is set to enable checking for similar conditions." UBYTE MC_MIS_SMLR_ENA 0 0 0 0 ECU_ADDRESS 0x3FB3F4 /end MEASUREMENT
/begin COMPU_METHOD MC_MIS_SMLR_ENA "MIS_SMLR_ENA conversion" RAT_FUNC "%3.0" "Unitless" COEFFS 0 1 0 0 0 1 /end COMPU_METHOD
/begin MEASUREMENT MIS_SPK_MULT "Multiplier to compensate misfire thresholds for loss of amplitude with spark retard from mbt." FLOAT32_IEEE MC_MIS_SPK_MULT 0 0 0 0 ECU_ADDRESS 0x3FB35C /end MEASUREMENT
/begin COMPU_METHOD MC_MIS_SPK_MULT "MIS_SPK_MULT conversion" RAT_FUNC "%10.5" "Unitless" COEFFS 0 1 0 0 0 1 /end COMPU_METHOD
/begin CHARACTERISTIC MIS_STRT_DLY "min time since exiting crank mode before misfire monitor will be ready" VALUE 0x5EE9E SD_UBYTE 0 SC_MIS_STRT_DLY 0 255 /end CHARACTERISTIC
/begin COMPU_METHOD SC_MIS_STRT_DLY "MIS_STRT_DLY conversion" RAT_FUNC "%3.0" "s" COEFFS 0 1 0 0 0 1 /end COMPU_METHOD
/begin MEASUREMENT MIS_SYNC "Counts number of cylinder events per engine cycle.  Used by misfire to remove variant due to V10 SYCN_CTRW parameter." UBYTE MC_MIS_SYNC 0 0 0 0 ECU_ADDRESS 0x3FB330 /end MEASUREMENT
/begin COMPU_METHOD MC_MIS_SYNC "MIS_SYNC conversion" RAT_FUNC "%3.0" "Unitless" COEFFS 0 1 0 0 0 1 /end COMPU_METHOD
/begin CHARACTERISTIC MIS_TIPIN "If ""tp_rate"" exceeds this theshold (i.e. a tip-in), disable misfire testing." VALUE 0x5EE80 SD_FLOAT32_IEEE 0 SC_MIS_TIPIN -1024 1023.97 /end CHARACTERISTIC
/begin COMPU_METHOD SC_MIS_TIPIN "MIS_TIPIN conversion" RAT_FUNC "%10.5" "ADCT" COEFFS 0 1 0 0 0 1 /end COMPU_METHOD
/begin CHARACTERISTIC MIS_TIPOUT "If ""tp_rate"" exceeds this negative theshold (i.e. a tip-out), disable misfire testing." VALUE 0x5EE7C SD_FLOAT32_IEEE 0 SC_MIS_TIPOUT -1024 1023.97 /end CHARACTERISTIC
/begin COMPU_METHOD SC_MIS_TIPOUT "MIS_TIPOUT conversion" RAT_FUNC "%10.5" "ADCT" COEFFS 0 1 0 0 0 1 /end COMPU_METHOD
/begin MEASUREMENT MIS_TQ_DELTA "Delta change in engine torque, used by misfire to disable testing during large torque swings." FLOAT32_IEEE MC_MIS_TQ_DELTA 0 0 0 0 ECU_ADDRESS 0x3FB378 /end MEASUREMENT
/begin COMPU_METHOD MC_MIS_TQ_DELTA "MIS_TQ_DELTA conversion" RAT_FUNC "%10.5" "Unitless" COEFFS 0 1 0 0 0 1 /end COMPU_METHOD
/begin MEASUREMENT MIS_TQ_LAST "Last value of engine toruue, used by misfire to calculate a delta torque value." FLOAT32_IEEE MC_MIS_TQ_LAST 0 0 0 0 ECU_ADDRESS 0x3FB370 /end MEASUREMENT
/begin COMPU_METHOD MC_MIS_TQ_LAST "MIS_TQ_LAST conversion" RAT_FUNC "%10.5" "Unitless" COEFFS 0 1 0 0 0 1 /end COMPU_METHOD
/begin MEASUREMENT MIS_TST_ENA "OBD-II Misfire Test enable flag. (1 => test enabled)" UBYTE MC_MIS_TST_ENA 0 0 0 0 ECU_ADDRESS 0x3F9E38 /end MEASUREMENT
/begin COMPU_METHOD MC_MIS_TST_ENA "MIS_TST_ENA conversion" RAT_FUNC "%3.0" "Unitless" COEFFS 0 1 0 0 0 1 /end COMPU_METHOD
/begin MEASUREMENT MIS_TST_RDY "MIS test ready flag; 1 ->  all  local  conditions have been met; ready to run MIS test." UBYTE MC_MIS_TST_RDY 0 0 0 0 ECU_ADDRESS 0x3FB382 /end MEASUREMENT
/begin COMPU_METHOD MC_MIS_TST_RDY "MIS_TST_RDY conversion" RAT_FUNC "%3.0" "Unitless" COEFFS 0 1 0 0 0 1 /end COMPU_METHOD
/begin CHARACTERISTIC MIS_USE_HALF "when one indicate 4 cylinder engine misfire uses 1/2 period stroke bracket" VALUE 0x5ED60 SD_UBYTE 0 SC_MIS_USE_HALF 0 1 /end CHARACTERISTIC
/begin COMPU_METHOD SC_MIS_USE_HALF "MIS_USE_HALF conversion" RAT_FUNC "%3.0" "Unitless" COEFFS 0 1 0 0 0 1 /end COMPU_METHOD
/begin MEASUREMENT MNT_AFR "" FLOAT32_IEEE MC_MNT_AFR 0 0 0 0 ECU_ADDRESS 0x3FAF58 /end MEASUREMENT
/begin COMPU_METHOD MC_MNT_AFR "MNT_AFR conversion" RAT_FUNC "%10.5" "Unitless" COEFFS 0 1 0 0 0 1 /end COMPU_METHOD
/begin MEASUREMENT MNT_BAP "Barometric Pressure (in KPA)" FLOAT32_IEEE MC_MNT_BAP 0 0 0 0 ECU_ADDRESS 0x3FAF50 /end MEASUREMENT
/begin COMPU_METHOD MC_MNT_BAP "MNT_BAP conversion" RAT_FUNC "%10.5" "Unitless" COEFFS 0 1 0 0 0 1 /end COMPU_METHOD
/begin MEASUREMENT MNT_BAPTST_CNT "" UWORD MC_MNT_BAPTST_CNT 0 0 0 0 ECU_ADDRESS 0x3FAFBE /end MEASUREMENT
/begin COMPU_METHOD MC_MNT_BAPTST_CNT "MNT_BAPTST_CNT conversion" RAT_FUNC "%5.0" "Unitless" COEFFS 0 1 0 0 0 1 /end COMPU_METHOD
/begin MEASUREMENT MNT_BAPTST_TMR "" FLOAT32_IEEE MC_MNT_BAPTST_TMR 0 0 0 0 ECU_ADDRESS 0x3FAF48 /end MEASUREMENT
/begin COMPU_METHOD MC_MNT_BAPTST_TMR "MNT_BAPTST_TMR conversion" RAT_FUNC "%10.5" "Unitless" COEFFS 0 1 0 0 0 1 /end COMPU_METHOD
/begin MEASUREMENT MNT_BAP_DT "Barometric Pressure (in KPA)" FLOAT32_IEEE MC_MNT_BAP_DT 0 0 0 0 ECU_ADDRESS 0x3FAF4C /end MEASUREMENT
/begin COMPU_METHOD MC_MNT_BAP_DT "MNT_BAP_DT conversion" RAT_FUNC "%10.5" "Unitless" COEFFS 0 1 0 0 0 1 /end COMPU_METHOD
/begin CHARACTERISTIC MNT_BAP_DT_MAX "" VALUE 0x5E820 SD_FLOAT32_IEEE 0 SC_MNT_BAP_DT_MAX 0 500 /end CHARACTERISTIC
/begin COMPU_METHOD SC_MNT_BAP_DT_MAX "MNT_BAP_DT_MAX conversion" RAT_FUNC "%10.5" "unitless" COEFFS 0 1 0 0 0 1 /end COMPU_METHOD
/begin CHARACTERISTIC MNT_BAP_MAX "" VALUE 0x5E81C SD_FLOAT32_IEEE 0 SC_MNT_BAP_MAX 0 200 /end CHARACTERISTIC
/begin COMPU_METHOD SC_MNT_BAP_MAX "MNT_BAP_MAX conversion" RAT_FUNC "%10.5" "unitless" COEFFS 0 1 0 0 0 1 /end COMPU_METHOD
/begin CHARACTERISTIC MNT_BAP_MIN "" VALUE 0x5E818 SD_FLOAT32_IEEE 0 SC_MNT_BAP_MIN 0 200 /end CHARACTERISTIC
/begin COMPU_METHOD SC_MNT_BAP_MIN "MNT_BAP_MIN conversion" RAT_FUNC "%10.5" "unitless" COEFFS 0 1 0 0 0 1 /end COMPU_METHOD
/begin MEASUREMENT MNT_B_M "" FLOAT32_IEEE MC_MNT_B_M 0 0 0 0 ECU_ADDRESS 0x3FAF54 /end MEASUREMENT
/begin COMPU_METHOD MC_MNT_B_M "MNT_B_M conversion" RAT_FUNC "%10.5" "Unitless" COEFFS 0 1 0 0 0 1 /end COMPU_METHOD
/begin MEASUREMENT MNT_CDA "" FLOAT32_IEEE MC_MNT_CDA 0 0 0 0 ECU_ADDRESS 0x3FAF44 /end MEASUREMENT
/begin COMPU_METHOD MC_MNT_CDA "MNT_CDA conversion" RAT_FUNC "%10.5" "Unitless" COEFFS 0 1 0 0 0 1 /end COMPU_METHOD
/begin CHARACTERISTIC MNT_CDA_ITP "" VALUE 0x5E814 SD_FLOAT32_IEEE 0 SC_MNT_CDA_ITP -2 10 /end CHARACTERISTIC
/begin COMPU_METHOD SC_MNT_CDA_ITP "MNT_CDA_ITP conversion" RAT_FUNC "%10.5" "unitless" COEFFS 0 1 0 0 0 1 /end COMPU_METHOD
/begin CHARACTERISTIC MNT_CDA_ITP1 "" VALUE 0x5E810 SD_FLOAT32_IEEE 0 SC_MNT_CDA_ITP1 -2 10 /end CHARACTERISTIC
/begin COMPU_METHOD SC_MNT_CDA_ITP1 "MNT_CDA_ITP1 conversion" RAT_FUNC "%10.5" "unitless" COEFFS 0 1 0 0 0 1 /end COMPU_METHOD
/begin CHARACTERISTIC MNT_CDA_ITP2 "" VALUE 0x5E80C SD_FLOAT32_IEEE 0 SC_MNT_CDA_ITP2 -2 10 /end CHARACTERISTIC
/begin COMPU_METHOD SC_MNT_CDA_ITP2 "MNT_CDA_ITP2 conversion" RAT_FUNC "%10.5" "unitless" COEFFS 0 1 0 0 0 1 /end COMPU_METHOD
/begin CHARACTERISTIC MNT_CDA_ITP3 "" VALUE 0x5E808 SD_FLOAT32_IEEE 0 SC_MNT_CDA_ITP3 -2 10 /end CHARACTERISTIC
/begin COMPU_METHOD SC_MNT_CDA_ITP3 "MNT_CDA_ITP3 conversion" RAT_FUNC "%10.5" "unitless" COEFFS 0 1 0 0 0 1 /end COMPU_METHOD
/begin MEASUREMENT MNT_CYL_FLOW "" FLOAT32_IEEE MC_MNT_CYL_FLOW 0 0 0 0 ECU_ADDRESS 0x3FAF40 /end MEASUREMENT
/begin COMPU_METHOD MC_MNT_CYL_FLOW "MNT_CYL_FLOW conversion" RAT_FUNC "%10.5" "Unitless" COEFFS 0 1 0 0 0 1 /end COMPU_METHOD
/begin CHARACTERISTIC MNT_CYL_VOL "" VALUE 0x5E804 SD_FLOAT32_IEEE 0 SC_MNT_CYL_VOL 0 5 /end CHARACTERISTIC
/begin COMPU_METHOD SC_MNT_CYL_VOL "MNT_CYL_VOL conversion" RAT_FUNC "%10.5" "unitless" COEFFS 0 1 0 0 0 1 /end COMPU_METHOD
/begin MEASUREMENT MNT_DELAY_CNT "" UWORD MC_MNT_DELAY_CNT 0 0 0 0 ECU_ADDRESS 0x3FAFBC /end MEASUREMENT
/begin COMPU_METHOD MC_MNT_DELAY_CNT "MNT_DELAY_CNT conversion" RAT_FUNC "%5.0" "Unitless" COEFFS 0 1 0 0 0 1 /end COMPU_METHOD
/begin MEASUREMENT MNT_DELAY_TMR "" FLOAT32_IEEE MC_MNT_DELAY_TMR 0 0 0 0 ECU_ADDRESS 0x3FAF3C /end MEASUREMENT
/begin COMPU_METHOD MC_MNT_DELAY_TMR "MNT_DELAY_TMR conversion" RAT_FUNC "%10.5" "Unitless" COEFFS 0 1 0 0 0 1 /end COMPU_METHOD
/begin MEASUREMENT MNT_DP "" FLOAT32_IEEE MC_MNT_DP 0 0 0 0 ECU_ADDRESS 0x3FAF38 /end MEASUREMENT
/begin COMPU_METHOD MC_MNT_DP "MNT_DP conversion" RAT_FUNC "%10.5" "Unitless" COEFFS 0 1 0 0 0 1 /end COMPU_METHOD
/begin MEASUREMENT MNT_DPCOMP "" UBYTE MC_MNT_DPCOMP 0 0 0 0 ECU_ADDRESS 0x3FAFF0 /end MEASUREMENT
/begin COMPU_METHOD MC_MNT_DPCOMP "MNT_DPCOMP conversion" RAT_FUNC "%3.0" "Unitless" COEFFS 0 1 0 0 0 1 /end COMPU_METHOD
/begin MEASUREMENT MNT_EBP "" FLOAT32_IEEE MC_MNT_EBP 0 0 0 0 ECU_ADDRESS 0x3FAF34 /end MEASUREMENT
/begin COMPU_METHOD MC_MNT_EBP "MNT_EBP conversion" RAT_FUNC "%10.5" "Unitless" COEFFS 0 1 0 0 0 1 /end COMPU_METHOD
/begin MEASUREMENT MNT_EBPG "" FLOAT32_IEEE MC_MNT_EBPG 0 0 0 0 ECU_ADDRESS 0x3FAF30 /end MEASUREMENT
/begin COMPU_METHOD MC_MNT_EBPG "MNT_EBPG conversion" RAT_FUNC "%10.5" "Unitless" COEFFS 0 1 0 0 0 1 /end COMPU_METHOD
/begin MEASUREMENT MNT_EBPTST_CNT "" UWORD MC_MNT_EBPTST_CNT 0 0 0 0 ECU_ADDRESS 0x3FAFBA /end MEASUREMENT
/begin COMPU_METHOD MC_MNT_EBPTST_CNT "MNT_EBPTST_CNT conversion" RAT_FUNC "%5.0" "Unitless" COEFFS 0 1 0 0 0 1 /end COMPU_METHOD
/begin MEASUREMENT MNT_EBPTST_TMR "" FLOAT32_IEEE MC_MNT_EBPTST_TMR 0 0 0 0 ECU_ADDRESS 0x3FAF24 /end MEASUREMENT
/begin COMPU_METHOD MC_MNT_EBPTST_TMR "MNT_EBPTST_TMR conversion" RAT_FUNC "%10.5" "Unitless" COEFFS 0 1 0 0 0 1 /end COMPU_METHOD
/begin MEASUREMENT MNT_EBP_DES "" FLOAT32_IEEE MC_MNT_EBP_DES 0 0 0 0 ECU_ADDRESS 0x3FAF2C /end MEASUREMENT
/begin COMPU_METHOD MC_MNT_EBP_DES "MNT_EBP_DES conversion" RAT_FUNC "%10.5" "Unitless" COEFFS 0 1 0 0 0 1 /end COMPU_METHOD
/begin MEASUREMENT MNT_EBP_DT "" FLOAT32_IEEE MC_MNT_EBP_DT 0 0 0 0 ECU_ADDRESS 0x3FAF28 /end MEASUREMENT
/begin COMPU_METHOD MC_MNT_EBP_DT "MNT_EBP_DT conversion" RAT_FUNC "%10.5" "Unitless" COEFFS 0 1 0 0 0 1 /end COMPU_METHOD
/begin CHARACTERISTIC MNT_EBP_DT_MAX "" VALUE 0x5E800 SD_FLOAT32_IEEE 0 SC_MNT_EBP_DT_MAX 0 2000 /end CHARACTERISTIC
/begin COMPU_METHOD SC_MNT_EBP_DT_MAX "MNT_EBP_DT_MAX conversion" RAT_FUNC "%10.5" "unitless" COEFFS 0 1 0 0 0 1 /end COMPU_METHOD
/begin CHARACTERISTIC MNT_EBP_MAX "" VALUE 0x5E7FC SD_FLOAT32_IEEE 0 SC_MNT_EBP_MAX 0 500 /end CHARACTERISTIC
/begin COMPU_METHOD SC_MNT_EBP_MAX "MNT_EBP_MAX conversion" RAT_FUNC "%10.5" "unitless" COEFFS 0 1 0 0 0 1 /end COMPU_METHOD
/begin CHARACTERISTIC MNT_EBP_MIN "" VALUE 0x5E7F8 SD_FLOAT32_IEEE 0 SC_MNT_EBP_MIN 0 500 /end CHARACTERISTIC
/begin COMPU_METHOD SC_MNT_EBP_MIN "MNT_EBP_MIN conversion" RAT_FUNC "%10.5" "unitless" COEFFS 0 1 0 0 0 1 /end COMPU_METHOD
/begin CHARACTERISTIC MNT_EBP_TOL "" VALUE 0x5E7F4 SD_FLOAT32_IEEE 0 SC_MNT_EBP_TOL 0 2 /end CHARACTERISTIC
/begin COMPU_METHOD SC_MNT_EBP_TOL "MNT_EBP_TOL conversion" RAT_FUNC "%10.5" "unitless" COEFFS 0 1 0 0 0 1 /end COMPU_METHOD
/begin MEASUREMENT MNT_ECT_C "" FLOAT32_IEEE MC_MNT_ECT_C 0 0 0 0 ECU_ADDRESS 0x3FAF20 /end MEASUREMENT
/begin COMPU_METHOD MC_MNT_ECT_C "MNT_ECT_C conversion" RAT_FUNC "%10.5" "Unitless" COEFFS 0 1 0 0 0 1 /end COMPU_METHOD
/begin MEASUREMENT MNT_ECT_CTST_CNT "" UWORD MC_MNT_ECT_CTST_CNT 0 0 0 0 ECU_ADDRESS 0x3FAFB8 /end MEASUREMENT
/begin COMPU_METHOD MC_MNT_ECT_CTST_CNT "MNT_ECT_CTST_CNT conversion" RAT_FUNC "%5.0" "Unitless" COEFFS 0 1 0 0 0 1 /end COMPU_METHOD
/begin MEASUREMENT MNT_ECT_C_DT "" FLOAT32_IEEE MC_MNT_ECT_C_DT 0 0 0 0 ECU_ADDRESS 0x3FAF1C /end MEASUREMENT
/begin COMPU_METHOD MC_MNT_ECT_C_DT "MNT_ECT_C_DT conversion" RAT_FUNC "%10.5" "Unitless" COEFFS 0 1 0 0 0 1 /end COMPU_METHOD
/begin CHARACTERISTIC MNT_ECT_C_DT_MAX "" VALUE 0x5E7F0 SD_FLOAT32_IEEE 0 SC_MNT_ECT_C_DT_MAX 0 500 /end CHARACTERISTIC
/begin COMPU_METHOD SC_MNT_ECT_C_DT_MAX "MNT_ECT_C_DT_MAX conversion" RAT_FUNC "%10.5" "unitless" COEFFS 0 1 0 0 0 1 /end COMPU_METHOD
/begin CHARACTERISTIC MNT_ECT_C_MAX "" VALUE 0x5E7EC SD_FLOAT32_IEEE 0 SC_MNT_ECT_C_MAX -100 300 /end CHARACTERISTIC
/begin COMPU_METHOD SC_MNT_ECT_C_MAX "MNT_ECT_C_MAX conversion" RAT_FUNC "%10.5" "unitless" COEFFS 0 1 0 0 0 1 /end COMPU_METHOD
/begin CHARACTERISTIC MNT_ECT_C_MIN "" VALUE 0x5E7E8 SD_FLOAT32_IEEE 0 SC_MNT_ECT_C_MIN -100 300 /end CHARACTERISTIC
/begin COMPU_METHOD SC_MNT_ECT_C_MIN "MNT_ECT_C_MIN conversion" RAT_FUNC "%10.5" "unitless" COEFFS 0 1 0 0 0 1 /end COMPU_METHOD
/begin CHARACTERISTIC MNT_ECT_FW "" VALUE 0x5E7E4 SD_FLOAT32_IEEE 0 SC_MNT_ECT_FW 0 200 /end CHARACTERISTIC
/begin COMPU_METHOD SC_MNT_ECT_FW "MNT_ECT_FW conversion" RAT_FUNC "%10.5" "unitless" COEFFS 0 1 0 0 0 1 /end COMPU_METHOD
/begin MEASUREMENT MNT_EGRP "" FLOAT32_IEEE MC_MNT_EGRP 0 0 0 0 ECU_ADDRESS 0x3FAF04 /end MEASUREMENT
/begin COMPU_METHOD MC_MNT_EGRP "MNT_EGRP conversion" RAT_FUNC "%10.5" "Unitless" COEFFS 0 1 0 0 0 1 /end COMPU_METHOD
/begin MEASUREMENT MNT_EGRPTST_CNT "" UWORD MC_MNT_EGRPTST_CNT 0 0 0 0 ECU_ADDRESS 0x3FAFB6 /end MEASUREMENT
/begin COMPU_METHOD MC_MNT_EGRPTST_CNT "MNT_EGRPTST_CNT conversion" RAT_FUNC "%5.0" "Unitless" COEFFS 0 1 0 0 0 1 /end COMPU_METHOD
/begin MEASUREMENT MNT_EGRPTST_TMR "" FLOAT32_IEEE MC_MNT_EGRPTST_TMR 0 0 0 0 ECU_ADDRESS 0x3FAEF8 /end MEASUREMENT
/begin COMPU_METHOD MC_MNT_EGRPTST_TMR "MNT_EGRPTST_TMR conversion" RAT_FUNC "%10.5" "Unitless" COEFFS 0 1 0 0 0 1 /end COMPU_METHOD
/begin CHARACTERISTIC MNT_EGRP_CLOSED "" VALUE 0x5E7B0 SD_FLOAT32_IEEE 0 SC_MNT_EGRP_CLOSED 0 1 /end CHARACTERISTIC
/begin COMPU_METHOD SC_MNT_EGRP_CLOSED "MNT_EGRP_CLOSED conversion" RAT_FUNC "%10.5" "unitless" COEFFS 0 1 0 0 0 1 /end COMPU_METHOD
/begin MEASUREMENT MNT_EGRP_DES "" FLOAT32_IEEE MC_MNT_EGRP_DES 0 0 0 0 ECU_ADDRESS 0x3FAF00 /end MEASUREMENT
/begin COMPU_METHOD MC_MNT_EGRP_DES "MNT_EGRP_DES conversion" RAT_FUNC "%10.5" "Unitless" COEFFS 0 1 0 0 0 1 /end COMPU_METHOD
/begin MEASUREMENT MNT_EGRP_DT "" FLOAT32_IEEE MC_MNT_EGRP_DT 0 0 0 0 ECU_ADDRESS 0x3FAEFC /end MEASUREMENT
/begin COMPU_METHOD MC_MNT_EGRP_DT "MNT_EGRP_DT conversion" RAT_FUNC "%10.5" "Unitless" COEFFS 0 1 0 0 0 1 /end COMPU_METHOD
/begin CHARACTERISTIC MNT_EGRP_DT_MIN "" VALUE 0x5E7AC SD_FLOAT32_IEEE 0 SC_MNT_EGRP_DT_MIN 0 1 /end CHARACTERISTIC
/begin COMPU_METHOD SC_MNT_EGRP_DT_MIN "MNT_EGRP_DT_MIN conversion" RAT_FUNC "%10.5" "unitless" COEFFS 0 1 0 0 0 1 /end COMPU_METHOD
/begin CHARACTERISTIC MNT_EGRP_MAX "" VALUE 0x5E7A8 SD_FLOAT32_IEEE 0 SC_MNT_EGRP_MAX 0 1 /end CHARACTERISTIC
/begin COMPU_METHOD SC_MNT_EGRP_MAX "MNT_EGRP_MAX conversion" RAT_FUNC "%10.5" "unitless" COEFFS 0 1 0 0 0 1 /end COMPU_METHOD
/begin CHARACTERISTIC MNT_EGRP_MIN "" VALUE 0x5E7A4 SD_FLOAT32_IEEE 0 SC_MNT_EGRP_MIN 0 1 /end CHARACTERISTIC
/begin COMPU_METHOD SC_MNT_EGRP_MIN "MNT_EGRP_MIN conversion" RAT_FUNC "%10.5" "unitless" COEFFS 0 1 0 0 0 1 /end COMPU_METHOD
/begin CHARACTERISTIC MNT_EGRP_OPEN "" VALUE 0x5E7A0 SD_FLOAT32_IEEE 0 SC_MNT_EGRP_OPEN 0 1 /end CHARACTERISTIC
/begin COMPU_METHOD SC_MNT_EGRP_OPEN "MNT_EGRP_OPEN conversion" RAT_FUNC "%10.5" "unitless" COEFFS 0 1 0 0 0 1 /end COMPU_METHOD
/begin CHARACTERISTIC MNT_EGRP_TOL "" VALUE 0x5E79C SD_FLOAT32_IEEE 0 SC_MNT_EGRP_TOL 0 2 /end CHARACTERISTIC
/begin COMPU_METHOD SC_MNT_EGRP_TOL "MNT_EGRP_TOL conversion" RAT_FUNC "%10.5" "unitless" COEFFS 0 1 0 0 0 1 /end COMPU_METHOD
/begin MEASUREMENT MNT_EGRT_PRED "" FLOAT32_IEEE MC_MNT_EGRT_PRED 0 0 0 0 ECU_ADDRESS 0x3FAEF4 /end MEASUREMENT
/begin COMPU_METHOD MC_MNT_EGRT_PRED "MNT_EGRT_PRED conversion" RAT_FUNC "%10.5" "Unitless" COEFFS 0 1 0 0 0 1 /end COMPU_METHOD
/begin CHARACTERISTIC MNT_EGR_COND_MULT_TRANS "" VALUE 0x5E7E0 SD_FLOAT32_IEEE 0 SC_MNT_EGR_COND_MULT_TRANS 0 1 /end CHARACTERISTIC
/begin COMPU_METHOD SC_MNT_EGR_COND_MULT_TRANS "MNT_EGR_COND_MULT_TRANS conversion" RAT_FUNC "%10.5" "unitless" COEFFS 0 1 0 0 0 1 /end COMPU_METHOD
/begin MEASUREMENT MNT_EGR_DES "" FLOAT32_IEEE MC_MNT_EGR_DES 0 0 0 0 ECU_ADDRESS 0x3FAF14 /end MEASUREMENT
/begin COMPU_METHOD MC_MNT_EGR_DES "MNT_EGR_DES conversion" RAT_FUNC "%10.5" "Unitless" COEFFS 0 1 0 0 0 1 /end COMPU_METHOD
/begin MEASUREMENT MNT_EGR_EST "" FLOAT32_IEEE MC_MNT_EGR_EST 0 0 0 0 ECU_ADDRESS 0x3FAF10 /end MEASUREMENT
/begin COMPU_METHOD MC_MNT_EGR_EST "MNT_EGR_EST conversion" RAT_FUNC "%10.5" "Unitless" COEFFS 0 1 0 0 0 1 /end COMPU_METHOD
/begin CHARACTERISTIC MNT_EGR_EST_KF "Filter constant for mnt_egr_est" VALUE 0x5E7D4 SD_FLOAT32_IEEE 0 SC_MNT_EGR_EST_KF -2 2 /end CHARACTERISTIC
/begin COMPU_METHOD SC_MNT_EGR_EST_KF "MNT_EGR_EST_KF conversion" RAT_FUNC "%10.5" "unitless" COEFFS 0 1 0 0 0 1 /end COMPU_METHOD
/begin CHARACTERISTIC MNT_EGR_EST_LMN "" VALUE 0x5E7DC SD_FLOAT32_IEEE 0 SC_MNT_EGR_EST_LMN 0 1 /end CHARACTERISTIC
/begin COMPU_METHOD SC_MNT_EGR_EST_LMN "MNT_EGR_EST_LMN conversion" RAT_FUNC "%10.5" "unitless" COEFFS 0 1 0 0 0 1 /end COMPU_METHOD
/begin CHARACTERISTIC MNT_EGR_EST_LMX "" VALUE 0x5E7D8 SD_FLOAT32_IEEE 0 SC_MNT_EGR_EST_LMX 0 1 /end CHARACTERISTIC
/begin COMPU_METHOD SC_MNT_EGR_EST_LMX "MNT_EGR_EST_LMX conversion" RAT_FUNC "%10.5" "unitless" COEFFS 0 1 0 0 0 1 /end COMPU_METHOD
/begin CHARACTERISTIC MNT_EGR_ETA_ECLR "" VALUE 0x5E7D0 SD_FLOAT32_IEEE 0 SC_MNT_EGR_ETA_ECLR 0 10 /end CHARACTERISTIC
/begin COMPU_METHOD SC_MNT_EGR_ETA_ECLR "MNT_EGR_ETA_ECLR conversion" RAT_FUNC "%10.5" "unitless" COEFFS 0 1 0 0 0 1 /end COMPU_METHOD
/begin CHARACTERISTIC MNT_EGR_ICT_CP "" VALUE 0x5E7C8 SD_FLOAT32_IEEE 0 SC_MNT_EGR_ICT_CP 0 5000 /end CHARACTERISTIC
/begin COMPU_METHOD SC_MNT_EGR_ICT_CP "MNT_EGR_ICT_CP conversion" RAT_FUNC "%10.5" "unitless" COEFFS 0 1 0 0 0 1 /end COMPU_METHOD
/begin CHARACTERISTIC MNT_EGR_ICT_LHV "" VALUE 0x5E7CC SD_FLOAT32_IEEE 0 SC_MNT_EGR_ICT_LHV 0 4.1943e+06 /end CHARACTERISTIC
/begin COMPU_METHOD SC_MNT_EGR_ICT_LHV "MNT_EGR_ICT_LHV conversion" RAT_FUNC "%10.5" "unitless" COEFFS 0 1 0 0 0 1 /end COMPU_METHOD
/begin MEASUREMENT MNT_EGR_KEXH "" FLOAT32_IEEE MC_MNT_EGR_KEXH 0 0 0 0 ECU_ADDRESS 0x3FAF0C /end MEASUREMENT
/begin COMPU_METHOD MC_MNT_EGR_KEXH "MNT_EGR_KEXH conversion" RAT_FUNC "%10.5" "Unitless" COEFFS 0 1 0 0 0 1 /end COMPU_METHOD
/begin CHARACTERISTIC MNT_EGR_KEXH_LMN "" VALUE 0x5E7C4 SD_FLOAT32_IEEE 0 SC_MNT_EGR_KEXH_LMN 0 1 /end CHARACTERISTIC
/begin COMPU_METHOD SC_MNT_EGR_KEXH_LMN "MNT_EGR_KEXH_LMN conversion" RAT_FUNC "%10.5" "unitless" COEFFS 0 1 0 0 0 1 /end COMPU_METHOD
/begin CHARACTERISTIC MNT_EGR_KEXH_LMX "" VALUE 0x5E7C0 SD_FLOAT32_IEEE 0 SC_MNT_EGR_KEXH_LMX 0 1 /end CHARACTERISTIC
/begin COMPU_METHOD SC_MNT_EGR_KEXH_LMX "MNT_EGR_KEXH_LMX conversion" RAT_FUNC "%10.5" "unitless" COEFFS 0 1 0 0 0 1 /end COMPU_METHOD
/begin MEASUREMENT MNT_EGR_PCT_HI_LMN "" FLOAT32_IEEE MC_MNT_EGR_PCT_HI_LMN 0 0 0 0 ECU_ADDRESS 0x3FACF0 /end MEASUREMENT
/begin COMPU_METHOD MC_MNT_EGR_PCT_HI_LMN "MNT_EGR_PCT_HI_LMN conversion" RAT_FUNC "%10.5" "Unitless" COEFFS 0 1 0 0 0 1 /end COMPU_METHOD
/begin MEASUREMENT MNT_EGR_PCT_HI_LMX "" FLOAT32_IEEE MC_MNT_EGR_PCT_HI_LMX 0 0 0 0 ECU_ADDRESS 0x3FACEC /end MEASUREMENT
/begin COMPU_METHOD MC_MNT_EGR_PCT_HI_LMX "MNT_EGR_PCT_HI_LMX conversion" RAT_FUNC "%10.5" "Unitless" COEFFS 0 1 0 0 0 1 /end COMPU_METHOD
/begin MEASUREMENT MNT_EGR_PCT_LMN "" FLOAT32_IEEE MC_MNT_EGR_PCT_LMN 0 0 0 0 ECU_ADDRESS 0x3FACE0 /end MEASUREMENT
/begin COMPU_METHOD MC_MNT_EGR_PCT_LMN "MNT_EGR_PCT_LMN conversion" RAT_FUNC "%10.5" "Unitless" COEFFS 0 1 0 0 0 1 /end COMPU_METHOD
/begin MEASUREMENT MNT_EGR_PCT_LMX "" FLOAT32_IEEE MC_MNT_EGR_PCT_LMX 0 0 0 0 ECU_ADDRESS 0x3FACDC /end MEASUREMENT
/begin COMPU_METHOD MC_MNT_EGR_PCT_LMX "MNT_EGR_PCT_LMX conversion" RAT_FUNC "%10.5" "Unitless" COEFFS 0 1 0 0 0 1 /end COMPU_METHOD
/begin MEASUREMENT MNT_EGR_PCT_LO_LMN "" FLOAT32_IEEE MC_MNT_EGR_PCT_LO_LMN 0 0 0 0 ECU_ADDRESS 0x3FACE8 /end MEASUREMENT
/begin COMPU_METHOD MC_MNT_EGR_PCT_LO_LMN "MNT_EGR_PCT_LO_LMN conversion" RAT_FUNC "%10.5" "Unitless" COEFFS 0 1 0 0 0 1 /end COMPU_METHOD
/begin MEASUREMENT MNT_EGR_PCT_LO_LMX "" FLOAT32_IEEE MC_MNT_EGR_PCT_LO_LMX 0 0 0 0 ECU_ADDRESS 0x3FACE4 /end MEASUREMENT
/begin COMPU_METHOD MC_MNT_EGR_PCT_LO_LMX "MNT_EGR_PCT_LO_LMX conversion" RAT_FUNC "%10.5" "Unitless" COEFFS 0 1 0 0 0 1 /end COMPU_METHOD
/begin MEASUREMENT MNT_EGR_RATE "" FLOAT32_IEEE MC_MNT_EGR_RATE 0 0 0 0 ECU_ADDRESS 0x3FAF08 /end MEASUREMENT
/begin COMPU_METHOD MC_MNT_EGR_RATE "MNT_EGR_RATE conversion" RAT_FUNC "%10.5" "Unitless" COEFFS 0 1 0 0 0 1 /end COMPU_METHOD
/begin CHARACTERISTIC MNT_EGR_RATE_TOL "" VALUE 0x5E7BC SD_FLOAT32_IEEE 0 SC_MNT_EGR_RATE_TOL 0 2 /end CHARACTERISTIC
/begin COMPU_METHOD SC_MNT_EGR_RATE_TOL "MNT_EGR_RATE_TOL conversion" RAT_FUNC "%10.5" "unitless" COEFFS 0 1 0 0 0 1 /end COMPU_METHOD
/begin CHARACTERISTIC MNT_EGR_ZERO_CYL "" VALUE 0x5E7B8 SD_FLOAT32_IEEE 0 SC_MNT_EGR_ZERO_CYL 0 2 /end CHARACTERISTIC
/begin COMPU_METHOD SC_MNT_EGR_ZERO_CYL "MNT_EGR_ZERO_CYL conversion" RAT_FUNC "%10.5" "unitless" COEFFS 0 1 0 0 0 1 /end COMPU_METHOD
/begin CHARACTERISTIC MNT_EGR_ZERO_MFL "" VALUE 0x5E7B4 SD_FLOAT32_IEEE 0 SC_MNT_EGR_ZERO_MFL 0 2 /end CHARACTERISTIC
/begin COMPU_METHOD SC_MNT_EGR_ZERO_MFL "MNT_EGR_ZERO_MFL conversion" RAT_FUNC "%10.5" "unitless" COEFFS 0 1 0 0 0 1 /end COMPU_METHOD
/begin MEASUREMENT MNT_ERPM "" FLOAT32_IEEE MC_MNT_ERPM 0 0 0 0 ECU_ADDRESS 0x3FAEF0 /end MEASUREMENT
/begin COMPU_METHOD MC_MNT_ERPM "MNT_ERPM conversion" RAT_FUNC "%10.5" "Unitless" COEFFS 0 1 0 0 0 1 /end COMPU_METHOD
/begin MEASUREMENT MNT_EXH_TEMP "" FLOAT32_IEEE MC_MNT_EXH_TEMP 0 0 0 0 ECU_ADDRESS 0x3FAEEC /end MEASUREMENT
/begin COMPU_METHOD MC_MNT_EXH_TEMP "MNT_EXH_TEMP conversion" RAT_FUNC "%10.5" "Unitless" COEFFS 0 1 0 0 0 1 /end COMPU_METHOD
/begin MEASUREMENT MNT_FAULT "" UBYTE MC_MNT_FAULT 0 0 0 0 ECU_ADDRESS 0x3FAFEF /end MEASUREMENT
/begin COMPU_METHOD MC_MNT_FAULT "MNT_FAULT conversion" RAT_FUNC "%3.0" "Unitless" COEFFS 0 1 0 0 0 1 /end COMPU_METHOD
/begin MEASUREMENT MNT_FLOW "" FLOAT32_IEEE MC_MNT_FLOW 0 0 0 0 ECU_ADDRESS 0x3FAEE8 /end MEASUREMENT
/begin COMPU_METHOD MC_MNT_FLOW "MNT_FLOW conversion" RAT_FUNC "%10.5" "Unitless" COEFFS 0 1 0 0 0 1 /end COMPU_METHOD
/begin MEASUREMENT MNT_ITP "" FLOAT32_IEEE MC_MNT_ITP 0 0 0 0 ECU_ADDRESS 0x3FAEE4 /end MEASUREMENT
/begin COMPU_METHOD MC_MNT_ITP "MNT_ITP conversion" RAT_FUNC "%10.5" "Unitless" COEFFS 0 1 0 0 0 1 /end COMPU_METHOD
/begin MEASUREMENT MNT_ITPTST_CNT "" UWORD MC_MNT_ITPTST_CNT 0 0 0 0 ECU_ADDRESS 0x3FAFB4 /end MEASUREMENT
/begin COMPU_METHOD MC_MNT_ITPTST_CNT "MNT_ITPTST_CNT conversion" RAT_FUNC "%5.0" "Unitless" COEFFS 0 1 0 0 0 1 /end COMPU_METHOD
/begin MEASUREMENT MNT_ITPTST_TMR "" FLOAT32_IEEE MC_MNT_ITPTST_TMR 0 0 0 0 ECU_ADDRESS 0x3FAEDC /end MEASUREMENT
/begin COMPU_METHOD MC_MNT_ITPTST_TMR "MNT_ITPTST_TMR conversion" RAT_FUNC "%10.5" "Unitless" COEFFS 0 1 0 0 0 1 /end COMPU_METHOD
/begin MEASUREMENT MNT_ITP_DT "" FLOAT32_IEEE MC_MNT_ITP_DT 0 0 0 0 ECU_ADDRESS 0x3FAEE0 /end MEASUREMENT
/begin COMPU_METHOD MC_MNT_ITP_DT "MNT_ITP_DT conversion" RAT_FUNC "%10.5" "Unitless" COEFFS 0 1 0 0 0 1 /end COMPU_METHOD
/begin CHARACTERISTIC MNT_ITP_DT_MIN "" VALUE 0x5E798 SD_FLOAT32_IEEE 0 SC_MNT_ITP_DT_MIN -1 1 /end CHARACTERISTIC
/begin COMPU_METHOD SC_MNT_ITP_DT_MIN "MNT_ITP_DT_MIN conversion" RAT_FUNC "%10.5" "unitless" COEFFS 0 1 0 0 0 1 /end COMPU_METHOD
/begin CHARACTERISTIC MNT_ITP_MAX "" VALUE 0x5E794 SD_FLOAT32_IEEE 0 SC_MNT_ITP_MAX 0 1 /end CHARACTERISTIC
/begin COMPU_METHOD SC_MNT_ITP_MAX "MNT_ITP_MAX conversion" RAT_FUNC "%10.5" "unitless" COEFFS 0 1 0 0 0 1 /end COMPU_METHOD
/begin CHARACTERISTIC MNT_ITP_MIN "" VALUE 0x5E790 SD_FLOAT32_IEEE 0 SC_MNT_ITP_MIN -1 1 /end CHARACTERISTIC
/begin COMPU_METHOD SC_MNT_ITP_MIN "MNT_ITP_MIN conversion" RAT_FUNC "%10.5" "unitless" COEFFS 0 1 0 0 0 1 /end COMPU_METHOD
/begin CHARACTERISTIC MNT_ITP_OPEN "" VALUE 0x5E78C SD_FLOAT32_IEEE 0 SC_MNT_ITP_OPEN -2 2 /end CHARACTERISTIC
/begin COMPU_METHOD SC_MNT_ITP_OPEN "MNT_ITP_OPEN conversion" RAT_FUNC "%10.5" "unitless" COEFFS 0 1 0 0 0 1 /end COMPU_METHOD
/begin MEASUREMENT MNT_MAF "" FLOAT32_IEEE MC_MNT_MAF 0 0 0 0 ECU_ADDRESS 0x3FAED4 /end MEASUREMENT
/begin COMPU_METHOD MC_MNT_MAF "MNT_MAF conversion" RAT_FUNC "%10.5" "Unitless" COEFFS 0 1 0 0 0 1 /end COMPU_METHOD
/begin CHARACTERISTIC MNT_MAFDELAY_TM "" VALUE 0x5E770 SD_FLOAT32_IEEE 0 SC_MNT_MAFDELAY_TM 0 100 /end CHARACTERISTIC
/begin COMPU_METHOD SC_MNT_MAFDELAY_TM "MNT_MAFDELAY_TM conversion" RAT_FUNC "%10.5" "unitless" COEFFS 0 1 0 0 0 1 /end COMPU_METHOD
/begin MEASUREMENT MNT_MAFTST_CNT "" UWORD MC_MNT_MAFTST_CNT 0 0 0 0 ECU_ADDRESS 0x3FAFB2 /end MEASUREMENT
/begin COMPU_METHOD MC_MNT_MAFTST_CNT "MNT_MAFTST_CNT conversion" RAT_FUNC "%5.0" "Unitless" COEFFS 0 1 0 0 0 1 /end COMPU_METHOD
/begin MEASUREMENT MNT_MAFTST_TMR "" FLOAT32_IEEE MC_MNT_MAFTST_TMR 0 0 0 0 ECU_ADDRESS 0x3FAEC0 /end MEASUREMENT
/begin COMPU_METHOD MC_MNT_MAFTST_TMR "MNT_MAFTST_TMR conversion" RAT_FUNC "%10.5" "Unitless" COEFFS 0 1 0 0 0 1 /end COMPU_METHOD
/begin MEASUREMENT MNT_MAF_DT "" FLOAT32_IEEE MC_MNT_MAF_DT 0 0 0 0 ECU_ADDRESS 0x3FAED0 /end MEASUREMENT
/begin COMPU_METHOD MC_MNT_MAF_DT "MNT_MAF_DT conversion" RAT_FUNC "%10.5" "Unitless" COEFFS 0 1 0 0 0 1 /end COMPU_METHOD
/begin CHARACTERISTIC MNT_MAF_DT_MAX "" VALUE 0x5E788 SD_FLOAT32_IEEE 0 SC_MNT_MAF_DT_MAX -50 350 /end CHARACTERISTIC
/begin COMPU_METHOD SC_MNT_MAF_DT_MAX "MNT_MAF_DT_MAX conversion" RAT_FUNC "%10.5" "unitless" COEFFS 0 1 0 0 0 1 /end COMPU_METHOD
/begin MEASUREMENT MNT_MAF_EST "" FLOAT32_IEEE MC_MNT_MAF_EST 0 0 0 0 ECU_ADDRESS 0x3FAECC /end MEASUREMENT
/begin COMPU_METHOD MC_MNT_MAF_EST "MNT_MAF_EST conversion" RAT_FUNC "%10.5" "Unitless" COEFFS 0 1 0 0 0 1 /end COMPU_METHOD
/begin CHARACTERISTIC MNT_MAF_EST_KF "Filter constant for mnt_maf_est" VALUE 0x5E784 SD_FLOAT32_IEEE 0 SC_MNT_MAF_EST_KF -2 2 /end CHARACTERISTIC
/begin COMPU_METHOD SC_MNT_MAF_EST_KF "MNT_MAF_EST_KF conversion" RAT_FUNC "%10.5" "unitless" COEFFS 0 1 0 0 0 1 /end COMPU_METHOD
/begin MEASUREMENT MNT_MAF_IDLE "" FLOAT32_IEEE MC_MNT_MAF_IDLE 0 0 0 0 ECU_ADDRESS 0x3FAEC8 /end MEASUREMENT
/begin COMPU_METHOD MC_MNT_MAF_IDLE "MNT_MAF_IDLE conversion" RAT_FUNC "%10.5" "Unitless" COEFFS 0 1 0 0 0 1 /end COMPU_METHOD
/begin CHARACTERISTIC MNT_MAF_MAX "" VALUE 0x5E780 SD_FLOAT32_IEEE 0 SC_MNT_MAF_MAX -50 350 /end CHARACTERISTIC
/begin COMPU_METHOD SC_MNT_MAF_MAX "MNT_MAF_MAX conversion" RAT_FUNC "%10.5" "unitless" COEFFS 0 1 0 0 0 1 /end COMPU_METHOD
/begin MEASUREMENT MNT_MAF_MG_STK "" FLOAT32_IEEE MC_MNT_MAF_MG_STK 0 0 0 0 ECU_ADDRESS 0x3FAEC4 /end MEASUREMENT
/begin COMPU_METHOD MC_MNT_MAF_MG_STK "MNT_MAF_MG_STK conversion" RAT_FUNC "%10.5" "Unitless" COEFFS 0 1 0 0 0 1 /end COMPU_METHOD
/begin CHARACTERISTIC MNT_MAF_MIN "" VALUE 0x5E77C SD_FLOAT32_IEEE 0 SC_MNT_MAF_MIN -50 350 /end CHARACTERISTIC
/begin COMPU_METHOD SC_MNT_MAF_MIN "MNT_MAF_MIN conversion" RAT_FUNC "%10.5" "unitless" COEFFS 0 1 0 0 0 1 /end COMPU_METHOD
/begin CHARACTERISTIC MNT_MAF_TOL "" VALUE 0x5E778 SD_FLOAT32_IEEE 0 SC_MNT_MAF_TOL 0 2 /end CHARACTERISTIC
/begin COMPU_METHOD SC_MNT_MAF_TOL "MNT_MAF_TOL conversion" RAT_FUNC "%10.5" "unitless" COEFFS 0 1 0 0 0 1 /end COMPU_METHOD
/begin CHARACTERISTIC MNT_MAF_TS "" VALUE 0x5E774 SD_FLOAT32_IEEE 0 SC_MNT_MAF_TS 0.004 0.1 /end CHARACTERISTIC
/begin COMPU_METHOD SC_MNT_MAF_TS "MNT_MAF_TS conversion" RAT_FUNC "%10.5" "unitless" COEFFS 0 1 0 0 0 1 /end COMPU_METHOD
/begin MEASUREMENT MNT_MAPTST_CNT "" UWORD MC_MNT_MAPTST_CNT 0 0 0 0 ECU_ADDRESS 0x3FAFB0 /end MEASUREMENT
/begin COMPU_METHOD MC_MNT_MAPTST_CNT "MNT_MAPTST_CNT conversion" RAT_FUNC "%5.0" "Unitless" COEFFS 0 1 0 0 0 1 /end COMPU_METHOD
/begin MEASUREMENT MNT_MAPTST_TMR "" FLOAT32_IEEE MC_MNT_MAPTST_TMR 0 0 0 0 ECU_ADDRESS 0x3FAEB4 /end MEASUREMENT
/begin COMPU_METHOD MC_MNT_MAPTST_TMR "MNT_MAPTST_TMR conversion" RAT_FUNC "%10.5" "Unitless" COEFFS 0 1 0 0 0 1 /end COMPU_METHOD
/begin CHARACTERISTIC MNT_MAP_DT_MAX "" VALUE 0x5E76C SD_FLOAT32_IEEE 0 SC_MNT_MAP_DT_MAX 0 500 /end CHARACTERISTIC
/begin COMPU_METHOD SC_MNT_MAP_DT_MAX "MNT_MAP_DT_MAX conversion" RAT_FUNC "%10.5" "unitless" COEFFS 0 1 0 0 0 1 /end COMPU_METHOD
/begin MEASUREMENT MNT_MAP_KPA "" FLOAT32_IEEE MC_MNT_MAP_KPA 0 0 0 0 ECU_ADDRESS 0x3FAEBC /end MEASUREMENT
/begin COMPU_METHOD MC_MNT_MAP_KPA "MNT_MAP_KPA conversion" RAT_FUNC "%10.5" "Unitless" COEFFS 0 1 0 0 0 1 /end COMPU_METHOD
/begin MEASUREMENT MNT_MAP_KPA_DT "" FLOAT32_IEEE MC_MNT_MAP_KPA_DT 0 0 0 0 ECU_ADDRESS 0x3FAEB8 /end MEASUREMENT
/begin COMPU_METHOD MC_MNT_MAP_KPA_DT "MNT_MAP_KPA_DT conversion" RAT_FUNC "%10.5" "Unitless" COEFFS 0 1 0 0 0 1 /end COMPU_METHOD
/begin CHARACTERISTIC MNT_MAP_MAX "" VALUE 0x5E768 SD_FLOAT32_IEEE 0 SC_MNT_MAP_MAX 0 500 /end CHARACTERISTIC
/begin COMPU_METHOD SC_MNT_MAP_MAX "MNT_MAP_MAX conversion" RAT_FUNC "%10.5" "unitless" COEFFS 0 1 0 0 0 1 /end COMPU_METHOD
/begin CHARACTERISTIC MNT_MAP_MIN "" VALUE 0x5E764 SD_FLOAT32_IEEE 0 SC_MNT_MAP_MIN 0 500 /end CHARACTERISTIC
/begin COMPU_METHOD SC_MNT_MAP_MIN "MNT_MAP_MIN conversion" RAT_FUNC "%10.5" "unitless" COEFFS 0 1 0 0 0 1 /end COMPU_METHOD
/begin MEASUREMENT MNT_MCT_K "" FLOAT32_IEEE MC_MNT_MCT_K 0 0 0 0 ECU_ADDRESS 0x3FAEB0 /end MEASUREMENT
/begin COMPU_METHOD MC_MNT_MCT_K "MNT_MCT_K conversion" RAT_FUNC "%10.5" "Unitless" COEFFS 0 1 0 0 0 1 /end COMPU_METHOD
/begin MEASUREMENT MNT_MCT_KTST_CNT "" UWORD MC_MNT_MCT_KTST_CNT 0 0 0 0 ECU_ADDRESS 0x3FAFAE /end MEASUREMENT
/begin COMPU_METHOD MC_MNT_MCT_KTST_CNT "MNT_MCT_KTST_CNT conversion" RAT_FUNC "%5.0" "Unitless" COEFFS 0 1 0 0 0 1 /end COMPU_METHOD
/begin MEASUREMENT MNT_MCT_KTST_TMR "" FLOAT32_IEEE MC_MNT_MCT_KTST_TMR 0 0 0 0 ECU_ADDRESS 0x3FAEA8 /end MEASUREMENT
/begin COMPU_METHOD MC_MNT_MCT_KTST_TMR "MNT_MCT_KTST_TMR conversion" RAT_FUNC "%10.5" "Unitless" COEFFS 0 1 0 0 0 1 /end COMPU_METHOD
/begin MEASUREMENT MNT_MCT_K_DT "" FLOAT32_IEEE MC_MNT_MCT_K_DT 0 0 0 0 ECU_ADDRESS 0x3FAEAC /end MEASUREMENT
/begin COMPU_METHOD MC_MNT_MCT_K_DT "MNT_MCT_K_DT conversion" RAT_FUNC "%10.5" "Unitless" COEFFS 0 1 0 0 0 1 /end COMPU_METHOD
/begin CHARACTERISTIC MNT_MCT_K_DT_MAX "" VALUE 0x5E760 SD_FLOAT32_IEEE 0 SC_MNT_MCT_K_DT_MAX 200 1000 /end CHARACTERISTIC
/begin COMPU_METHOD SC_MNT_MCT_K_DT_MAX "MNT_MCT_K_DT_MAX conversion" RAT_FUNC "%10.5" "unitless" COEFFS 0 1 0 0 0 1 /end COMPU_METHOD
/begin CHARACTERISTIC MNT_MCT_K_MAX "" VALUE 0x5E75C SD_FLOAT32_IEEE 0 SC_MNT_MCT_K_MAX 200 1000 /end CHARACTERISTIC
/begin COMPU_METHOD SC_MNT_MCT_K_MAX "MNT_MCT_K_MAX conversion" RAT_FUNC "%10.5" "unitless" COEFFS 0 1 0 0 0 1 /end COMPU_METHOD
/begin CHARACTERISTIC MNT_MCT_K_MIN "" VALUE 0x5E758 SD_FLOAT32_IEEE 0 SC_MNT_MCT_K_MIN 200 1000 /end CHARACTERISTIC
/begin COMPU_METHOD SC_MNT_MCT_K_MIN "MNT_MCT_K_MIN conversion" RAT_FUNC "%10.5" "unitless" COEFFS 0 1 0 0 0 1 /end COMPU_METHOD
/begin MEASUREMENT MNT_MFDES "" FLOAT32_IEEE MC_MNT_MFDES 0 0 0 0 ECU_ADDRESS 0x3FAEA4 /end MEASUREMENT
/begin COMPU_METHOD MC_MNT_MFDES "MNT_MFDES conversion" RAT_FUNC "%10.5" "Unitless" COEFFS 0 1 0 0 0 1 /end COMPU_METHOD
/begin MEASUREMENT MNT_M_E "" FLOAT32_IEEE MC_MNT_M_E 0 0 0 0 ECU_ADDRESS 0x3FAED8 /end MEASUREMENT
/begin COMPU_METHOD MC_MNT_M_E "MNT_M_E conversion" RAT_FUNC "%10.5" "Unitless" COEFFS 0 1 0 0 0 1 /end COMPU_METHOD
/begin CHARACTERISTIC MNT_NCYL "" VALUE 0x5E86A SD_UBYTE 0 SC_MNT_NCYL 4 12 /end CHARACTERISTIC
/begin COMPU_METHOD SC_MNT_NCYL "MNT_NCYL conversion" RAT_FUNC "%3.0" "unitless" COEFFS 0 1 0 0 0 1 /end COMPU_METHOD
/begin CHARACTERISTIC MNT_N_IDLE_MAX "" VALUE 0x5E754 SD_FLOAT32_IEEE 0 SC_MNT_N_IDLE_MAX 500 1200 /end CHARACTERISTIC
/begin COMPU_METHOD SC_MNT_N_IDLE_MAX "MNT_N_IDLE_MAX conversion" RAT_FUNC "%10.5" "unitless" COEFFS 0 1 0 0 0 1 /end COMPU_METHOD
/begin CHARACTERISTIC MNT_N_IDLE_MIN "" VALUE 0x5E750 SD_FLOAT32_IEEE 0 SC_MNT_N_IDLE_MIN 500 1200 /end CHARACTERISTIC
/begin COMPU_METHOD SC_MNT_N_IDLE_MIN "MNT_N_IDLE_MIN conversion" RAT_FUNC "%10.5" "unitless" COEFFS 0 1 0 0 0 1 /end COMPU_METHOD
/begin MEASUREMENT MNT_OBD_TRANS "" UBYTE MC_MNT_OBD_TRANS 0 0 0 0 ECU_ADDRESS 0x3FAFEE /end MEASUREMENT
/begin COMPU_METHOD MC_MNT_OBD_TRANS "MNT_OBD_TRANS conversion" RAT_FUNC "%3.0" "Unitless" COEFFS 0 1 0 0 0 1 /end COMPU_METHOD
/begin MEASUREMENT MNT_P0101COMP "" UBYTE MC_MNT_P0101COMP 0 0 0 0 ECU_ADDRESS 0x3FAFED /end MEASUREMENT
/begin COMPU_METHOD MC_MNT_P0101COMP "MNT_P0101COMP conversion" RAT_FUNC "%3.0" "Unitless" COEFFS 0 1 0 0 0 1 /end COMPU_METHOD
/begin MEASUREMENT MNT_P0101FLT "" UBYTE MC_MNT_P0101FLT 0 0 0 0 ECU_ADDRESS 0x3FAFEC /end MEASUREMENT
/begin COMPU_METHOD MC_MNT_P0101FLT "MNT_P0101FLT conversion" RAT_FUNC "%3.0" "Unitless" COEFFS 0 1 0 0 0 1 /end COMPU_METHOD
/begin MEASUREMENT MNT_P0101FLT_CNT "" UWORD MC_MNT_P0101FLT_CNT 0 0 0 0 ECU_ADDRESS 0x3FAFAC /end MEASUREMENT
/begin COMPU_METHOD MC_MNT_P0101FLT_CNT "MNT_P0101FLT_CNT conversion" RAT_FUNC "%5.0" "Unitless" COEFFS 0 1 0 0 0 1 /end COMPU_METHOD
/begin CHARACTERISTIC MNT_P0101FLT_TM "" VALUE 0x5E74C SD_FLOAT32_IEEE 0 SC_MNT_P0101FLT_TM 0 20 /end CHARACTERISTIC
/begin COMPU_METHOD SC_MNT_P0101FLT_TM "MNT_P0101FLT_TM conversion" RAT_FUNC "%10.5" "unitless" COEFFS 0 1 0 0 0 1 /end COMPU_METHOD
/begin MEASUREMENT MNT_P0101FLT_TMR "" FLOAT32_IEEE MC_MNT_P0101FLT_TMR 0 0 0 0 ECU_ADDRESS 0x3FAE9C /end MEASUREMENT
/begin COMPU_METHOD MC_MNT_P0101FLT_TMR "MNT_P0101FLT_TMR conversion" RAT_FUNC "%10.5" "Unitless" COEFFS 0 1 0 0 0 1 /end COMPU_METHOD
/begin CHARACTERISTIC MNT_P0101TST_TM "" VALUE 0x5E748 SD_FLOAT32_IEEE 0 SC_MNT_P0101TST_TM 0 20 /end CHARACTERISTIC
/begin COMPU_METHOD SC_MNT_P0101TST_TM "MNT_P0101TST_TM conversion" RAT_FUNC "%10.5" "unitless" COEFFS 0 1 0 0 0 1 /end COMPU_METHOD
/begin MEASUREMENT MNT_P0102COMP "" UBYTE MC_MNT_P0102COMP 0 0 0 0 ECU_ADDRESS 0x3FAFEB /end MEASUREMENT
/begin COMPU_METHOD MC_MNT_P0102COMP "MNT_P0102COMP conversion" RAT_FUNC "%3.0" "Unitless" COEFFS 0 1 0 0 0 1 /end COMPU_METHOD
/begin MEASUREMENT MNT_P0102FLT "" UBYTE MC_MNT_P0102FLT 0 0 0 0 ECU_ADDRESS 0x3FAFEA /end MEASUREMENT
/begin COMPU_METHOD MC_MNT_P0102FLT "MNT_P0102FLT conversion" RAT_FUNC "%3.0" "Unitless" COEFFS 0 1 0 0 0 1 /end COMPU_METHOD
/begin MEASUREMENT MNT_P0102FLT_CNT "" UWORD MC_MNT_P0102FLT_CNT 0 0 0 0 ECU_ADDRESS 0x3FAFAA /end MEASUREMENT
/begin COMPU_METHOD MC_MNT_P0102FLT_CNT "MNT_P0102FLT_CNT conversion" RAT_FUNC "%5.0" "Unitless" COEFFS 0 1 0 0 0 1 /end COMPU_METHOD
/begin CHARACTERISTIC MNT_P0102FLT_TM "" VALUE 0x5E744 SD_FLOAT32_IEEE 0 SC_MNT_P0102FLT_TM 0 20 /end CHARACTERISTIC
/begin COMPU_METHOD SC_MNT_P0102FLT_TM "MNT_P0102FLT_TM conversion" RAT_FUNC "%10.5" "unitless" COEFFS 0 1 0 0 0 1 /end COMPU_METHOD
/begin MEASUREMENT MNT_P0102FLT_TMR "" FLOAT32_IEEE MC_MNT_P0102FLT_TMR 0 0 0 0 ECU_ADDRESS 0x3FAE98 /end MEASUREMENT
/begin COMPU_METHOD MC_MNT_P0102FLT_TMR "MNT_P0102FLT_TMR conversion" RAT_FUNC "%10.5" "Unitless" COEFFS 0 1 0 0 0 1 /end COMPU_METHOD
/begin MEASUREMENT MNT_P0102_0103TST_CNT "" UWORD MC_MNT_P0102_0103TST_CNT 0 0 0 0 ECU_ADDRESS 0x3FAFA8 /end MEASUREMENT
/begin COMPU_METHOD MC_MNT_P0102_0103TST_CNT "MNT_P0102_0103TST_CNT conversion" RAT_FUNC "%5.0" "Unitless" COEFFS 0 1 0 0 0 1 /end COMPU_METHOD
/begin CHARACTERISTIC MNT_P0102_0103TST_TM "" VALUE 0x5E740 SD_FLOAT32_IEEE 0 SC_MNT_P0102_0103TST_TM 0 20 /end CHARACTERISTIC
/begin COMPU_METHOD SC_MNT_P0102_0103TST_TM "MNT_P0102_0103TST_TM conversion" RAT_FUNC "%10.5" "unitless" COEFFS 0 1 0 0 0 1 /end COMPU_METHOD
/begin MEASUREMENT MNT_P0102_0103TST_TMR "" FLOAT32_IEEE MC_MNT_P0102_0103TST_TMR 0 0 0 0 ECU_ADDRESS 0x3FAE94 /end MEASUREMENT
/begin COMPU_METHOD MC_MNT_P0102_0103TST_TMR "MNT_P0102_0103TST_TMR conversion" RAT_FUNC "%10.5" "Unitless" COEFFS 0 1 0 0 0 1 /end COMPU_METHOD
/begin MEASUREMENT MNT_P0103COMP "" UBYTE MC_MNT_P0103COMP 0 0 0 0 ECU_ADDRESS 0x3FAFE9 /end MEASUREMENT
/begin COMPU_METHOD MC_MNT_P0103COMP "MNT_P0103COMP conversion" RAT_FUNC "%3.0" "Unitless" COEFFS 0 1 0 0 0 1 /end COMPU_METHOD
/begin MEASUREMENT MNT_P0103FLT "" UBYTE MC_MNT_P0103FLT 0 0 0 0 ECU_ADDRESS 0x3FAFE8 /end MEASUREMENT
/begin COMPU_METHOD MC_MNT_P0103FLT "MNT_P0103FLT conversion" RAT_FUNC "%3.0" "Unitless" COEFFS 0 1 0 0 0 1 /end COMPU_METHOD
/begin MEASUREMENT MNT_P0103FLT_CNT "" UWORD MC_MNT_P0103FLT_CNT 0 0 0 0 ECU_ADDRESS 0x3FAFA6 /end MEASUREMENT
/begin COMPU_METHOD MC_MNT_P0103FLT_CNT "MNT_P0103FLT_CNT conversion" RAT_FUNC "%5.0" "Unitless" COEFFS 0 1 0 0 0 1 /end COMPU_METHOD
/begin CHARACTERISTIC MNT_P0103FLT_TM "" VALUE 0x5E73C SD_FLOAT32_IEEE 0 SC_MNT_P0103FLT_TM 0 20 /end CHARACTERISTIC
/begin COMPU_METHOD SC_MNT_P0103FLT_TM "MNT_P0103FLT_TM conversion" RAT_FUNC "%10.5" "unitless" COEFFS 0 1 0 0 0 1 /end COMPU_METHOD
/begin MEASUREMENT MNT_P0103FLT_TMR "" FLOAT32_IEEE MC_MNT_P0103FLT_TMR 0 0 0 0 ECU_ADDRESS 0x3FAE90 /end MEASUREMENT
/begin COMPU_METHOD MC_MNT_P0103FLT_TMR "MNT_P0103FLT_TMR conversion" RAT_FUNC "%10.5" "Unitless" COEFFS 0 1 0 0 0 1 /end COMPU_METHOD
/begin MEASUREMENT MNT_P0106FLT "" UBYTE MC_MNT_P0106FLT 0 0 0 0 ECU_ADDRESS 0x3FAFE7 /end MEASUREMENT
/begin COMPU_METHOD MC_MNT_P0106FLT "MNT_P0106FLT conversion" RAT_FUNC "%3.0" "Unitless" COEFFS 0 1 0 0 0 1 /end COMPU_METHOD
/begin MEASUREMENT MNT_P0106OSFLT "" UBYTE MC_MNT_P0106OSFLT 0 0 0 0 ECU_ADDRESS 0x3FAFE6 /end MEASUREMENT
/begin COMPU_METHOD MC_MNT_P0106OSFLT "MNT_P0106OSFLT conversion" RAT_FUNC "%3.0" "Unitless" COEFFS 0 1 0 0 0 1 /end COMPU_METHOD
/begin MEASUREMENT MNT_P0106SIGCOMP "" UBYTE MC_MNT_P0106SIGCOMP 0 0 0 0 ECU_ADDRESS 0x3FAFE5 /end MEASUREMENT
/begin COMPU_METHOD MC_MNT_P0106SIGCOMP "MNT_P0106SIGCOMP conversion" RAT_FUNC "%3.0" "Unitless" COEFFS 0 1 0 0 0 1 /end COMPU_METHOD
/begin MEASUREMENT MNT_P0106SIGFLT "" UBYTE MC_MNT_P0106SIGFLT 0 0 0 0 ECU_ADDRESS 0x3FAFE4 /end MEASUREMENT
/begin COMPU_METHOD MC_MNT_P0106SIGFLT "MNT_P0106SIGFLT conversion" RAT_FUNC "%3.0" "Unitless" COEFFS 0 1 0 0 0 1 /end COMPU_METHOD
/begin MEASUREMENT MNT_P0106SIGFLT_CNT "" UWORD MC_MNT_P0106SIGFLT_CNT 0 0 0 0 ECU_ADDRESS 0x3FAFA4 /end MEASUREMENT
/begin COMPU_METHOD MC_MNT_P0106SIGFLT_CNT "MNT_P0106SIGFLT_CNT conversion" RAT_FUNC "%5.0" "Unitless" COEFFS 0 1 0 0 0 1 /end COMPU_METHOD
/begin CHARACTERISTIC MNT_P0106SIGFLT_TM "" VALUE 0x5E738 SD_FLOAT32_IEEE 0 SC_MNT_P0106SIGFLT_TM 0 20 /end CHARACTERISTIC
/begin COMPU_METHOD SC_MNT_P0106SIGFLT_TM "MNT_P0106SIGFLT_TM conversion" RAT_FUNC "%10.5" "unitless" COEFFS 0 1 0 0 0 1 /end COMPU_METHOD
/begin MEASUREMENT MNT_P0106SIGFLT_TMR "" FLOAT32_IEEE MC_MNT_P0106SIGFLT_TMR 0 0 0 0 ECU_ADDRESS 0x3FAE8C /end MEASUREMENT
/begin COMPU_METHOD MC_MNT_P0106SIGFLT_TMR "MNT_P0106SIGFLT_TMR conversion" RAT_FUNC "%10.5" "Unitless" COEFFS 0 1 0 0 0 1 /end COMPU_METHOD
/begin CHARACTERISTIC MNT_P0106SIGTST_TM "" VALUE 0x5E734 SD_FLOAT32_IEEE 0 SC_MNT_P0106SIGTST_TM 0 20 /end CHARACTERISTIC
/begin COMPU_METHOD SC_MNT_P0106SIGTST_TM "MNT_P0106SIGTST_TM conversion" RAT_FUNC "%10.5" "unitless" COEFFS 0 1 0 0 0 1 /end COMPU_METHOD
/begin MEASUREMENT MNT_P0111COMP "" UBYTE MC_MNT_P0111COMP 0 0 0 0 ECU_ADDRESS 0x3FAFE3 /end MEASUREMENT
/begin COMPU_METHOD MC_MNT_P0111COMP "MNT_P0111COMP conversion" RAT_FUNC "%3.0" "Unitless" COEFFS 0 1 0 0 0 1 /end COMPU_METHOD
/begin MEASUREMENT MNT_P0111FLT "" UBYTE MC_MNT_P0111FLT 0 0 0 0 ECU_ADDRESS 0x3FAFE2 /end MEASUREMENT
/begin COMPU_METHOD MC_MNT_P0111FLT "MNT_P0111FLT conversion" RAT_FUNC "%3.0" "Unitless" COEFFS 0 1 0 0 0 1 /end COMPU_METHOD
/begin MEASUREMENT MNT_P0111FLT_CNT "" UWORD MC_MNT_P0111FLT_CNT 0 0 0 0 ECU_ADDRESS 0x3FAFA2 /end MEASUREMENT
/begin COMPU_METHOD MC_MNT_P0111FLT_CNT "MNT_P0111FLT_CNT conversion" RAT_FUNC "%5.0" "Unitless" COEFFS 0 1 0 0 0 1 /end COMPU_METHOD
/begin CHARACTERISTIC MNT_P0111FLT_TM "" VALUE 0x5E730 SD_FLOAT32_IEEE 0 SC_MNT_P0111FLT_TM 0 20 /end CHARACTERISTIC
/begin COMPU_METHOD SC_MNT_P0111FLT_TM "MNT_P0111FLT_TM conversion" RAT_FUNC "%10.5" "unitless" COEFFS 0 1 0 0 0 1 /end COMPU_METHOD
/begin MEASUREMENT MNT_P0111FLT_TMR "" FLOAT32_IEEE MC_MNT_P0111FLT_TMR 0 0 0 0 ECU_ADDRESS 0x3FAE88 /end MEASUREMENT
/begin COMPU_METHOD MC_MNT_P0111FLT_TMR "MNT_P0111FLT_TMR conversion" RAT_FUNC "%10.5" "Unitless" COEFFS 0 1 0 0 0 1 /end COMPU_METHOD
/begin CHARACTERISTIC MNT_P0111TST_TM "" VALUE 0x5E72C SD_FLOAT32_IEEE 0 SC_MNT_P0111TST_TM 0 20 /end CHARACTERISTIC
/begin COMPU_METHOD SC_MNT_P0111TST_TM "MNT_P0111TST_TM conversion" RAT_FUNC "%10.5" "unitless" COEFFS 0 1 0 0 0 1 /end COMPU_METHOD
/begin MEASUREMENT MNT_P0116COMP "" UBYTE MC_MNT_P0116COMP 0 0 0 0 ECU_ADDRESS 0x3FAFE1 /end MEASUREMENT
/begin COMPU_METHOD MC_MNT_P0116COMP "MNT_P0116COMP conversion" RAT_FUNC "%3.0" "Unitless" COEFFS 0 1 0 0 0 1 /end COMPU_METHOD
/begin MEASUREMENT MNT_P0116FLT "" UBYTE MC_MNT_P0116FLT 0 0 0 0 ECU_ADDRESS 0x3FAFE0 /end MEASUREMENT
/begin COMPU_METHOD MC_MNT_P0116FLT "MNT_P0116FLT conversion" RAT_FUNC "%3.0" "Unitless" COEFFS 0 1 0 0 0 1 /end COMPU_METHOD
/begin MEASUREMENT MNT_P0116FLT_CNT "" UWORD MC_MNT_P0116FLT_CNT 0 0 0 0 ECU_ADDRESS 0x3FAFA0 /end MEASUREMENT
/begin COMPU_METHOD MC_MNT_P0116FLT_CNT "MNT_P0116FLT_CNT conversion" RAT_FUNC "%5.0" "Unitless" COEFFS 0 1 0 0 0 1 /end COMPU_METHOD
/begin CHARACTERISTIC MNT_P0116FLT_TM "" VALUE 0x5E728 SD_FLOAT32_IEEE 0 SC_MNT_P0116FLT_TM 0 20 /end CHARACTERISTIC
/begin COMPU_METHOD SC_MNT_P0116FLT_TM "MNT_P0116FLT_TM conversion" RAT_FUNC "%10.5" "unitless" COEFFS 0 1 0 0 0 1 /end COMPU_METHOD
/begin MEASUREMENT MNT_P0116FLT_TMR "" FLOAT32_IEEE MC_MNT_P0116FLT_TMR 0 0 0 0 ECU_ADDRESS 0x3FAE84 /end MEASUREMENT
/begin COMPU_METHOD MC_MNT_P0116FLT_TMR "MNT_P0116FLT_TMR conversion" RAT_FUNC "%10.5" "Unitless" COEFFS 0 1 0 0 0 1 /end COMPU_METHOD
/begin CHARACTERISTIC MNT_P0116TST_TM "" VALUE 0x5E724 SD_FLOAT32_IEEE 0 SC_MNT_P0116TST_TM 0 20 /end CHARACTERISTIC
/begin COMPU_METHOD SC_MNT_P0116TST_TM "MNT_P0116TST_TM conversion" RAT_FUNC "%10.5" "unitless" COEFFS 0 1 0 0 0 1 /end COMPU_METHOD
/begin MEASUREMENT MNT_P0400COMP "" UBYTE MC_MNT_P0400COMP 0 0 0 0 ECU_ADDRESS 0x3FAFDF /end MEASUREMENT
/begin COMPU_METHOD MC_MNT_P0400COMP "MNT_P0400COMP conversion" RAT_FUNC "%3.0" "Unitless" COEFFS 0 1 0 0 0 1 /end COMPU_METHOD
/begin MEASUREMENT MNT_P0400FLT_CNT "" UWORD MC_MNT_P0400FLT_CNT 0 0 0 0 ECU_ADDRESS 0x3FAF9E /end MEASUREMENT
/begin COMPU_METHOD MC_MNT_P0400FLT_CNT "MNT_P0400FLT_CNT conversion" RAT_FUNC "%5.0" "Unitless" COEFFS 0 1 0 0 0 1 /end COMPU_METHOD
/begin CHARACTERISTIC MNT_P0400FLT_TM "" VALUE 0x5E720 SD_FLOAT32_IEEE 0 SC_MNT_P0400FLT_TM 0 2000 /end CHARACTERISTIC
/begin COMPU_METHOD SC_MNT_P0400FLT_TM "MNT_P0400FLT_TM conversion" RAT_FUNC "%10.5" "unitless" COEFFS 0 1 0 0 0 1 /end COMPU_METHOD
/begin MEASUREMENT MNT_P0400FLT_TMR "" FLOAT32_IEEE MC_MNT_P0400FLT_TMR 0 0 0 0 ECU_ADDRESS 0x3FAE80 /end MEASUREMENT
/begin COMPU_METHOD MC_MNT_P0400FLT_TMR "MNT_P0400FLT_TMR conversion" RAT_FUNC "%10.5" "Unitless" COEFFS 0 1 0 0 0 1 /end COMPU_METHOD
/begin MEASUREMENT MNT_P0400TST_CNT "" UWORD MC_MNT_P0400TST_CNT 0 0 0 0 ECU_ADDRESS 0x3FAF9C /end MEASUREMENT
/begin COMPU_METHOD MC_MNT_P0400TST_CNT "MNT_P0400TST_CNT conversion" RAT_FUNC "%5.0" "Unitless" COEFFS 0 1 0 0 0 1 /end COMPU_METHOD
/begin CHARACTERISTIC MNT_P0400TST_TM "" VALUE 0x5E71C SD_FLOAT32_IEEE 0 SC_MNT_P0400TST_TM 0 20000 /end CHARACTERISTIC
/begin COMPU_METHOD SC_MNT_P0400TST_TM "MNT_P0400TST_TM conversion" RAT_FUNC "%10.5" "unitless" COEFFS 0 1 0 0 0 1 /end COMPU_METHOD
/begin MEASUREMENT MNT_P0400TST_TMR "" FLOAT32_IEEE MC_MNT_P0400TST_TMR 0 0 0 0 ECU_ADDRESS 0x3FAE7C /end MEASUREMENT
/begin COMPU_METHOD MC_MNT_P0400TST_TMR "MNT_P0400TST_TMR conversion" RAT_FUNC "%10.5" "Unitless" COEFFS 0 1 0 0 0 1 /end COMPU_METHOD
/begin MEASUREMENT MNT_P0401FLT "" UBYTE MC_MNT_P0401FLT 0 0 0 0 ECU_ADDRESS 0x3FAFDE /end MEASUREMENT
/begin COMPU_METHOD MC_MNT_P0401FLT "MNT_P0401FLT conversion" RAT_FUNC "%3.0" "Unitless" COEFFS 0 1 0 0 0 1 /end COMPU_METHOD
/begin MEASUREMENT MNT_P0402FLT "" UBYTE MC_MNT_P0402FLT 0 0 0 0 ECU_ADDRESS 0x3FAFDD /end MEASUREMENT
/begin COMPU_METHOD MC_MNT_P0402FLT "MNT_P0402FLT conversion" RAT_FUNC "%3.0" "Unitless" COEFFS 0 1 0 0 0 1 /end COMPU_METHOD
/begin MEASUREMENT MNT_P0471FLT "" UBYTE MC_MNT_P0471FLT 0 0 0 0 ECU_ADDRESS 0x3FAFDC /end MEASUREMENT
/begin COMPU_METHOD MC_MNT_P0471FLT "MNT_P0471FLT conversion" RAT_FUNC "%3.0" "Unitless" COEFFS 0 1 0 0 0 1 /end COMPU_METHOD
/begin MEASUREMENT MNT_P0471OSFLT "" UBYTE MC_MNT_P0471OSFLT 0 0 0 0 ECU_ADDRESS 0x3FAFDB /end MEASUREMENT
/begin COMPU_METHOD MC_MNT_P0471OSFLT "MNT_P0471OSFLT conversion" RAT_FUNC "%3.0" "Unitless" COEFFS 0 1 0 0 0 1 /end COMPU_METHOD
/begin MEASUREMENT MNT_P0471SIGCOMP "" UBYTE MC_MNT_P0471SIGCOMP 0 0 0 0 ECU_ADDRESS 0x3FAFDA /end MEASUREMENT
/begin COMPU_METHOD MC_MNT_P0471SIGCOMP "MNT_P0471SIGCOMP conversion" RAT_FUNC "%3.0" "Unitless" COEFFS 0 1 0 0 0 1 /end COMPU_METHOD
/begin MEASUREMENT MNT_P0471SIGFLT "" UBYTE MC_MNT_P0471SIGFLT 0 0 0 0 ECU_ADDRESS 0x3FAFD9 /end MEASUREMENT
/begin COMPU_METHOD MC_MNT_P0471SIGFLT "MNT_P0471SIGFLT conversion" RAT_FUNC "%3.0" "Unitless" COEFFS 0 1 0 0 0 1 /end COMPU_METHOD
/begin MEASUREMENT MNT_P0471SIGFLT_CNT "" UWORD MC_MNT_P0471SIGFLT_CNT 0 0 0 0 ECU_ADDRESS 0x3FAF9A /end MEASUREMENT
/begin COMPU_METHOD MC_MNT_P0471SIGFLT_CNT "MNT_P0471SIGFLT_CNT conversion" RAT_FUNC "%5.0" "Unitless" COEFFS 0 1 0 0 0 1 /end COMPU_METHOD
/begin CHARACTERISTIC MNT_P0471SIGFLT_TM "" VALUE 0x5E718 SD_FLOAT32_IEEE 0 SC_MNT_P0471SIGFLT_TM 0 20 /end CHARACTERISTIC
/begin COMPU_METHOD SC_MNT_P0471SIGFLT_TM "MNT_P0471SIGFLT_TM conversion" RAT_FUNC "%10.5" "unitless" COEFFS 0 1 0 0 0 1 /end COMPU_METHOD
/begin MEASUREMENT MNT_P0471SIGFLT_TMR "" FLOAT32_IEEE MC_MNT_P0471SIGFLT_TMR 0 0 0 0 ECU_ADDRESS 0x3FAE78 /end MEASUREMENT
/begin COMPU_METHOD MC_MNT_P0471SIGFLT_TMR "MNT_P0471SIGFLT_TMR conversion" RAT_FUNC "%10.5" "Unitless" COEFFS 0 1 0 0 0 1 /end COMPU_METHOD
/begin CHARACTERISTIC MNT_P0471SIGTST_TM "" VALUE 0x5E714 SD_FLOAT32_IEEE 0 SC_MNT_P0471SIGTST_TM 0 20 /end CHARACTERISTIC
/begin COMPU_METHOD SC_MNT_P0471SIGTST_TM "MNT_P0471SIGTST_TM conversion" RAT_FUNC "%10.5" "unitless" COEFFS 0 1 0 0 0 1 /end COMPU_METHOD
/begin MEASUREMENT MNT_P0477EGRFLT "" UBYTE MC_MNT_P0477EGRFLT 0 0 0 0 ECU_ADDRESS 0x3FAFD7 /end MEASUREMENT
/begin COMPU_METHOD MC_MNT_P0477EGRFLT "MNT_P0477EGRFLT conversion" RAT_FUNC "%3.0" "Unitless" COEFFS 0 1 0 0 0 1 /end COMPU_METHOD
/begin MEASUREMENT MNT_P0477EGRFLT_CNT "" UWORD MC_MNT_P0477EGRFLT_CNT 0 0 0 0 ECU_ADDRESS 0x3FAF98 /end MEASUREMENT
/begin COMPU_METHOD MC_MNT_P0477EGRFLT_CNT "MNT_P0477EGRFLT_CNT conversion" RAT_FUNC "%5.0" "Unitless" COEFFS 0 1 0 0 0 1 /end COMPU_METHOD
/begin CHARACTERISTIC MNT_P0477EGRFLT_TM "" VALUE 0x5E710 SD_FLOAT32_IEEE 0 SC_MNT_P0477EGRFLT_TM 0 2000 /end CHARACTERISTIC
/begin COMPU_METHOD SC_MNT_P0477EGRFLT_TM "MNT_P0477EGRFLT_TM conversion" RAT_FUNC "%10.5" "unitless" COEFFS 0 1 0 0 0 1 /end COMPU_METHOD
/begin MEASUREMENT MNT_P0477EGRFLT_TMR "" FLOAT32_IEEE MC_MNT_P0477EGRFLT_TMR 0 0 0 0 ECU_ADDRESS 0x3FAE74 /end MEASUREMENT
/begin COMPU_METHOD MC_MNT_P0477EGRFLT_TMR "MNT_P0477EGRFLT_TMR conversion" RAT_FUNC "%10.5" "Unitless" COEFFS 0 1 0 0 0 1 /end COMPU_METHOD
/begin MEASUREMENT MNT_P0477FLT "" UBYTE MC_MNT_P0477FLT 0 0 0 0 ECU_ADDRESS 0x3FAFD8 /end MEASUREMENT
/begin COMPU_METHOD MC_MNT_P0477FLT "MNT_P0477FLT conversion" RAT_FUNC "%3.0" "Unitless" COEFFS 0 1 0 0 0 1 /end COMPU_METHOD
/begin MEASUREMENT MNT_P0477VALUECOMP "" UBYTE MC_MNT_P0477VALUECOMP 0 0 0 0 ECU_ADDRESS 0x3FAFD6 /end MEASUREMENT
/begin COMPU_METHOD MC_MNT_P0477VALUECOMP "MNT_P0477VALUECOMP conversion" RAT_FUNC "%3.0" "Unitless" COEFFS 0 1 0 0 0 1 /end COMPU_METHOD
/begin MEASUREMENT MNT_P0477VALUEFLT "" UBYTE MC_MNT_P0477VALUEFLT 0 0 0 0 ECU_ADDRESS 0x3FAFD5 /end MEASUREMENT
/begin COMPU_METHOD MC_MNT_P0477VALUEFLT "MNT_P0477VALUEFLT conversion" RAT_FUNC "%3.0" "Unitless" COEFFS 0 1 0 0 0 1 /end COMPU_METHOD
/begin MEASUREMENT MNT_P0477VALUEFLT_CNT "" UWORD MC_MNT_P0477VALUEFLT_CNT 0 0 0 0 ECU_ADDRESS 0x3FAF96 /end MEASUREMENT
/begin COMPU_METHOD MC_MNT_P0477VALUEFLT_CNT "MNT_P0477VALUEFLT_CNT conversion" RAT_FUNC "%5.0" "Unitless" COEFFS 0 1 0 0 0 1 /end COMPU_METHOD
/begin CHARACTERISTIC MNT_P0477VALUEFLT_TM "" VALUE 0x5E70C SD_FLOAT32_IEEE 0 SC_MNT_P0477VALUEFLT_TM 0 20 /end CHARACTERISTIC
/begin COMPU_METHOD SC_MNT_P0477VALUEFLT_TM "MNT_P0477VALUEFLT_TM conversion" RAT_FUNC "%10.5" "unitless" COEFFS 0 1 0 0 0 1 /end COMPU_METHOD
/begin MEASUREMENT MNT_P0477VALUEFLT_TMR "" FLOAT32_IEEE MC_MNT_P0477VALUEFLT_TMR 0 0 0 0 ECU_ADDRESS 0x3FAE70 /end MEASUREMENT
/begin COMPU_METHOD MC_MNT_P0477VALUEFLT_TMR "MNT_P0477VALUEFLT_TMR conversion" RAT_FUNC "%10.5" "Unitless" COEFFS 0 1 0 0 0 1 /end COMPU_METHOD
/begin MEASUREMENT MNT_P0477VALUETST_CNT "" UWORD MC_MNT_P0477VALUETST_CNT 0 0 0 0 ECU_ADDRESS 0x3FAF94 /end MEASUREMENT
/begin COMPU_METHOD MC_MNT_P0477VALUETST_CNT "MNT_P0477VALUETST_CNT conversion" RAT_FUNC "%5.0" "Unitless" COEFFS 0 1 0 0 0 1 /end COMPU_METHOD
/begin CHARACTERISTIC MNT_P0477VALUETST_TM "" VALUE 0x5E708 SD_FLOAT32_IEEE 0 SC_MNT_P0477VALUETST_TM 0 20 /end CHARACTERISTIC
/begin COMPU_METHOD SC_MNT_P0477VALUETST_TM "MNT_P0477VALUETST_TM conversion" RAT_FUNC "%10.5" "unitless" COEFFS 0 1 0 0 0 1 /end COMPU_METHOD
/begin MEASUREMENT MNT_P0477VALUETST_TMR "" FLOAT32_IEEE MC_MNT_P0477VALUETST_TMR 0 0 0 0 ECU_ADDRESS 0x3FAE6C /end MEASUREMENT
/begin COMPU_METHOD MC_MNT_P0477VALUETST_TMR "MNT_P0477VALUETST_TMR conversion" RAT_FUNC "%10.5" "Unitless" COEFFS 0 1 0 0 0 1 /end COMPU_METHOD
/begin MEASUREMENT MNT_P0478EGRFLT "" UBYTE MC_MNT_P0478EGRFLT 0 0 0 0 ECU_ADDRESS 0x3FAFD3 /end MEASUREMENT
/begin COMPU_METHOD MC_MNT_P0478EGRFLT "MNT_P0478EGRFLT conversion" RAT_FUNC "%3.0" "Unitless" COEFFS 0 1 0 0 0 1 /end COMPU_METHOD
/begin MEASUREMENT MNT_P0478EGRFLT_CNT "" UWORD MC_MNT_P0478EGRFLT_CNT 0 0 0 0 ECU_ADDRESS 0x3FAF92 /end MEASUREMENT
/begin COMPU_METHOD MC_MNT_P0478EGRFLT_CNT "MNT_P0478EGRFLT_CNT conversion" RAT_FUNC "%5.0" "Unitless" COEFFS 0 1 0 0 0 1 /end COMPU_METHOD
/begin RECORD_LAYOUT SD_UBYTE FNC_VALUES 1 UBYTE ROW_DIR DIRECT /end RECORD_LAYOUT
/begin RECORD_LAYOUT SD_UWORD FNC_VALUES 1 UWORD ROW_DIR DIRECT /end RECORD_LAYOUT
/begin RECORD_LAYOUT SD_SLONG FNC_VALUES 1 SLONG ROW_DIR DIRECT /end RECORD_LAYOUT
/begin RECORD_LAYOUT SD_FLOAT32_IEEE FNC_VALUES 1 FLOAT32_IEEE ROW_DIR DIRECT /end RECORD_LAYOUT
/end MODULE
/end PROJECT
