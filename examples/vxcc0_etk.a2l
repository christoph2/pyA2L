/begin PROJECT DPU-2XX "Visteon Diesel"
/begin HEADER " " VERSION "1" PROJECT_NO Global /end HEADER
/begin MODULE ENGINE "International Engine Controller"
/begin MOD_COMMON " " BYTE_ORDER MSB_FIRST /end MOD_COMMON
/begin CHARACTERISTIC MNT_P0478EGRFLT_TM "" VALUE 0x5E704 SD_FLOAT32_IEEE 0 SC_MNT_P0478EGRFLT_TM 0 2000 /end CHARACTERISTIC
/begin COMPU_METHOD SC_MNT_P0478EGRFLT_TM "MNT_P0478EGRFLT_TM conversion" RAT_FUNC "%10.5" "unitless" COEFFS 0 1 0 0 0 1 /end COMPU_METHOD
/begin MEASUREMENT MNT_P0478EGRFLT_TMR "" FLOAT32_IEEE MC_MNT_P0478EGRFLT_TMR 0 0 0 0 ECU_ADDRESS 0x3FAE68 /end MEASUREMENT
/begin COMPU_METHOD MC_MNT_P0478EGRFLT_TMR "MNT_P0478EGRFLT_TMR conversion" RAT_FUNC "%10.5" "Unitless" COEFFS 0 1 0 0 0 1 /end COMPU_METHOD
/begin MEASUREMENT MNT_P0478FLT "" UBYTE MC_MNT_P0478FLT 0 0 0 0 ECU_ADDRESS 0x3FAFD4 /end MEASUREMENT
/begin COMPU_METHOD MC_MNT_P0478FLT "MNT_P0478FLT conversion" RAT_FUNC "%3.0" "Unitless" COEFFS 0 1 0 0 0 1 /end COMPU_METHOD
/begin MEASUREMENT MNT_P0478VALUECOMP "" UBYTE MC_MNT_P0478VALUECOMP 0 0 0 0 ECU_ADDRESS 0x3FAFD2 /end MEASUREMENT
/begin COMPU_METHOD MC_MNT_P0478VALUECOMP "MNT_P0478VALUECOMP conversion" RAT_FUNC "%3.0" "Unitless" COEFFS 0 1 0 0 0 1 /end COMPU_METHOD
/begin MEASUREMENT MNT_P0478VALUEFLT "" UBYTE MC_MNT_P0478VALUEFLT 0 0 0 0 ECU_ADDRESS 0x3FAFD1 /end MEASUREMENT
/begin COMPU_METHOD MC_MNT_P0478VALUEFLT "MNT_P0478VALUEFLT conversion" RAT_FUNC "%3.0" "Unitless" COEFFS 0 1 0 0 0 1 /end COMPU_METHOD
/begin MEASUREMENT MNT_P0478VALUEFLT_CNT "" UWORD MC_MNT_P0478VALUEFLT_CNT 0 0 0 0 ECU_ADDRESS 0x3FAF90 /end MEASUREMENT
/begin COMPU_METHOD MC_MNT_P0478VALUEFLT_CNT "MNT_P0478VALUEFLT_CNT conversion" RAT_FUNC "%5.0" "Unitless" COEFFS 0 1 0 0 0 1 /end COMPU_METHOD
/begin CHARACTERISTIC MNT_P0478VALUEFLT_TM "" VALUE 0x5E700 SD_FLOAT32_IEEE 0 SC_MNT_P0478VALUEFLT_TM 0 20 /end CHARACTERISTIC
/begin COMPU_METHOD SC_MNT_P0478VALUEFLT_TM "MNT_P0478VALUEFLT_TM conversion" RAT_FUNC "%10.5" "unitless" COEFFS 0 1 0 0 0 1 /end COMPU_METHOD
/begin MEASUREMENT MNT_P0478VALUEFLT_TMR "" FLOAT32_IEEE MC_MNT_P0478VALUEFLT_TMR 0 0 0 0 ECU_ADDRESS 0x3FAE64 /end MEASUREMENT
/begin COMPU_METHOD MC_MNT_P0478VALUEFLT_TMR "MNT_P0478VALUEFLT_TMR conversion" RAT_FUNC "%10.5" "Unitless" COEFFS 0 1 0 0 0 1 /end COMPU_METHOD
/begin MEASUREMENT MNT_P0488DTCOMP "" UBYTE MC_MNT_P0488DTCOMP 0 0 0 0 ECU_ADDRESS 0x3FAFD0 /end MEASUREMENT
/begin COMPU_METHOD MC_MNT_P0488DTCOMP "MNT_P0488DTCOMP conversion" RAT_FUNC "%3.0" "Unitless" COEFFS 0 1 0 0 0 1 /end COMPU_METHOD
/begin MEASUREMENT MNT_P0488DTFLT "" UBYTE MC_MNT_P0488DTFLT 0 0 0 0 ECU_ADDRESS 0x3FAFCF /end MEASUREMENT
/begin COMPU_METHOD MC_MNT_P0488DTFLT "MNT_P0488DTFLT conversion" RAT_FUNC "%3.0" "Unitless" COEFFS 0 1 0 0 0 1 /end COMPU_METHOD
/begin MEASUREMENT MNT_P0488DTFLT_CNT "" UWORD MC_MNT_P0488DTFLT_CNT 0 0 0 0 ECU_ADDRESS 0x3FAF8E /end MEASUREMENT
/begin COMPU_METHOD MC_MNT_P0488DTFLT_CNT "MNT_P0488DTFLT_CNT conversion" RAT_FUNC "%5.0" "Unitless" COEFFS 0 1 0 0 0 1 /end COMPU_METHOD
/begin CHARACTERISTIC MNT_P0488DTFLT_TM "" VALUE 0x5E6FC SD_FLOAT32_IEEE 0 SC_MNT_P0488DTFLT_TM 0 20 /end CHARACTERISTIC
/begin COMPU_METHOD SC_MNT_P0488DTFLT_TM "MNT_P0488DTFLT_TM conversion" RAT_FUNC "%10.5" "unitless" COEFFS 0 1 0 0 0 1 /end COMPU_METHOD
/begin MEASUREMENT MNT_P0488DTFLT_TMR "" FLOAT32_IEEE MC_MNT_P0488DTFLT_TMR 0 0 0 0 ECU_ADDRESS 0x3FAE60 /end MEASUREMENT
/begin COMPU_METHOD MC_MNT_P0488DTFLT_TMR "MNT_P0488DTFLT_TMR conversion" RAT_FUNC "%10.5" "Unitless" COEFFS 0 1 0 0 0 1 /end COMPU_METHOD
/begin MEASUREMENT MNT_P0488DTTST_CNT "" UWORD MC_MNT_P0488DTTST_CNT 0 0 0 0 ECU_ADDRESS 0x3FAF8C /end MEASUREMENT
/begin COMPU_METHOD MC_MNT_P0488DTTST_CNT "MNT_P0488DTTST_CNT conversion" RAT_FUNC "%5.0" "Unitless" COEFFS 0 1 0 0 0 1 /end COMPU_METHOD
/begin CHARACTERISTIC MNT_P0488DTTST_TM "" VALUE 0x5E6F8 SD_FLOAT32_IEEE 0 SC_MNT_P0488DTTST_TM 0 20 /end CHARACTERISTIC
/begin COMPU_METHOD SC_MNT_P0488DTTST_TM "MNT_P0488DTTST_TM conversion" RAT_FUNC "%10.5" "unitless" COEFFS 0 1 0 0 0 1 /end COMPU_METHOD
/begin MEASUREMENT MNT_P0488DTTST_TMR "" FLOAT32_IEEE MC_MNT_P0488DTTST_TMR 0 0 0 0 ECU_ADDRESS 0x3FAE5C /end MEASUREMENT
/begin COMPU_METHOD MC_MNT_P0488DTTST_TMR "MNT_P0488DTTST_TMR conversion" RAT_FUNC "%10.5" "Unitless" COEFFS 0 1 0 0 0 1 /end COMPU_METHOD
/begin MEASUREMENT MNT_P0488FLT "" UBYTE MC_MNT_P0488FLT 0 0 0 0 ECU_ADDRESS 0x3FAFCE /end MEASUREMENT
/begin COMPU_METHOD MC_MNT_P0488FLT "MNT_P0488FLT conversion" RAT_FUNC "%3.0" "Unitless" COEFFS 0 1 0 0 0 1 /end COMPU_METHOD
/begin MEASUREMENT MNT_P0488IDLECOMP "" UBYTE MC_MNT_P0488IDLECOMP 0 0 0 0 ECU_ADDRESS 0x3FAFCB /end MEASUREMENT
/begin COMPU_METHOD MC_MNT_P0488IDLECOMP "MNT_P0488IDLECOMP conversion" RAT_FUNC "%3.0" "Unitless" COEFFS 0 1 0 0 0 1 /end COMPU_METHOD
/begin MEASUREMENT MNT_P0488IDLEFLT "" UBYTE MC_MNT_P0488IDLEFLT 0 0 0 0 ECU_ADDRESS 0x3FAFCA /end MEASUREMENT
/begin COMPU_METHOD MC_MNT_P0488IDLEFLT "MNT_P0488IDLEFLT conversion" RAT_FUNC "%3.0" "Unitless" COEFFS 0 1 0 0 0 1 /end COMPU_METHOD
/begin MEASUREMENT MNT_P0488IDLEFLT_CNT "" UWORD MC_MNT_P0488IDLEFLT_CNT 0 0 0 0 ECU_ADDRESS 0x3FAF88 /end MEASUREMENT
/begin COMPU_METHOD MC_MNT_P0488IDLEFLT_CNT "MNT_P0488IDLEFLT_CNT conversion" RAT_FUNC "%5.0" "Unitless" COEFFS 0 1 0 0 0 1 /end COMPU_METHOD
/begin CHARACTERISTIC MNT_P0488IDLEFLT_TM "" VALUE 0x5E6F4 SD_FLOAT32_IEEE 0 SC_MNT_P0488IDLEFLT_TM 0 20 /end CHARACTERISTIC
/begin COMPU_METHOD SC_MNT_P0488IDLEFLT_TM "MNT_P0488IDLEFLT_TM conversion" RAT_FUNC "%10.5" "unitless" COEFFS 0 1 0 0 0 1 /end COMPU_METHOD
/begin MEASUREMENT MNT_P0488IDLEFLT_TMR "" FLOAT32_IEEE MC_MNT_P0488IDLEFLT_TMR 0 0 0 0 ECU_ADDRESS 0x3FAE54 /end MEASUREMENT
/begin COMPU_METHOD MC_MNT_P0488IDLEFLT_TMR "MNT_P0488IDLEFLT_TMR conversion" RAT_FUNC "%10.5" "Unitless" COEFFS 0 1 0 0 0 1 /end COMPU_METHOD
/begin MEASUREMENT MNT_P0488IDLETST_CNT "" UWORD MC_MNT_P0488IDLETST_CNT 0 0 0 0 ECU_ADDRESS 0x3FAF86 /end MEASUREMENT
/begin COMPU_METHOD MC_MNT_P0488IDLETST_CNT "MNT_P0488IDLETST_CNT conversion" RAT_FUNC "%5.0" "Unitless" COEFFS 0 1 0 0 0 1 /end COMPU_METHOD
/begin CHARACTERISTIC MNT_P0488IDLETST_TM "" VALUE 0x5E6F0 SD_FLOAT32_IEEE 0 SC_MNT_P0488IDLETST_TM 0 20 /end CHARACTERISTIC
/begin COMPU_METHOD SC_MNT_P0488IDLETST_TM "MNT_P0488IDLETST_TM conversion" RAT_FUNC "%10.5" "unitless" COEFFS 0 1 0 0 0 1 /end COMPU_METHOD
/begin MEASUREMENT MNT_P0488IDLETST_TMR "" FLOAT32_IEEE MC_MNT_P0488IDLETST_TMR 0 0 0 0 ECU_ADDRESS 0x3FAE50 /end MEASUREMENT
/begin COMPU_METHOD MC_MNT_P0488IDLETST_TMR "MNT_P0488IDLETST_TMR conversion" RAT_FUNC "%10.5" "Unitless" COEFFS 0 1 0 0 0 1 /end COMPU_METHOD
/begin MEASUREMENT MNT_P0488SIGCOMP "" UBYTE MC_MNT_P0488SIGCOMP 0 0 0 0 ECU_ADDRESS 0x3FAFCD /end MEASUREMENT
/begin COMPU_METHOD MC_MNT_P0488SIGCOMP "MNT_P0488SIGCOMP conversion" RAT_FUNC "%3.0" "Unitless" COEFFS 0 1 0 0 0 1 /end COMPU_METHOD
/begin MEASUREMENT MNT_P0488SIGFLT "" UBYTE MC_MNT_P0488SIGFLT 0 0 0 0 ECU_ADDRESS 0x3FAFCC /end MEASUREMENT
/begin COMPU_METHOD MC_MNT_P0488SIGFLT "MNT_P0488SIGFLT conversion" RAT_FUNC "%3.0" "Unitless" COEFFS 0 1 0 0 0 1 /end COMPU_METHOD
/begin MEASUREMENT MNT_P0488SIGFLT_CNT "" UWORD MC_MNT_P0488SIGFLT_CNT 0 0 0 0 ECU_ADDRESS 0x3FAF8A /end MEASUREMENT
/begin COMPU_METHOD MC_MNT_P0488SIGFLT_CNT "MNT_P0488SIGFLT_CNT conversion" RAT_FUNC "%5.0" "Unitless" COEFFS 0 1 0 0 0 1 /end COMPU_METHOD
/begin CHARACTERISTIC MNT_P0488SIGFLT_TM "" VALUE 0x5E6EC SD_FLOAT32_IEEE 0 SC_MNT_P0488SIGFLT_TM 0 20 /end CHARACTERISTIC
/begin COMPU_METHOD SC_MNT_P0488SIGFLT_TM "MNT_P0488SIGFLT_TM conversion" RAT_FUNC "%10.5" "unitless" COEFFS 0 1 0 0 0 1 /end COMPU_METHOD
/begin MEASUREMENT MNT_P0488SIGFLT_TMR "" FLOAT32_IEEE MC_MNT_P0488SIGFLT_TMR 0 0 0 0 ECU_ADDRESS 0x3FAE58 /end MEASUREMENT
/begin COMPU_METHOD MC_MNT_P0488SIGFLT_TMR "MNT_P0488SIGFLT_TMR conversion" RAT_FUNC "%10.5" "Unitless" COEFFS 0 1 0 0 0 1 /end COMPU_METHOD
/begin CHARACTERISTIC MNT_P0488SIGTST_TM "" VALUE 0x5E6E8 SD_FLOAT32_IEEE 0 SC_MNT_P0488SIGTST_TM 0 20 /end CHARACTERISTIC
/begin COMPU_METHOD SC_MNT_P0488SIGTST_TM "MNT_P0488SIGTST_TM conversion" RAT_FUNC "%10.5" "unitless" COEFFS 0 1 0 0 0 1 /end COMPU_METHOD
/begin MEASUREMENT MNT_P1195FLT "" UBYTE MC_MNT_P1195FLT 0 0 0 0 ECU_ADDRESS 0x3FAFC9 /end MEASUREMENT
/begin COMPU_METHOD MC_MNT_P1195FLT "MNT_P1195FLT conversion" RAT_FUNC "%3.0" "Unitless" COEFFS 0 1 0 0 0 1 /end COMPU_METHOD
/begin MEASUREMENT MNT_P1195OSFLT "" UBYTE MC_MNT_P1195OSFLT 0 0 0 0 ECU_ADDRESS 0x3FAFC8 /end MEASUREMENT
/begin COMPU_METHOD MC_MNT_P1195OSFLT "MNT_P1195OSFLT conversion" RAT_FUNC "%3.0" "Unitless" COEFFS 0 1 0 0 0 1 /end COMPU_METHOD
/begin MEASUREMENT MNT_P1195SIGCOMP "" UBYTE MC_MNT_P1195SIGCOMP 0 0 0 0 ECU_ADDRESS 0x3FAFC7 /end MEASUREMENT
/begin COMPU_METHOD MC_MNT_P1195SIGCOMP "MNT_P1195SIGCOMP conversion" RAT_FUNC "%3.0" "Unitless" COEFFS 0 1 0 0 0 1 /end COMPU_METHOD
/begin MEASUREMENT MNT_P1195SIGFLT "" UBYTE MC_MNT_P1195SIGFLT 0 0 0 0 ECU_ADDRESS 0x3FAFC6 /end MEASUREMENT
/begin COMPU_METHOD MC_MNT_P1195SIGFLT "MNT_P1195SIGFLT conversion" RAT_FUNC "%3.0" "Unitless" COEFFS 0 1 0 0 0 1 /end COMPU_METHOD
/begin MEASUREMENT MNT_P1195SIGFLT_CNT "" UWORD MC_MNT_P1195SIGFLT_CNT 0 0 0 0 ECU_ADDRESS 0x3FAF84 /end MEASUREMENT
/begin COMPU_METHOD MC_MNT_P1195SIGFLT_CNT "MNT_P1195SIGFLT_CNT conversion" RAT_FUNC "%5.0" "Unitless" COEFFS 0 1 0 0 0 1 /end COMPU_METHOD
/begin CHARACTERISTIC MNT_P1195SIGFLT_TM "" VALUE 0x5E6E4 SD_FLOAT32_IEEE 0 SC_MNT_P1195SIGFLT_TM 0 20 /end CHARACTERISTIC
/begin COMPU_METHOD SC_MNT_P1195SIGFLT_TM "MNT_P1195SIGFLT_TM conversion" RAT_FUNC "%10.5" "unitless" COEFFS 0 1 0 0 0 1 /end COMPU_METHOD
/begin MEASUREMENT MNT_P1195SIGFLT_TMR "" FLOAT32_IEEE MC_MNT_P1195SIGFLT_TMR 0 0 0 0 ECU_ADDRESS 0x3FAE4C /end MEASUREMENT
/begin COMPU_METHOD MC_MNT_P1195SIGFLT_TMR "MNT_P1195SIGFLT_TMR conversion" RAT_FUNC "%10.5" "Unitless" COEFFS 0 1 0 0 0 1 /end COMPU_METHOD
/begin CHARACTERISTIC MNT_P1195SIGTST_TM "" VALUE 0x5E6E0 SD_FLOAT32_IEEE 0 SC_MNT_P1195SIGTST_TM 0 20 /end CHARACTERISTIC
/begin COMPU_METHOD SC_MNT_P1195SIGTST_TM "MNT_P1195SIGTST_TM conversion" RAT_FUNC "%10.5" "unitless" COEFFS 0 1 0 0 0 1 /end COMPU_METHOD
/begin MEASUREMENT MNT_P1400FLT "" UBYTE MC_MNT_P1400FLT 0 0 0 0 ECU_ADDRESS 0x3FAFC5 /end MEASUREMENT
/begin COMPU_METHOD MC_MNT_P1400FLT "MNT_P1400FLT conversion" RAT_FUNC "%3.0" "Unitless" COEFFS 0 1 0 0 0 1 /end COMPU_METHOD
/begin CHARACTERISTIC MNT_P1400FLT_TM "" VALUE 0x5E6DC SD_FLOAT32_IEEE 0 SC_MNT_P1400FLT_TM 0 2000 /end CHARACTERISTIC
/begin COMPU_METHOD SC_MNT_P1400FLT_TM "MNT_P1400FLT_TM conversion" RAT_FUNC "%10.5" "unitless" COEFFS 0 1 0 0 0 1 /end COMPU_METHOD
/begin MEASUREMENT MNT_P1400FLT_TMR "" FLOAT32_IEEE MC_MNT_P1400FLT_TMR 0 0 0 0 ECU_ADDRESS 0x3FAE48 /end MEASUREMENT
/begin COMPU_METHOD MC_MNT_P1400FLT_TMR "MNT_P1400FLT_TMR conversion" RAT_FUNC "%10.5" "Unitless" COEFFS 0 1 0 0 0 1 /end COMPU_METHOD
/begin MEASUREMENT MNT_P1401COMP "" UBYTE MC_MNT_P1401COMP 0 0 0 0 ECU_ADDRESS 0x3FAFC4 /end MEASUREMENT
/begin COMPU_METHOD MC_MNT_P1401COMP "MNT_P1401COMP conversion" RAT_FUNC "%3.0" "Unitless" COEFFS 0 1 0 0 0 1 /end COMPU_METHOD
/begin MEASUREMENT MNT_P1401FLT "" UBYTE MC_MNT_P1401FLT 0 0 0 0 ECU_ADDRESS 0x3FAFC3 /end MEASUREMENT
/begin COMPU_METHOD MC_MNT_P1401FLT "MNT_P1401FLT conversion" RAT_FUNC "%3.0" "Unitless" COEFFS 0 1 0 0 0 1 /end COMPU_METHOD
/begin MEASUREMENT MNT_P1401FLT_CNT "" UWORD MC_MNT_P1401FLT_CNT 0 0 0 0 ECU_ADDRESS 0x3FAF80 /end MEASUREMENT
/begin COMPU_METHOD MC_MNT_P1401FLT_CNT "MNT_P1401FLT_CNT conversion" RAT_FUNC "%5.0" "Unitless" COEFFS 0 1 0 0 0 1 /end COMPU_METHOD
/begin CHARACTERISTIC MNT_P1401FLT_TM "" VALUE 0x5E6D8 SD_FLOAT32_IEEE 0 SC_MNT_P1401FLT_TM 0 20 /end CHARACTERISTIC
/begin COMPU_METHOD SC_MNT_P1401FLT_TM "MNT_P1401FLT_TM conversion" RAT_FUNC "%10.5" "unitless" COEFFS 0 1 0 0 0 1 /end COMPU_METHOD
/begin MEASUREMENT MNT_P1401FLT_TMR "" FLOAT32_IEEE MC_MNT_P1401FLT_TMR 0 0 0 0 ECU_ADDRESS 0x3FAE44 /end MEASUREMENT
/begin COMPU_METHOD MC_MNT_P1401FLT_TMR "MNT_P1401FLT_TMR conversion" RAT_FUNC "%10.5" "Unitless" COEFFS 0 1 0 0 0 1 /end COMPU_METHOD
/begin CHARACTERISTIC MNT_P1401TST_TM "" VALUE 0x5E6D4 SD_FLOAT32_IEEE 0 SC_MNT_P1401TST_TM 0 20 /end CHARACTERISTIC
/begin COMPU_METHOD SC_MNT_P1401TST_TM "MNT_P1401TST_TM conversion" RAT_FUNC "%10.5" "unitless" COEFFS 0 1 0 0 0 1 /end COMPU_METHOD
/begin MEASUREMENT MNT_P1412COMP "" UBYTE MC_MNT_P1412COMP 0 0 0 0 ECU_ADDRESS 0x3FAFC2 /end MEASUREMENT
/begin COMPU_METHOD MC_MNT_P1412COMP "MNT_P1412COMP conversion" RAT_FUNC "%3.0" "Unitless" COEFFS 0 1 0 0 0 1 /end COMPU_METHOD
/begin MEASUREMENT MNT_P1412FLT "" UBYTE MC_MNT_P1412FLT 0 0 0 0 ECU_ADDRESS 0x3FAFC1 /end MEASUREMENT
/begin COMPU_METHOD MC_MNT_P1412FLT "MNT_P1412FLT conversion" RAT_FUNC "%3.0" "Unitless" COEFFS 0 1 0 0 0 1 /end COMPU_METHOD
/begin MEASUREMENT MNT_P1412FLT_CNT "" UWORD MC_MNT_P1412FLT_CNT 0 0 0 0 ECU_ADDRESS 0x3FAF7E /end MEASUREMENT
/begin COMPU_METHOD MC_MNT_P1412FLT_CNT "MNT_P1412FLT_CNT conversion" RAT_FUNC "%5.0" "Unitless" COEFFS 0 1 0 0 0 1 /end COMPU_METHOD
/begin CHARACTERISTIC MNT_P1412FLT_TM "" VALUE 0x5E6D0 SD_FLOAT32_IEEE 0 SC_MNT_P1412FLT_TM 0 20 /end CHARACTERISTIC
/begin COMPU_METHOD SC_MNT_P1412FLT_TM "MNT_P1412FLT_TM conversion" RAT_FUNC "%10.5" "unitless" COEFFS 0 1 0 0 0 1 /end COMPU_METHOD
/begin MEASUREMENT MNT_P1412FLT_TMR "" FLOAT32_IEEE MC_MNT_P1412FLT_TMR 0 0 0 0 ECU_ADDRESS 0x3FAE40 /end MEASUREMENT
/begin COMPU_METHOD MC_MNT_P1412FLT_TMR "MNT_P1412FLT_TMR conversion" RAT_FUNC "%10.5" "Unitless" COEFFS 0 1 0 0 0 1 /end COMPU_METHOD
/begin MEASUREMENT MNT_P1412TST_CNT "" UWORD MC_MNT_P1412TST_CNT 0 0 0 0 ECU_ADDRESS 0x3FAF7C /end MEASUREMENT
/begin COMPU_METHOD MC_MNT_P1412TST_CNT "MNT_P1412TST_CNT conversion" RAT_FUNC "%5.0" "Unitless" COEFFS 0 1 0 0 0 1 /end COMPU_METHOD
/begin CHARACTERISTIC MNT_P1412TST_TM "" VALUE 0x5E6CC SD_FLOAT32_IEEE 0 SC_MNT_P1412TST_TM 0 20 /end CHARACTERISTIC
/begin COMPU_METHOD SC_MNT_P1412TST_TM "MNT_P1412TST_TM conversion" RAT_FUNC "%10.5" "unitless" COEFFS 0 1 0 0 0 1 /end COMPU_METHOD
/begin MEASUREMENT MNT_P1412TST_TMR "" FLOAT32_IEEE MC_MNT_P1412TST_TMR 0 0 0 0 ECU_ADDRESS 0x3FAE3C /end MEASUREMENT
/begin COMPU_METHOD MC_MNT_P1412TST_TMR "MNT_P1412TST_TMR conversion" RAT_FUNC "%10.5" "Unitless" COEFFS 0 1 0 0 0 1 /end COMPU_METHOD
/begin CHARACTERISTIC MNT_P_OS_FLT_TM "" VALUE 0x5E6C8 SD_FLOAT32_IEEE 0 SC_MNT_P_OS_FLT_TM 0 20 /end CHARACTERISTIC
/begin COMPU_METHOD SC_MNT_P_OS_FLT_TM "MNT_P_OS_FLT_TM conversion" RAT_FUNC "%10.5" "unitless" COEFFS 0 1 0 0 0 1 /end COMPU_METHOD
/begin MEASUREMENT MNT_P_OS_FLT_TMR "" FLOAT32_IEEE MC_MNT_P_OS_FLT_TMR 0 0 0 0 ECU_ADDRESS 0x3FAE38 /end MEASUREMENT
/begin COMPU_METHOD MC_MNT_P_OS_FLT_TMR "MNT_P_OS_FLT_TMR conversion" RAT_FUNC "%10.5" "Unitless" COEFFS 0 1 0 0 0 1 /end COMPU_METHOD
/begin CHARACTERISTIC MNT_P_OS_MAX "" VALUE 0x5E6C0 SD_FLOAT32_IEEE 0 SC_MNT_P_OS_MAX 0 30 /end CHARACTERISTIC
/begin COMPU_METHOD SC_MNT_P_OS_MAX "MNT_P_OS_MAX conversion" RAT_FUNC "%10.5" "unitless" COEFFS 0 1 0 0 0 1 /end COMPU_METHOD
/begin MEASUREMENT MNT_P_OS_TST_CNT "" UWORD MC_MNT_P_OS_TST_CNT 0 0 0 0 ECU_ADDRESS 0x3FAF78 /end MEASUREMENT
/begin COMPU_METHOD MC_MNT_P_OS_TST_CNT "MNT_P_OS_TST_CNT conversion" RAT_FUNC "%5.0" "Unitless" COEFFS 0 1 0 0 0 1 /end COMPU_METHOD
/begin CHARACTERISTIC MNT_P_OS_TST_TM "" VALUE 0x5E6C4 SD_FLOAT32_IEEE 0 SC_MNT_P_OS_TST_TM 0 20 /end CHARACTERISTIC
/begin COMPU_METHOD SC_MNT_P_OS_TST_TM "MNT_P_OS_TST_TM conversion" RAT_FUNC "%10.5" "unitless" COEFFS 0 1 0 0 0 1 /end COMPU_METHOD
/begin MEASUREMENT MNT_P_OS_TST_TMR "" FLOAT32_IEEE MC_MNT_P_OS_TST_TMR 0 0 0 0 ECU_ADDRESS 0x3FAE34 /end MEASUREMENT
/begin COMPU_METHOD MC_MNT_P_OS_TST_TMR "MNT_P_OS_TST_TMR conversion" RAT_FUNC "%10.5" "Unitless" COEFFS 0 1 0 0 0 1 /end COMPU_METHOD
/begin MEASUREMENT MNT_P_RATIO "" FLOAT32_IEEE MC_MNT_P_RATIO 0 0 0 0 ECU_ADDRESS 0x3FAEA0 /end MEASUREMENT
/begin COMPU_METHOD MC_MNT_P_RATIO "MNT_P_RATIO conversion" RAT_FUNC "%10.5" "Unitless" COEFFS 0 1 0 0 0 1 /end COMPU_METHOD
/begin CHARACTERISTIC MNT_SD_SPD_R "" VALUE 0x5E6BC SD_FLOAT32_IEEE 0 SC_MNT_SD_SPD_R 200 500 /end CHARACTERISTIC
/begin COMPU_METHOD SC_MNT_SD_SPD_R "MNT_SD_SPD_R conversion" RAT_FUNC "%10.5" "unitless" COEFFS 0 1 0 0 0 1 /end COMPU_METHOD
/begin MEASUREMENT MNT_SP_D_MF "" FLOAT32_IEEE MC_MNT_SP_D_MF 0 0 0 0 ECU_ADDRESS 0x3FAE30 /end MEASUREMENT
/begin COMPU_METHOD MC_MNT_SP_D_MF "MNT_SP_D_MF conversion" RAT_FUNC "%10.5" "Unitless" COEFFS 0 1 0 0 0 1 /end COMPU_METHOD
/begin MEASUREMENT MNT_T_EGR "" FLOAT32_IEEE MC_MNT_T_EGR 0 0 0 0 ECU_ADDRESS 0x3FAE2C /end MEASUREMENT
/begin COMPU_METHOD MC_MNT_T_EGR "MNT_T_EGR conversion" RAT_FUNC "%10.5" "Unitless" COEFFS 0 1 0 0 0 1 /end COMPU_METHOD
/begin CHARACTERISTIC MNT_VEFF_A "" VALUE 0x5E6B8 SD_FLOAT32_IEEE 0 SC_MNT_VEFF_A -10 10 /end CHARACTERISTIC
/begin COMPU_METHOD SC_MNT_VEFF_A "MNT_VEFF_A conversion" RAT_FUNC "%10.5" "unitless" COEFFS 0 1 0 0 0 1 /end COMPU_METHOD
/begin CHARACTERISTIC MNT_VEFF_B "" VALUE 0x5E6B4 SD_FLOAT32_IEEE 0 SC_MNT_VEFF_B -10 10 /end CHARACTERISTIC
/begin COMPU_METHOD SC_MNT_VEFF_B "MNT_VEFF_B conversion" RAT_FUNC "%10.5" "unitless" COEFFS 0 1 0 0 0 1 /end COMPU_METHOD
/begin CHARACTERISTIC MNT_VEFF_C "" VALUE 0x5E6B0 SD_FLOAT32_IEEE 0 SC_MNT_VEFF_C -10 10 /end CHARACTERISTIC
/begin COMPU_METHOD SC_MNT_VEFF_C "MNT_VEFF_C conversion" RAT_FUNC "%10.5" "unitless" COEFFS 0 1 0 0 0 1 /end COMPU_METHOD
/begin CHARACTERISTIC MNT_VEFF_D "" VALUE 0x5E6AC SD_FLOAT32_IEEE 0 SC_MNT_VEFF_D -10 10 /end CHARACTERISTIC
/begin COMPU_METHOD SC_MNT_VEFF_D "MNT_VEFF_D conversion" RAT_FUNC "%10.5" "unitless" COEFFS 0 1 0 0 0 1 /end COMPU_METHOD
/begin CHARACTERISTIC MNT_VEFF_E "" VALUE 0x5E6A8 SD_FLOAT32_IEEE 0 SC_MNT_VEFF_E -10 10 /end CHARACTERISTIC
/begin COMPU_METHOD SC_MNT_VEFF_E "MNT_VEFF_E conversion" RAT_FUNC "%10.5" "unitless" COEFFS 0 1 0 0 0 1 /end COMPU_METHOD
/begin MEASUREMENT MNT_VOL_EFF "" FLOAT32_IEEE MC_MNT_VOL_EFF 0 0 0 0 ECU_ADDRESS 0x3FAE28 /end MEASUREMENT
/begin COMPU_METHOD MC_MNT_VOL_EFF "MNT_VOL_EFF conversion" RAT_FUNC "%10.5" "Unitless" COEFFS 0 1 0 0 0 1 /end COMPU_METHOD
/begin CHARACTERISTIC MNT_VOL_EFF_LMN "" VALUE 0x5E6A4 SD_FLOAT32_IEEE 0 SC_MNT_VOL_EFF_LMN 0 10 /end CHARACTERISTIC
/begin COMPU_METHOD SC_MNT_VOL_EFF_LMN "MNT_VOL_EFF_LMN conversion" RAT_FUNC "%10.5" "unitless" COEFFS 0 1 0 0 0 1 /end COMPU_METHOD
/begin CHARACTERISTIC MNT_VOL_EFF_LMX "" VALUE 0x5E6A0 SD_FLOAT32_IEEE 0 SC_MNT_VOL_EFF_LMX 0 10 /end CHARACTERISTIC
/begin COMPU_METHOD SC_MNT_VOL_EFF_LMX "MNT_VOL_EFF_LMX conversion" RAT_FUNC "%10.5" "unitless" COEFFS 0 1 0 0 0 1 /end COMPU_METHOD
/begin CHARACTERISTIC MNT_VOL_EFF_SEL "" VALUE 0x5E869 SD_UBYTE 0 SC_MNT_VOL_EFF_SEL 0 255 /end CHARACTERISTIC
/begin COMPU_METHOD SC_MNT_VOL_EFF_SEL "MNT_VOL_EFF_SEL conversion" RAT_FUNC "%3.0" "unitless" COEFFS 0 1 0 0 0 1 /end COMPU_METHOD
/begin MEASUREMENT MODE "HOT MODE" UBYTE MC_MODE 0 0 0 0 ECU_ADDRESS 0x3FA8B5 /end MEASUREMENT
/begin COMPU_METHOD MC_MODE "MODE conversion" RAT_FUNC "%3.0" "Unitless" COEFFS 0 1 0 0 0 1 /end COMPU_METHOD
/begin CHARACTERISTIC MODE08MAP_1 "Bit mapped map indicating Mode 08 test ID supported (Top bit = test id 1, bottom bit = test id 8).  (Bit set = test enabled)." VALUE 0x5EFFB SD_UBYTE 0 SC_MODE08MAP_1 0 255 /end CHARACTERISTIC
/begin COMPU_METHOD SC_MODE08MAP_1 "MODE08MAP_1 conversion" RAT_FUNC "%3.0" "unitless" COEFFS 0 1 0 0 0 1 /end COMPU_METHOD
/begin CHARACTERISTIC MODE08MAP_2 "Bit mapped map indicating Mode 08 test ID supported (Top bit = test id 9, bottom bit = test id 16).  (Bit set = test enabled)." VALUE 0x5EFFA SD_UBYTE 0 SC_MODE08MAP_2 0 255 /end CHARACTERISTIC
/begin COMPU_METHOD SC_MODE08MAP_2 "MODE08MAP_2 conversion" RAT_FUNC "%3.0" "unitless" COEFFS 0 1 0 0 0 1 /end COMPU_METHOD
/begin CHARACTERISTIC MODE08MAP_3 "Bit mapped map indicating Mode 08 test ID supported (Top bit = test id 17, bottom bit = test id 24).  (Bit set = test enabled)." VALUE 0x5EFF9 SD_UBYTE 0 SC_MODE08MAP_3 0 255 /end CHARACTERISTIC
/begin COMPU_METHOD SC_MODE08MAP_3 "MODE08MAP_3 conversion" RAT_FUNC "%3.0" "unitless" COEFFS 0 1 0 0 0 1 /end COMPU_METHOD
/begin CHARACTERISTIC MODE08MAP_4 "Bit mapped map indicating Mode 08 test ID supported (Top bit = test id 25, bottom bit = test id 32).  (Bit set = test enabled)." VALUE 0x5EFF8 SD_UBYTE 0 SC_MODE08MAP_4 0 255 /end CHARACTERISTIC
/begin COMPU_METHOD SC_MODE08MAP_4 "MODE08MAP_4 conversion" RAT_FUNC "%3.0" "unitless" COEFFS 0 1 0 0 0 1 /end COMPU_METHOD
/begin MEASUREMENT MODE09_CTR "Counter indicating the message number of a multiple message response to a MODE09 request." UBYTE MC_MODE09_CTR 0 0 0 0 ECU_ADDRESS 0x3FB43E /end MEASUREMENT
/begin COMPU_METHOD MC_MODE09_CTR "MODE09_CTR conversion" RAT_FUNC "%3.0" "Unitless" COEFFS 0 1 0 0 0 1 /end COMPU_METHOD
/begin MEASUREMENT MODE8_DATA1 "Optional data byte sent via Mode 8" UBYTE MC_MODE8_DATA1 0 0 0 0 ECU_ADDRESS 0x3FB480 /end MEASUREMENT
/begin COMPU_METHOD MC_MODE8_DATA1 "MODE8_DATA1 conversion" RAT_FUNC "%3.0" "Unitless" COEFFS 0 1 0 0 0 1 /end COMPU_METHOD
/begin MEASUREMENT MODE8_DATA2 "Optional data byte sent via Mode 8" UBYTE MC_MODE8_DATA2 0 0 0 0 ECU_ADDRESS 0x3FB47F /end MEASUREMENT
/begin COMPU_METHOD MC_MODE8_DATA2 "MODE8_DATA2 conversion" RAT_FUNC "%3.0" "Unitless" COEFFS 0 1 0 0 0 1 /end COMPU_METHOD
/begin MEASUREMENT MODE8_DATA3 "Optional data byte sent via Mode 8" UBYTE MC_MODE8_DATA3 0 0 0 0 ECU_ADDRESS 0x3FB47E /end MEASUREMENT
/begin COMPU_METHOD MC_MODE8_DATA3 "MODE8_DATA3 conversion" RAT_FUNC "%3.0" "Unitless" COEFFS 0 1 0 0 0 1 /end COMPU_METHOD
/begin MEASUREMENT MODE8_DATA4 "Optional data byte sent via Mode 8" UBYTE MC_MODE8_DATA4 0 0 0 0 ECU_ADDRESS 0x3FB47D /end MEASUREMENT
/begin COMPU_METHOD MC_MODE8_DATA4 "MODE8_DATA4 conversion" RAT_FUNC "%3.0" "Unitless" COEFFS 0 1 0 0 0 1 /end COMPU_METHOD
/begin MEASUREMENT MODE8_DATA5 "Optional data byte sent via Mode 8" UBYTE MC_MODE8_DATA5 0 0 0 0 ECU_ADDRESS 0x3FB47C /end MEASUREMENT
/begin COMPU_METHOD MC_MODE8_DATA5 "MODE8_DATA5 conversion" RAT_FUNC "%3.0" "Unitless" COEFFS 0 1 0 0 0 1 /end COMPU_METHOD
/begin MEASUREMENT MODE8_TESTID "TEST ID FOR J1979 MODE 8" UBYTE MC_MODE8_TESTID 0 0 0 0 ECU_ADDRESS 0x3FB481 /end MEASUREMENT
/begin COMPU_METHOD MC_MODE8_TESTID "MODE8_TESTID conversion" RAT_FUNC "%3.0" "Unitless" COEFFS 0 1 0 0 0 1 /end COMPU_METHOD
/begin CHARACTERISTIC MPHERR_TMX "" VALUE 0x5DB7C SD_FLOAT32_IEEE 0 SC_MPHERR_TMX 0 60 /end CHARACTERISTIC
/begin COMPU_METHOD SC_MPHERR_TMX "MPHERR_TMX conversion" RAT_FUNC "%10.5" "s" COEFFS 0 1 0 0 0 1 /end COMPU_METHOD
/begin CHARACTERISTIC MPH_AC_LCH1 "Vehicle speed below which A/C cutout logic is active" VALUE 0x5CBCC SD_FLOAT32_IEEE 0 SC_MPH_AC_LCH1 0 127 /end CHARACTERISTIC
/begin COMPU_METHOD SC_MPH_AC_LCH1 "MPH_AC_LCH1 conversion" RAT_FUNC "%10.5" "MPH" COEFFS 0 1 0 0 0 1 /end COMPU_METHOD
/begin CHARACTERISTIC MPH_AC_LCH2 "Vehicle speed above which launch A/C cutout logic is deactivated" VALUE 0x5CBB8 SD_FLOAT32_IEEE 0 SC_MPH_AC_LCH2 0 127 /end CHARACTERISTIC
/begin COMPU_METHOD SC_MPH_AC_LCH2 "MPH_AC_LCH2 conversion" RAT_FUNC "%10.5" "MPH" COEFFS 0 1 0 0 0 1 /end COMPU_METHOD
/begin MEASUREMENT MPH_FILT "Filtered vehicle speed in miles per hour" FLOAT32_IEEE MC_MPH_FILT 0 0 0 0 ECU_ADDRESS 0x3FA038 /end MEASUREMENT
/begin COMPU_METHOD MC_MPH_FILT "MPH_FILT conversion" RAT_FUNC "%10.5" "Unitless" COEFFS 0 1 0 0 0 1 /end COMPU_METHOD
/begin CHARACTERISTIC MPH_FILT_LMX "Vehicle speeed limit calibration constant" VALUE 0x5D144 SD_FLOAT32_IEEE 0 SC_MPH_FILT_LMX 0 127 /end CHARACTERISTIC
/begin COMPU_METHOD SC_MPH_FILT_LMX "MPH_FILT_LMX conversion" RAT_FUNC "%10.5" "MPH" COEFFS 0 1 0 0 0 1 /end COMPU_METHOD
/begin CHARACTERISTIC MPH_FILT_TM "p0297malf timer limit" VALUE 0x5D140 SD_FLOAT32_IEEE 0 SC_MPH_FILT_TM 0 5000 /end CHARACTERISTIC
/begin COMPU_METHOD SC_MPH_FILT_TM "MPH_FILT_TM conversion" RAT_FUNC "%10.5" "unitless" COEFFS 0 1 0 0 0 1 /end COMPU_METHOD
/begin MEASUREMENT MPH_FILT_TMR "p0297malf timer." FLOAT32_IEEE MC_MPH_FILT_TMR 0 0 0 0 ECU_ADDRESS 0x3FA024 /end MEASUREMENT
/begin COMPU_METHOD MC_MPH_FILT_TMR "MPH_FILT_TMR conversion" RAT_FUNC "%10.5" "Unitless" COEFFS 0 1 0 0 0 1 /end COMPU_METHOD
/begin CHARACTERISTIC MPH_GOVBAIL "" VALUE 0x5DBB0 SD_FLOAT32_IEEE 0 SC_MPH_GOVBAIL 2 25 /end CHARACTERISTIC
/begin COMPU_METHOD SC_MPH_GOVBAIL "MPH_GOVBAIL conversion" RAT_FUNC "%10.5" "MPH" COEFFS 0 1 0 0 0 1 /end COMPU_METHOD
/begin CHARACTERISTIC MPH_INJ_OFF_LMT "vehicle speed limit for injector off test" VALUE 0x5CEE4 SD_FLOAT32_IEEE 0 SC_MPH_INJ_OFF_LMT 0 20 /end CHARACTERISTIC
/begin COMPU_METHOD SC_MPH_INJ_OFF_LMT "MPH_INJ_OFF_LMT conversion" RAT_FUNC "%10.5" "mi" COEFFS 0 1 0 0 0 1 /end COMPU_METHOD
/begin CHARACTERISTIC MPH_MAX_PTO "MAX pto vehicle speed in miles per hour" VALUE 0x5EA64 SD_FLOAT32_IEEE 0 SC_MPH_MAX_PTO 0 127 /end CHARACTERISTIC
/begin COMPU_METHOD SC_MPH_MAX_PTO "MPH_MAX_PTO conversion" RAT_FUNC "%10.5" "MPH" COEFFS 0 1 0 0 0 1 /end COMPU_METHOD
/begin MEASUREMENT MPH_VS "Vehicle speed in miles per hour (unfiltered)" FLOAT32_IEEE MC_MPH_VS 0 0 0 0 ECU_ADDRESS 0x3FA03C /end MEASUREMENT
/begin COMPU_METHOD MC_MPH_VS "MPH_VS conversion" RAT_FUNC "%10.5" "Unitless" COEFFS 0 1 0 0 0 1 /end COMPU_METHOD
/begin MEASUREMENT MSS_EGR "Misfire ""snap shot"" data, egr sensor input at the time of most recent misfire." FLOAT32_IEEE MC_MSS_EGR 0 0 0 0 ECU_ADDRESS 0x3FB2C0 /end MEASUREMENT
/begin COMPU_METHOD MC_MSS_EGR "MSS_EGR conversion" RAT_FUNC "%10.5" "Unitless" COEFFS 0 1 0 0 0 1 /end COMPU_METHOD
/begin MEASUREMENT MSS_LOAD "Misfire ""snap shot"" data, load at the time of most recent misfire." FLOAT32_IEEE MC_MSS_LOAD 0 0 0 0 ECU_ADDRESS 0x3FB2C8 /end MEASUREMENT
/begin COMPU_METHOD MC_MSS_LOAD "MSS_LOAD conversion" RAT_FUNC "%10.5" "Unitless" COEFFS 0 1 0 0 0 1 /end COMPU_METHOD
/begin MEASUREMENT MSS_N "Misfire ""snap shot"" data, rpm at the time of most recent misfire." FLOAT32_IEEE MC_MSS_N 0 0 0 0 ECU_ADDRESS 0x3FB2CC /end MEASUREMENT
/begin COMPU_METHOD MC_MSS_N "MSS_N conversion" RAT_FUNC "%10.5" "Unitless" COEFFS 0 1 0 0 0 1 /end COMPU_METHOD
/begin MEASUREMENT MSS_NDSFLG "Misfire snap shot data, saves value of ndsflg at time of first misfire." UBYTE MC_MSS_NDSFLG 0 0 0 0 ECU_ADDRESS 0x3FB2D4 /end MEASUREMENT
/begin COMPU_METHOD MC_MSS_NDSFLG "MSS_NDSFLG conversion" RAT_FUNC "%3.0" "Unitless" COEFFS 0 1 0 0 0 1 /end COMPU_METHOD
/begin MEASUREMENT MSS_POST_FLG "Misfire snap shot post trigger flag, set after the snap shot is complete." UBYTE MC_MSS_POST_FLG 0 0 0 0 ECU_ADDRESS 0x3FB2D3 /end MEASUREMENT
/begin COMPU_METHOD MC_MSS_POST_FLG "MSS_POST_FLG conversion" RAT_FUNC "%3.0" "Unitless" COEFFS 0 1 0 0 0 1 /end COMPU_METHOD
/begin MEASUREMENT MSS_PRET_FLG "Misfire snap shot pre trigger flag, set by the first misfire in a 200 block test to take snap shot of operating conditions." UBYTE MC_MSS_PRET_FLG 0 0 0 0 ECU_ADDRESS 0x3FB3DE /end MEASUREMENT
/begin COMPU_METHOD MC_MSS_PRET_FLG "MSS_PRET_FLG conversion" RAT_FUNC "%3.0" "Unitless" COEFFS 0 1 0 0 0 1 /end COMPU_METHOD
/begin MEASUREMENT MSS_TP "Misfire snap shot data, saves value of tp at time of first misfire in current 200 block test." FLOAT32_IEEE MC_MSS_TP 0 0 0 0 ECU_ADDRESS 0x3FB2BC /end MEASUREMENT
/begin COMPU_METHOD MC_MSS_TP "MSS_TP conversion" RAT_FUNC "%10.5" "Unitless" COEFFS 0 1 0 0 0 1 /end COMPU_METHOD
/begin MEASUREMENT MSS_VSBAR "Misfire ""snap shot"" data, vehicle speed at the time of most recent misfire." FLOAT32_IEEE MC_MSS_VSBAR 0 0 0 0 ECU_ADDRESS 0x3FB2C4 /end MEASUREMENT
/begin COMPU_METHOD MC_MSS_VSBAR "MSS_VSBAR conversion" RAT_FUNC "%10.5" "Unitless" COEFFS 0 1 0 0 0 1 /end COMPU_METHOD
/begin CHARACTERISTIC MULTI_CAL_EN "If set to zero any Multi-calibration information is automatically defaulted to a base calibration." VALUE 0x5EF8E SD_UBYTE 0 SC_MULTI_CAL_EN 0 1 /end CHARACTERISTIC
/begin COMPU_METHOD SC_MULTI_CAL_EN "MULTI_CAL_EN conversion" RAT_FUNC "%3.0" "Unitless" COEFFS 0 1 0 0 0 1 /end COMPU_METHOD
/begin CHARACTERISTIC MX_TSLVS_SPK "Maximum time since last VS spike for the noise counter to update" VALUE 0x5D950 SD_FLOAT32_IEEE 0 SC_MX_TSLVS_SPK 0 31.875 /end CHARACTERISTIC
/begin COMPU_METHOD SC_MX_TSLVS_SPK "MX_TSLVS_SPK conversion" RAT_FUNC "%10.5" "s" COEFFS 0 1 0 0 0 1 /end COMPU_METHOD
/begin MEASUREMENT N "Engine speed (RPM)." FLOAT32_IEEE MC_N 0 0 0 0 ECU_ADDRESS 0x3FA114 /end MEASUREMENT
/begin COMPU_METHOD MC_N "N conversion" RAT_FUNC "%10.5" "Unitless" COEFFS 0 1 0 0 0 1 /end COMPU_METHOD
/begin MEASUREMENT NACTMR "TIME AT P.T. OR WOT" FLOAT32_IEEE MC_NACTMR 0 0 0 0 ECU_ADDRESS 0x3FB5E0 /end MEASUREMENT
/begin COMPU_METHOD MC_NACTMR "NACTMR conversion" RAT_FUNC "%10.5" "Unitless" COEFFS 0 1 0 0 0 1 /end COMPU_METHOD
/begin MEASUREMENT NBAR "ROLL. AVG. RPM" FLOAT32_IEEE MC_NBAR 0 0 0 0 ECU_ADDRESS 0x3F9B24 /end MEASUREMENT
/begin COMPU_METHOD MC_NBAR "NBAR conversion" RAT_FUNC "%10.5" "Unitless" COEFFS 0 1 0 0 0 1 /end COMPU_METHOD
/begin MEASUREMENT NCOLDEBPG "Output of function fncoldebpg" FLOAT32_IEEE MC_NCOLDEBPG 0 0 0 0 ECU_ADDRESS 0x3FA6F4 /end MEASUREMENT
/begin COMPU_METHOD MC_NCOLDEBPG "NCOLDEBPG conversion" RAT_FUNC "%10.5" "Unitless" COEFFS 0 1 0 0 0 1 /end COMPU_METHOD
/begin MEASUREMENT NCOLDIDLE "Output from FNCOLDIDL" FLOAT32_IEEE MC_NCOLDIDLE 0 0 0 0 ECU_ADDRESS 0x3FA6F0 /end MEASUREMENT
/begin COMPU_METHOD MC_NCOLDIDLE "NCOLDIDLE conversion" RAT_FUNC "%10.5" "Unitless" COEFFS 0 1 0 0 0 1 /end COMPU_METHOD
/begin MEASUREMENT NCOLD_NLIDLE "Final 'COLD' idle term (RPM)" FLOAT32_IEEE MC_NCOLD_NLIDLE 0 0 0 0 ECU_ADDRESS 0x3FA6EC /end MEASUREMENT
/begin COMPU_METHOD MC_NCOLD_NLIDLE "NCOLD_NLIDLE conversion" RAT_FUNC "%10.5" "Unitless" COEFFS 0 1 0 0 0 1 /end COMPU_METHOD
/begin MEASUREMENT NCP_DES "Desired Engine speed (RPM) for CP." FLOAT32_IEEE MC_NCP_DES 0 0 0 0 ECU_ADDRESS 0x3FB178 /end MEASUREMENT
/begin COMPU_METHOD MC_NCP_DES "NCP_DES conversion" RAT_FUNC "%10.5" "Unitless" COEFFS 0 1 0 0 0 1 /end COMPU_METHOD
/begin CHARACTERISTIC NCRANK_THLD "" VALUE 0x5DD80 SD_FLOAT32_IEEE 0 SC_NCRANK_THLD 0 2000 /end CHARACTERISTIC
/begin COMPU_METHOD SC_NCRANK_THLD "NCRANK_THLD conversion" RAT_FUNC "%10.5" "RPM" COEFFS 0 1 0 0 0 1 /end COMPU_METHOD
/begin MEASUREMENT ND "Unfiltered engine speed derivative" FLOAT32_IEEE MC_ND 0 0 0 0 ECU_ADDRESS 0x3FA10C /end MEASUREMENT
/begin COMPU_METHOD MC_ND "ND conversion" RAT_FUNC "%10.5" "Unitless" COEFFS 0 1 0 0 0 1 /end COMPU_METHOD
/begin MEASUREMENT NDES "Desired Engine speed (RPM)" FLOAT32_IEEE MC_NDES 0 0 0 0 ECU_ADDRESS 0x3FA6CC /end MEASUREMENT
/begin COMPU_METHOD MC_NDES "NDES conversion" RAT_FUNC "%10.5" "Unitless" COEFFS 0 1 0 0 0 1 /end COMPU_METHOD
/begin CHARACTERISTIC NDES_OSC_CHANNEL "IOC channel assignment" VALUE 0x5DA18 SD_UBYTE 0 SC_NDES_OSC_CHANNEL 0 255 /end CHARACTERISTIC
/begin COMPU_METHOD SC_NDES_OSC_CHANNEL "NDES_OSC_CHANNEL conversion" RAT_FUNC "%3.0" "unitless" COEFFS 0 1 0 0 0 1 /end COMPU_METHOD
/begin MEASUREMENT NDES_SLIDE_BAR "IO Control desired engine speed, in RPM" FLOAT32_IEEE MC_NDES_SLIDE_BAR 0 0 0 0 ECU_ADDRESS 0x3FA6E8 /end MEASUREMENT
/begin COMPU_METHOD MC_NDES_SLIDE_BAR "NDES_SLIDE_BAR conversion" RAT_FUNC "%10.5" "Unitless" COEFFS 0 1 0 0 0 1 /end COMPU_METHOD
/begin MEASUREMENT NDSFLG "NEUTRAL/DRIVE flag; 1 -> drive." UBYTE MC_NDSFLG 0 0 0 0 ECU_ADDRESS 0x3FA2B8 /end MEASUREMENT
/begin COMPU_METHOD MC_NDSFLG "NDSFLG conversion" RAT_FUNC "%3.0" "Unitless" COEFFS 0 1 0 0 0 1 /end COMPU_METHOD
/begin MEASUREMENT ND_FF_TMRCTL "Governor 'FF' term for N/D timer flag (1=count)" UBYTE MC_ND_FF_TMRCTL 0 0 0 0 ECU_ADDRESS 0x3FA7BA /end MEASUREMENT
/begin COMPU_METHOD MC_ND_FF_TMRCTL "ND_FF_TMRCTL conversion" RAT_FUNC "%3.0" "Unitless" COEFFS 0 1 0 0 0 1 /end COMPU_METHOD
/begin MEASUREMENT NERR "Engine speed error (RPM)." FLOAT32_IEEE MC_NERR 0 0 0 0 ECU_ADDRESS 0x3FA754 /end MEASUREMENT
/begin COMPU_METHOD MC_NERR "NERR conversion" RAT_FUNC "%10.5" "Unitless" COEFFS 0 1 0 0 0 1 /end COMPU_METHOD
/begin CHARACTERISTIC NERR_GOVTM "" VALUE 0x5DB80 SD_FLOAT32_IEEE 0 SC_NERR_GOVTM 0 60 /end CHARACTERISTIC
/begin COMPU_METHOD SC_NERR_GOVTM "NERR_GOVTM conversion" RAT_FUNC "%10.5" "s" COEFFS 0 1 0 0 0 1 /end COMPU_METHOD
/begin MEASUREMENT NERR_GOVTMR "" FLOAT32_IEEE MC_NERR_GOVTMR 0 0 0 0 ECU_ADDRESS 0x3FA714 /end MEASUREMENT
/begin COMPU_METHOD MC_NERR_GOVTMR "NERR_GOVTMR conversion" RAT_FUNC "%10.5" "Unitless" COEFFS 0 1 0 0 0 1 /end COMPU_METHOD
/begin CHARACTERISTIC NERR_RPM1 "Nerr value to control gov. global fuel variable." VALUE 0x5DBC4 SD_FLOAT32_IEEE 0 SC_NERR_RPM1 -3000 1000 /end CHARACTERISTIC
/begin COMPU_METHOD SC_NERR_RPM1 "NERR_RPM1 conversion" RAT_FUNC "%10.5" "RPM" COEFFS 0 1 0 0 0 1 /end COMPU_METHOD
/begin CHARACTERISTIC NERR_RPM2 "Nerr value to control gov. global fuel variable." VALUE 0x5DBC0 SD_FLOAT32_IEEE 0 SC_NERR_RPM2 -3000 1000 /end CHARACTERISTIC
/begin COMPU_METHOD SC_NERR_RPM2 "NERR_RPM2 conversion" RAT_FUNC "%10.5" "RPM" COEFFS 0 1 0 0 0 1 /end COMPU_METHOD
/begin CHARACTERISTIC NERR_RPM3 "Nerr value to control gov. global fuel variable." VALUE 0x5DBBC SD_FLOAT32_IEEE 0 SC_NERR_RPM3 -3000 1000 /end CHARACTERISTIC
/begin COMPU_METHOD SC_NERR_RPM3 "NERR_RPM3 conversion" RAT_FUNC "%10.5" "RPM" COEFFS 0 1 0 0 0 1 /end COMPU_METHOD
/begin CHARACTERISTIC NERR_RPM4 "Nerr value to control gov. global fuel variable." VALUE 0x5DBB8 SD_FLOAT32_IEEE 0 SC_NERR_RPM4 -3000 1000 /end CHARACTERISTIC
/begin COMPU_METHOD SC_NERR_RPM4 "NERR_RPM4 conversion" RAT_FUNC "%10.5" "RPM" COEFFS 0 1 0 0 0 1 /end COMPU_METHOD
/begin MEASUREMENT NEW_CF_DATA "indicates to bg profile logic that fg has updated data array since last bg" UBYTE MC_NEW_CF_DATA 0 0 0 0 ECU_ADDRESS 0x3FB338 /end MEASUREMENT
/begin COMPU_METHOD MC_NEW_CF_DATA "NEW_CF_DATA conversion" RAT_FUNC "%3.0" "Unitless" COEFFS 0 1 0 0 0 1 /end COMPU_METHOD
/begin CHARACTERISTIC NE_CSTDWN "Engine speed above which the coast down inferred vheicle motion load check will be enabled" VALUE 0x5D908 SD_FLOAT32_IEEE 0 SC_NE_CSTDWN 0 6000 /end CHARACTERISTIC
/begin COMPU_METHOD SC_NE_CSTDWN "NE_CSTDWN conversion" RAT_FUNC "%10.5" "RPM" COEFFS 0 1 0 0 0 1 /end COMPU_METHOD
/begin CHARACTERISTIC NE_VMOV_MAX "Maximum engine speed at which vehicle motion will be inferred" VALUE 0x5D8C4 SD_FLOAT32_IEEE 0 SC_NE_VMOV_MAX 0 16383.8 /end CHARACTERISTIC
/begin COMPU_METHOD SC_NE_VMOV_MAX "NE_VMOV_MAX conversion" RAT_FUNC "%10.5" "RPM" COEFFS 0 1 0 0 0 1 /end COMPU_METHOD
/begin MEASUREMENT NFMFLG "Engine speed calculation failure" UBYTE MC_NFMFLG 0 0 0 0 ECU_ADDRESS 0x3FA2B9 /end MEASUREMENT
/begin COMPU_METHOD MC_NFMFLG "NFMFLG conversion" RAT_FUNC "%3.0" "Unitless" COEFFS 0 1 0 0 0 1 /end COMPU_METHOD
/begin MEASUREMENT NG_ACTIVE "Signal which is used to disable monitors affected by NG fuel." UBYTE MC_NG_ACTIVE 0 0 0 0 ECU_ADDRESS 0x3F9E35 /end MEASUREMENT
/begin COMPU_METHOD MC_NG_ACTIVE "NG_ACTIVE conversion" RAT_FUNC "%3.0" "Unitless" COEFFS 0 1 0 0 0 1 /end COMPU_METHOD
/begin CHARACTERISTIC NG_TST_SW "Mapped byte of sys_NG_SW flag bits in the order(0..7): {cat,ccm,purg,sair,fuel,ego,egr,mis}." VALUE 0x5CE31 SD_UBYTE 0 SC_NG_TST_SW 0 255 /end CHARACTERISTIC
/begin COMPU_METHOD SC_NG_TST_SW "NG_TST_SW conversion" RAT_FUNC "%3.0" "MAPPED_BYTE" COEFFS 0 1 0 0 0 1 /end COMPU_METHOD
/begin MEASUREMENT NHIDLE "High idle engine speed (RPM)" FLOAT32_IEEE MC_NHIDLE 0 0 0 0 ECU_ADDRESS 0x3FA6D8 /end MEASUREMENT
/begin COMPU_METHOD MC_NHIDLE "NHIDLE conversion" RAT_FUNC "%10.5" "Unitless" COEFFS 0 1 0 0 0 1 /end COMPU_METHOD
/begin CHARACTERISTIC NIDES_LMX "Desired Engine speed max limit (RPM)" VALUE 0x5DA00 SD_FLOAT32_IEEE 0 SC_NIDES_LMX 3000 4000 /end CHARACTERISTIC
/begin COMPU_METHOD SC_NIDES_LMX "NIDES_LMX conversion" RAT_FUNC "%10.5" "RPM" COEFFS 0 1 0 0 0 1 /end COMPU_METHOD
/begin MEASUREMENT NIDLE_MIN_TRANS_N "" FLOAT32_IEEE MC_NIDLE_MIN_TRANS_N 0 0 0 0 ECU_ADDRESS 0x3FA6BC /end MEASUREMENT
/begin COMPU_METHOD MC_NIDLE_MIN_TRANS_N "NIDLE_MIN_TRANS_N conversion" RAT_FUNC "%10.5" "Unitless" COEFFS 0 1 0 0 0 1 /end COMPU_METHOD
/begin MEASUREMENT NIDLE_SETPNT "Cold idle kicker limit for desired engine speed" FLOAT32_IEEE MC_NIDLE_SETPNT 0 0 0 0 ECU_ADDRESS 0x3FA6C4 /end MEASUREMENT
/begin COMPU_METHOD MC_NIDLE_SETPNT "NIDLE_SETPNT conversion" RAT_FUNC "%10.5" "Unitless" COEFFS 0 1 0 0 0 1 /end COMPU_METHOD
/begin MEASUREMENT NIDLE_TOT_MIN "Transmission Fluid Temp. based idle setpoint" FLOAT32_IEEE MC_NIDLE_TOT_MIN 0 0 0 0 ECU_ADDRESS 0x3FA6E4 /end MEASUREMENT
/begin COMPU_METHOD MC_NIDLE_TOT_MIN "NIDLE_TOT_MIN conversion" RAT_FUNC "%10.5" "Unitless" COEFFS 0 1 0 0 0 1 /end COMPU_METHOD
/begin CHARACTERISTIC NIDLE_TRANS_FAULT_N "" VALUE 0x5D9F4 SD_FLOAT32_IEEE 0 SC_NIDLE_TRANS_FAULT_N 0 16383.8 /end CHARACTERISTIC
/begin COMPU_METHOD SC_NIDLE_TRANS_FAULT_N "NIDLE_TRANS_FAULT_N conversion" RAT_FUNC "%10.5" "RPM" COEFFS 0 1 0 0 0 1 /end COMPU_METHOD
/begin MEASUREMENT NLIDLE "Desired idle speed (rpm)" FLOAT32_IEEE MC_NLIDLE 0 0 0 0 ECU_ADDRESS 0x3FA6DC /end MEASUREMENT
/begin COMPU_METHOD MC_NLIDLE "NLIDLE conversion" RAT_FUNC "%10.5" "Unitless" COEFFS 0 1 0 0 0 1 /end COMPU_METHOD
/begin MEASUREMENT NLIDLE_HICAM "High-cam setpoint for idle speed" FLOAT32_IEEE MC_NLIDLE_HICAM 0 0 0 0 ECU_ADDRESS 0x3FA6E0 /end MEASUREMENT
/begin COMPU_METHOD MC_NLIDLE_HICAM "NLIDLE_HICAM conversion" RAT_FUNC "%10.5" "Unitless" COEFFS 0 1 0 0 0 1 /end COMPU_METHOD
/begin CHARACTERISTIC NLIDLE_SPD "Low idle engine speed" VALUE 0x5D254 SD_FLOAT32_IEEE 0 SC_NLIDLE_SPD 0 6000 /end CHARACTERISTIC
/begin COMPU_METHOD SC_NLIDLE_SPD "NLIDLE_SPD conversion" RAT_FUNC "%10.5" "RPM" COEFFS 0 1 0 0 0 1 /end COMPU_METHOD
/begin MEASUREMENT NLIMPH "Vehicle speed based idle setpoint" FLOAT32_IEEE MC_NLIMPH 0 0 0 0 ECU_ADDRESS 0x3FA6D4 /end MEASUREMENT
/begin COMPU_METHOD MC_NLIMPH "NLIMPH conversion" RAT_FUNC "%10.5" "Unitless" COEFFS 0 1 0 0 0 1 /end COMPU_METHOD
/begin CHARACTERISTIC NLIMPH_MAX "Vehicle speed based idle setpoint - max RPM" VALUE 0x5D9FC SD_FLOAT32_IEEE 0 SC_NLIMPH_MAX 0 4000 /end CHARACTERISTIC
/begin COMPU_METHOD SC_NLIMPH_MAX "NLIMPH_MAX conversion" RAT_FUNC "%10.5" "RPM" COEFFS 0 1 0 0 0 1 /end COMPU_METHOD
/begin MEASUREMENT NLINOBART "Output of fn_nlinobart table." FLOAT32_IEEE MC_NLINOBART 0 0 0 0 ECU_ADDRESS 0x3FA6B8 /end MEASUREMENT
/begin COMPU_METHOD MC_NLINOBART "NLINOBART conversion" RAT_FUNC "%10.5" "Unitless" COEFFS 0 1 0 0 0 1 /end COMPU_METHOD
/begin CHARACTERISTIC NLINOBART_MAX "Engine speed setpoint - max RPM" VALUE 0x5D97C SD_FLOAT32_IEEE 0 SC_NLINOBART_MAX 0 4000 /end CHARACTERISTIC
/begin COMPU_METHOD SC_NLINOBART_MAX "NLINOBART_MAX conversion" RAT_FUNC "%10.5" "RPM" COEFFS 0 1 0 0 0 1 /end COMPU_METHOD
/begin CHARACTERISTIC NLI_MPHMIN "Vehicle speed based idle setpoint - minimum speed" VALUE 0x5D9F8 SD_FLOAT32_IEEE 0 SC_NLI_MPHMIN 0 180 /end CHARACTERISTIC
/begin COMPU_METHOD SC_NLI_MPHMIN "NLI_MPHMIN conversion" RAT_FUNC "%10.5" "MPH" COEFFS 0 1 0 0 0 1 /end COMPU_METHOD
/begin CHARACTERISTIC NLI_NOBARTMIN "Filtered Output Shaft Speed in RPM limit for engine speed setpoint logic." VALUE 0x5D978 SD_FLOAT32_IEEE 0 SC_NLI_NOBARTMIN 0 16383.8 /end CHARACTERISTIC
/begin COMPU_METHOD SC_NLI_NOBARTMIN "NLI_NOBARTMIN conversion" RAT_FUNC "%10.5" "RPM" COEFFS 0 1 0 0 0 1 /end COMPU_METHOD
/begin MEASUREMENT NLMX "Max engine speed for upshift (RPM)" FLOAT32_IEEE MC_NLMX 0 0 0 0 ECU_ADDRESS 0x3FA6D0 /end MEASUREMENT
/begin COMPU_METHOD MC_NLMX "NLMX conversion" RAT_FUNC "%10.5" "Unitless" COEFFS 0 1 0 0 0 1 /end COMPU_METHOD
/begin CHARACTERISTIC NMAX "Maximum engine speed in RPM" VALUE 0x5D988 SD_FLOAT32_IEEE 0 SC_NMAX 2600 8000 /end CHARACTERISTIC
/begin COMPU_METHOD SC_NMAX "NMAX conversion" RAT_FUNC "%10.5" "RPM" COEFFS 0 1 0 0 0 1 /end COMPU_METHOD
/begin CHARACTERISTIC NMAX_DIAG "Maximum engine speed in RPM for diagnostics" VALUE 0x5D250 SD_FLOAT32_IEEE 0 SC_NMAX_DIAG 2600 8000 /end CHARACTERISTIC
/begin COMPU_METHOD SC_NMAX_DIAG "NMAX_DIAG conversion" RAT_FUNC "%10.5" "RPM" COEFFS 0 1 0 0 0 1 /end COMPU_METHOD
/begin CHARACTERISTIC NMAX_F_TM "Engine overspeed malf timer" VALUE 0x5D248 SD_FLOAT32_IEEE 0 SC_NMAX_F_TM 0 512 /end CHARACTERISTIC
/begin COMPU_METHOD SC_NMAX_F_TM "NMAX_F_TM conversion" RAT_FUNC "%10.5" "s" COEFFS 0 1 0 0 0 1 /end COMPU_METHOD
/begin MEASUREMENT NMAX_F_TMR "Engine overspeed malf timer" FLOAT32_IEEE MC_NMAX_F_TMR 0 0 0 0 ECU_ADDRESS 0x3FA100 /end MEASUREMENT
/begin COMPU_METHOD MC_NMAX_F_TMR "NMAX_F_TMR conversion" RAT_FUNC "%10.5" "Unitless" COEFFS 0 1 0 0 0 1 /end COMPU_METHOD
/begin CHARACTERISTIC NMAX_P_TM "Engine overspeed update timer" VALUE 0x5D24C SD_FLOAT32_IEEE 0 SC_NMAX_P_TM 0 512 /end CHARACTERISTIC
/begin COMPU_METHOD SC_NMAX_P_TM "NMAX_P_TM conversion" RAT_FUNC "%10.5" "s" COEFFS 0 1 0 0 0 1 /end COMPU_METHOD
/begin MEASUREMENT NMAX_P_TMR "Engine overspeed update timer" FLOAT32_IEEE MC_NMAX_P_TMR 0 0 0 0 ECU_ADDRESS 0x3FA104 /end MEASUREMENT
/begin COMPU_METHOD MC_NMAX_P_TMR "NMAX_P_TMR conversion" RAT_FUNC "%10.5" "Unitless" COEFFS 0 1 0 0 0 1 /end COMPU_METHOD
/begin MEASUREMENT NOBART "Filtered Output Shaft Speed in RPM" FLOAT32_IEEE MC_NOBART 0 0 0 0 ECU_ADDRESS 0x3FB71C /end MEASUREMENT
/begin COMPU_METHOD MC_NOBART "NOBART conversion" RAT_FUNC "%10.5" "Unitless" COEFFS 0 1 0 0 0 1 /end COMPU_METHOD
/begin MEASUREMENT NOCALLBGTOBG "Total cylinder events not tested by Misfire in between bg passes." UBYTE MC_NOCALLBGTOBG 0 0 0 0 ECU_ADDRESS 0x3FB3A9 /end MEASUREMENT
/begin COMPU_METHOD MC_NOCALLBGTOBG "NOCALLBGTOBG conversion" RAT_FUNC "%3.0" "Unitless" COEFFS 0 1 0 0 0 1 /end COMPU_METHOD
/begin MEASUREMENT NOISE_COUNT "when non-zero no assessment of misfire due to signal noise" UBYTE MC_NOISE_COUNT 0 0 0 0 ECU_ADDRESS 0x3FB359 /end MEASUREMENT
/begin COMPU_METHOD MC_NOISE_COUNT "NOISE_COUNT conversion" RAT_FUNC "%3.0" "Unitless" COEFFS 0 1 0 0 0 1 /end COMPU_METHOD
/begin CHARACTERISTIC NOISE_LOCK "Multiplier for misfire noise threshold when the torque convertor is locked." VALUE 0x5EE10 SD_FLOAT32_IEEE 0 SC_NOISE_LOCK 0 1.99997 /end CHARACTERISTIC
/begin COMPU_METHOD SC_NOISE_LOCK "NOISE_LOCK conversion" RAT_FUNC "%10.5" "unitless" COEFFS 0 1 0 0 0 1 /end COMPU_METHOD
/begin MEASUREMENT NOISE_MULT "Misfire noise threshold multiplier (percentage of daccel_hght)." FLOAT32_IEEE MC_NOISE_MULT 0 0 0 0 ECU_ADDRESS 0x3FB360 /end MEASUREMENT
/begin COMPU_METHOD MC_NOISE_MULT "NOISE_MULT conversion" RAT_FUNC "%10.5" "Unitless" COEFFS 0 1 0 0 0 1 /end COMPU_METHOD
/begin MEASUREMENT NORM_FN011DS "" FLOAT32_IEEE MC_NORM_FN011DS 0 0 0 0 ECU_ADDRESS 0x3FA9E0 /end MEASUREMENT
/begin COMPU_METHOD MC_NORM_FN011DS "NORM_FN011DS conversion" RAT_FUNC "%10.5" "Unitless" COEFFS 0 1 0 0 0 1 /end COMPU_METHOD
/begin MEASUREMENT NORM_FN011P "" FLOAT32_IEEE MC_NORM_FN011P 0 0 0 0 ECU_ADDRESS 0x3FA9DC /end MEASUREMENT
/begin COMPU_METHOD MC_NORM_FN011P "NORM_FN011P conversion" RAT_FUNC "%10.5" "Unitless" COEFFS 0 1 0 0 0 1 /end COMPU_METHOD
/begin MEASUREMENT NORM_FN012 "" FLOAT32_IEEE MC_NORM_FN012 0 0 0 0 ECU_ADDRESS 0x3FA878 /end MEASUREMENT
/begin COMPU_METHOD MC_NORM_FN012 "NORM_FN012 conversion" RAT_FUNC "%10.5" "Unitless" COEFFS 0 1 0 0 0 1 /end COMPU_METHOD
/begin MEASUREMENT NORM_FN012P "" FLOAT32_IEEE MC_NORM_FN012P 0 0 0 0 ECU_ADDRESS 0x3FA874 /end MEASUREMENT
/begin COMPU_METHOD MC_NORM_FN012P "NORM_FN012P conversion" RAT_FUNC "%10.5" "Unitless" COEFFS 0 1 0 0 0 1 /end COMPU_METHOD
/begin MEASUREMENT NORM_FN013 "" FLOAT32_IEEE MC_NORM_FN013 0 0 0 0 ECU_ADDRESS 0x3FA98C /end MEASUREMENT
/begin COMPU_METHOD MC_NORM_FN013 "NORM_FN013 conversion" RAT_FUNC "%10.5" "Unitless" COEFFS 0 1 0 0 0 1 /end COMPU_METHOD
/begin MEASUREMENT NORM_FN014 "Normalized fn014 value" FLOAT32_IEEE MC_NORM_FN014 0 0 0 0 ECU_ADDRESS 0x3FA890 /end MEASUREMENT
/begin COMPU_METHOD MC_NORM_FN014 "NORM_FN014 conversion" RAT_FUNC "%10.5" "Unitless" COEFFS 0 1 0 0 0 1 /end COMPU_METHOD
/begin MEASUREMENT NORM_FN014P "Normalized fn014p value" FLOAT32_IEEE MC_NORM_FN014P 0 0 0 0 ECU_ADDRESS 0x3FA88C /end MEASUREMENT
/begin COMPU_METHOD MC_NORM_FN014P "NORM_FN014P conversion" RAT_FUNC "%10.5" "Unitless" COEFFS 0 1 0 0 0 1 /end COMPU_METHOD
/begin MEASUREMENT NORM_FN019 "" FLOAT32_IEEE MC_NORM_FN019 0 0 0 0 ECU_ADDRESS 0x3FA994 /end MEASUREMENT
/begin COMPU_METHOD MC_NORM_FN019 "NORM_FN019 conversion" RAT_FUNC "%10.5" "Unitless" COEFFS 0 1 0 0 0 1 /end COMPU_METHOD
/begin MEASUREMENT NORM_FN019_A "" FLOAT32_IEEE MC_NORM_FN019_A 0 0 0 0 ECU_ADDRESS 0x3FA990 /end MEASUREMENT
/begin COMPU_METHOD MC_NORM_FN019_A "NORM_FN019_A conversion" RAT_FUNC "%10.5" "Unitless" COEFFS 0 1 0 0 0 1 /end COMPU_METHOD
/begin MEASUREMENT NORM_FN021 "Normalized fn021 value" FLOAT32_IEEE MC_NORM_FN021 0 0 0 0 ECU_ADDRESS 0x3FA744 /end MEASUREMENT
/begin COMPU_METHOD MC_NORM_FN021 "NORM_FN021 conversion" RAT_FUNC "%10.5" "Unitless" COEFFS 0 1 0 0 0 1 /end COMPU_METHOD
/begin MEASUREMENT NORM_FN021P "Normalized fn021p value" FLOAT32_IEEE MC_NORM_FN021P 0 0 0 0 ECU_ADDRESS 0x3FA74C /end MEASUREMENT
/begin COMPU_METHOD MC_NORM_FN021P "NORM_FN021P conversion" RAT_FUNC "%10.5" "Unitless" COEFFS 0 1 0 0 0 1 /end COMPU_METHOD
/begin MEASUREMENT NORM_FN030 "" FLOAT32_IEEE MC_NORM_FN030 0 0 0 0 ECU_ADDRESS 0x3FA870 /end MEASUREMENT
/begin COMPU_METHOD MC_NORM_FN030 "NORM_FN030 conversion" RAT_FUNC "%10.5" "Unitless" COEFFS 0 1 0 0 0 1 /end COMPU_METHOD
/begin MEASUREMENT NORM_FN030P "" FLOAT32_IEEE MC_NORM_FN030P 0 0 0 0 ECU_ADDRESS 0x3FA86C /end MEASUREMENT
/begin COMPU_METHOD MC_NORM_FN030P "NORM_FN030P conversion" RAT_FUNC "%10.5" "Unitless" COEFFS 0 1 0 0 0 1 /end COMPU_METHOD
/begin MEASUREMENT NORM_FN031DS "" FLOAT32_IEEE MC_NORM_FN031DS 0 0 0 0 ECU_ADDRESS 0x3FA9D8 /end MEASUREMENT
/begin COMPU_METHOD MC_NORM_FN031DS "NORM_FN031DS conversion" RAT_FUNC "%10.5" "Unitless" COEFFS 0 1 0 0 0 1 /end COMPU_METHOD
/begin MEASUREMENT NORM_FN031P "" FLOAT32_IEEE MC_NORM_FN031P 0 0 0 0 ECU_ADDRESS 0x3FA9D4 /end MEASUREMENT
/begin COMPU_METHOD MC_NORM_FN031P "NORM_FN031P conversion" RAT_FUNC "%10.5" "Unitless" COEFFS 0 1 0 0 0 1 /end COMPU_METHOD
/begin MEASUREMENT NORM_FN032 "" FLOAT32_IEEE MC_NORM_FN032 0 0 0 0 ECU_ADDRESS 0x3FA96C /end MEASUREMENT
/begin COMPU_METHOD MC_NORM_FN032 "NORM_FN032 conversion" RAT_FUNC "%10.5" "Unitless" COEFFS 0 1 0 0 0 1 /end COMPU_METHOD
/begin MEASUREMENT NORM_FN033 "" FLOAT32_IEEE MC_NORM_FN033 0 0 0 0 ECU_ADDRESS 0x3FA970 /end MEASUREMENT
/begin COMPU_METHOD MC_NORM_FN033 "NORM_FN033 conversion" RAT_FUNC "%10.5" "Unitless" COEFFS 0 1 0 0 0 1 /end COMPU_METHOD
/begin MEASUREMENT NORM_FN035 "Normalized fn035 value" FLOAT32_IEEE MC_NORM_FN035 0 0 0 0 ECU_ADDRESS 0x3FA748 /end MEASUREMENT
/begin COMPU_METHOD MC_NORM_FN035 "NORM_FN035 conversion" RAT_FUNC "%10.5" "Unitless" COEFFS 0 1 0 0 0 1 /end COMPU_METHOD
/begin MEASUREMENT NORM_FN035P "Normalized fn035p value" FLOAT32_IEEE MC_NORM_FN035P 0 0 0 0 ECU_ADDRESS 0x3FA750 /end MEASUREMENT
/begin COMPU_METHOD MC_NORM_FN035P "NORM_FN035P conversion" RAT_FUNC "%10.5" "Unitless" COEFFS 0 1 0 0 0 1 /end COMPU_METHOD
/begin MEASUREMENT NORM_FN040 "" FLOAT32_IEEE MC_NORM_FN040 0 0 0 0 ECU_ADDRESS 0x3FA9D0 /end MEASUREMENT
/begin COMPU_METHOD MC_NORM_FN040 "NORM_FN040 conversion" RAT_FUNC "%10.5" "Unitless" COEFFS 0 1 0 0 0 1 /end COMPU_METHOD
/begin MEASUREMENT NORM_FN041 "" FLOAT32_IEEE MC_NORM_FN041 0 0 0 0 ECU_ADDRESS 0x3FA9CC /end MEASUREMENT
/begin COMPU_METHOD MC_NORM_FN041 "NORM_FN041 conversion" RAT_FUNC "%10.5" "Unitless" COEFFS 0 1 0 0 0 1 /end COMPU_METHOD
/begin MEASUREMENT NORM_FN052 "Normalized fn052 value" FLOAT32_IEEE MC_NORM_FN052 0 0 0 0 ECU_ADDRESS 0x3FA7C8 /end MEASUREMENT
/begin COMPU_METHOD MC_NORM_FN052 "NORM_FN052 conversion" RAT_FUNC "%10.5" "Unitless" COEFFS 0 1 0 0 0 1 /end COMPU_METHOD
/begin MEASUREMENT NORM_FN053 "Normalized fn053 value" FLOAT32_IEEE MC_NORM_FN053 0 0 0 0 ECU_ADDRESS 0x3FA7CC /end MEASUREMENT
/begin COMPU_METHOD MC_NORM_FN053 "NORM_FN053 conversion" RAT_FUNC "%10.5" "Unitless" COEFFS 0 1 0 0 0 1 /end COMPU_METHOD
/begin MEASUREMENT NORM_FN055 "" FLOAT32_IEEE MC_NORM_FN055 0 0 0 0 ECU_ADDRESS 0x3FA988 /end MEASUREMENT
/begin COMPU_METHOD MC_NORM_FN055 "NORM_FN055 conversion" RAT_FUNC "%10.5" "Unitless" COEFFS 0 1 0 0 0 1 /end COMPU_METHOD
/begin MEASUREMENT NORM_FN055DS "" FLOAT32_IEEE MC_NORM_FN055DS 0 0 0 0 ECU_ADDRESS 0x3FA9C8 /end MEASUREMENT
/begin COMPU_METHOD MC_NORM_FN055DS "NORM_FN055DS conversion" RAT_FUNC "%10.5" "Unitless" COEFFS 0 1 0 0 0 1 /end COMPU_METHOD
/begin MEASUREMENT NORM_FN056 "" FLOAT32_IEEE MC_NORM_FN056 0 0 0 0 ECU_ADDRESS 0x3FA984 /end MEASUREMENT
/begin COMPU_METHOD MC_NORM_FN056 "NORM_FN056 conversion" RAT_FUNC "%10.5" "Unitless" COEFFS 0 1 0 0 0 1 /end COMPU_METHOD
/begin MEASUREMENT NORM_FN056DS "" FLOAT32_IEEE MC_NORM_FN056DS 0 0 0 0 ECU_ADDRESS 0x3FA9C4 /end MEASUREMENT
/begin COMPU_METHOD MC_NORM_FN056DS "NORM_FN056DS conversion" RAT_FUNC "%10.5" "Unitless" COEFFS 0 1 0 0 0 1 /end COMPU_METHOD
/begin MEASUREMENT NORM_FN057 "" FLOAT32_IEEE MC_NORM_FN057 0 0 0 0 ECU_ADDRESS 0x3FA980 /end MEASUREMENT
/begin COMPU_METHOD MC_NORM_FN057 "NORM_FN057 conversion" RAT_FUNC "%10.5" "Unitless" COEFFS 0 1 0 0 0 1 /end COMPU_METHOD
/begin MEASUREMENT NORM_FN058 "" FLOAT32_IEEE MC_NORM_FN058 0 0 0 0 ECU_ADDRESS 0x3FA97C /end MEASUREMENT
/begin COMPU_METHOD MC_NORM_FN058 "NORM_FN058 conversion" RAT_FUNC "%10.5" "Unitless" COEFFS 0 1 0 0 0 1 /end COMPU_METHOD
/begin MEASUREMENT NORM_FN059 "" FLOAT32_IEEE MC_NORM_FN059 0 0 0 0 ECU_ADDRESS 0x3FA978 /end MEASUREMENT
/begin COMPU_METHOD MC_NORM_FN059 "NORM_FN059 conversion" RAT_FUNC "%10.5" "Unitless" COEFFS 0 1 0 0 0 1 /end COMPU_METHOD
/begin MEASUREMENT NORM_FN060 "" FLOAT32_IEEE MC_NORM_FN060 0 0 0 0 ECU_ADDRESS 0x3FA974 /end MEASUREMENT
/begin COMPU_METHOD MC_NORM_FN060 "NORM_FN060 conversion" RAT_FUNC "%10.5" "Unitless" COEFFS 0 1 0 0 0 1 /end COMPU_METHOD
/begin MEASUREMENT NORM_FN090P_AFR "" FLOAT32_IEEE MC_NORM_FN090P_AFR 0 0 0 0 ECU_ADDRESS 0x3FA884 /end MEASUREMENT
/begin COMPU_METHOD MC_NORM_FN090P_AFR "NORM_FN090P_AFR conversion" RAT_FUNC "%10.5" "Unitless" COEFFS 0 1 0 0 0 1 /end COMPU_METHOD
/begin MEASUREMENT NORM_FN090_AFR "Normalized fn090_afr value" FLOAT32_IEEE MC_NORM_FN090_AFR 0 0 0 0 ECU_ADDRESS 0x3FA888 /end MEASUREMENT
/begin COMPU_METHOD MC_NORM_FN090_AFR "NORM_FN090_AFR conversion" RAT_FUNC "%10.5" "Unitless" COEFFS 0 1 0 0 0 1 /end COMPU_METHOD
/begin MEASUREMENT NORM_FN090_ICP "" FLOAT32_IEEE MC_NORM_FN090_ICP 0 0 0 0 ECU_ADDRESS 0x3FA9C0 /end MEASUREMENT
/begin COMPU_METHOD MC_NORM_FN090_ICP "NORM_FN090_ICP conversion" RAT_FUNC "%10.5" "Unitless" COEFFS 0 1 0 0 0 1 /end COMPU_METHOD
/begin MEASUREMENT NORM_FN090_ICPA "Normalized fn090_icpa value" FLOAT32_IEEE MC_NORM_FN090_ICPA 0 0 0 0 ECU_ADDRESS 0x3FA868 /end MEASUREMENT
/begin COMPU_METHOD MC_NORM_FN090_ICPA "NORM_FN090_ICPA conversion" RAT_FUNC "%10.5" "Unitless" COEFFS 0 1 0 0 0 1 /end COMPU_METHOD
/begin MEASUREMENT NORM_FN091P_AFR "" FLOAT32_IEEE MC_NORM_FN091P_AFR 0 0 0 0 ECU_ADDRESS 0x3FA87C /end MEASUREMENT
/begin COMPU_METHOD MC_NORM_FN091P_AFR "NORM_FN091P_AFR conversion" RAT_FUNC "%10.5" "Unitless" COEFFS 0 1 0 0 0 1 /end COMPU_METHOD
/begin MEASUREMENT NORM_FN091_AFR "Normalized fn091_afr value" FLOAT32_IEEE MC_NORM_FN091_AFR 0 0 0 0 ECU_ADDRESS 0x3FA880 /end MEASUREMENT
/begin COMPU_METHOD MC_NORM_FN091_AFR "NORM_FN091_AFR conversion" RAT_FUNC "%10.5" "Unitless" COEFFS 0 1 0 0 0 1 /end COMPU_METHOD
/begin MEASUREMENT NORM_FN091_ICP "" FLOAT32_IEEE MC_NORM_FN091_ICP 0 0 0 0 ECU_ADDRESS 0x3FA9BC /end MEASUREMENT
/begin COMPU_METHOD MC_NORM_FN091_ICP "NORM_FN091_ICP conversion" RAT_FUNC "%10.5" "Unitless" COEFFS 0 1 0 0 0 1 /end COMPU_METHOD
/begin MEASUREMENT NORM_FN091_ICPA "Normalized fn091_icpa value" FLOAT32_IEEE MC_NORM_FN091_ICPA 0 0 0 0 ECU_ADDRESS 0x3FA864 /end MEASUREMENT
/begin COMPU_METHOD MC_NORM_FN091_ICPA "NORM_FN091_ICPA conversion" RAT_FUNC "%10.5" "Unitless" COEFFS 0 1 0 0 0 1 /end COMPU_METHOD
/begin MEASUREMENT NORM_FNMATDS "" FLOAT32_IEEE MC_NORM_FNMATDS 0 0 0 0 ECU_ADDRESS 0x3FA964 /end MEASUREMENT
/begin COMPU_METHOD MC_NORM_FNMATDS "NORM_FNMATDS conversion" RAT_FUNC "%10.5" "Unitless" COEFFS 0 1 0 0 0 1 /end COMPU_METHOD
/begin MEASUREMENT NORM_FNMFDES_DSH_DIT "normalised output of table fnmfdes_dsh_dit" FLOAT32_IEEE MC_NORM_FNMFDES_DSH_DIT 0 0 0 0 ECU_ADDRESS 0x3FA950 /end MEASUREMENT
/begin COMPU_METHOD MC_NORM_FNMFDES_DSH_DIT "NORM_FNMFDES_DSH_DIT conversion" RAT_FUNC "%10.5" "Unitless" COEFFS 0 1 0 0 0 1 /end COMPU_METHOD
/begin MEASUREMENT NORM_FNN_DSH_DIT "normalised output of table fnn_dsh_dit" FLOAT32_IEEE MC_NORM_FNN_DSH_DIT 0 0 0 0 ECU_ADDRESS 0x3FA94C /end MEASUREMENT
/begin COMPU_METHOD MC_NORM_FNN_DSH_DIT "NORM_FNN_DSH_DIT conversion" RAT_FUNC "%10.5" "Unitless" COEFFS 0 1 0 0 0 1 /end COMPU_METHOD
/begin MEASUREMENT NOT_A_GREEN_ENG "Not a green engine flag" UBYTE MC_NOT_A_GREEN_ENG 0 0 0 0 ECU_ADDRESS 0x3FCD40 /end MEASUREMENT
/begin COMPU_METHOD MC_NOT_A_GREEN_ENG "NOT_A_GREEN_ENG conversion" RAT_FUNC "%3.0" "Unitless" COEFFS 0 1 0 0 0 1 /end COMPU_METHOD
/begin CHARACTERISTIC NOV_VID_SW "Calibration switch to enable/disable using VID block information for NOV;  0 -> use Cal Cons, 1 -> use VID blcok" VALUE 0x5CB21 SD_UBYTE 0 SC_NOV_VID_SW 0 1 /end CHARACTERISTIC
/begin COMPU_METHOD SC_NOV_VID_SW "NOV_VID_SW conversion" RAT_FUNC "%3.0" "unitless" COEFFS 0 1 0 0 0 1 /end COMPU_METHOD
/begin MEASUREMENT NO_BOOST "DIT no boost adder" FLOAT32_IEEE MC_NO_BOOST 0 0 0 0 ECU_ADDRESS 0x3FA918 /end MEASUREMENT
/begin COMPU_METHOD MC_NO_BOOST "NO_BOOST conversion" RAT_FUNC "%10.5" "Unitless" COEFFS 0 1 0 0 0 1 /end COMPU_METHOD
/begin MEASUREMENT NO_CKP_CMP_SGNL "" UBYTE MC_NO_CKP_CMP_SGNL 0 0 0 0 ECU_ADDRESS 0x3FB6B7 /end MEASUREMENT
/begin COMPU_METHOD MC_NO_CKP_CMP_SGNL "NO_CKP_CMP_SGNL conversion" RAT_FUNC "%3.0" "Unitless" COEFFS 0 1 0 0 0 1 /end COMPU_METHOD
/begin MEASUREMENT NO_CKP_SGNL_CNTR "No crank signal fault counter" UBYTE MC_NO_CKP_SGNL_CNTR 0 0 0 0 ECU_ADDRESS 0x3FB6E5 /end MEASUREMENT
/begin COMPU_METHOD MC_NO_CKP_SGNL_CNTR "NO_CKP_SGNL_CNTR conversion" RAT_FUNC "%3.0" "Unitless" COEFFS 0 1 0 0 0 1 /end COMPU_METHOD
/begin MEASUREMENT NO_CKP_SGNL_CNTR_IN_NORUN "Crank  signal fault counter when eng. is not running" UBYTE MC_NO_CKP_SGNL_CNTR_IN_NORUN 0 0 0 0 ECU_ADDRESS 0x3FA64D /end MEASUREMENT
/begin COMPU_METHOD MC_NO_CKP_SGNL_CNTR_IN_NORUN "NO_CKP_SGNL_CNTR_IN_NORUN conversion" RAT_FUNC "%3.0" "Unitless" COEFFS 0 1 0 0 0 1 /end COMPU_METHOD
/begin CHARACTERISTIC NO_CKP_SGNL_CNT_CRANK "No crank signal during crank, fault decl. limit value" VALUE 0x5D8A5 SD_UBYTE 0 SC_NO_CKP_SGNL_CNT_CRANK 0 255 /end CHARACTERISTIC
/begin COMPU_METHOD SC_NO_CKP_SGNL_CNT_CRANK "NO_CKP_SGNL_CNT_CRANK conversion" RAT_FUNC "%3.0" "unitless" COEFFS 0 1 0 0 0 1 /end COMPU_METHOD
/begin CHARACTERISTIC NO_CKP_SGNL_CNT_RUN "No crank signal during engine run, fault decl. limit value" VALUE 0x5D8A1 SD_UBYTE 0 SC_NO_CKP_SGNL_CNT_RUN 0 255 /end CHARACTERISTIC
/begin COMPU_METHOD SC_NO_CKP_SGNL_CNT_RUN "NO_CKP_SGNL_CNT_RUN conversion" RAT_FUNC "%3.0" "unitless" COEFFS 0 1 0 0 0 1 /end COMPU_METHOD
/begin MEASUREMENT NO_CKP_SGNL_CRANK_FLT_FLG "Indicates  crank signal fault during crank" UBYTE MC_NO_CKP_SGNL_CRANK_FLT_FLG 0 0 0 0 ECU_ADDRESS 0x3FA649 /end MEASUREMENT
/begin COMPU_METHOD MC_NO_CKP_SGNL_CRANK_FLT_FLG "NO_CKP_SGNL_CRANK_FLT_FLG conversion" RAT_FUNC "%3.0" "Unitless" COEFFS 0 1 0 0 0 1 /end COMPU_METHOD
/begin MEASUREMENT NO_CKP_SGNL_RUN_FLT_FLG "Indicates  no crank signal  fault during engine run" UBYTE MC_NO_CKP_SGNL_RUN_FLT_FLG 0 0 0 0 ECU_ADDRESS 0x3FA645 /end MEASUREMENT
/begin COMPU_METHOD MC_NO_CKP_SGNL_RUN_FLT_FLG "NO_CKP_SGNL_RUN_FLT_FLG conversion" RAT_FUNC "%3.0" "Unitless" COEFFS 0 1 0 0 0 1 /end COMPU_METHOD
/begin MEASUREMENT NO_CMP_SGNL_CNTR "Cam Signal fault counter" UBYTE MC_NO_CMP_SGNL_CNTR 0 0 0 0 ECU_ADDRESS 0x3FB6E4 /end MEASUREMENT
/begin COMPU_METHOD MC_NO_CMP_SGNL_CNTR "NO_CMP_SGNL_CNTR conversion" RAT_FUNC "%3.0" "Unitless" COEFFS 0 1 0 0 0 1 /end COMPU_METHOD
/begin MEASUREMENT NO_CMP_SGNL_CNTR_IN_NORUN "Cam signal fault counter when eng. is not running" UBYTE MC_NO_CMP_SGNL_CNTR_IN_NORUN 0 0 0 0 ECU_ADDRESS 0x3FA64F /end MEASUREMENT
/begin COMPU_METHOD MC_NO_CMP_SGNL_CNTR_IN_NORUN "NO_CMP_SGNL_CNTR_IN_NORUN conversion" RAT_FUNC "%3.0" "Unitless" COEFFS 0 1 0 0 0 1 /end COMPU_METHOD
/begin CHARACTERISTIC NO_CMP_SGNL_CNT_CRANK "No cam signal during crank, fault decl. limit value" VALUE 0x5D8A7 SD_UBYTE 0 SC_NO_CMP_SGNL_CNT_CRANK 0 255 /end CHARACTERISTIC
/begin COMPU_METHOD SC_NO_CMP_SGNL_CNT_CRANK "NO_CMP_SGNL_CNT_CRANK conversion" RAT_FUNC "%3.0" "unitless" COEFFS 0 1 0 0 0 1 /end COMPU_METHOD
/begin CHARACTERISTIC NO_CMP_SGNL_CNT_RUN "No cam signal  during engine run, fault decl. limit value" VALUE 0x5D8A3 SD_UBYTE 0 SC_NO_CMP_SGNL_CNT_RUN 0 255 /end CHARACTERISTIC
/begin COMPU_METHOD SC_NO_CMP_SGNL_CNT_RUN "NO_CMP_SGNL_CNT_RUN conversion" RAT_FUNC "%3.0" "unitless" COEFFS 0 1 0 0 0 1 /end COMPU_METHOD
/begin MEASUREMENT NO_CMP_SGNL_CRANK_FLT_FLG "Indicates cam signal fault during crank" UBYTE MC_NO_CMP_SGNL_CRANK_FLT_FLG 0 0 0 0 ECU_ADDRESS 0x3FA64B /end MEASUREMENT
/begin COMPU_METHOD MC_NO_CMP_SGNL_CRANK_FLT_FLG "NO_CMP_SGNL_CRANK_FLT_FLG conversion" RAT_FUNC "%3.0" "Unitless" COEFFS 0 1 0 0 0 1 /end COMPU_METHOD
/begin MEASUREMENT NO_CMP_SGNL_RUN_FLT_FLG "Indicates  cam signal fault during engine run" UBYTE MC_NO_CMP_SGNL_RUN_FLT_FLG 0 0 0 0 ECU_ADDRESS 0x3FA647 /end MEASUREMENT
/begin COMPU_METHOD MC_NO_CMP_SGNL_RUN_FLT_FLG "NO_CMP_SGNL_RUN_FLT_FLG conversion" RAT_FUNC "%3.0" "Unitless" COEFFS 0 1 0 0 0 1 /end COMPU_METHOD
/begin CHARACTERISTIC NO_OF_CYL "Number of cylinders" VALUE 0x5DD50 SD_ULONG 0 SC_NO_OF_CYL 0 8 /end CHARACTERISTIC
/begin COMPU_METHOD SC_NO_OF_CYL "NO_OF_CYL conversion" RAT_FUNC "%10.0" "N/A" COEFFS 0 1 0 0 0 1 /end COMPU_METHOD
/begin CHARACTERISTIC NQUALIFY_CAL "" VALUE 0x5C486 SD_UBYTE 0 SC_NQUALIFY_CAL 0 255 /end CHARACTERISTIC
/begin COMPU_METHOD SC_NQUALIFY_CAL "NQUALIFY_CAL conversion" RAT_FUNC "%3.0" "unitless" COEFFS 0 1 0 0 0 1 /end COMPU_METHOD
/begin MEASUREMENT NSRC_DES "'Selectable RPM Control' (SRC) ""N"" Desired" FLOAT32_IEEE MC_NSRC_DES 0 0 0 0 ECU_ADDRESS 0x3FB174 /end MEASUREMENT
/begin COMPU_METHOD MC_NSRC_DES "NSRC_DES conversion" RAT_FUNC "%10.5" "Unitless" COEFFS 0 1 0 0 0 1 /end COMPU_METHOD
/begin CHARACTERISTIC NSTALL "Engine stall speed to re-enter CRANK mode." VALUE 0x5C878 SD_FLOAT32_IEEE 0 SC_NSTALL 0 500 /end CHARACTERISTIC
/begin COMPU_METHOD SC_NSTALL "NSTALL conversion" RAT_FUNC "%10.5" "RPM" COEFFS 0 1 0 0 0 1 /end COMPU_METHOD
/begin CHARACTERISTIC NSTRT_TM "Max time w/o CRNK transition until N=0 (ms)" VALUE 0x5DD7C SD_ULONG 0 SC_NSTRT_TM 0 10000 /end CHARACTERISTIC
/begin COMPU_METHOD SC_NSTRT_TM "NSTRT_TM conversion" RAT_FUNC "%10.0" "ms" COEFFS 0 1 0 0 0 1 /end COMPU_METHOD
/begin MEASUREMENT NTBART "FILTERED TRANSMISSION TURBINE SPEED" FLOAT32_IEEE MC_NTBART 0 0 0 0 ECU_ADDRESS 0x3FB718 /end MEASUREMENT
/begin COMPU_METHOD MC_NTBART "NTBART conversion" RAT_FUNC "%10.5" "Unitless" COEFFS 0 1 0 0 0 1 /end COMPU_METHOD
/begin CHARACTERISTIC NUMCYL_0 "Number of cylinders in the engine. Range is 0-255, although many implementations may support only up to 8 or 10." VALUE 0x5C485 SD_UBYTE 0 SC_NUMCYL_0 0 255 /end CHARACTERISTIC
/begin COMPU_METHOD SC_NUMCYL_0 "NUMCYL_0 conversion" RAT_FUNC "%3.0" "ENUMERATED" COEFFS 0 1 0 0 0 1 /end COMPU_METHOD
/begin MEASUREMENT NUM_CODES "Number of OBD-II fault codes currently stored in memory." UBYTE MC_NUM_CODES 0 0 0 0 ECU_ADDRESS 0x3FCCE1 /end MEASUREMENT
/begin COMPU_METHOD MC_NUM_CODES "NUM_CODES conversion" RAT_FUNC "%3.0" "Unitless" COEFFS 0 1 0 0 0 1 /end COMPU_METHOD
/begin CHARACTERISTIC N_DACCEL7C "Disable misfire detection on the second median filter daccel7c while rpm exceeds this limit." VALUE 0x5EDFC SD_FLOAT32_IEEE 0 SC_N_DACCEL7C 0 16383.8 /end CHARACTERISTIC
/begin COMPU_METHOD SC_N_DACCEL7C "N_DACCEL7C conversion" RAT_FUNC "%10.5" "RPM" COEFFS 0 1 0 0 0 1 /end COMPU_METHOD
/begin MEASUREMENT N_FILT "Filtered Engine speed (RPM)." FLOAT32_IEEE MC_N_FILT 0 0 0 0 ECU_ADDRESS 0x3FA110 /end MEASUREMENT
/begin COMPU_METHOD MC_N_FILT "N_FILT conversion" RAT_FUNC "%10.5" "Unitless" COEFFS 0 1 0 0 0 1 /end COMPU_METHOD
/begin CHARACTERISTIC N_FILT_KF "Engine speed filter gain for N_FILT calculation" VALUE 0x5D234 SD_FLOAT32_IEEE 0 SC_N_FILT_KF 0 1 /end CHARACTERISTIC
/begin COMPU_METHOD SC_N_FILT_KF "N_FILT_KF conversion" RAT_FUNC "%10.5" "unitless" COEFFS 0 1 0 0 0 1 /end COMPU_METHOD
/begin MEASUREMENT N_IDM "Engine speed calculated by the IDM" FLOAT32_IEEE MC_N_IDM 0 0 0 0 ECU_ADDRESS 0x3FB6CC /end MEASUREMENT
/begin COMPU_METHOD MC_N_IDM "N_IDM conversion" RAT_FUNC "%10.5" "Unitless" COEFFS 0 1 0 0 0 1 /end COMPU_METHOD
/begin MEASUREMENT N_I_SEED "Governor seed value (mg/stroke)" FLOAT32_IEEE MC_N_I_SEED 0 0 0 0 ECU_ADDRESS 0x3FA78C /end MEASUREMENT
/begin COMPU_METHOD MC_N_I_SEED "N_I_SEED conversion" RAT_FUNC "%10.5" "Unitless" COEFFS 0 1 0 0 0 1 /end COMPU_METHOD
/begin CHARACTERISTIC N_I_SEED_MAX "max engine speed allowed governor reseeding" VALUE 0x5DBDC SD_FLOAT32_IEEE 0 SC_N_I_SEED_MAX 0 2000 /end CHARACTERISTIC
/begin COMPU_METHOD SC_N_I_SEED_MAX "N_I_SEED_MAX conversion" RAT_FUNC "%10.5" "RPM" COEFFS 0 1 0 0 0 1 /end COMPU_METHOD
/begin CHARACTERISTIC N_I_SEED_MIN "min engine speed allowed governor reseeding" VALUE 0x5DBE0 SD_FLOAT32_IEEE 0 SC_N_I_SEED_MIN 0 2000 /end CHARACTERISTIC
/begin COMPU_METHOD SC_N_I_SEED_MIN "N_I_SEED_MIN conversion" RAT_FUNC "%10.5" "RPM" COEFFS 0 1 0 0 0 1 /end COMPU_METHOD
/begin CHARACTERISTIC N_MIS_ENA "Max engine speed to run misfire detection" VALUE 0x5EE64 SD_FLOAT32_IEEE 0 SC_N_MIS_ENA 0 16383.8 /end CHARACTERISTIC
/begin COMPU_METHOD SC_N_MIS_ENA "N_MIS_ENA conversion" RAT_FUNC "%10.5" "RPM" COEFFS 0 1 0 0 0 1 /end COMPU_METHOD
/begin MEASUREMENT N_NORM "" FLOAT32_IEEE MC_N_NORM 0 0 0 0 ECU_ADDRESS 0x3FB0FC /end MEASUREMENT
/begin COMPU_METHOD MC_N_NORM "N_NORM conversion" RAT_FUNC "%10.5" "Unitless" COEFFS 0 1 0 0 0 1 /end COMPU_METHOD
/begin MEASUREMENT N_PREV "LAST PASS VALUE OF N FOR DISPLAY" FLOAT32_IEEE MC_N_PREV 0 0 0 0 ECU_ADDRESS 0x3FA9A8 /end MEASUREMENT
/begin COMPU_METHOD MC_N_PREV "N_PREV conversion" RAT_FUNC "%10.5" "Unitless" COEFFS 0 1 0 0 0 1 /end COMPU_METHOD
/begin MEASUREMENT N_RAW "Raw engine speed (RPM) from engine position input driver." FLOAT32_IEEE MC_N_RAW 0 0 0 0 ECU_ADDRESS 0x3F9888 /end MEASUREMENT
/begin COMPU_METHOD MC_N_RAW "N_RAW conversion" RAT_FUNC "%10.5" "Unitless" COEFFS 0 1 0 0 0 1 /end COMPU_METHOD
/begin MEASUREMENT N_RDSP_LMX "Road speed limited engine speed (RPM)" FLOAT32_IEEE MC_N_RDSP_LMX 0 0 0 0 ECU_ADDRESS 0x3FA6F8 /end MEASUREMENT
/begin COMPU_METHOD MC_N_RDSP_LMX "N_RDSP_LMX conversion" RAT_FUNC "%10.5" "Unitless" COEFFS 0 1 0 0 0 1 /end COMPU_METHOD
/begin MEASUREMENT N_SETPNT "Cold idle kicker limit for desired RPM." FLOAT32_IEEE MC_N_SETPNT 0 0 0 0 ECU_ADDRESS 0x3FA6C8 /end MEASUREMENT
/begin COMPU_METHOD MC_N_SETPNT "N_SETPNT conversion" RAT_FUNC "%10.5" "Unitless" COEFFS 0 1 0 0 0 1 /end COMPU_METHOD
/begin MEASUREMENT N_SMS_F_IDM "" UBYTE MC_N_SMS_F_IDM 0 0 0 0 ECU_ADDRESS 0x3FB6D2 /end MEASUREMENT
/begin COMPU_METHOD MC_N_SMS_F_IDM "N_SMS_F_IDM conversion" RAT_FUNC "%3.0" "Unitless" COEFFS 0 1 0 0 0 1 /end COMPU_METHOD
/begin MEASUREMENT N_TO_P "No pilot to pilot transition flag" UBYTE MC_N_TO_P 0 0 0 0 ECU_ADDRESS 0x3FA8CA /end MEASUREMENT
/begin COMPU_METHOD MC_N_TO_P "N_TO_P conversion" RAT_FUNC "%3.0" "Unitless" COEFFS 0 1 0 0 0 1 /end COMPU_METHOD
/begin MEASUREMENT N_TRPTO_DES "Desired Engine speed (RPM) for PTO." FLOAT32_IEEE MC_N_TRPTO_DES 0 0 0 0 ECU_ADDRESS 0x3FB170 /end MEASUREMENT
/begin COMPU_METHOD MC_N_TRPTO_DES "N_TRPTO_DES conversion" RAT_FUNC "%10.5" "Unitless" COEFFS 0 1 0 0 0 1 /end COMPU_METHOD
/begin CHARACTERISTIC N_VGT_WARMUP "" VALUE 0x5E99C SD_FLOAT32_IEEE 0 SC_N_VGT_WARMUP 0 5000 /end CHARACTERISTIC
/begin COMPU_METHOD SC_N_VGT_WARMUP "N_VGT_WARMUP conversion" RAT_FUNC "%10.5" "unitless" COEFFS 0 1 0 0 0 1 /end COMPU_METHOD
/begin CHARACTERISTIC OBD2_FUL_LVL "Fuel level threshold below which ""low fuel"" condition is signalled to other OBDII monitors, % fill" VALUE 0x5D10C SD_FLOAT32_IEEE 0 SC_OBD2_FUL_LVL 0 1.99997 /end CHARACTERISTIC
/begin COMPU_METHOD SC_OBD2_FUL_LVL "OBD2_FUL_LVL conversion" RAT_FUNC "%10.5" "%" COEFFS 0 1 0 0 0 1 /end COMPU_METHOD
/begin CHARACTERISTIC OBDII_DELAY "Time into run mode before enabling any continuous OBD-II monitor." VALUE 0x5CE2C SD_UBYTE 0 SC_OBDII_DELAY 0 255 /end CHARACTERISTIC
/begin COMPU_METHOD SC_OBDII_DELAY "OBDII_DELAY conversion" RAT_FUNC "%3.0" "s" COEFFS 0 1 0 0 0 1 /end COMPU_METHOD
/begin MEASUREMENT OBDII_MIL_ON "bit0=cat_mil_on;bit1=ccm_mil_on;bit2=purg_mil_on;bit3=sair_mil_on;bit4=fuel_mil_on;bit5=ego_mil_on;bit6=egr_mil_on;bit7=mis_mil_on" UBYTE MC_OBDII_MIL_ON 0 0 0 0 ECU_ADDRESS 0x3FCCDF /end MEASUREMENT
/begin COMPU_METHOD MC_OBDII_MIL_ON "OBDII_MIL_ON conversion" RAT_FUNC "%3.0" "Unitless" COEFFS 0 1 0 0 0 1 /end COMPU_METHOD
/begin CHARACTERISTIC OBDII_MIL_SW "Mapped byte of sys_MIL_SW flag bits in the order(0..7):{cat,ccm,purg,sair,fuel,ego,egr,mis}." VALUE 0x5CDF4 SD_UBYTE 0 SC_OBDII_MIL_SW 0 255 /end CHARACTERISTIC
/begin COMPU_METHOD SC_OBDII_MIL_SW "OBDII_MIL_SW conversion" RAT_FUNC "%3.0" "group_of_bits" COEFFS 0 1 0 0 0 1 /end COMPU_METHOD
/begin MEASUREMENT OBDII_PARM_RST "1 = OBDII Parameter reset active" UBYTE MC_OBDII_PARM_RST 0 0 0 0 ECU_ADDRESS 0x3F9CEB /end MEASUREMENT
/begin COMPU_METHOD MC_OBDII_PARM_RST "OBDII_PARM_RST conversion" RAT_FUNC "%3.0" "Unitless" COEFFS 0 1 0 0 0 1 /end COMPU_METHOD
/begin MEASUREMENT OBDII_RESET "Flag used to simulate the receipt of an OBD-II scan tool reset message." UBYTE MC_OBDII_RESET 0 0 0 0 ECU_ADDRESS 0x3F9E12 /end MEASUREMENT
/begin COMPU_METHOD MC_OBDII_RESET "OBDII_RESET conversion" RAT_FUNC "%3.0" "Unitless" COEFFS 0 1 0 0 0 1 /end COMPU_METHOD
/begin MEASUREMENT OBDII_STATE "Current state of the obdII sequence controller." UBYTE MC_OBDII_STATE 0 0 0 0 ECU_ADDRESS 0x3F9E32 /end MEASUREMENT
/begin COMPU_METHOD MC_OBDII_STATE "OBDII_STATE conversion" RAT_FUNC "%3.0" "Unitless" COEFFS 0 1 0 0 0 1 /end COMPU_METHOD
/begin CHARACTERISTIC OBDII_TST_SW "Mapped byte of sys_TST_SW flag bits in the order(0..7): {cat,ccm,purg,sair,fuel,ego,egr,mis}." VALUE 0x5CE30 SD_UBYTE 0 SC_OBDII_TST_SW 0 255 /end CHARACTERISTIC
/begin COMPU_METHOD SC_OBDII_TST_SW "OBDII_TST_SW conversion" RAT_FUNC "%3.0" "MAPPED_BYTE" COEFFS 0 1 0 0 0 1 /end COMPU_METHOD
/begin MEASUREMENT OBDII_WARMUP "FLAG INDICATING ENGINE WARM-UP HAS OCCURED AS DEFINED BY CARB." UBYTE MC_OBDII_WARMUP 0 0 0 0 ECU_ADDRESS 0x3F9E15 /end MEASUREMENT
/begin COMPU_METHOD MC_OBDII_WARMUP "OBDII_WARMUP conversion" RAT_FUNC "%3.0" "Unitless" COEFFS 0 1 0 0 0 1 /end COMPU_METHOD
/begin MEASUREMENT OBD_PARM_RST "OBDII paramter reset signal; 1-> reset parameters." UBYTE MC_OBD_PARM_RST 0 0 0 0 ECU_ADDRESS 0x3F9E33 /end MEASUREMENT
/begin COMPU_METHOD MC_OBD_PARM_RST "OBD_PARM_RST conversion" RAT_FUNC "%3.0" "Unitless" COEFFS 0 1 0 0 0 1 /end COMPU_METHOD
/begin MEASUREMENT OBD_TRIP_RST "1 = An OBD-II trip reset is requested." UBYTE MC_OBD_TRIP_RST 0 0 0 0 ECU_ADDRESS 0x3F9E70 /end MEASUREMENT
/begin COMPU_METHOD MC_OBD_TRIP_RST "OBD_TRIP_RST conversion" RAT_FUNC "%3.0" "Unitless" COEFFS 0 1 0 0 0 1 /end COMPU_METHOD
/begin CHARACTERISTIC OBD_VBAT_MAX "Maximum voltage allowed to run OBDII system monitors." VALUE 0x5F0D8 SD_FLOAT32_IEEE 0 SC_OBD_VBAT_MAX 0 63.999 /end CHARACTERISTIC
/begin COMPU_METHOD SC_OBD_VBAT_MAX "OBD_VBAT_MAX conversion" RAT_FUNC "%10.5" "VOLTS" COEFFS 0 1 0 0 0 1 /end COMPU_METHOD
/begin CHARACTERISTIC OBD_VBAT_MIN "Minimum voltage allowed to run OBDII system monitors." VALUE 0x5F0DC SD_FLOAT32_IEEE 0 SC_OBD_VBAT_MIN 0 63.999 /end CHARACTERISTIC
/begin COMPU_METHOD SC_OBD_VBAT_MIN "OBD_VBAT_MIN conversion" RAT_FUNC "%10.5" "VOLTS" COEFFS 0 1 0 0 0 1 /end COMPU_METHOD
/begin MEASUREMENT ODR_REQ "Overdrive cancel lamp request" UBYTE MC_ODR_REQ 0 0 0 0 ECU_ADDRESS 0x3FA2B7 /end MEASUREMENT
/begin COMPU_METHOD MC_ODR_REQ "ODR_REQ conversion" RAT_FUNC "%3.0" "Unitless" COEFFS 0 1 0 0 0 1 /end COMPU_METHOD
/begin MEASUREMENT ODU_CODE_CTR "OBDII fault code tables' index indicating the position where the last code was transmitted." UWORD MC_ODU_CODE_CTR 0 0 0 0 ECU_ADDRESS 0x3FB458 /end MEASUREMENT
/begin COMPU_METHOD MC_ODU_CODE_CTR "ODU_CODE_CTR conversion" RAT_FUNC "%5.0" "Unitless" COEFFS 0 1 0 0 0 1 /end COMPU_METHOD
/begin MEASUREMENT ODU_CODE_RQ "State register indicating which OBDII codes request message is being responded to." UBYTE MC_ODU_CODE_RQ 0 0 0 0 ECU_ADDRESS 0x3FB45D /end MEASUREMENT
/begin COMPU_METHOD MC_ODU_CODE_RQ "ODU_CODE_RQ conversion" RAT_FUNC "%3.0" "Unitless" COEFFS 0 1 0 0 0 1 /end COMPU_METHOD
/begin CHARACTERISTIC ODU_TIMEOUT "Time-out value for certain offboard diagnostic routines." VALUE 0x5EFB4 SD_FLOAT32_IEEE 0 SC_ODU_TIMEOUT 0 31.875 /end CHARACTERISTIC
/begin COMPU_METHOD SC_ODU_TIMEOUT "ODU_TIMEOUT conversion" RAT_FUNC "%10.5" "s" COEFFS 0 1 0 0 0 1 /end COMPU_METHOD
/begin MEASUREMENT ODU_UP_STATE "Flag set when Offboard Unit is actively communicating with the EEC over SCP" UBYTE MC_ODU_UP_STATE 0 0 0 0 ECU_ADDRESS 0x3FB437 /end MEASUREMENT
/begin COMPU_METHOD MC_ODU_UP_STATE "ODU_UP_STATE conversion" RAT_FUNC "%3.0" "Unitless" COEFFS 0 1 0 0 0 1 /end COMPU_METHOD
/begin MEASUREMENT ODU_UP_TMR "Offboard Diag Unit Activity timer." FLOAT32_IEEE MC_ODU_UP_TMR 0 0 0 0 ECU_ADDRESS 0x3FB42C /end MEASUREMENT
/begin COMPU_METHOD MC_ODU_UP_TMR "ODU_UP_TMR conversion" RAT_FUNC "%10.5" "Unitless" COEFFS 0 1 0 0 0 1 /end COMPU_METHOD
/begin MEASUREMENT OD_CODE_CNT "Count of total number of on-demand codes currently stored." UBYTE MC_OD_CODE_CNT 0 0 0 0 ECU_ADDRESS 0x3FCCDC /end MEASUREMENT
/begin COMPU_METHOD MC_OD_CODE_CNT "OD_CODE_CNT conversion" RAT_FUNC "%3.0" "Unitless" COEFFS 0 1 0 0 0 1 /end COMPU_METHOD
/begin MEASUREMENT OFFIDLE_HOLDOFF_FLG "SP  off-idle trasition holdoff flag" UBYTE MC_OFFIDLE_HOLDOFF_FLG 0 0 0 0 ECU_ADDRESS 0x3FA8C8 /end MEASUREMENT
/begin COMPU_METHOD MC_OFFIDLE_HOLDOFF_FLG "OFFIDLE_HOLDOFF_FLG conversion" RAT_FUNC "%3.0" "Unitless" COEFFS 0 1 0 0 0 1 /end COMPU_METHOD
/begin MEASUREMENT OL_DRIVE "Open loop due to driving conditions (not FMEM or HOLD related)." UBYTE MC_OL_DRIVE 0 0 0 0 ECU_ADDRESS 0x3F9CDF /end MEASUREMENT
/begin COMPU_METHOD MC_OL_DRIVE "OL_DRIVE conversion" RAT_FUNC "%3.0" "Unitless" COEFFS 0 1 0 0 0 1 /end COMPU_METHOD
/begin MEASUREMENT OL_FMEM "Open loop due to detected system fault flag.  1 = open loop ude to FMEM." UBYTE MC_OL_FMEM 0 0 0 0 ECU_ADDRESS 0x3F9CE0 /end MEASUREMENT
/begin COMPU_METHOD MC_OL_FMEM "OL_FMEM conversion" RAT_FUNC "%3.0" "Unitless" COEFFS 0 1 0 0 0 1 /end COMPU_METHOD
/begin MEASUREMENT OL_HOLD "PRESENT CONDITIONS NOT SATISFIED TO GO CLOSED LOOP FLAG. 1 = HOLD IN OPEN LOOP." UBYTE MC_OL_HOLD 0 0 0 0 ECU_ADDRESS 0x3F9CE3 /end MEASUREMENT
/begin COMPU_METHOD MC_OL_HOLD "OL_HOLD conversion" RAT_FUNC "%3.0" "Unitless" COEFFS 0 1 0 0 0 1 /end COMPU_METHOD
/begin MEASUREMENT OPER_RSP_CHK "Flag to signal that it is time to check for operator response (BOO, PSPS, etc)" UBYTE MC_OPER_RSP_CHK 0 0 0 0 ECU_ADDRESS 0x3FB4FA /end MEASUREMENT
/begin COMPU_METHOD MC_OPER_RSP_CHK "OPER_RSP_CHK conversion" RAT_FUNC "%3.0" "Unitless" COEFFS 0 1 0 0 0 1 /end COMPU_METHOD
/begin CHARACTERISTIC OP_RUN_TM "wait time in ms before setting run_latch_flg" VALUE 0x5DD8C SD_UWORD 0 SC_OP_RUN_TM 0 65535 /end CHARACTERISTIC
/begin COMPU_METHOD SC_OP_RUN_TM "OP_RUN_TM conversion" RAT_FUNC "%5.0" "ms" COEFFS 0 1 0 0 0 1 /end COMPU_METHOD
/begin MEASUREMENT OP_RUN_TMR "timer to latch run_latch_flg, res 8ms" UWORD MC_OP_RUN_TMR 0 0 0 0 ECU_ADDRESS 0x3FA8B0 /end MEASUREMENT
/begin COMPU_METHOD MC_OP_RUN_TMR "OP_RUN_TMR conversion" RAT_FUNC "%5.0" "Unitless" COEFFS 0 1 0 0 0 1 /end COMPU_METHOD
/begin MEASUREMENT OSCTR "Count of unrealistic changes in output shaft speed" UBYTE MC_OSCTR 0 0 0 0 ECU_ADDRESS 0x3FA6A7 /end MEASUREMENT
/begin COMPU_METHOD MC_OSCTR "OSCTR conversion" RAT_FUNC "%3.0" "Unitless" COEFFS 0 1 0 0 0 1 /end COMPU_METHOD
/begin CHARACTERISTIC OSC_MASK "Key to unlock each OSC channel." VALUE 0x5CB2E SD_UBYTE 0 SC_OSC_MASK 135 135 /end CHARACTERISTIC
/begin COMPU_METHOD SC_OSC_MASK "OSC_MASK conversion" RAT_FUNC "%3.0" "NONE" COEFFS 0 1 0 0 0 1 /end COMPU_METHOD
/begin MEASUREMENT OSC_STATE "Output state control state variable." UBYTE MC_OSC_STATE 0 0 0 0 ECU_ADDRESS 0x3FB474 /end MEASUREMENT
/begin COMPU_METHOD MC_OSC_STATE "OSC_STATE conversion" RAT_FUNC "%3.0" "Unitless" COEFFS 0 1 0 0 0 1 /end COMPU_METHOD
/begin MEASUREMENT OSFMFLG "Output Shaft Speed Sensor FMEM Flag;  1 -> in FMEM." UBYTE MC_OSFMFLG 0 0 0 0 ECU_ADDRESS 0x3FB65A /end MEASUREMENT
/begin COMPU_METHOD MC_OSFMFLG "OSFMFLG conversion" RAT_FUNC "%3.0" "Unitless" COEFFS 0 1 0 0 0 1 /end COMPU_METHOD
/begin MEASUREMENT OSM_EDF_OFF "Request for EDF Off from OSM or OTM test" UBYTE MC_OSM_EDF_OFF 0 0 0 0 ECU_ADDRESS 0x3FB521 /end MEASUREMENT
/begin COMPU_METHOD MC_OSM_EDF_OFF "OSM_EDF_OFF conversion" RAT_FUNC "%3.0" "Unitless" COEFFS 0 1 0 0 0 1 /end COMPU_METHOD
/begin MEASUREMENT OSM_EDF_ON "Request for EDF on from OSM or OTM test" UBYTE MC_OSM_EDF_ON 0 0 0 0 ECU_ADDRESS 0x3FB520 /end MEASUREMENT
/begin COMPU_METHOD MC_OSM_EDF_ON "OSM_EDF_ON conversion" RAT_FUNC "%3.0" "Unitless" COEFFS 0 1 0 0 0 1 /end COMPU_METHOD
/begin MEASUREMENT OSM_EO_OFF "OFF state requested for OSM outputs during engine off on demand test." UBYTE MC_OSM_EO_OFF 0 0 0 0 ECU_ADDRESS 0x3FB51F /end MEASUREMENT
/begin COMPU_METHOD MC_OSM_EO_OFF "OSM_EO_OFF conversion" RAT_FUNC "%3.0" "Unitless" COEFFS 0 1 0 0 0 1 /end COMPU_METHOD
/begin MEASUREMENT OSM_EO_ON "ON state requested for OSM outputs during engine off on demand test." UBYTE MC_OSM_EO_ON 0 0 0 0 ECU_ADDRESS 0x3FB51E /end MEASUREMENT
/begin COMPU_METHOD MC_OSM_EO_ON "OSM_EO_ON conversion" RAT_FUNC "%3.0" "Unitless" COEFFS 0 1 0 0 0 1 /end COMPU_METHOD
/begin CHARACTERISTIC OSM_EO_WAIT "Value of EO_STATUS when waiting for OSM test to complete during engine off on demand test" VALUE 0x5F0E2 SD_UBYTE 0 SC_OSM_EO_WAIT 0 100 /end CHARACTERISTIC
/begin COMPU_METHOD SC_OSM_EO_WAIT "OSM_EO_WAIT conversion" RAT_FUNC "%3.0" "unitless" COEFFS 0 1 0 0 0 1 /end COMPU_METHOD
/begin MEASUREMENT OSM_HEDF_OFF "Request for HEDF Off from OSM or OTM test" UBYTE MC_OSM_HEDF_OFF 0 0 0 0 ECU_ADDRESS 0x3FB51D /end MEASUREMENT
/begin COMPU_METHOD MC_OSM_HEDF_OFF "OSM_HEDF_OFF conversion" RAT_FUNC "%3.0" "Unitless" COEFFS 0 1 0 0 0 1 /end COMPU_METHOD
/begin MEASUREMENT OSM_HEDF_ON "Request for HEDF On from OSM or OTM test" UBYTE MC_OSM_HEDF_ON 0 0 0 0 ECU_ADDRESS 0x3FB51C /end MEASUREMENT
/begin COMPU_METHOD MC_OSM_HEDF_ON "OSM_HEDF_ON conversion" RAT_FUNC "%3.0" "Unitless" COEFFS 0 1 0 0 0 1 /end COMPU_METHOD
/begin CHARACTERISTIC OS_MOV "Output Shaft Speed above which test will be executed." VALUE 0x5D8EC SD_FLOAT32_IEEE 0 SC_OS_MOV 0 1024 /end CHARACTERISTIC
/begin COMPU_METHOD SC_OS_MOV "OS_MOV conversion" RAT_FUNC "%10.5" "RPM" COEFFS 0 1 0 0 0 1 /end COMPU_METHOD
/begin CHARACTERISTIC OTM_MAX_TM "Maximum time in Output Test Mode without changing states" VALUE 0x5F0EC SD_FLOAT32_IEEE 0 SC_OTM_MAX_TM 0 600 /end CHARACTERISTIC
/begin COMPU_METHOD SC_OTM_MAX_TM "OTM_MAX_TM conversion" RAT_FUNC "%10.5" "s" COEFFS 0 1 0 0 0 1 /end COMPU_METHOD
/begin MEASUREMENT OTM_STATE "Current State of Output Test Mode Controller (Inactive, Off, On, EDF On...)" UBYTE MC_OTM_STATE 0 0 0 0 ECU_ADDRESS 0x3FB519 /end MEASUREMENT
/begin COMPU_METHOD MC_OTM_STATE "OTM_STATE conversion" RAT_FUNC "%3.0" "Unitless" COEFFS 0 1 0 0 0 1 /end COMPU_METHOD
/begin MEASUREMENT OTM_TIMER "Output Test Mode Time out timer" FLOAT32_IEEE MC_OTM_TIMER 0 0 0 0 ECU_ADDRESS 0x3FB4E0 /end MEASUREMENT
/begin COMPU_METHOD MC_OTM_TIMER "OTM_TIMER conversion" RAT_FUNC "%10.5" "Unitless" COEFFS 0 1 0 0 0 1 /end COMPU_METHOD
/begin MEASUREMENT OTM_TST_ENA "Flag to activate the output test mode on demand test." UBYTE MC_OTM_TST_ENA 0 0 0 0 ECU_ADDRESS 0x3F9E46 /end MEASUREMENT
/begin COMPU_METHOD MC_OTM_TST_ENA "OTM_TST_ENA conversion" RAT_FUNC "%3.0" "Unitless" COEFFS 0 1 0 0 0 1 /end COMPU_METHOD
/begin MEASUREMENT OTM_TST_RDY "Flag to signal the OBD-II executive that the output test mode is ready." UBYTE MC_OTM_TST_RDY 0 0 0 0 ECU_ADDRESS 0x3FB51B /end MEASUREMENT
/begin COMPU_METHOD MC_OTM_TST_RDY "OTM_TST_RDY conversion" RAT_FUNC "%3.0" "Unitless" COEFFS 0 1 0 0 0 1 /end COMPU_METHOD
/begin MEASUREMENT OUTCD_RAND_K "One byte random number used in generation of tx_outcode, Stored in KAM." UBYTE MC_OUTCD_RAND_K 0 0 0 0 ECU_ADDRESS 0x3FCC92 /end MEASUREMENT
/begin COMPU_METHOD MC_OUTCD_RAND_K "OUTCD_RAND_K conversion" RAT_FUNC "%3.0" "Unitless" COEFFS 0 1 0 0 0 1 /end COMPU_METHOD
/begin MEASUREMENT OUTCD_STAT "Outcode Status where a 01h => Outcode stored and a 00h => Outcode not yet stored." UBYTE MC_OUTCD_STAT 0 0 0 0 ECU_ADDRESS 0x3F9DB5 /end MEASUREMENT
/begin COMPU_METHOD MC_OUTCD_STAT "OUTCD_STAT conversion" RAT_FUNC "%3.0" "Unitless" COEFFS 0 1 0 0 0 1 /end COMPU_METHOD
/begin MEASUREMENT OUTCD_TCTR_K "Nos of key-ons left with current incode, stored in KAM." UBYTE MC_OUTCD_TCTR_K 0 0 0 0 ECU_ADDRESS 0x3FCC91 /end MEASUREMENT
/begin COMPU_METHOD MC_OUTCD_TCTR_K "OUTCD_TCTR_K conversion" RAT_FUNC "%3.0" "Unitless" COEFFS 0 1 0 0 0 1 /end COMPU_METHOD
/begin MEASUREMENT OUTCODE1 "First Byte Of Outcode" UBYTE MC_OUTCODE1 0 0 0 0 ECU_ADDRESS 0x3F9DE9 /end MEASUREMENT
/begin COMPU_METHOD MC_OUTCODE1 "OUTCODE1 conversion" RAT_FUNC "%3.0" "Unitless" COEFFS 0 1 0 0 0 1 /end COMPU_METHOD
/begin MEASUREMENT OUTCODE2 "Second byte of Outcode" UBYTE MC_OUTCODE2 0 0 0 0 ECU_ADDRESS 0x3F9DE8 /end MEASUREMENT
/begin COMPU_METHOD MC_OUTCODE2 "OUTCODE2 conversion" RAT_FUNC "%3.0" "Unitless" COEFFS 0 1 0 0 0 1 /end COMPU_METHOD
/begin MEASUREMENT OUTPUT_MODE "Output Test Mode State requested by SCP. (Inactive, Off, On, EDF on ...)" UBYTE MC_OUTPUT_MODE 0 0 0 0 ECU_ADDRESS 0x3FB4AB /end MEASUREMENT
/begin COMPU_METHOD MC_OUTPUT_MODE "OUTPUT_MODE conversion" RAT_FUNC "%3.0" "Unitless" COEFFS 0 1 0 0 0 1 /end COMPU_METHOD
/begin MEASUREMENT OVRBST_MFL_SEL "" UBYTE MC_OVRBST_MFL_SEL 0 0 0 0 ECU_ADDRESS 0x5DC59 /end MEASUREMENT
/begin COMPU_METHOD MC_OVRBST_MFL_SEL "OVRBST_MFL_SEL conversion" RAT_FUNC "%3.0" "Unitless" COEFFS 0 1 0 0 0 1 /end COMPU_METHOD
/begin MEASUREMENT P0026MALF "" UBYTE MC_P0026MALF 0 0 0 0 ECU_ADDRESS 0x3FA407 /end MEASUREMENT
/begin COMPU_METHOD MC_P0026MALF "P0026MALF conversion" RAT_FUNC "%3.0" "Unitless" COEFFS 0 1 0 0 0 1 /end COMPU_METHOD
/begin CHARACTERISTIC P0026SW "" VALUE 0x5D7CA SD_UBYTE 0 SC_P0026SW 0 1 /end CHARACTERISTIC
/begin COMPU_METHOD SC_P0026SW "P0026SW conversion" RAT_FUNC "%3.0" "unitless" COEFFS 0 1 0 0 0 1 /end COMPU_METHOD
/begin MEASUREMENT P0026UPDATE "" UBYTE MC_P0026UPDATE 0 0 0 0 ECU_ADDRESS 0x3FA406 /end MEASUREMENT
/begin COMPU_METHOD MC_P0026UPDATE "P0026UPDATE conversion" RAT_FUNC "%3.0" "Unitless" COEFFS 0 1 0 0 0 1 /end COMPU_METHOD
/begin MEASUREMENT P0046MALF "" UBYTE MC_P0046MALF 0 0 0 0 ECU_ADDRESS 0x3FA4B0 /end MEASUREMENT
/begin COMPU_METHOD MC_P0046MALF "P0046MALF conversion" RAT_FUNC "%3.0" "Unitless" COEFFS 0 1 0 0 0 1 /end COMPU_METHOD
/begin CHARACTERISTIC P0046SW "VGT fault record updation enable switch" VALUE 0x5D7C4 SD_UBYTE 0 SC_P0046SW 0 2 /end CHARACTERISTIC
/begin COMPU_METHOD SC_P0046SW "P0046SW conversion" RAT_FUNC "%3.0" "unitless" COEFFS 0 1 0 0 0 1 /end COMPU_METHOD
/begin MEASUREMENT P0046UPDATE "" UBYTE MC_P0046UPDATE 0 0 0 0 ECU_ADDRESS 0x3FA4B1 /end MEASUREMENT
/begin COMPU_METHOD MC_P0046UPDATE "P0046UPDATE conversion" RAT_FUNC "%3.0" "Unitless" COEFFS 0 1 0 0 0 1 /end COMPU_METHOD
/begin MEASUREMENT P0069MALF "OBD-II malfunction flag for altitude reference adder" UBYTE MC_P0069MALF 0 0 0 0 ECU_ADDRESS 0x3FA4EA /end MEASUREMENT
/begin COMPU_METHOD MC_P0069MALF "P0069MALF conversion" RAT_FUNC "%3.0" "Unitless" COEFFS 0 1 0 0 0 1 /end COMPU_METHOD
/begin CHARACTERISTIC P0069SW "0=cal_out; 1=non_mil; 2=mil" VALUE 0x5D785 SD_UBYTE 0 SC_P0069SW 0 255 /end CHARACTERISTIC
/begin COMPU_METHOD SC_P0069SW "P0069SW conversion" RAT_FUNC "%3.0" "Unitless" COEFFS 0 1 0 0 0 1 /end COMPU_METHOD
/begin MEASUREMENT P0069UPDATE "p0069 malf update indication flag" UBYTE MC_P0069UPDATE 0 0 0 0 ECU_ADDRESS 0x3FA4E9 /end MEASUREMENT
/begin COMPU_METHOD MC_P0069UPDATE "P0069UPDATE conversion" RAT_FUNC "%3.0" "Unitless" COEFFS 0 1 0 0 0 1 /end COMPU_METHOD
/begin MEASUREMENT P0096MALF "EO IAT/MAT rationale test result flag" UBYTE MC_P0096MALF 0 0 0 0 ECU_ADDRESS 0x3FA540 /end MEASUREMENT
/begin COMPU_METHOD MC_P0096MALF "P0096MALF conversion" RAT_FUNC "%3.0" "Unitless" COEFFS 0 1 0 0 0 1 /end COMPU_METHOD
/begin CHARACTERISTIC P0096SW "0=cal_out; 1=non_mil; 2=mil" VALUE 0x5D783 SD_UBYTE 0 SC_P0096SW 0 255 /end CHARACTERISTIC
/begin COMPU_METHOD SC_P0096SW "P0096SW conversion" RAT_FUNC "%3.0" "Unitless" COEFFS 0 1 0 0 0 1 /end COMPU_METHOD
/begin MEASUREMENT P0096UPDATE "EO IAT/MAT rationale test update flag" UBYTE MC_P0096UPDATE 0 0 0 0 ECU_ADDRESS 0x3FA53F /end MEASUREMENT
/begin COMPU_METHOD MC_P0096UPDATE "P0096UPDATE conversion" RAT_FUNC "%3.0" "Unitless" COEFFS 0 1 0 0 0 1 /end COMPU_METHOD
/begin MEASUREMENT P0097MALF "OBD II malfunction flag for mat below min. value" UBYTE MC_P0097MALF 0 0 0 0 ECU_ADDRESS 0x3FA219 /end MEASUREMENT
/begin COMPU_METHOD MC_P0097MALF "P0097MALF conversion" RAT_FUNC "%3.0" "Unitless" COEFFS 0 1 0 0 0 1 /end COMPU_METHOD
/begin CHARACTERISTIC P0097SW "MAT low  fault record updation enable switch" VALUE 0x5D788 SD_UBYTE 0 SC_P0097SW 0 2 /end CHARACTERISTIC
/begin COMPU_METHOD SC_P0097SW "P0097SW conversion" RAT_FUNC "%3.0" "unitless" COEFFS 0 1 0 0 0 1 /end COMPU_METHOD
/begin MEASUREMENT P0097UPDATE "p0097 malf update indication flag" UBYTE MC_P0097UPDATE 0 0 0 0 ECU_ADDRESS 0x3FA217 /end MEASUREMENT
/begin COMPU_METHOD MC_P0097UPDATE "P0097UPDATE conversion" RAT_FUNC "%3.0" "Unitless" COEFFS 0 1 0 0 0 1 /end COMPU_METHOD
/begin MEASUREMENT P0097UPD_CNTR "MAT low failure update - Counter" SLONG MC_P0097UPD_CNTR 0 0 0 0 ECU_ADDRESS 0x3FA1F4 /end MEASUREMENT
/begin COMPU_METHOD MC_P0097UPD_CNTR "P0097UPD_CNTR conversion" RAT_FUNC "%10.0" "Unitless" COEFFS 0 1 0 0 0 1 /end COMPU_METHOD
/begin MEASUREMENT P0098MALF "OBDII malfunction flag for MAT above max. Cal. value" UBYTE MC_P0098MALF 0 0 0 0 ECU_ADDRESS 0x3FA21A /end MEASUREMENT
/begin COMPU_METHOD MC_P0098MALF "P0098MALF conversion" RAT_FUNC "%3.0" "Unitless" COEFFS 0 1 0 0 0 1 /end COMPU_METHOD
/begin CHARACTERISTIC P0098SW "MAT high  fault record updation enable switch" VALUE 0x5D787 SD_UBYTE 0 SC_P0098SW 0 2 /end CHARACTERISTIC
/begin COMPU_METHOD SC_P0098SW "P0098SW conversion" RAT_FUNC "%3.0" "unitless" COEFFS 0 1 0 0 0 1 /end COMPU_METHOD
/begin MEASUREMENT P0098UPDATE "p0098 malf update indication flag" UBYTE MC_P0098UPDATE 0 0 0 0 ECU_ADDRESS 0x3FA218 /end MEASUREMENT
/begin COMPU_METHOD MC_P0098UPDATE "P0098UPDATE conversion" RAT_FUNC "%3.0" "Unitless" COEFFS 0 1 0 0 0 1 /end COMPU_METHOD
/begin MEASUREMENT P0098UPD_CNTR "MAT  high failure update - counter" SLONG MC_P0098UPD_CNTR 0 0 0 0 ECU_ADDRESS 0x3FA1F8 /end MEASUREMENT
/begin COMPU_METHOD MC_P0098UPD_CNTR "P0098UPD_CNTR conversion" RAT_FUNC "%10.0" "Unitless" COEFFS 0 1 0 0 0 1 /end COMPU_METHOD
/begin CHARACTERISTIC P0101SW "Calibratable switch for p-code" VALUE 0x5E868 SD_UBYTE 0 SC_P0101SW 0 255 /end CHARACTERISTIC
/begin COMPU_METHOD SC_P0101SW "P0101SW conversion" RAT_FUNC "%3.0" "unitless" COEFFS 0 1 0 0 0 1 /end COMPU_METHOD
/begin MEASUREMENT P0102MALF "OBDII malfunction flag for MAF input below minimum acceptable value" UBYTE MC_P0102MALF 0 0 0 0 ECU_ADDRESS 0x3FA15F /end MEASUREMENT
/begin COMPU_METHOD MC_P0102MALF "P0102MALF conversion" RAT_FUNC "%3.0" "Unitless" COEFFS 0 1 0 0 0 1 /end COMPU_METHOD
/begin CHARACTERISTIC P0102SW "0=cal_out; 1=non_mil; 2=mil" VALUE 0x5D78F SD_UBYTE 0 SC_P0102SW 0 255 /end CHARACTERISTIC
/begin COMPU_METHOD SC_P0102SW "P0102SW conversion" RAT_FUNC "%3.0" "Unitless" COEFFS 0 1 0 0 0 1 /end COMPU_METHOD
/begin MEASUREMENT P0102UPDATE "p0102 malf update indication flag" UBYTE MC_P0102UPDATE 0 0 0 0 ECU_ADDRESS 0x3FA15B /end MEASUREMENT
/begin COMPU_METHOD MC_P0102UPDATE "P0102UPDATE conversion" RAT_FUNC "%3.0" "Unitless" COEFFS 0 1 0 0 0 1 /end COMPU_METHOD
/begin MEASUREMENT P0102UPD_CNTR "MAF low failure update - Counter" SLONG MC_P0102UPD_CNTR 0 0 0 0 ECU_ADDRESS 0x3FA130 /end MEASUREMENT
/begin COMPU_METHOD MC_P0102UPD_CNTR "P0102UPD_CNTR conversion" RAT_FUNC "%10.0" "Unitless" COEFFS 0 1 0 0 0 1 /end COMPU_METHOD
/begin MEASUREMENT P0103MALF "OBDII malfunction flag for MAF input above maximum acceptable value" UBYTE MC_P0103MALF 0 0 0 0 ECU_ADDRESS 0x3FA160 /end MEASUREMENT
/begin COMPU_METHOD MC_P0103MALF "P0103MALF conversion" RAT_FUNC "%3.0" "Unitless" COEFFS 0 1 0 0 0 1 /end COMPU_METHOD
/begin CHARACTERISTIC P0103SW "0=cal_out; 1=non_mil; 2=mil" VALUE 0x5D78E SD_UBYTE 0 SC_P0103SW 0 255 /end CHARACTERISTIC
/begin COMPU_METHOD SC_P0103SW "P0103SW conversion" RAT_FUNC "%3.0" "Unitless" COEFFS 0 1 0 0 0 1 /end COMPU_METHOD
/begin MEASUREMENT P0103UPDATE "p0103 malf update indication flag" UBYTE MC_P0103UPDATE 0 0 0 0 ECU_ADDRESS 0x3FA15C /end MEASUREMENT
/begin COMPU_METHOD MC_P0103UPDATE "P0103UPDATE conversion" RAT_FUNC "%3.0" "Unitless" COEFFS 0 1 0 0 0 1 /end COMPU_METHOD
/begin MEASUREMENT P0103UPD_CNTR "MAF  high failure update - counter" SLONG MC_P0103UPD_CNTR 0 0 0 0 ECU_ADDRESS 0x3FA134 /end MEASUREMENT
/begin COMPU_METHOD MC_P0103UPD_CNTR "P0103UPD_CNTR conversion" RAT_FUNC "%10.0" "Unitless" COEFFS 0 1 0 0 0 1 /end COMPU_METHOD
/begin CHARACTERISTIC P0106SW "0=cal_out; 1=non_mil; 2=mil" VALUE 0x5E867 SD_UBYTE 0 SC_P0106SW 0 255 /end CHARACTERISTIC
/begin COMPU_METHOD SC_P0106SW "P0106SW conversion" RAT_FUNC "%3.0" "Unitless" COEFFS 0 1 0 0 0 1 /end COMPU_METHOD
/begin MEASUREMENT P0107MALF "OBD-II malfunction flag for BP low fault" UBYTE MC_P0107MALF 0 0 0 0 ECU_ADDRESS 0x3F9ECD /end MEASUREMENT
/begin COMPU_METHOD MC_P0107MALF "P0107MALF conversion" RAT_FUNC "%3.0" "Unitless" COEFFS 0 1 0 0 0 1 /end COMPU_METHOD
/begin CHARACTERISTIC P0107SW "0=cal_out; 1=non_mil; 2=mil" VALUE 0x5D7C1 SD_UBYTE 0 SC_P0107SW 0 255 /end CHARACTERISTIC
/begin COMPU_METHOD SC_P0107SW "P0107SW conversion" RAT_FUNC "%3.0" "Unitless" COEFFS 0 1 0 0 0 1 /end COMPU_METHOD
/begin MEASUREMENT P0107UPDATE "p0107 malf update indication flag" UBYTE MC_P0107UPDATE 0 0 0 0 ECU_ADDRESS 0x3F9ECB /end MEASUREMENT
/begin COMPU_METHOD MC_P0107UPDATE "P0107UPDATE conversion" RAT_FUNC "%3.0" "Unitless" COEFFS 0 1 0 0 0 1 /end COMPU_METHOD
/begin MEASUREMENT P0107UPD_CNTR "BP low failure update - Counter" SLONG MC_P0107UPD_CNTR 0 0 0 0 ECU_ADDRESS 0x3F9EAC /end MEASUREMENT
/begin COMPU_METHOD MC_P0107UPD_CNTR "P0107UPD_CNTR conversion" RAT_FUNC "%10.0" "Unitless" COEFFS 0 1 0 0 0 1 /end COMPU_METHOD
/begin MEASUREMENT P0108MALF "OBD-II malfunction flag for BP high fault" UBYTE MC_P0108MALF 0 0 0 0 ECU_ADDRESS 0x3F9ECE /end MEASUREMENT
/begin COMPU_METHOD MC_P0108MALF "P0108MALF conversion" RAT_FUNC "%3.0" "Unitless" COEFFS 0 1 0 0 0 1 /end COMPU_METHOD
/begin CHARACTERISTIC P0108SW "0=cal_out; 1=non_mil; 2=mil" VALUE 0x5D7C0 SD_UBYTE 0 SC_P0108SW 0 255 /end CHARACTERISTIC
/begin COMPU_METHOD SC_P0108SW "P0108SW conversion" RAT_FUNC "%3.0" "Unitless" COEFFS 0 1 0 0 0 1 /end COMPU_METHOD
/begin MEASUREMENT P0108UPDATE "p0108 malf update indication flag" UBYTE MC_P0108UPDATE 0 0 0 0 ECU_ADDRESS 0x3F9ECC /end MEASUREMENT
/begin COMPU_METHOD MC_P0108UPDATE "P0108UPDATE conversion" RAT_FUNC "%3.0" "Unitless" COEFFS 0 1 0 0 0 1 /end COMPU_METHOD
/begin MEASUREMENT P0108UPD_CNTR "BP high failure update - counter" SLONG MC_P0108UPD_CNTR 0 0 0 0 ECU_ADDRESS 0x3F9EB0 /end MEASUREMENT
/begin COMPU_METHOD MC_P0108UPD_CNTR "P0108UPD_CNTR conversion" RAT_FUNC "%10.0" "Unitless" COEFFS 0 1 0 0 0 1 /end COMPU_METHOD
/begin CHARACTERISTIC P0109SW "0=cal_out; 1=non_mil; 2=mil" VALUE 0x5CE51 SD_UBYTE 0 SC_P0109SW 0 255 /end CHARACTERISTIC
/begin COMPU_METHOD SC_P0109SW "P0109SW conversion" RAT_FUNC "%3.0" "Unitless" COEFFS 0 1 0 0 0 1 /end COMPU_METHOD
/begin CHARACTERISTIC P0111SW "0=cal_out; 1=non_mil; 2=mil" VALUE 0x5E866 SD_UBYTE 0 SC_P0111SW 0 255 /end CHARACTERISTIC
/begin COMPU_METHOD SC_P0111SW "P0111SW conversion" RAT_FUNC "%3.0" "Unitless" COEFFS 0 1 0 0 0 1 /end COMPU_METHOD
/begin MEASUREMENT P0112MALF "OBD II malfunction flag for IAT below min. value" UBYTE MC_P0112MALF 0 0 0 0 ECU_ADDRESS 0x3FA370 /end MEASUREMENT
/begin COMPU_METHOD MC_P0112MALF "P0112MALF conversion" RAT_FUNC "%3.0" "Unitless" COEFFS 0 1 0 0 0 1 /end COMPU_METHOD
/begin CHARACTERISTIC P0112SW "0=cal_out; 1=non_mil; 2=mil" VALUE 0x5D7C9 SD_UBYTE 0 SC_P0112SW 0 255 /end CHARACTERISTIC
/begin COMPU_METHOD SC_P0112SW "P0112SW conversion" RAT_FUNC "%3.0" "Unitless" COEFFS 0 1 0 0 0 1 /end COMPU_METHOD
/begin MEASUREMENT P0112UPDATE "p0112 malf update indication flag" UBYTE MC_P0112UPDATE 0 0 0 0 ECU_ADDRESS 0x3FA36C /end MEASUREMENT
/begin COMPU_METHOD MC_P0112UPDATE "P0112UPDATE conversion" RAT_FUNC "%3.0" "Unitless" COEFFS 0 1 0 0 0 1 /end COMPU_METHOD
/begin MEASUREMENT P0112UPD_CNTR "IAT low failure update - Counter" SLONG MC_P0112UPD_CNTR 0 0 0 0 ECU_ADDRESS 0x3FA34C /end MEASUREMENT
/begin COMPU_METHOD MC_P0112UPD_CNTR "P0112UPD_CNTR conversion" RAT_FUNC "%10.0" "Unitless" COEFFS 0 1 0 0 0 1 /end COMPU_METHOD
/begin MEASUREMENT P0113MALF "OBDII malfunction flag for IAT above max. Cal. value" UBYTE MC_P0113MALF 0 0 0 0 ECU_ADDRESS 0x3FA371 /end MEASUREMENT
/begin COMPU_METHOD MC_P0113MALF "P0113MALF conversion" RAT_FUNC "%3.0" "Unitless" COEFFS 0 1 0 0 0 1 /end COMPU_METHOD
/begin CHARACTERISTIC P0113SW "0=cal_out; 1=non_mil; 2=mil" VALUE 0x5D7C8 SD_UBYTE 0 SC_P0113SW 0 255 /end CHARACTERISTIC
/begin COMPU_METHOD SC_P0113SW "P0113SW conversion" RAT_FUNC "%3.0" "Unitless" COEFFS 0 1 0 0 0 1 /end COMPU_METHOD
/begin MEASUREMENT P0113UPDATE "p0113 malf update indication flag" UBYTE MC_P0113UPDATE 0 0 0 0 ECU_ADDRESS 0x3FA36D /end MEASUREMENT
/begin COMPU_METHOD MC_P0113UPDATE "P0113UPDATE conversion" RAT_FUNC "%3.0" "Unitless" COEFFS 0 1 0 0 0 1 /end COMPU_METHOD
/begin MEASUREMENT P0113UPD_CNTR "IAT high failure update - counter" SLONG MC_P0113UPD_CNTR 0 0 0 0 ECU_ADDRESS 0x3FA350 /end MEASUREMENT
/begin COMPU_METHOD MC_P0113UPD_CNTR "P0113UPD_CNTR conversion" RAT_FUNC "%10.0" "Unitless" COEFFS 0 1 0 0 0 1 /end COMPU_METHOD
/begin MEASUREMENT P0116MALF "Threshold monitor cold malfunction flag" UBYTE MC_P0116MALF 0 0 0 0 ECU_ADDRESS 0x3F9F8E /end MEASUREMENT
/begin COMPU_METHOD MC_P0116MALF "P0116MALF conversion" RAT_FUNC "%3.0" "Unitless" COEFFS 0 1 0 0 0 1 /end COMPU_METHOD
/begin CHARACTERISTIC P0116SW "0=cal_out; 1=non_mil; 2=mil" VALUE 0x5D7BA SD_UBYTE 0 SC_P0116SW 0 255 /end CHARACTERISTIC
/begin COMPU_METHOD SC_P0116SW "P0116SW conversion" RAT_FUNC "%3.0" "Unitless" COEFFS 0 1 0 0 0 1 /end COMPU_METHOD
/begin MEASUREMENT P0116UPDATE "threshold monitor cold updation flag" UBYTE MC_P0116UPDATE 0 0 0 0 ECU_ADDRESS 0x3F9F90 /end MEASUREMENT
/begin COMPU_METHOD MC_P0116UPDATE "P0116UPDATE conversion" RAT_FUNC "%3.0" "Unitless" COEFFS 0 1 0 0 0 1 /end COMPU_METHOD
/begin MEASUREMENT P0117MALF "OBDII malfunction flag for ect below the minimum cal value." UBYTE MC_P0117MALF 0 0 0 0 ECU_ADDRESS 0x3F9F99 /end MEASUREMENT
/begin COMPU_METHOD MC_P0117MALF "P0117MALF conversion" RAT_FUNC "%3.0" "Unitless" COEFFS 0 1 0 0 0 1 /end COMPU_METHOD
/begin CHARACTERISTIC P0117SW "0=cal_out; 1=non_mil; 2=mil" VALUE 0x5D7BC SD_UBYTE 0 SC_P0117SW 0 255 /end CHARACTERISTIC
/begin COMPU_METHOD SC_P0117SW "P0117SW conversion" RAT_FUNC "%3.0" "Unitless" COEFFS 0 1 0 0 0 1 /end COMPU_METHOD
/begin MEASUREMENT P0117UPDATE "p0117malf update flag." UBYTE MC_P0117UPDATE 0 0 0 0 ECU_ADDRESS 0x3F9F95 /end MEASUREMENT
/begin COMPU_METHOD MC_P0117UPDATE "P0117UPDATE conversion" RAT_FUNC "%3.0" "Unitless" COEFFS 0 1 0 0 0 1 /end COMPU_METHOD
/begin MEASUREMENT P0117UPD_CNTR "p0117 malf update counetr" SLONG MC_P0117UPD_CNTR 0 0 0 0 ECU_ADDRESS 0x3F9F70 /end MEASUREMENT
/begin COMPU_METHOD MC_P0117UPD_CNTR "P0117UPD_CNTR conversion" RAT_FUNC "%10.0" "Unitless" COEFFS 0 1 0 0 0 1 /end COMPU_METHOD
/begin MEASUREMENT P0118MALF "OBDII malfunction flag for ect above max calibration value" UBYTE MC_P0118MALF 0 0 0 0 ECU_ADDRESS 0x3F9F9A /end MEASUREMENT
/begin COMPU_METHOD MC_P0118MALF "P0118MALF conversion" RAT_FUNC "%3.0" "Unitless" COEFFS 0 1 0 0 0 1 /end COMPU_METHOD
/begin CHARACTERISTIC P0118SW "0=cal_out; 1=non_mil; 2=mil" VALUE 0x5D7BB SD_UBYTE 0 SC_P0118SW 0 255 /end CHARACTERISTIC
/begin COMPU_METHOD SC_P0118SW "P0118SW conversion" RAT_FUNC "%3.0" "Unitless" COEFFS 0 1 0 0 0 1 /end COMPU_METHOD
/begin MEASUREMENT P0118UPDATE "p0118 malfunction update  flag" UBYTE MC_P0118UPDATE 0 0 0 0 ECU_ADDRESS 0x3F9F96 /end MEASUREMENT
/begin COMPU_METHOD MC_P0118UPDATE "P0118UPDATE conversion" RAT_FUNC "%3.0" "Unitless" COEFFS 0 1 0 0 0 1 /end COMPU_METHOD
/begin MEASUREMENT P0118UPD_CNTR "ect high failure update counter" SLONG MC_P0118UPD_CNTR 0 0 0 0 ECU_ADDRESS 0x3F9F74 /end MEASUREMENT
/begin COMPU_METHOD MC_P0118UPD_CNTR "P0118UPD_CNTR conversion" RAT_FUNC "%10.0" "Unitless" COEFFS 0 1 0 0 0 1 /end COMPU_METHOD
/begin MEASUREMENT P0126MALF "Threshold monitor hot malfunction flag" UBYTE MC_P0126MALF 0 0 0 0 ECU_ADDRESS 0x3F9F8D /end MEASUREMENT
/begin COMPU_METHOD MC_P0126MALF "P0126MALF conversion" RAT_FUNC "%3.0" "Unitless" COEFFS 0 1 0 0 0 1 /end COMPU_METHOD
/begin CHARACTERISTIC P0126SW "0=cal_out; 1=non_mil; 2=mil" VALUE 0x5D7B9 SD_UBYTE 0 SC_P0126SW 0 255 /end CHARACTERISTIC
/begin COMPU_METHOD SC_P0126SW "P0126SW conversion" RAT_FUNC "%3.0" "Unitless" COEFFS 0 1 0 0 0 1 /end COMPU_METHOD
/begin MEASUREMENT P0126UPDATE "threshold monitor hot update flag" UBYTE MC_P0126UPDATE 0 0 0 0 ECU_ADDRESS 0x3F9F8F /end MEASUREMENT
/begin COMPU_METHOD MC_P0126UPDATE "P0126UPDATE conversion" RAT_FUNC "%3.0" "Unitless" COEFFS 0 1 0 0 0 1 /end COMPU_METHOD
/begin MEASUREMENT P0196MALF "threshold monitor cold malfunction flag" UBYTE MC_P0196MALF 0 0 0 0 ECU_ADDRESS 0x3F9F31 /end MEASUREMENT
/begin COMPU_METHOD MC_P0196MALF "P0196MALF conversion" RAT_FUNC "%3.0" "Unitless" COEFFS 0 1 0 0 0 1 /end COMPU_METHOD
/begin CHARACTERISTIC P0196SW "0=cal_out; 1=non_mil; 2=mil" VALUE 0x5D7B3 SD_UBYTE 0 SC_P0196SW 0 255 /end CHARACTERISTIC
/begin COMPU_METHOD SC_P0196SW "P0196SW conversion" RAT_FUNC "%3.0" "Unitless" COEFFS 0 1 0 0 0 1 /end COMPU_METHOD
/begin MEASUREMENT P0196UPDATE "threshold monitor update flag" UBYTE MC_P0196UPDATE 0 0 0 0 ECU_ADDRESS 0x3F9F33 /end MEASUREMENT
/begin COMPU_METHOD MC_P0196UPDATE "P0196UPDATE conversion" RAT_FUNC "%3.0" "Unitless" COEFFS 0 1 0 0 0 1 /end COMPU_METHOD
/begin MEASUREMENT P0197MALF "OBDII malfunction flag for eot below minimum cal value" UBYTE MC_P0197MALF 0 0 0 0 ECU_ADDRESS 0x3F9F3C /end MEASUREMENT
/begin COMPU_METHOD MC_P0197MALF "P0197MALF conversion" RAT_FUNC "%3.0" "Unitless" COEFFS 0 1 0 0 0 1 /end COMPU_METHOD
/begin CHARACTERISTIC P0197SW "0=cal_out; 1=non_mil; 2=mil" VALUE 0x5D7B5 SD_UBYTE 0 SC_P0197SW 0 255 /end CHARACTERISTIC
/begin COMPU_METHOD SC_P0197SW "P0197SW conversion" RAT_FUNC "%3.0" "Unitless" COEFFS 0 1 0 0 0 1 /end COMPU_METHOD
/begin MEASUREMENT P0197UPDATE "p0197 malf update flag" UBYTE MC_P0197UPDATE 0 0 0 0 ECU_ADDRESS 0x3F9F38 /end MEASUREMENT
/begin COMPU_METHOD MC_P0197UPDATE "P0197UPDATE conversion" RAT_FUNC "%3.0" "Unitless" COEFFS 0 1 0 0 0 1 /end COMPU_METHOD
/begin MEASUREMENT P0197UPD_CNTR "p0197 malf update counter" SLONG MC_P0197UPD_CNTR 0 0 0 0 ECU_ADDRESS 0x3F9F14 /end MEASUREMENT
/begin COMPU_METHOD MC_P0197UPD_CNTR "P0197UPD_CNTR conversion" RAT_FUNC "%10.0" "Unitless" COEFFS 0 1 0 0 0 1 /end COMPU_METHOD
/begin MEASUREMENT P0198MALF "OBDII malfunction flag for eot above maximum cal value" UBYTE MC_P0198MALF 0 0 0 0 ECU_ADDRESS 0x3F9F3D /end MEASUREMENT
/begin COMPU_METHOD MC_P0198MALF "P0198MALF conversion" RAT_FUNC "%3.0" "Unitless" COEFFS 0 1 0 0 0 1 /end COMPU_METHOD
/begin CHARACTERISTIC P0198SW "0=cal_out; 1=non_mil; 2=mil" VALUE 0x5D7B4 SD_UBYTE 0 SC_P0198SW 0 255 /end CHARACTERISTIC
/begin COMPU_METHOD SC_P0198SW "P0198SW conversion" RAT_FUNC "%3.0" "Unitless" COEFFS 0 1 0 0 0 1 /end COMPU_METHOD
/begin MEASUREMENT P0198UPDATE "p00198 malf update flag" UBYTE MC_P0198UPDATE 0 0 0 0 ECU_ADDRESS 0x3F9F39 /end MEASUREMENT
/begin COMPU_METHOD MC_P0198UPDATE "P0198UPDATE conversion" RAT_FUNC "%3.0" "Unitless" COEFFS 0 1 0 0 0 1 /end COMPU_METHOD
/begin MEASUREMENT P0198UPD_CNTR "eot high, failure update counter" SLONG MC_P0198UPD_CNTR 0 0 0 0 ECU_ADDRESS 0x3F9F18 /end MEASUREMENT
/begin COMPU_METHOD MC_P0198UPD_CNTR "P0198UPD_CNTR conversion" RAT_FUNC "%10.0" "Unitless" COEFFS 0 1 0 0 0 1 /end COMPU_METHOD
/begin MEASUREMENT P0219MALF "Engine overspeed malf flag" UBYTE MC_P0219MALF 0 0 0 0 ECU_ADDRESS 0x3FA119 /end MEASUREMENT
/begin COMPU_METHOD MC_P0219MALF "P0219MALF conversion" RAT_FUNC "%3.0" "Unitless" COEFFS 0 1 0 0 0 1 /end COMPU_METHOD
/begin CHARACTERISTIC P0219SW "0=cal_out; 1=non_mil; 2=mil" VALUE 0x5D786 SD_UBYTE 0 SC_P0219SW 0 255 /end CHARACTERISTIC
/begin COMPU_METHOD SC_P0219SW "P0219SW conversion" RAT_FUNC "%3.0" "Unitless" COEFFS 0 1 0 0 0 1 /end COMPU_METHOD
/begin MEASUREMENT P0219UPDATE "Engine overspeed malf update flag" UBYTE MC_P0219UPDATE 0 0 0 0 ECU_ADDRESS 0x3FA118 /end MEASUREMENT
/begin COMPU_METHOD MC_P0219UPDATE "P0219UPDATE conversion" RAT_FUNC "%3.0" "Unitless" COEFFS 0 1 0 0 0 1 /end COMPU_METHOD
/begin CHARACTERISTIC P0230FLT_LMX "timer delay limit for FP monitor p0230malf." VALUE 0x5EABC SD_FLOAT32_IEEE 0 SC_P0230FLT_LMX 0 5000 /end CHARACTERISTIC
/begin COMPU_METHOD SC_P0230FLT_LMX "P0230FLT_LMX conversion" RAT_FUNC "%10.5" "unitless" COEFFS 0 1 0 0 0 1 /end COMPU_METHOD
/begin MEASUREMENT P0230FLT_TMR "P0230malf timer." FLOAT32_IEEE MC_P0230FLT_TMR 0 0 0 0 ECU_ADDRESS 0x3FB1AC /end MEASUREMENT
/begin COMPU_METHOD MC_P0230FLT_TMR "P0230FLT_TMR conversion" RAT_FUNC "%10.5" "Unitless" COEFFS 0 1 0 0 0 1 /end COMPU_METHOD
/begin MEASUREMENT P0230MALF "P0230malf flag." UBYTE MC_P0230MALF 0 0 0 0 ECU_ADDRESS 0x3FB1B2 /end MEASUREMENT
/begin COMPU_METHOD MC_P0230MALF "P0230MALF conversion" RAT_FUNC "%3.0" "Unitless" COEFFS 0 1 0 0 0 1 /end COMPU_METHOD
/begin CHARACTERISTIC P0230SW "0=cal_out; 1=non_mil; 2=mil" VALUE 0x5EAD0 SD_UBYTE 0 SC_P0230SW 0 255 /end CHARACTERISTIC
/begin COMPU_METHOD SC_P0230SW "P0230SW conversion" RAT_FUNC "%3.0" "Unitless" COEFFS 0 1 0 0 0 1 /end COMPU_METHOD
/begin CHARACTERISTIC P0231FLT_LMX "timer delay limit for FP monitor p0231malf." VALUE 0x5EAB8 SD_FLOAT32_IEEE 0 SC_P0231FLT_LMX 0 5000 /end CHARACTERISTIC
/begin COMPU_METHOD SC_P0231FLT_LMX "P0231FLT_LMX conversion" RAT_FUNC "%10.5" "unitless" COEFFS 0 1 0 0 0 1 /end COMPU_METHOD
/begin MEASUREMENT P0231FLT_TMR "P0231malf timer." FLOAT32_IEEE MC_P0231FLT_TMR 0 0 0 0 ECU_ADDRESS 0x3FB1A8 /end MEASUREMENT
/begin COMPU_METHOD MC_P0231FLT_TMR "P0231FLT_TMR conversion" RAT_FUNC "%10.5" "Unitless" COEFFS 0 1 0 0 0 1 /end COMPU_METHOD
/begin MEASUREMENT P0231MALF "P0231malf flag." UBYTE MC_P0231MALF 0 0 0 0 ECU_ADDRESS 0x3FB1B1 /end MEASUREMENT
/begin COMPU_METHOD MC_P0231MALF "P0231MALF conversion" RAT_FUNC "%3.0" "Unitless" COEFFS 0 1 0 0 0 1 /end COMPU_METHOD
/begin CHARACTERISTIC P0231SW "0=cal_out; 1=non_mil; 2=mil" VALUE 0x5EACF SD_UBYTE 0 SC_P0231SW 0 255 /end CHARACTERISTIC
/begin COMPU_METHOD SC_P0231SW "P0231SW conversion" RAT_FUNC "%3.0" "Unitless" COEFFS 0 1 0 0 0 1 /end COMPU_METHOD
/begin CHARACTERISTIC P0232FLT_LMX "timer delay limit for FP monitor p0232malf." VALUE 0x5EAB4 SD_FLOAT32_IEEE 0 SC_P0232FLT_LMX 0 5000 /end CHARACTERISTIC
/begin COMPU_METHOD SC_P0232FLT_LMX "P0232FLT_LMX conversion" RAT_FUNC "%10.5" "unitless" COEFFS 0 1 0 0 0 1 /end COMPU_METHOD
/begin MEASUREMENT P0232FLT_TMR "P0232malf timer." FLOAT32_IEEE MC_P0232FLT_TMR 0 0 0 0 ECU_ADDRESS 0x3FB1A4 /end MEASUREMENT
/begin COMPU_METHOD MC_P0232FLT_TMR "P0232FLT_TMR conversion" RAT_FUNC "%10.5" "Unitless" COEFFS 0 1 0 0 0 1 /end COMPU_METHOD
/begin MEASUREMENT P0232MALF "P0232malf flag." UBYTE MC_P0232MALF 0 0 0 0 ECU_ADDRESS 0x3FB1B0 /end MEASUREMENT
/begin COMPU_METHOD MC_P0232MALF "P0232MALF conversion" RAT_FUNC "%3.0" "Unitless" COEFFS 0 1 0 0 0 1 /end COMPU_METHOD
/begin CHARACTERISTIC P0232SW "0=cal_out; 1=non_mil; 2=mil" VALUE 0x5EACE SD_UBYTE 0 SC_P0232SW 0 255 /end CHARACTERISTIC
/begin COMPU_METHOD SC_P0232SW "P0232SW conversion" RAT_FUNC "%3.0" "Unitless" COEFFS 0 1 0 0 0 1 /end COMPU_METHOD
/begin MEASUREMENT P0236MALF "In-Range MAP Fault flag" UBYTE MC_P0236MALF 0 0 0 0 ECU_ADDRESS 0x3FA1E4 /end MEASUREMENT
/begin COMPU_METHOD MC_P0236MALF "P0236MALF conversion" RAT_FUNC "%3.0" "Unitless" COEFFS 0 1 0 0 0 1 /end COMPU_METHOD
/begin CHARACTERISTIC P0236SW "0=cal_out; 1=non_mil; 2=mil" VALUE 0x5D789 SD_UBYTE 0 SC_P0236SW 0 255 /end CHARACTERISTIC
/begin COMPU_METHOD SC_P0236SW "P0236SW conversion" RAT_FUNC "%3.0" "Unitless" COEFFS 0 1 0 0 0 1 /end COMPU_METHOD
/begin MEASUREMENT P0236UPDATE "p0236 malf update indication flag" UBYTE MC_P0236UPDATE 0 0 0 0 ECU_ADDRESS 0x3FA1E1 /end MEASUREMENT
/begin COMPU_METHOD MC_P0236UPDATE "P0236UPDATE conversion" RAT_FUNC "%3.0" "Unitless" COEFFS 0 1 0 0 0 1 /end COMPU_METHOD
/begin MEASUREMENT P0237MALF "OBDII malfunction flag for MAP input below minimum acceptable value" UBYTE MC_P0237MALF 0 0 0 0 ECU_ADDRESS 0x3FA1EC /end MEASUREMENT
/begin COMPU_METHOD MC_P0237MALF "P0237MALF conversion" RAT_FUNC "%3.0" "Unitless" COEFFS 0 1 0 0 0 1 /end COMPU_METHOD
/begin CHARACTERISTIC P0237SW "0=cal_out; 1=non_mil; 2=mil" VALUE 0x5D78D SD_UBYTE 0 SC_P0237SW 0 255 /end CHARACTERISTIC
/begin COMPU_METHOD SC_P0237SW "P0237SW conversion" RAT_FUNC "%3.0" "Unitless" COEFFS 0 1 0 0 0 1 /end COMPU_METHOD
/begin MEASUREMENT P0237UPDATE "p0237 malf update indication flag" UBYTE MC_P0237UPDATE 0 0 0 0 ECU_ADDRESS 0x3FA1E8 /end MEASUREMENT
/begin COMPU_METHOD MC_P0237UPDATE "P0237UPDATE conversion" RAT_FUNC "%3.0" "Unitless" COEFFS 0 1 0 0 0 1 /end COMPU_METHOD
/begin MEASUREMENT P0237UPD_CNTR "MAP Sensor low failure update - Counter" SLONG MC_P0237UPD_CNTR 0 0 0 0 ECU_ADDRESS 0x3FA1BC /end MEASUREMENT
/begin COMPU_METHOD MC_P0237UPD_CNTR "P0237UPD_CNTR conversion" RAT_FUNC "%10.0" "Unitless" COEFFS 0 1 0 0 0 1 /end COMPU_METHOD
/begin MEASUREMENT P0238MALF "OBDII malfunction flag for MAP input above maximum acceptable value" UBYTE MC_P0238MALF 0 0 0 0 ECU_ADDRESS 0x3FA1ED /end MEASUREMENT
/begin COMPU_METHOD MC_P0238MALF "P0238MALF conversion" RAT_FUNC "%3.0" "Unitless" COEFFS 0 1 0 0 0 1 /end COMPU_METHOD
/begin CHARACTERISTIC P0238SW "0=cal_out; 1=non_mil; 2=mil" VALUE 0x5D78C SD_UBYTE 0 SC_P0238SW 0 255 /end CHARACTERISTIC
/begin COMPU_METHOD SC_P0238SW "P0238SW conversion" RAT_FUNC "%3.0" "Unitless" COEFFS 0 1 0 0 0 1 /end COMPU_METHOD
/begin MEASUREMENT P0238UPDATE "p0238 malf update indication flag" UBYTE MC_P0238UPDATE 0 0 0 0 ECU_ADDRESS 0x3FA1E9 /end MEASUREMENT
/begin COMPU_METHOD MC_P0238UPDATE "P0238UPDATE conversion" RAT_FUNC "%3.0" "Unitless" COEFFS 0 1 0 0 0 1 /end COMPU_METHOD
/begin MEASUREMENT P0238UPD_CNTR "MAP Sensor  high failure update - counter" SLONG MC_P0238UPD_CNTR 0 0 0 0 ECU_ADDRESS 0x3FA1C0 /end MEASUREMENT
/begin COMPU_METHOD MC_P0238UPD_CNTR "P0238UPD_CNTR conversion" RAT_FUNC "%10.0" "Unitless" COEFFS 0 1 0 0 0 1 /end COMPU_METHOD
/begin MEASUREMENT P0261MALF "Injector 1 coil open fault status" UBYTE MC_P0261MALF 0 0 0 0 ECU_ADDRESS 0x3FA634 /end MEASUREMENT
/begin COMPU_METHOD MC_P0261MALF "P0261MALF conversion" RAT_FUNC "%3.0" "Unitless" COEFFS 0 1 0 0 0 1 /end COMPU_METHOD
/begin CHARACTERISTIC P0261SW "Injector 1 coil open fault status  malf fault record updation enable switch" VALUE 0x5D7A7 SD_UBYTE 0 SC_P0261SW 0 255 /end CHARACTERISTIC
/begin COMPU_METHOD SC_P0261SW "P0261SW conversion" RAT_FUNC "%3.0" "unitless" COEFFS 0 1 0 0 0 1 /end COMPU_METHOD
/begin MEASUREMENT P0261UPDATE "Injector 1 coil open malf update status flag" UBYTE MC_P0261UPDATE 0 0 0 0 ECU_ADDRESS 0x3FA61C /end MEASUREMENT
/begin COMPU_METHOD MC_P0261UPDATE "P0261UPDATE conversion" RAT_FUNC "%3.0" "Unitless" COEFFS 0 1 0 0 0 1 /end COMPU_METHOD
/begin MEASUREMENT P0262MALF "Injector 1 coil short and side short fault status" UBYTE MC_P0262MALF 0 0 0 0 ECU_ADDRESS 0x3FA633 /end MEASUREMENT
/begin COMPU_METHOD MC_P0262MALF "P0262MALF conversion" RAT_FUNC "%3.0" "Unitless" COEFFS 0 1 0 0 0 1 /end COMPU_METHOD
/begin CHARACTERISTIC P0262SW "Injector 1 coil short and side short fault status  malf fault record updation enable switch" VALUE 0x5D7A6 SD_UBYTE 0 SC_P0262SW 0 255 /end CHARACTERISTIC
/begin COMPU_METHOD SC_P0262SW "P0262SW conversion" RAT_FUNC "%3.0" "unitless" COEFFS 0 1 0 0 0 1 /end COMPU_METHOD
/begin MEASUREMENT P0262UPDATE "Injector 1 coil short and side short  malf update status flag" UBYTE MC_P0262UPDATE 0 0 0 0 ECU_ADDRESS 0x3FA61B /end MEASUREMENT
/begin COMPU_METHOD MC_P0262UPDATE "P0262UPDATE conversion" RAT_FUNC "%3.0" "Unitless" COEFFS 0 1 0 0 0 1 /end COMPU_METHOD
/begin MEASUREMENT P0263MALF "Injector 1 cylinder balance,  malf" UBYTE MC_P0263MALF 0 0 0 0 ECU_ADDRESS 0x3FA624 /end MEASUREMENT
/begin COMPU_METHOD MC_P0263MALF "P0263MALF conversion" RAT_FUNC "%3.0" "Unitless" COEFFS 0 1 0 0 0 1 /end COMPU_METHOD
/begin CHARACTERISTIC P0263SW "Injector 1 cylinder balance  fault status  malf fault record updation enable switch" VALUE 0x5D77E SD_UBYTE 0 SC_P0263SW 0 255 /end CHARACTERISTIC
/begin COMPU_METHOD SC_P0263SW "P0263SW conversion" RAT_FUNC "%3.0" "unitless" COEFFS 0 1 0 0 0 1 /end COMPU_METHOD
/begin MEASUREMENT P0263UPDATE "Injector 1 cylinder balance  fault malf update status flag" UBYTE MC_P0263UPDATE 0 0 0 0 ECU_ADDRESS 0x3FA60C /end MEASUREMENT
/begin COMPU_METHOD MC_P0263UPDATE "P0263UPDATE conversion" RAT_FUNC "%3.0" "Unitless" COEFFS 0 1 0 0 0 1 /end COMPU_METHOD
/begin MEASUREMENT P0264MALF "Injector 2 coil open fault status" UBYTE MC_P0264MALF 0 0 0 0 ECU_ADDRESS 0x3FA632 /end MEASUREMENT
/begin COMPU_METHOD MC_P0264MALF "P0264MALF conversion" RAT_FUNC "%3.0" "Unitless" COEFFS 0 1 0 0 0 1 /end COMPU_METHOD
/begin CHARACTERISTIC P0264SW "Injector 2 coil open fault status  malf fault record updation enable switch" VALUE 0x5D7A5 SD_UBYTE 0 SC_P0264SW 0 255 /end CHARACTERISTIC
/begin COMPU_METHOD SC_P0264SW "P0264SW conversion" RAT_FUNC "%3.0" "unitless" COEFFS 0 1 0 0 0 1 /end COMPU_METHOD
/begin MEASUREMENT P0264UPDATE "Injector 2 coil open malf update status flag" UBYTE MC_P0264UPDATE 0 0 0 0 ECU_ADDRESS 0x3FA61A /end MEASUREMENT
/begin COMPU_METHOD MC_P0264UPDATE "P0264UPDATE conversion" RAT_FUNC "%3.0" "Unitless" COEFFS 0 1 0 0 0 1 /end COMPU_METHOD
/begin MEASUREMENT P0265MALF "Injector 2 coil short and side short fault status" UBYTE MC_P0265MALF 0 0 0 0 ECU_ADDRESS 0x3FA631 /end MEASUREMENT
/begin COMPU_METHOD MC_P0265MALF "P0265MALF conversion" RAT_FUNC "%3.0" "Unitless" COEFFS 0 1 0 0 0 1 /end COMPU_METHOD
/begin CHARACTERISTIC P0265SW "Injector 2 coil short and side short fault status  malf fault record updation enable switch" VALUE 0x5D7A4 SD_UBYTE 0 SC_P0265SW 0 255 /end CHARACTERISTIC
/begin COMPU_METHOD SC_P0265SW "P0265SW conversion" RAT_FUNC "%3.0" "unitless" COEFFS 0 1 0 0 0 1 /end COMPU_METHOD
/begin MEASUREMENT P0265UPDATE "Injector 2 coil short and side short  malf update status flag" UBYTE MC_P0265UPDATE 0 0 0 0 ECU_ADDRESS 0x3FA619 /end MEASUREMENT
/begin COMPU_METHOD MC_P0265UPDATE "P0265UPDATE conversion" RAT_FUNC "%3.0" "Unitless" COEFFS 0 1 0 0 0 1 /end COMPU_METHOD
/begin MEASUREMENT P0266MALF "Injector 2 cylinder balance,  malf" UBYTE MC_P0266MALF 0 0 0 0 ECU_ADDRESS 0x3FA623 /end MEASUREMENT
/begin COMPU_METHOD MC_P0266MALF "P0266MALF conversion" RAT_FUNC "%3.0" "Unitless" COEFFS 0 1 0 0 0 1 /end COMPU_METHOD
/begin CHARACTERISTIC P0266SW "Injector 2 cylinder balance  fault status  malf fault record updation enable switch" VALUE 0x5D77D SD_UBYTE 0 SC_P0266SW 0 255 /end CHARACTERISTIC
/begin COMPU_METHOD SC_P0266SW "P0266SW conversion" RAT_FUNC "%3.0" "unitless" COEFFS 0 1 0 0 0 1 /end COMPU_METHOD
/begin MEASUREMENT P0266UPDATE "Injector 2 cylinder balance fault malf update status flag" UBYTE MC_P0266UPDATE 0 0 0 0 ECU_ADDRESS 0x3FA60B /end MEASUREMENT
/begin COMPU_METHOD MC_P0266UPDATE "P0266UPDATE conversion" RAT_FUNC "%3.0" "Unitless" COEFFS 0 1 0 0 0 1 /end COMPU_METHOD
/begin MEASUREMENT P0267MALF "Injector 3 coil open fault status" UBYTE MC_P0267MALF 0 0 0 0 ECU_ADDRESS 0x3FA630 /end MEASUREMENT
/begin COMPU_METHOD MC_P0267MALF "P0267MALF conversion" RAT_FUNC "%3.0" "Unitless" COEFFS 0 1 0 0 0 1 /end COMPU_METHOD
/begin CHARACTERISTIC P0267SW "Injector 3 coil open fault status  malf fault record updation enable switch" VALUE 0x5D7A3 SD_UBYTE 0 SC_P0267SW 0 255 /end CHARACTERISTIC
/begin COMPU_METHOD SC_P0267SW "P0267SW conversion" RAT_FUNC "%3.0" "unitless" COEFFS 0 1 0 0 0 1 /end COMPU_METHOD
/begin MEASUREMENT P0267UPDATE "Injector 3 coil open malf update status flag" UBYTE MC_P0267UPDATE 0 0 0 0 ECU_ADDRESS 0x3FA618 /end MEASUREMENT
/begin COMPU_METHOD MC_P0267UPDATE "P0267UPDATE conversion" RAT_FUNC "%3.0" "Unitless" COEFFS 0 1 0 0 0 1 /end COMPU_METHOD
/begin MEASUREMENT P0268MALF "Injector 3 coil short and side short fault status" UBYTE MC_P0268MALF 0 0 0 0 ECU_ADDRESS 0x3FA62F /end MEASUREMENT
/begin COMPU_METHOD MC_P0268MALF "P0268MALF conversion" RAT_FUNC "%3.0" "Unitless" COEFFS 0 1 0 0 0 1 /end COMPU_METHOD
/begin CHARACTERISTIC P0268SW "Injector 3 coil short and side short fault status  malf fault record updation enable switch" VALUE 0x5D7A2 SD_UBYTE 0 SC_P0268SW 0 255 /end CHARACTERISTIC
/begin COMPU_METHOD SC_P0268SW "P0268SW conversion" RAT_FUNC "%3.0" "unitless" COEFFS 0 1 0 0 0 1 /end COMPU_METHOD
/begin MEASUREMENT P0268UPDATE "Injector 3 coil short and side short  malf update status flag" UBYTE MC_P0268UPDATE 0 0 0 0 ECU_ADDRESS 0x3FA617 /end MEASUREMENT
/begin COMPU_METHOD MC_P0268UPDATE "P0268UPDATE conversion" RAT_FUNC "%3.0" "Unitless" COEFFS 0 1 0 0 0 1 /end COMPU_METHOD
/begin MEASUREMENT P0269MALF "Injector 3 cylinder balance,  malf" UBYTE MC_P0269MALF 0 0 0 0 ECU_ADDRESS 0x3FA622 /end MEASUREMENT
/begin COMPU_METHOD MC_P0269MALF "P0269MALF conversion" RAT_FUNC "%3.0" "Unitless" COEFFS 0 1 0 0 0 1 /end COMPU_METHOD
/begin CHARACTERISTIC P0269SW "Injector 3 cylinder balance  fault status  malf fault record updation enable switch" VALUE 0x5D77C SD_UBYTE 0 SC_P0269SW 0 255 /end CHARACTERISTIC
/begin COMPU_METHOD SC_P0269SW "P0269SW conversion" RAT_FUNC "%3.0" "unitless" COEFFS 0 1 0 0 0 1 /end COMPU_METHOD
/begin MEASUREMENT P0269UPDATE "Injector 3 cylinder balance  fault malf update status flag" UBYTE MC_P0269UPDATE 0 0 0 0 ECU_ADDRESS 0x3FA60A /end MEASUREMENT
/begin COMPU_METHOD MC_P0269UPDATE "P0269UPDATE conversion" RAT_FUNC "%3.0" "Unitless" COEFFS 0 1 0 0 0 1 /end COMPU_METHOD
/begin MEASUREMENT P0270MALF "Injector 4 coil open fault status" UBYTE MC_P0270MALF 0 0 0 0 ECU_ADDRESS 0x3FA62E /end MEASUREMENT
/begin COMPU_METHOD MC_P0270MALF "P0270MALF conversion" RAT_FUNC "%3.0" "Unitless" COEFFS 0 1 0 0 0 1 /end COMPU_METHOD
/begin CHARACTERISTIC P0270SW "Injector 4 coil open fault status  malf fault record updation enable switch" VALUE 0x5D7A1 SD_UBYTE 0 SC_P0270SW 0 255 /end CHARACTERISTIC
/begin COMPU_METHOD SC_P0270SW "P0270SW conversion" RAT_FUNC "%3.0" "unitless" COEFFS 0 1 0 0 0 1 /end COMPU_METHOD
/begin MEASUREMENT P0270UPDATE "Injector 4 coil open malf update status flag" UBYTE MC_P0270UPDATE 0 0 0 0 ECU_ADDRESS 0x3FA616 /end MEASUREMENT
/begin COMPU_METHOD MC_P0270UPDATE "P0270UPDATE conversion" RAT_FUNC "%3.0" "Unitless" COEFFS 0 1 0 0 0 1 /end COMPU_METHOD
/begin MEASUREMENT P0271MALF "Injector 4 coil short and side short fault status" UBYTE MC_P0271MALF 0 0 0 0 ECU_ADDRESS 0x3FA62D /end MEASUREMENT
/begin COMPU_METHOD MC_P0271MALF "P0271MALF conversion" RAT_FUNC "%3.0" "Unitless" COEFFS 0 1 0 0 0 1 /end COMPU_METHOD
/begin CHARACTERISTIC P0271SW "Injector 4 coil short and side short fault status  malf fault record updation enable switch" VALUE 0x5D7A0 SD_UBYTE 0 SC_P0271SW 0 255 /end CHARACTERISTIC
/begin COMPU_METHOD SC_P0271SW "P0271SW conversion" RAT_FUNC "%3.0" "unitless" COEFFS 0 1 0 0 0 1 /end COMPU_METHOD
/begin MEASUREMENT P0271UPDATE "Injector 4 coil short and side short  malf update status flag" UBYTE MC_P0271UPDATE 0 0 0 0 ECU_ADDRESS 0x3FA615 /end MEASUREMENT
/begin COMPU_METHOD MC_P0271UPDATE "P0271UPDATE conversion" RAT_FUNC "%3.0" "Unitless" COEFFS 0 1 0 0 0 1 /end COMPU_METHOD
/begin MEASUREMENT P0272MALF "Injector 4 cylinder balance,  malf" UBYTE MC_P0272MALF 0 0 0 0 ECU_ADDRESS 0x3FA621 /end MEASUREMENT
/begin COMPU_METHOD MC_P0272MALF "P0272MALF conversion" RAT_FUNC "%3.0" "Unitless" COEFFS 0 1 0 0 0 1 /end COMPU_METHOD
/begin CHARACTERISTIC P0272SW "Injector 4 cylinder balance  fault status  malf fault record updation enable switch" VALUE 0x5D77B SD_UBYTE 0 SC_P0272SW 0 255 /end CHARACTERISTIC
/begin COMPU_METHOD SC_P0272SW "P0272SW conversion" RAT_FUNC "%3.0" "unitless" COEFFS 0 1 0 0 0 1 /end COMPU_METHOD
/begin MEASUREMENT P0272UPDATE "Injector 4 cylinder balance  fault malf update status flag" UBYTE MC_P0272UPDATE 0 0 0 0 ECU_ADDRESS 0x3FA609 /end MEASUREMENT
/begin COMPU_METHOD MC_P0272UPDATE "P0272UPDATE conversion" RAT_FUNC "%3.0" "Unitless" COEFFS 0 1 0 0 0 1 /end COMPU_METHOD
/begin MEASUREMENT P0273MALF "Injector 5 coil open fault status" UBYTE MC_P0273MALF 0 0 0 0 ECU_ADDRESS 0x3FA62C /end MEASUREMENT
/begin COMPU_METHOD MC_P0273MALF "P0273MALF conversion" RAT_FUNC "%3.0" "Unitless" COEFFS 0 1 0 0 0 1 /end COMPU_METHOD
/begin CHARACTERISTIC P0273SW "Injector 5 coil open fault status  malf fault record updation enable switch" VALUE 0x5D79F SD_UBYTE 0 SC_P0273SW 0 255 /end CHARACTERISTIC
/begin COMPU_METHOD SC_P0273SW "P0273SW conversion" RAT_FUNC "%3.0" "unitless" COEFFS 0 1 0 0 0 1 /end COMPU_METHOD
/begin MEASUREMENT P0273UPDATE "Injector 5 coil open malf update status flag" UBYTE MC_P0273UPDATE 0 0 0 0 ECU_ADDRESS 0x3FA614 /end MEASUREMENT
/begin COMPU_METHOD MC_P0273UPDATE "P0273UPDATE conversion" RAT_FUNC "%3.0" "Unitless" COEFFS 0 1 0 0 0 1 /end COMPU_METHOD
/begin MEASUREMENT P0274MALF "Injector 5 coil short and side short fault status" UBYTE MC_P0274MALF 0 0 0 0 ECU_ADDRESS 0x3FA62B /end MEASUREMENT
/begin COMPU_METHOD MC_P0274MALF "P0274MALF conversion" RAT_FUNC "%3.0" "Unitless" COEFFS 0 1 0 0 0 1 /end COMPU_METHOD
/begin CHARACTERISTIC P0274SW "Injector 5 coil short and side short fault status  malf fault record updation enable switch" VALUE 0x5D79E SD_UBYTE 0 SC_P0274SW 0 255 /end CHARACTERISTIC
/begin COMPU_METHOD SC_P0274SW "P0274SW conversion" RAT_FUNC "%3.0" "unitless" COEFFS 0 1 0 0 0 1 /end COMPU_METHOD
/begin MEASUREMENT P0274UPDATE "Injector 5 coil short and side short  malf update status flag" UBYTE MC_P0274UPDATE 0 0 0 0 ECU_ADDRESS 0x3FA613 /end MEASUREMENT
/begin COMPU_METHOD MC_P0274UPDATE "P0274UPDATE conversion" RAT_FUNC "%3.0" "Unitless" COEFFS 0 1 0 0 0 1 /end COMPU_METHOD
/begin MEASUREMENT P0275MALF "Injector 5 cylinder balance,  malf" UBYTE MC_P0275MALF 0 0 0 0 ECU_ADDRESS 0x3FA620 /end MEASUREMENT
/begin COMPU_METHOD MC_P0275MALF "P0275MALF conversion" RAT_FUNC "%3.0" "Unitless" COEFFS 0 1 0 0 0 1 /end COMPU_METHOD
/begin CHARACTERISTIC P0275SW "Injector 5 cylinder balance  fault status  malf fault record updation enable switch" VALUE 0x5D77A SD_UBYTE 0 SC_P0275SW 0 255 /end CHARACTERISTIC
/begin COMPU_METHOD SC_P0275SW "P0275SW conversion" RAT_FUNC "%3.0" "unitless" COEFFS 0 1 0 0 0 1 /end COMPU_METHOD
/begin MEASUREMENT P0275UPDATE "Injector 5 cylinder balance  fault malf update status flag" UBYTE MC_P0275UPDATE 0 0 0 0 ECU_ADDRESS 0x3FA608 /end MEASUREMENT
/begin COMPU_METHOD MC_P0275UPDATE "P0275UPDATE conversion" RAT_FUNC "%3.0" "Unitless" COEFFS 0 1 0 0 0 1 /end COMPU_METHOD
/begin MEASUREMENT P0276MALF "Injector 6 coil open fault status" UBYTE MC_P0276MALF 0 0 0 0 ECU_ADDRESS 0x3FA62A /end MEASUREMENT
/begin COMPU_METHOD MC_P0276MALF "P0276MALF conversion" RAT_FUNC "%3.0" "Unitless" COEFFS 0 1 0 0 0 1 /end COMPU_METHOD
/begin CHARACTERISTIC P0276SW "Injector 6 coil open fault status  malf fault record updation enable switch" VALUE 0x5D79D SD_UBYTE 0 SC_P0276SW 0 255 /end CHARACTERISTIC
/begin COMPU_METHOD SC_P0276SW "P0276SW conversion" RAT_FUNC "%3.0" "unitless" COEFFS 0 1 0 0 0 1 /end COMPU_METHOD
/begin MEASUREMENT P0276UPDATE "Injector 6 coil open malf update status flag" UBYTE MC_P0276UPDATE 0 0 0 0 ECU_ADDRESS 0x3FA612 /end MEASUREMENT
/begin COMPU_METHOD MC_P0276UPDATE "P0276UPDATE conversion" RAT_FUNC "%3.0" "Unitless" COEFFS 0 1 0 0 0 1 /end COMPU_METHOD
/begin MEASUREMENT P0277MALF "Injector 6 coil short and side short fault status" UBYTE MC_P0277MALF 0 0 0 0 ECU_ADDRESS 0x3FA629 /end MEASUREMENT
/begin COMPU_METHOD MC_P0277MALF "P0277MALF conversion" RAT_FUNC "%3.0" "Unitless" COEFFS 0 1 0 0 0 1 /end COMPU_METHOD
/begin CHARACTERISTIC P0277SW "Injector 6 coil short and side short fault status  malf fault record updation enable switch" VALUE 0x5D79C SD_UBYTE 0 SC_P0277SW 0 255 /end CHARACTERISTIC
/begin COMPU_METHOD SC_P0277SW "P0277SW conversion" RAT_FUNC "%3.0" "unitless" COEFFS 0 1 0 0 0 1 /end COMPU_METHOD
/begin MEASUREMENT P0277UPDATE "Injector 6 coil short and side short  malf update status flag" UBYTE MC_P0277UPDATE 0 0 0 0 ECU_ADDRESS 0x3FA611 /end MEASUREMENT
/begin COMPU_METHOD MC_P0277UPDATE "P0277UPDATE conversion" RAT_FUNC "%3.0" "Unitless" COEFFS 0 1 0 0 0 1 /end COMPU_METHOD
/begin MEASUREMENT P0278MALF "Injector 6 cylinder balance,  malf" UBYTE MC_P0278MALF 0 0 0 0 ECU_ADDRESS 0x3FA61F /end MEASUREMENT
/begin COMPU_METHOD MC_P0278MALF "P0278MALF conversion" RAT_FUNC "%3.0" "Unitless" COEFFS 0 1 0 0 0 1 /end COMPU_METHOD
/begin CHARACTERISTIC P0278SW "Injector 6 cylinder balance  fault status  malf fault record updation enable switch" VALUE 0x5D779 SD_UBYTE 0 SC_P0278SW 0 255 /end CHARACTERISTIC
/begin COMPU_METHOD SC_P0278SW "P0278SW conversion" RAT_FUNC "%3.0" "unitless" COEFFS 0 1 0 0 0 1 /end COMPU_METHOD
/begin MEASUREMENT P0278UPDATE "Injector 6 cylinder balance  fault malf update status flag" UBYTE MC_P0278UPDATE 0 0 0 0 ECU_ADDRESS 0x3FA607 /end MEASUREMENT
/begin COMPU_METHOD MC_P0278UPDATE "P0278UPDATE conversion" RAT_FUNC "%3.0" "Unitless" COEFFS 0 1 0 0 0 1 /end COMPU_METHOD
/begin MEASUREMENT P0279MALF "Injector 7 coil open fault status" UBYTE MC_P0279MALF 0 0 0 0 ECU_ADDRESS 0x3FA628 /end MEASUREMENT
/begin COMPU_METHOD MC_P0279MALF "P0279MALF conversion" RAT_FUNC "%3.0" "Unitless" COEFFS 0 1 0 0 0 1 /end COMPU_METHOD
/begin CHARACTERISTIC P0279SW "Injector 7 coil open fault status  malf fault record updation enable switch" VALUE 0x5D79B SD_UBYTE 0 SC_P0279SW 0 255 /end CHARACTERISTIC
/begin COMPU_METHOD SC_P0279SW "P0279SW conversion" RAT_FUNC "%3.0" "unitless" COEFFS 0 1 0 0 0 1 /end COMPU_METHOD
/begin MEASUREMENT P0279UPDATE "Injector 7 coil open malf update status flag" UBYTE MC_P0279UPDATE 0 0 0 0 ECU_ADDRESS 0x3FA610 /end MEASUREMENT
/begin COMPU_METHOD MC_P0279UPDATE "P0279UPDATE conversion" RAT_FUNC "%3.0" "Unitless" COEFFS 0 1 0 0 0 1 /end COMPU_METHOD
/begin MEASUREMENT P0280MALF "Injector 7 coil short and side short fault status" UBYTE MC_P0280MALF 0 0 0 0 ECU_ADDRESS 0x3FA627 /end MEASUREMENT
/begin COMPU_METHOD MC_P0280MALF "P0280MALF conversion" RAT_FUNC "%3.0" "Unitless" COEFFS 0 1 0 0 0 1 /end COMPU_METHOD
/begin CHARACTERISTIC P0280SW "Injector 7 coil short and side short fault status  malf fault record updation enable switch" VALUE 0x5D79A SD_UBYTE 0 SC_P0280SW 0 255 /end CHARACTERISTIC
/begin COMPU_METHOD SC_P0280SW "P0280SW conversion" RAT_FUNC "%3.0" "unitless" COEFFS 0 1 0 0 0 1 /end COMPU_METHOD
/begin MEASUREMENT P0280UPDATE "Injector 7 coil short and side short  malf update status flag" UBYTE MC_P0280UPDATE 0 0 0 0 ECU_ADDRESS 0x3FA60F /end MEASUREMENT
/begin COMPU_METHOD MC_P0280UPDATE "P0280UPDATE conversion" RAT_FUNC "%3.0" "Unitless" COEFFS 0 1 0 0 0 1 /end COMPU_METHOD
/begin MEASUREMENT P0281MALF "Injector 7 cylinder balance,  malf" UBYTE MC_P0281MALF 0 0 0 0 ECU_ADDRESS 0x3FA61E /end MEASUREMENT
/begin COMPU_METHOD MC_P0281MALF "P0281MALF conversion" RAT_FUNC "%3.0" "Unitless" COEFFS 0 1 0 0 0 1 /end COMPU_METHOD
/begin CHARACTERISTIC P0281SW "Injector 7 cylinder balance  fault status  malf fault record updation enable switch" VALUE 0x5D778 SD_UBYTE 0 SC_P0281SW 0 255 /end CHARACTERISTIC
/begin COMPU_METHOD SC_P0281SW "P0281SW conversion" RAT_FUNC "%3.0" "unitless" COEFFS 0 1 0 0 0 1 /end COMPU_METHOD
/begin MEASUREMENT P0281UPDATE "Injector 7 cylinder balance  fault malf update status flag" UBYTE MC_P0281UPDATE 0 0 0 0 ECU_ADDRESS 0x3FA606 /end MEASUREMENT
/begin COMPU_METHOD MC_P0281UPDATE "P0281UPDATE conversion" RAT_FUNC "%3.0" "Unitless" COEFFS 0 1 0 0 0 1 /end COMPU_METHOD
/begin MEASUREMENT P0282MALF "Injector 8 coil open fault status" UBYTE MC_P0282MALF 0 0 0 0 ECU_ADDRESS 0x3FA626 /end MEASUREMENT
/begin COMPU_METHOD MC_P0282MALF "P0282MALF conversion" RAT_FUNC "%3.0" "Unitless" COEFFS 0 1 0 0 0 1 /end COMPU_METHOD
/begin CHARACTERISTIC P0282SW "Injector 8 coil open fault status  malf fault record updation enable switch" VALUE 0x5D799 SD_UBYTE 0 SC_P0282SW 0 255 /end CHARACTERISTIC
/begin COMPU_METHOD SC_P0282SW "P0282SW conversion" RAT_FUNC "%3.0" "unitless" COEFFS 0 1 0 0 0 1 /end COMPU_METHOD
/begin MEASUREMENT P0282UPDATE "Injector 8 coil open malf update status flag" UBYTE MC_P0282UPDATE 0 0 0 0 ECU_ADDRESS 0x3FA60E /end MEASUREMENT
/begin COMPU_METHOD MC_P0282UPDATE "P0282UPDATE conversion" RAT_FUNC "%3.0" "Unitless" COEFFS 0 1 0 0 0 1 /end COMPU_METHOD
/begin MEASUREMENT P0283MALF "Injector 8 coil short and side short fault status" UBYTE MC_P0283MALF 0 0 0 0 ECU_ADDRESS 0x3FA625 /end MEASUREMENT
/begin COMPU_METHOD MC_P0283MALF "P0283MALF conversion" RAT_FUNC "%3.0" "Unitless" COEFFS 0 1 0 0 0 1 /end COMPU_METHOD
/begin CHARACTERISTIC P0283SW "Injector 8 coil short and side short fault status  malf fault record updation enable switch" VALUE 0x5D798 SD_UBYTE 0 SC_P0283SW 0 255 /end CHARACTERISTIC
/begin COMPU_METHOD SC_P0283SW "P0283SW conversion" RAT_FUNC "%3.0" "unitless" COEFFS 0 1 0 0 0 1 /end COMPU_METHOD
/begin MEASUREMENT P0283UPDATE "Injector 8 coil short and side short  malf update status flag" UBYTE MC_P0283UPDATE 0 0 0 0 ECU_ADDRESS 0x3FA60D /end MEASUREMENT
/begin COMPU_METHOD MC_P0283UPDATE "P0283UPDATE conversion" RAT_FUNC "%3.0" "Unitless" COEFFS 0 1 0 0 0 1 /end COMPU_METHOD
/begin MEASUREMENT P0284MALF "Injector 8 cylinder balance,  malf" UBYTE MC_P0284MALF 0 0 0 0 ECU_ADDRESS 0x3FA61D /end MEASUREMENT
/begin COMPU_METHOD MC_P0284MALF "P0284MALF conversion" RAT_FUNC "%3.0" "Unitless" COEFFS 0 1 0 0 0 1 /end COMPU_METHOD
/begin CHARACTERISTIC P0284SW "Injector 8 cylinder balance  fault status  malf fault record updation enable switch" VALUE 0x5D777 SD_UBYTE 0 SC_P0284SW 0 255 /end CHARACTERISTIC
/begin COMPU_METHOD SC_P0284SW "P0284SW conversion" RAT_FUNC "%3.0" "unitless" COEFFS 0 1 0 0 0 1 /end COMPU_METHOD
/begin MEASUREMENT P0284UPDATE "Injector 8 cylinder balance  fault malf update status flag" UBYTE MC_P0284UPDATE 0 0 0 0 ECU_ADDRESS 0x3FA605 /end MEASUREMENT
/begin COMPU_METHOD MC_P0284UPDATE "P0284UPDATE conversion" RAT_FUNC "%3.0" "Unitless" COEFFS 0 1 0 0 0 1 /end COMPU_METHOD
/begin MEASUREMENT P0297MALF "Vehicle speed limiter is reached fault flag." UBYTE MC_P0297MALF 0 0 0 0 ECU_ADDRESS 0x3FA042 /end MEASUREMENT
/begin COMPU_METHOD MC_P0297MALF "P0297MALF conversion" RAT_FUNC "%3.0" "Unitless" COEFFS 0 1 0 0 0 1 /end COMPU_METHOD
/begin CHARACTERISTIC P0297SW "0=cal_out; 1=non_mil; 2=mil" VALUE 0x5D7B2 SD_UBYTE 0 SC_P0297SW 0 255 /end CHARACTERISTIC
/begin COMPU_METHOD SC_P0297SW "P0297SW conversion" RAT_FUNC "%3.0" "Unitless" COEFFS 0 1 0 0 0 1 /end COMPU_METHOD
/begin MEASUREMENT P0297UPDATE "Vehicle Overspeed malf update flag" UBYTE MC_P0297UPDATE 0 0 0 0 ECU_ADDRESS 0x3FA041 /end MEASUREMENT
/begin COMPU_METHOD MC_P0297UPDATE "P0297UPDATE conversion" RAT_FUNC "%3.0" "Unitless" COEFFS 0 1 0 0 0 1 /end COMPU_METHOD
/begin MEASUREMENT P0298MALF "threshold monitor hot malfunction flag" UBYTE MC_P0298MALF 0 0 0 0 ECU_ADDRESS 0x3F9F30 /end MEASUREMENT
/begin COMPU_METHOD MC_P0298MALF "P0298MALF conversion" RAT_FUNC "%3.0" "Unitless" COEFFS 0 1 0 0 0 1 /end COMPU_METHOD
/begin CHARACTERISTIC P0298SW "0=cal_out; 1=non_mil; 2=mil" VALUE 0x5D7B1 SD_UBYTE 0 SC_P0298SW 0 255 /end CHARACTERISTIC
/begin COMPU_METHOD SC_P0298SW "P0298SW conversion" RAT_FUNC "%3.0" "Unitless" COEFFS 0 1 0 0 0 1 /end COMPU_METHOD
/begin MEASUREMENT P0298UPDATE "threshold monitor update flag" UBYTE MC_P0298UPDATE 0 0 0 0 ECU_ADDRESS 0x3F9F32 /end MEASUREMENT
/begin COMPU_METHOD MC_P0298UPDATE "P0298UPDATE conversion" RAT_FUNC "%3.0" "Unitless" COEFFS 0 1 0 0 0 1 /end COMPU_METHOD
/begin MEASUREMENT P0299MALF "" UBYTE MC_P0299MALF 0 0 0 0 ECU_ADDRESS 0x3FB5A3 /end MEASUREMENT
/begin COMPU_METHOD MC_P0299MALF "P0299MALF conversion" RAT_FUNC "%3.0" "Unitless" COEFFS 0 1 0 0 0 1 /end COMPU_METHOD
/begin CHARACTERISTIC P0299SW "" VALUE 0x5F19A SD_UBYTE 0 SC_P0299SW 0 255 /end CHARACTERISTIC
/begin COMPU_METHOD SC_P0299SW "P0299SW conversion" RAT_FUNC "%3.0" "unitless" COEFFS 0 1 0 0 0 1 /end COMPU_METHOD
/begin CHARACTERISTIC P0300SW "0=cal_out; 1=non_mil; 2=mil" VALUE 0x5ED5D SD_UBYTE 0 SC_P0300SW 0 255 /end CHARACTERISTIC
/begin COMPU_METHOD SC_P0300SW "P0300SW conversion" RAT_FUNC "%3.0" "Unitless" COEFFS 0 1 0 0 0 1 /end COMPU_METHOD
/begin CHARACTERISTIC P0301SW "0=cal_out; 1=non_mil; 2=mil" VALUE 0x5ED5C SD_UBYTE 0 SC_P0301SW 0 255 /end CHARACTERISTIC
/begin COMPU_METHOD SC_P0301SW "P0301SW conversion" RAT_FUNC "%3.0" "Unitless" COEFFS 0 1 0 0 0 1 /end COMPU_METHOD
/begin CHARACTERISTIC P0302SW "0=cal_out; 1=non_mil; 2=mil" VALUE 0x5ED5B SD_UBYTE 0 SC_P0302SW 0 255 /end CHARACTERISTIC
/begin COMPU_METHOD SC_P0302SW "P0302SW conversion" RAT_FUNC "%3.0" "Unitless" COEFFS 0 1 0 0 0 1 /end COMPU_METHOD
/begin CHARACTERISTIC P0303SW "0=cal_out; 1=non_mil; 2=mil" VALUE 0x5ED5A SD_UBYTE 0 SC_P0303SW 0 255 /end CHARACTERISTIC
/begin COMPU_METHOD SC_P0303SW "P0303SW conversion" RAT_FUNC "%3.0" "Unitless" COEFFS 0 1 0 0 0 1 /end COMPU_METHOD
/begin CHARACTERISTIC P0304SW "0=cal_out; 1=non_mil; 2=mil" VALUE 0x5ED59 SD_UBYTE 0 SC_P0304SW 0 255 /end CHARACTERISTIC
/begin COMPU_METHOD SC_P0304SW "P0304SW conversion" RAT_FUNC "%3.0" "Unitless" COEFFS 0 1 0 0 0 1 /end COMPU_METHOD
/begin CHARACTERISTIC P0305SW "0=cal_out; 1=non_mil; 2=mil" VALUE 0x5ED58 SD_UBYTE 0 SC_P0305SW 0 255 /end CHARACTERISTIC
/begin COMPU_METHOD SC_P0305SW "P0305SW conversion" RAT_FUNC "%3.0" "Unitless" COEFFS 0 1 0 0 0 1 /end COMPU_METHOD
/begin CHARACTERISTIC P0306SW "0=cal_out; 1=non_mil; 2=mil" VALUE 0x5ED57 SD_UBYTE 0 SC_P0306SW 0 255 /end CHARACTERISTIC
/begin COMPU_METHOD SC_P0306SW "P0306SW conversion" RAT_FUNC "%3.0" "Unitless" COEFFS 0 1 0 0 0 1 /end COMPU_METHOD
/begin CHARACTERISTIC P0307SW "0=cal_out; 1=non_mil; 2=mil" VALUE 0x5ED56 SD_UBYTE 0 SC_P0307SW 0 255 /end CHARACTERISTIC
/begin COMPU_METHOD SC_P0307SW "P0307SW conversion" RAT_FUNC "%3.0" "Unitless" COEFFS 0 1 0 0 0 1 /end COMPU_METHOD
/begin CHARACTERISTIC P0308SW "0=cal_out; 1=non_mil; 2=mil" VALUE 0x5ED55 SD_UBYTE 0 SC_P0308SW 0 255 /end CHARACTERISTIC
/begin COMPU_METHOD SC_P0308SW "P0308SW conversion" RAT_FUNC "%3.0" "Unitless" COEFFS 0 1 0 0 0 1 /end COMPU_METHOD
/begin CHARACTERISTIC P0315SW "0=cal_out; 1=non_mil; 2=mil" VALUE 0x5ED54 SD_UBYTE 0 SC_P0315SW 0 255 /end CHARACTERISTIC
/begin COMPU_METHOD SC_P0315SW "P0315SW conversion" RAT_FUNC "%3.0" "unitless" COEFFS 0 1 0 0 0 1 /end COMPU_METHOD
/begin MEASUREMENT P0335MALF "crank shaft position sensor A circuit malfunction" UBYTE MC_P0335MALF 0 0 0 0 ECU_ADDRESS 0x3FB28F /end MEASUREMENT
/begin COMPU_METHOD MC_P0335MALF "P0335MALF conversion" RAT_FUNC "%3.0" "Unitless" COEFFS 0 1 0 0 0 1 /end COMPU_METHOD
/begin CHARACTERISTIC P0335SW "0=cal_out; 1=non_mil; 2=mil" VALUE 0x5ED07 SD_UBYTE 0 SC_P0335SW 0 255 /end CHARACTERISTIC
/begin COMPU_METHOD SC_P0335SW "P0335SW conversion" RAT_FUNC "%3.0" "Unitless" COEFFS 0 1 0 0 0 1 /end COMPU_METHOD
/begin MEASUREMENT P0336MALF "crank shaft position sensor A circuit range/perfirmance" UBYTE MC_P0336MALF 0 0 0 0 ECU_ADDRESS 0x3FB28E /end MEASUREMENT
/begin COMPU_METHOD MC_P0336MALF "P0336MALF conversion" RAT_FUNC "%3.0" "Unitless" COEFFS 0 1 0 0 0 1 /end COMPU_METHOD
/begin CHARACTERISTIC P0336SW "0=cal_out; 1=non_mil; 2=mil" VALUE 0x5ED06 SD_UBYTE 0 SC_P0336SW 0 255 /end CHARACTERISTIC
/begin COMPU_METHOD SC_P0336SW "P0336SW conversion" RAT_FUNC "%3.0" "Unitless" COEFFS 0 1 0 0 0 1 /end COMPU_METHOD
/begin MEASUREMENT P0340MALF "cam shaft position sensor A circuit malfunction" UBYTE MC_P0340MALF 0 0 0 0 ECU_ADDRESS 0x3FB28D /end MEASUREMENT
/begin COMPU_METHOD MC_P0340MALF "P0340MALF conversion" RAT_FUNC "%3.0" "Unitless" COEFFS 0 1 0 0 0 1 /end COMPU_METHOD
/begin CHARACTERISTIC P0340SW "0=cal_out; 1=non_mil; 2=mil" VALUE 0x5ED05 SD_UBYTE 0 SC_P0340SW 0 255 /end CHARACTERISTIC
/begin COMPU_METHOD SC_P0340SW "P0340SW conversion" RAT_FUNC "%3.0" "Unitless" COEFFS 0 1 0 0 0 1 /end COMPU_METHOD
/begin MEASUREMENT P0341MALF "cam shaft position sensor circuit A range/performance" UBYTE MC_P0341MALF 0 0 0 0 ECU_ADDRESS 0x3FB28C /end MEASUREMENT
/begin COMPU_METHOD MC_P0341MALF "P0341MALF conversion" RAT_FUNC "%3.0" "Unitless" COEFFS 0 1 0 0 0 1 /end COMPU_METHOD
/begin CHARACTERISTIC P0341SW "0=cal_out; 1=non_mil; 2=mil" VALUE 0x5ED04 SD_UBYTE 0 SC_P0341SW 0 255 /end CHARACTERISTIC
/begin COMPU_METHOD SC_P0341SW "P0341SW conversion" RAT_FUNC "%3.0" "Unitless" COEFFS 0 1 0 0 0 1 /end COMPU_METHOD
/begin MEASUREMENT P0381MALF "" UBYTE MC_P0381MALF 0 0 0 0 ECU_ADDRESS 0x3FA4AE /end MEASUREMENT
/begin COMPU_METHOD MC_P0381MALF "P0381MALF conversion" RAT_FUNC "%3.0" "Unitless" COEFFS 0 1 0 0 0 1 /end COMPU_METHOD
/begin CHARACTERISTIC P0381SW "GPL fault record updation enable switch" VALUE 0x5D7C3 SD_UBYTE 0 SC_P0381SW 0 255 /end CHARACTERISTIC
/begin COMPU_METHOD SC_P0381SW "P0381SW conversion" RAT_FUNC "%3.0" "unitless" COEFFS 0 1 0 0 0 1 /end COMPU_METHOD
/begin MEASUREMENT P0381UPDATE "" UBYTE MC_P0381UPDATE 0 0 0 0 ECU_ADDRESS 0x3FA4AF /end MEASUREMENT
/begin COMPU_METHOD MC_P0381UPDATE "P0381UPDATE conversion" RAT_FUNC "%3.0" "Unitless" COEFFS 0 1 0 0 0 1 /end COMPU_METHOD
/begin MEASUREMENT P0381UPD_CNTR "" SLONG MC_P0381UPD_CNTR 0 0 0 0 ECU_ADDRESS 0x3FA48C /end MEASUREMENT
/begin COMPU_METHOD MC_P0381UPD_CNTR "P0381UPD_CNTR conversion" RAT_FUNC "%10.0" "Unitless" COEFFS 0 1 0 0 0 1 /end COMPU_METHOD
/begin CHARACTERISTIC P0401SW "0=cal_out; 1=non_mil; 2=mil" VALUE 0x5E865 SD_UBYTE 0 SC_P0401SW 0 255 /end CHARACTERISTIC
/begin COMPU_METHOD SC_P0401SW "P0401SW conversion" RAT_FUNC "%3.0" "Unitless" COEFFS 0 1 0 0 0 1 /end COMPU_METHOD
/begin CHARACTERISTIC P0402SW "0=cal_out; 1=non_mil; 2=mil" VALUE 0x5E864 SD_UBYTE 0 SC_P0402SW 0 255 /end CHARACTERISTIC
/begin COMPU_METHOD SC_P0402SW "P0402SW conversion" RAT_FUNC "%3.0" "Unitless" COEFFS 0 1 0 0 0 1 /end COMPU_METHOD
/begin MEASUREMENT P0403MALF "P0403 Malfunction flag" UBYTE MC_P0403MALF 0 0 0 0 ECU_ADDRESS 0x3FA4B6 /end MEASUREMENT
/begin COMPU_METHOD MC_P0403MALF "P0403MALF conversion" RAT_FUNC "%3.0" "Unitless" COEFFS 0 1 0 0 0 1 /end COMPU_METHOD
/begin CHARACTERISTIC P0403SW "0=cal_out; 1=non_mil; 2=mil" VALUE 0x5D7C7 SD_UBYTE 0 SC_P0403SW 0 255 /end CHARACTERISTIC
/begin COMPU_METHOD SC_P0403SW "P0403SW conversion" RAT_FUNC "%3.0" "Unitless" COEFFS 0 1 0 0 0 1 /end COMPU_METHOD
/begin MEASUREMENT P0403UPDATE "" UBYTE MC_P0403UPDATE 0 0 0 0 ECU_ADDRESS 0x3FA4B7 /end MEASUREMENT
/begin COMPU_METHOD MC_P0403UPDATE "P0403UPDATE conversion" RAT_FUNC "%3.0" "Unitless" COEFFS 0 1 0 0 0 1 /end COMPU_METHOD
/begin MEASUREMENT P0404MALF "" UBYTE MC_P0404MALF 0 0 0 0 ECU_ADDRESS 0x3F9FD1 /end MEASUREMENT
/begin COMPU_METHOD MC_P0404MALF "P0404MALF conversion" RAT_FUNC "%3.0" "Unitless" COEFFS 0 1 0 0 0 1 /end COMPU_METHOD
/begin CHARACTERISTIC P0404SW " fault record updation enable switch" VALUE 0x5D7B6 SD_UBYTE 0 SC_P0404SW 0 255 /end CHARACTERISTIC
/begin COMPU_METHOD SC_P0404SW "P0404SW conversion" RAT_FUNC "%3.0" "unitless" COEFFS 0 1 0 0 0 1 /end COMPU_METHOD
/begin MEASUREMENT P0404UPDATE "" UBYTE MC_P0404UPDATE 0 0 0 0 ECU_ADDRESS 0x3F9FCB /end MEASUREMENT
/begin COMPU_METHOD MC_P0404UPDATE "P0404UPDATE conversion" RAT_FUNC "%3.0" "Unitless" COEFFS 0 1 0 0 0 1 /end COMPU_METHOD
/begin MEASUREMENT P0405MALF "OBD II malfunction flag for egrp below min. value" UBYTE MC_P0405MALF 0 0 0 0 ECU_ADDRESS 0x3F9FD2 /end MEASUREMENT
/begin COMPU_METHOD MC_P0405MALF "P0405MALF conversion" RAT_FUNC "%3.0" "Unitless" COEFFS 0 1 0 0 0 1 /end COMPU_METHOD
/begin CHARACTERISTIC P0405SW "EGRP low malf  fault record updation enable switch" VALUE 0x5D7B8 SD_UBYTE 0 SC_P0405SW 0 255 /end CHARACTERISTIC
/begin COMPU_METHOD SC_P0405SW "P0405SW conversion" RAT_FUNC "%3.0" "unitless" COEFFS 0 1 0 0 0 1 /end COMPU_METHOD
/begin MEASUREMENT P0405UPDATE "p0405 malf update indication flag" UBYTE MC_P0405UPDATE 0 0 0 0 ECU_ADDRESS 0x3F9FCC /end MEASUREMENT
/begin COMPU_METHOD MC_P0405UPDATE "P0405UPDATE conversion" RAT_FUNC "%3.0" "Unitless" COEFFS 0 1 0 0 0 1 /end COMPU_METHOD
/begin MEASUREMENT P0405UPD_CNTR "EGRP low failure update - Counter" SLONG MC_P0405UPD_CNTR 0 0 0 0 ECU_ADDRESS 0x3F9FB4 /end MEASUREMENT
/begin COMPU_METHOD MC_P0405UPD_CNTR "P0405UPD_CNTR conversion" RAT_FUNC "%10.0" "Unitless" COEFFS 0 1 0 0 0 1 /end COMPU_METHOD
/begin MEASUREMENT P0406MALF "OBDII malfunction flag for EGRP above max. Cal. value" UBYTE MC_P0406MALF 0 0 0 0 ECU_ADDRESS 0x3F9FD3 /end MEASUREMENT
/begin COMPU_METHOD MC_P0406MALF "P0406MALF conversion" RAT_FUNC "%3.0" "Unitless" COEFFS 0 1 0 0 0 1 /end COMPU_METHOD
/begin CHARACTERISTIC P0406SW "EGRP high malf  fault record updation enable switch" VALUE 0x5D7B7 SD_UBYTE 0 SC_P0406SW 0 255 /end CHARACTERISTIC
/begin COMPU_METHOD SC_P0406SW "P0406SW conversion" RAT_FUNC "%3.0" "unitless" COEFFS 0 1 0 0 0 1 /end COMPU_METHOD
/begin MEASUREMENT P0406UPDATE "p0406 malf update indication flag" UBYTE MC_P0406UPDATE 0 0 0 0 ECU_ADDRESS 0x3F9FCD /end MEASUREMENT
/begin COMPU_METHOD MC_P0406UPDATE "P0406UPDATE conversion" RAT_FUNC "%3.0" "Unitless" COEFFS 0 1 0 0 0 1 /end COMPU_METHOD
/begin MEASUREMENT P0406UPD_CNTR "EGRP  high failure update - counter" SLONG MC_P0406UPD_CNTR 0 0 0 0 ECU_ADDRESS 0x3F9FB8 /end MEASUREMENT
/begin COMPU_METHOD MC_P0406UPD_CNTR "P0406UPD_CNTR conversion" RAT_FUNC "%10.0" "Unitless" COEFFS 0 1 0 0 0 1 /end COMPU_METHOD
/begin MEASUREMENT P0407MALF "OBD II malfunction flag for ithp below min. value" UBYTE MC_P0407MALF 0 0 0 0 ECU_ADDRESS 0x3FA404 /end MEASUREMENT
/begin COMPU_METHOD MC_P0407MALF "P0407MALF conversion" RAT_FUNC "%3.0" "Unitless" COEFFS 0 1 0 0 0 1 /end COMPU_METHOD
/begin CHARACTERISTIC P0407SW "ITHP low  malf fault record updation enable switch" VALUE 0x5D797 SD_UBYTE 0 SC_P0407SW 0 255 /end CHARACTERISTIC
/begin COMPU_METHOD SC_P0407SW "P0407SW conversion" RAT_FUNC "%3.0" "unitless" COEFFS 0 1 0 0 0 1 /end COMPU_METHOD
/begin MEASUREMENT P0407UPDATE "p0407 malf update indication flag" UBYTE MC_P0407UPDATE 0 0 0 0 ECU_ADDRESS 0x3FA400 /end MEASUREMENT
/begin COMPU_METHOD MC_P0407UPDATE "P0407UPDATE conversion" RAT_FUNC "%3.0" "Unitless" COEFFS 0 1 0 0 0 1 /end COMPU_METHOD
/begin MEASUREMENT P0407UPD_CNTR "ITHP low failure update - Counter" SLONG MC_P0407UPD_CNTR 0 0 0 0 ECU_ADDRESS 0x3FA3CC /end MEASUREMENT
/begin COMPU_METHOD MC_P0407UPD_CNTR "P0407UPD_CNTR conversion" RAT_FUNC "%10.0" "Unitless" COEFFS 0 1 0 0 0 1 /end COMPU_METHOD
/begin MEASUREMENT P0408MALF "OBDII malfunction flag for ITHP above max. Cal. value" UBYTE MC_P0408MALF 0 0 0 0 ECU_ADDRESS 0x3FA405 /end MEASUREMENT
/begin COMPU_METHOD MC_P0408MALF "P0408MALF conversion" RAT_FUNC "%3.0" "Unitless" COEFFS 0 1 0 0 0 1 /end COMPU_METHOD
/begin CHARACTERISTIC P0408SW "ITHP high  malf fault record updation enable switch" VALUE 0x5D796 SD_UBYTE 0 SC_P0408SW 0 255 /end CHARACTERISTIC
/begin COMPU_METHOD SC_P0408SW "P0408SW conversion" RAT_FUNC "%3.0" "unitless" COEFFS 0 1 0 0 0 1 /end COMPU_METHOD
/begin MEASUREMENT P0408UPDATE "p0408 malf update indication flag" UBYTE MC_P0408UPDATE 0 0 0 0 ECU_ADDRESS 0x3FA401 /end MEASUREMENT
/begin COMPU_METHOD MC_P0408UPDATE "P0408UPDATE conversion" RAT_FUNC "%3.0" "Unitless" COEFFS 0 1 0 0 0 1 /end COMPU_METHOD
/begin MEASUREMENT P0408UPD_CNTR "ITHP high failure update - counter" SLONG MC_P0408UPD_CNTR 0 0 0 0 ECU_ADDRESS 0x3FA3D0 /end MEASUREMENT
/begin COMPU_METHOD MC_P0408UPD_CNTR "P0408UPD_CNTR conversion" RAT_FUNC "%10.0" "Unitless" COEFFS 0 1 0 0 0 1 /end COMPU_METHOD
/begin MEASUREMENT P0460MON "P0460 code has been monitored flag." UBYTE MC_P0460MON 0 0 0 0 ECU_ADDRESS 0x3FA00A /end MEASUREMENT
/begin COMPU_METHOD MC_P0460MON "P0460MON conversion" RAT_FUNC "%3.0" "Unitless" COEFFS 0 1 0 0 0 1 /end COMPU_METHOD
/begin CHARACTERISTIC P0460SW "0=cal_out; 1=non_mil; 2=mil" VALUE 0x5D13D SD_UBYTE 0 SC_P0460SW 0 255 /end CHARACTERISTIC
/begin COMPU_METHOD SC_P0460SW "P0460SW conversion" RAT_FUNC "%3.0" "Unitless" COEFFS 0 1 0 0 0 1 /end COMPU_METHOD
/begin CHARACTERISTIC P0461SW "0=cal_out; 1=non_mil; 2=mil" VALUE 0x5D13C SD_UBYTE 0 SC_P0461SW 0 255 /end CHARACTERISTIC
/begin COMPU_METHOD SC_P0461SW "P0461SW conversion" RAT_FUNC "%3.0" "Unitless" COEFFS 0 1 0 0 0 1 /end COMPU_METHOD
/begin MEASUREMENT P0470MALF "No start/crank excessive EBP fault detection ,alf flag" UBYTE MC_P0470MALF 0 0 0 0 ECU_ADDRESS 0x3FA3BD /end MEASUREMENT
/begin COMPU_METHOD MC_P0470MALF "P0470MALF conversion" RAT_FUNC "%3.0" "Unitless" COEFFS 0 1 0 0 0 1 /end COMPU_METHOD
/begin CHARACTERISTIC P0470SW "0=cal_out; 1=non_mil; 2=mil" VALUE 0x5CB2C SD_UBYTE 0 SC_P0470SW 0 255 /end CHARACTERISTIC
/begin COMPU_METHOD SC_P0470SW "P0470SW conversion" RAT_FUNC "%3.0" "Unitless" COEFFS 0 1 0 0 0 1 /end COMPU_METHOD
/begin MEASUREMENT P0470UPDATE "No start/crank excessive EBP fault detection ,malf update flag" UBYTE MC_P0470UPDATE 0 0 0 0 ECU_ADDRESS 0x3FA3BC /end MEASUREMENT
/begin COMPU_METHOD MC_P0470UPDATE "P0470UPDATE conversion" RAT_FUNC "%3.0" "Unitless" COEFFS 0 1 0 0 0 1 /end COMPU_METHOD
/begin MEASUREMENT P0471MALF "Engine speed based EBP delta change fault detection malf flag" UBYTE MC_P0471MALF 0 0 0 0 ECU_ADDRESS 0x3FA3BB /end MEASUREMENT
/begin COMPU_METHOD MC_P0471MALF "P0471MALF conversion" RAT_FUNC "%3.0" "Unitless" COEFFS 0 1 0 0 0 1 /end COMPU_METHOD
/begin CHARACTERISTIC P0471SW "Calibratable switch for p-code" VALUE 0x5E863 SD_UBYTE 0 SC_P0471SW 0 255 /end CHARACTERISTIC
/begin COMPU_METHOD SC_P0471SW "P0471SW conversion" RAT_FUNC "%3.0" "unitless" COEFFS 0 1 0 0 0 1 /end COMPU_METHOD
/begin MEASUREMENT P0471UPDATE "Engine speed based EBP delta change fault detection malf update flag" UBYTE MC_P0471UPDATE 0 0 0 0 ECU_ADDRESS 0x3FA3BA /end MEASUREMENT
/begin COMPU_METHOD MC_P0471UPDATE "P0471UPDATE conversion" RAT_FUNC "%3.0" "Unitless" COEFFS 0 1 0 0 0 1 /end COMPU_METHOD
/begin MEASUREMENT P0472MALF "OBD II EBP out of range low malf flag" UBYTE MC_P0472MALF 0 0 0 0 ECU_ADDRESS 0x3FA3C5 /end MEASUREMENT
/begin COMPU_METHOD MC_P0472MALF "P0472MALF conversion" RAT_FUNC "%3.0" "Unitless" COEFFS 0 1 0 0 0 1 /end COMPU_METHOD
/begin CHARACTERISTIC P0472SW "EBP low malf  fault record updation enable switch" VALUE 0x5D7BF SD_UBYTE 0 SC_P0472SW 0 255 /end CHARACTERISTIC
/begin COMPU_METHOD SC_P0472SW "P0472SW conversion" RAT_FUNC "%3.0" "unitless" COEFFS 0 1 0 0 0 1 /end COMPU_METHOD
/begin MEASUREMENT P0472UPDATE "p0472 malf update flag" UBYTE MC_P0472UPDATE 0 0 0 0 ECU_ADDRESS 0x3FA3C1 /end MEASUREMENT
/begin COMPU_METHOD MC_P0472UPDATE "P0472UPDATE conversion" RAT_FUNC "%3.0" "Unitless" COEFFS 0 1 0 0 0 1 /end COMPU_METHOD
/begin MEASUREMENT P0472UPD_CNTR "System voltage low failure update counter" SLONG MC_P0472UPD_CNTR 0 0 0 0 ECU_ADDRESS 0x3FA394 /end MEASUREMENT
/begin COMPU_METHOD MC_P0472UPD_CNTR "P0472UPD_CNTR conversion" RAT_FUNC "%10.0" "Unitless" COEFFS 0 1 0 0 0 1 /end COMPU_METHOD
/begin MEASUREMENT P0473MALF "OBDII EBP out of range high malf flag" UBYTE MC_P0473MALF 0 0 0 0 ECU_ADDRESS 0x3FA3C6 /end MEASUREMENT
/begin COMPU_METHOD MC_P0473MALF "P0473MALF conversion" RAT_FUNC "%3.0" "Unitless" COEFFS 0 1 0 0 0 1 /end COMPU_METHOD
/begin CHARACTERISTIC P0473SW "EBP high malf  fault record updation enable switch" VALUE 0x5D7BE SD_UBYTE 0 SC_P0473SW 0 255 /end CHARACTERISTIC
/begin COMPU_METHOD SC_P0473SW "P0473SW conversion" RAT_FUNC "%3.0" "unitless" COEFFS 0 1 0 0 0 1 /end COMPU_METHOD
/begin MEASUREMENT P0473UPDATE " p0473 malf update flag" UBYTE MC_P0473UPDATE 0 0 0 0 ECU_ADDRESS 0x3FA3C2 /end MEASUREMENT
/begin COMPU_METHOD MC_P0473UPDATE "P0473UPDATE conversion" RAT_FUNC "%3.0" "Unitless" COEFFS 0 1 0 0 0 1 /end COMPU_METHOD
/begin MEASUREMENT P0473UPD_CNTR "System voltage high failure update counter" SLONG MC_P0473UPD_CNTR 0 0 0 0 ECU_ADDRESS 0x3FA398 /end MEASUREMENT
/begin COMPU_METHOD MC_P0473UPD_CNTR "P0473UPD_CNTR conversion" RAT_FUNC "%10.0" "Unitless" COEFFS 0 1 0 0 0 1 /end COMPU_METHOD
/begin CHARACTERISTIC P0477SW "Calibratable switch for p-code" VALUE 0x5E862 SD_UBYTE 0 SC_P0477SW 0 255 /end CHARACTERISTIC
/begin COMPU_METHOD SC_P0477SW "P0477SW conversion" RAT_FUNC "%3.0" "unitless" COEFFS 0 1 0 0 0 1 /end COMPU_METHOD
/begin MEASUREMENT P0478MALF "Run mode excessive EBP fault detection malf flag" UBYTE MC_P0478MALF 0 0 0 0 ECU_ADDRESS 0x3FA3B9 /end MEASUREMENT
/begin COMPU_METHOD MC_P0478MALF "P0478MALF conversion" RAT_FUNC "%3.0" "Unitless" COEFFS 0 1 0 0 0 1 /end COMPU_METHOD
/begin CHARACTERISTIC P0478SW "Calibratable switch for p-code" VALUE 0x5D7BD SD_UBYTE 0 SC_P0478SW 0 255 /end CHARACTERISTIC
/begin COMPU_METHOD SC_P0478SW "P0478SW conversion" RAT_FUNC "%3.0" "unitless" COEFFS 0 1 0 0 0 1 /end COMPU_METHOD
/begin MEASUREMENT P0478UPDATE "Run mode excessive EBP fault detection malf update flag" UBYTE MC_P0478UPDATE 0 0 0 0 ECU_ADDRESS 0x3FA3B8 /end MEASUREMENT
/begin COMPU_METHOD MC_P0478UPDATE "P0478UPDATE conversion" RAT_FUNC "%3.0" "Unitless" COEFFS 0 1 0 0 0 1 /end COMPU_METHOD
/begin MEASUREMENT P0480MALF "Variable speed fan output fault flag" UBYTE MC_P0480MALF 0 0 0 0 ECU_ADDRESS 0x3FB241 /end MEASUREMENT
/begin COMPU_METHOD MC_P0480MALF "P0480MALF conversion" RAT_FUNC "%3.0" "Unitless" COEFFS 0 1 0 0 0 1 /end COMPU_METHOD
/begin CHARACTERISTIC P0480SW "Fan output driver code switch: 0=cal_out; 1=non_mil; 2=mil" VALUE 0x5EC4D SD_UBYTE 0 SC_P0480SW 0 255 /end CHARACTERISTIC
/begin COMPU_METHOD SC_P0480SW "P0480SW conversion" RAT_FUNC "%3.0" "Unitless" COEFFS 0 1 0 0 0 1 /end COMPU_METHOD
/begin CHARACTERISTIC P0480_CT_TC "Fault filter time constant P0480- continuous, fan output driver fault" VALUE 0x5EC48 SD_FLOAT32_IEEE 0 SC_P0480_CT_TC 0 16 /end CHARACTERISTIC
/begin COMPU_METHOD SC_P0480_CT_TC "P0480_CT_TC conversion" RAT_FUNC "%10.5" "s" COEFFS 0 1 0 0 0 1 /end COMPU_METHOD
/begin CHARACTERISTIC P0480_EO_TC "Fault filter time constant P0480- KOEO,  fan output driver fault" VALUE 0x5EC44 SD_FLOAT32_IEEE 0 SC_P0480_EO_TC 0 16 /end CHARACTERISTIC
/begin COMPU_METHOD SC_P0480_EO_TC "P0480_EO_TC conversion" RAT_FUNC "%10.5" "s" COEFFS 0 1 0 0 0 1 /end COMPU_METHOD
/begin MEASUREMENT P0480_FIL "Visctronic fan output driver fault filter." FLOAT32_IEEE MC_P0480_FIL 0 0 0 0 ECU_ADDRESS 0x3FB23C /end MEASUREMENT
/begin COMPU_METHOD MC_P0480_FIL "P0480_FIL conversion" RAT_FUNC "%10.5" "Unitless" COEFFS 0 1 0 0 0 1 /end COMPU_METHOD
/begin CHARACTERISTIC P0480_LVL "Fault filter threshold for code P0480,  Visctronic fan output driver fault detected" VALUE 0x5EC30 SD_FLOAT32_IEEE 0 SC_P0480_LVL 0 1 /end CHARACTERISTIC
/begin COMPU_METHOD SC_P0480_LVL "P0480_LVL conversion" RAT_FUNC "%10.5" "counts" COEFFS 0 1 0 0 0 1 /end COMPU_METHOD
/begin MEASUREMENT P0487MALF "" UBYTE MC_P0487MALF 0 0 0 0 ECU_ADDRESS 0x3FA4B2 /end MEASUREMENT
/begin COMPU_METHOD MC_P0487MALF "P0487MALF conversion" RAT_FUNC "%3.0" "Unitless" COEFFS 0 1 0 0 0 1 /end COMPU_METHOD
/begin CHARACTERISTIC P0487SW "ITH fault record updation enable switch" VALUE 0x5D7C5 SD_UBYTE 0 SC_P0487SW 0 255 /end CHARACTERISTIC
/begin COMPU_METHOD SC_P0487SW "P0487SW conversion" RAT_FUNC "%3.0" "unitless" COEFFS 0 1 0 0 0 1 /end COMPU_METHOD
/begin MEASUREMENT P0487UPDATE "" UBYTE MC_P0487UPDATE 0 0 0 0 ECU_ADDRESS 0x3FA4B3 /end MEASUREMENT
/begin COMPU_METHOD MC_P0487UPDATE "P0487UPDATE conversion" RAT_FUNC "%3.0" "Unitless" COEFFS 0 1 0 0 0 1 /end COMPU_METHOD
/begin CHARACTERISTIC P0488SW "Calibratable switch for p-code" VALUE 0x5E861 SD_UBYTE 0 SC_P0488SW 0 255 /end CHARACTERISTIC
/begin COMPU_METHOD SC_P0488SW "P0488SW conversion" RAT_FUNC "%3.0" "unitless" COEFFS 0 1 0 0 0 1 /end COMPU_METHOD
/begin MEASUREMENT P0500MALF "VSS Failure" UBYTE MC_P0500MALF 0 0 0 0 ECU_ADDRESS 0x3FA6A2 /end MEASUREMENT
/begin COMPU_METHOD MC_P0500MALF "P0500MALF conversion" RAT_FUNC "%3.0" "Unitless" COEFFS 0 1 0 0 0 1 /end COMPU_METHOD
/begin MEASUREMENT P0500MON "VSS monitor flag; 1 -> the VSS has been monitored at least once this power-up." UBYTE MC_P0500MON 0 0 0 0 ECU_ADDRESS 0x3FA6A4 /end MEASUREMENT
/begin COMPU_METHOD MC_P0500MON "P0500MON conversion" RAT_FUNC "%3.0" "Unitless" COEFFS 0 1 0 0 0 1 /end COMPU_METHOD
/begin CHARACTERISTIC P0500SW "0=cal_out; 1=non_mil; 2=mil" VALUE 0x5D795 SD_UBYTE 0 SC_P0500SW 0 255 /end CHARACTERISTIC
/begin COMPU_METHOD SC_P0500SW "P0500SW conversion" RAT_FUNC "%3.0" "Unitless" COEFFS 0 1 0 0 0 1 /end COMPU_METHOD
/begin MEASUREMENT P0503MALF "Noisy VSS Malf" UBYTE MC_P0503MALF 0 0 0 0 ECU_ADDRESS 0x3FA6A1 /end MEASUREMENT
/begin COMPU_METHOD MC_P0503MALF "P0503MALF conversion" RAT_FUNC "%3.0" "Unitless" COEFFS 0 1 0 0 0 1 /end COMPU_METHOD
/begin CHARACTERISTIC P0503SW "0=cal_out; 1=non_mil; 2=mil" VALUE 0x5D794 SD_UBYTE 0 SC_P0503SW 0 255 /end CHARACTERISTIC
/begin COMPU_METHOD SC_P0503SW "P0503SW conversion" RAT_FUNC "%3.0" "Unitless" COEFFS 0 1 0 0 0 1 /end COMPU_METHOD
/begin MEASUREMENT P0505MALF "" UBYTE MC_P0505MALF 0 0 0 0 ECU_ADDRESS 0x3FB4F9 /end MEASUREMENT
/begin COMPU_METHOD MC_P0505MALF "P0505MALF conversion" RAT_FUNC "%3.0" "Unitless" COEFFS 0 1 0 0 0 1 /end COMPU_METHOD
/begin CHARACTERISTIC P0505SW "0=cal_out; 1=non_mil; 2=mil" VALUE 0x5F0B5 SD_UBYTE 0 SC_P0505SW 0 255 /end CHARACTERISTIC
/begin COMPU_METHOD SC_P0505SW "P0505SW conversion" RAT_FUNC "%3.0" "Unitless" COEFFS 0 1 0 0 0 1 /end COMPU_METHOD
/begin MEASUREMENT P0528MALF "Fan speed sensor fault flag" UBYTE MC_P0528MALF 0 0 0 0 ECU_ADDRESS 0x3FB240 /end MEASUREMENT
/begin COMPU_METHOD MC_P0528MALF "P0528MALF conversion" RAT_FUNC "%3.0" "Unitless" COEFFS 0 1 0 0 0 1 /end COMPU_METHOD
/begin CHARACTERISTIC P0528SW "No fan input speed code switch: 0=cal_out;1=non_mil;2=mil" VALUE 0x5EC4C SD_UBYTE 0 SC_P0528SW 0 255 /end CHARACTERISTIC
/begin COMPU_METHOD SC_P0528SW "P0528SW conversion" RAT_FUNC "%3.0" "Unitless" COEFFS 0 1 0 0 0 1 /end COMPU_METHOD
/begin CHARACTERISTIC P0528_CT_TC "Fault filter time constant P0528- continuous,  noVisctronic fan input speed" VALUE 0x5EC3C SD_FLOAT32_IEEE 0 SC_P0528_CT_TC 0 16 /end CHARACTERISTIC
/begin COMPU_METHOD SC_P0528_CT_TC "P0528_CT_TC conversion" RAT_FUNC "%10.5" "s" COEFFS 0 1 0 0 0 1 /end COMPU_METHOD
/begin CHARACTERISTIC P0528_ER_TC "Fault filter time constant P0528- KOER,  noVisctronic fan input speed" VALUE 0x5EC40 SD_FLOAT32_IEEE 0 SC_P0528_ER_TC 0 16 /end CHARACTERISTIC
/begin COMPU_METHOD SC_P0528_ER_TC "P0528_ER_TC conversion" RAT_FUNC "%10.5" "s" COEFFS 0 1 0 0 0 1 /end COMPU_METHOD
/begin MEASUREMENT P0528_FIL "No Visctronic fan input speed fault filter" FLOAT32_IEEE MC_P0528_FIL 0 0 0 0 ECU_ADDRESS 0x3FB238 /end MEASUREMENT
/begin COMPU_METHOD MC_P0528_FIL "P0528_FIL conversion" RAT_FUNC "%10.5" "Unitless" COEFFS 0 1 0 0 0 1 /end COMPU_METHOD
/begin CHARACTERISTIC P0528_LVL "Fault filter threshold for code P0528, no input speed detected for Visctronic fan" VALUE 0x5EC2C SD_FLOAT32_IEEE 0 SC_P0528_LVL 0 1 /end CHARACTERISTIC
/begin COMPU_METHOD SC_P0528_LVL "P0528_LVL conversion" RAT_FUNC "%10.5" "counts" COEFFS 0 1 0 0 0 1 /end COMPU_METHOD
/begin MEASUREMENT P0560MALF "" UBYTE MC_P0560MALF 0 0 0 0 ECU_ADDRESS 0x3FB5A2 /end MEASUREMENT
/begin COMPU_METHOD MC_P0560MALF "P0560MALF conversion" RAT_FUNC "%3.0" "Unitless" COEFFS 0 1 0 0 0 1 /end COMPU_METHOD
/begin CHARACTERISTIC P0560SW "" VALUE 0x5F199 SD_UBYTE 0 SC_P0560SW 0 255 /end CHARACTERISTIC
/begin COMPU_METHOD SC_P0560SW "P0560SW conversion" RAT_FUNC "%3.0" "unitless" COEFFS 0 1 0 0 0 1 /end COMPU_METHOD
/begin MEASUREMENT P0562MALF "OBD II malfunction flag for system voltage below min. value" UBYTE MC_P0562MALF 0 0 0 0 ECU_ADDRESS 0x3FA435 /end MEASUREMENT
/begin COMPU_METHOD MC_P0562MALF "P0562MALF conversion" RAT_FUNC "%3.0" "Unitless" COEFFS 0 1 0 0 0 1 /end COMPU_METHOD
/begin CHARACTERISTIC P0562SW "IVPWR low malf fault record updation enable switch" VALUE 0x5D792 SD_UBYTE 0 SC_P0562SW 0 255 /end CHARACTERISTIC
/begin COMPU_METHOD SC_P0562SW "P0562SW conversion" RAT_FUNC "%3.0" "unitless" COEFFS 0 1 0 0 0 1 /end COMPU_METHOD
/begin MEASUREMENT P0562UPDATE "p0562 malf update indication flag" UBYTE MC_P0562UPDATE 0 0 0 0 ECU_ADDRESS 0x3FA433 /end MEASUREMENT
/begin COMPU_METHOD MC_P0562UPDATE "P0562UPDATE conversion" RAT_FUNC "%3.0" "Unitless" COEFFS 0 1 0 0 0 1 /end COMPU_METHOD
/begin MEASUREMENT P0562UPD_CNTR "System voltage low failure update - Counter" SLONG MC_P0562UPD_CNTR 0 0 0 0 ECU_ADDRESS 0x3FA428 /end MEASUREMENT
/begin COMPU_METHOD MC_P0562UPD_CNTR "P0562UPD_CNTR conversion" RAT_FUNC "%10.0" "Unitless" COEFFS 0 1 0 0 0 1 /end COMPU_METHOD
/begin MEASUREMENT P0563MALF "OBDII malfunction flag for System voltage above max. Cal. value" UBYTE MC_P0563MALF 0 0 0 0 ECU_ADDRESS 0x3FA436 /end MEASUREMENT
/begin COMPU_METHOD MC_P0563MALF "P0563MALF conversion" RAT_FUNC "%3.0" "Unitless" COEFFS 0 1 0 0 0 1 /end COMPU_METHOD
/begin CHARACTERISTIC P0563SW "IVPWR high malf fault record updation enable switch" VALUE 0x5D791 SD_UBYTE 0 SC_P0563SW 0 255 /end CHARACTERISTIC
/begin COMPU_METHOD SC_P0563SW "P0563SW conversion" RAT_FUNC "%3.0" "unitless" COEFFS 0 1 0 0 0 1 /end COMPU_METHOD
/begin MEASUREMENT P0563UPDATE "p0563 malf update indication flag" UBYTE MC_P0563UPDATE 0 0 0 0 ECU_ADDRESS 0x3FA434 /end MEASUREMENT
/begin COMPU_METHOD MC_P0563UPDATE "P0563UPDATE conversion" RAT_FUNC "%3.0" "Unitless" COEFFS 0 1 0 0 0 1 /end COMPU_METHOD
/begin MEASUREMENT P0563UPD_CNTR "System voltage  high failure update - counter" SLONG MC_P0563UPD_CNTR 0 0 0 0 ECU_ADDRESS 0x3FA42C /end MEASUREMENT
/begin COMPU_METHOD MC_P0563UPD_CNTR "P0563UPD_CNTR conversion" RAT_FUNC "%10.0" "Unitless" COEFFS 0 1 0 0 0 1 /end COMPU_METHOD
/begin MEASUREMENT P0565MALF "" UBYTE MC_P0565MALF 0 0 0 0 ECU_ADDRESS 0x3FB5A1 /end MEASUREMENT
/begin COMPU_METHOD MC_P0565MALF "P0565MALF conversion" RAT_FUNC "%3.0" "Unitless" COEFFS 0 1 0 0 0 1 /end COMPU_METHOD
/begin CHARACTERISTIC P0565SW "" VALUE 0x5F198 SD_UBYTE 0 SC_P0565SW 0 255 /end CHARACTERISTIC
/begin COMPU_METHOD SC_P0565SW "P0565SW conversion" RAT_FUNC "%3.0" "unitless" COEFFS 0 1 0 0 0 1 /end COMPU_METHOD
/begin MEASUREMENT P0566MALF "" UBYTE MC_P0566MALF 0 0 0 0 ECU_ADDRESS 0x3FB5A0 /end MEASUREMENT
/begin COMPU_METHOD MC_P0566MALF "P0566MALF conversion" RAT_FUNC "%3.0" "Unitless" COEFFS 0 1 0 0 0 1 /end COMPU_METHOD
/begin CHARACTERISTIC P0566SW "Calibratable switch for p-code" VALUE 0x5F197 SD_UBYTE 0 SC_P0566SW 0 255 /end CHARACTERISTIC
/begin COMPU_METHOD SC_P0566SW "P0566SW conversion" RAT_FUNC "%3.0" "unitless" COEFFS 0 1 0 0 0 1 /end COMPU_METHOD
/begin MEASUREMENT P0567MALF "" UBYTE MC_P0567MALF 0 0 0 0 ECU_ADDRESS 0x3FB59F /end MEASUREMENT
/begin COMPU_METHOD MC_P0567MALF "P0567MALF conversion" RAT_FUNC "%3.0" "Unitless" COEFFS 0 1 0 0 0 1 /end COMPU_METHOD
/begin CHARACTERISTIC P0567SW "Calibratable switch for p-code" VALUE 0x5F196 SD_UBYTE 0 SC_P0567SW 0 255 /end CHARACTERISTIC
/begin COMPU_METHOD SC_P0567SW "P0567SW conversion" RAT_FUNC "%3.0" "unitless" COEFFS 0 1 0 0 0 1 /end COMPU_METHOD
/begin MEASUREMENT P0568MALF "" UBYTE MC_P0568MALF 0 0 0 0 ECU_ADDRESS 0x3FB59E /end MEASUREMENT
/begin COMPU_METHOD MC_P0568MALF "P0568MALF conversion" RAT_FUNC "%3.0" "Unitless" COEFFS 0 1 0 0 0 1 /end COMPU_METHOD
/begin CHARACTERISTIC P0568SW "Calibratable switch for p-code" VALUE 0x5F195 SD_UBYTE 0 SC_P0568SW 0 255 /end CHARACTERISTIC
/begin COMPU_METHOD SC_P0568SW "P0568SW conversion" RAT_FUNC "%3.0" "unitless" COEFFS 0 1 0 0 0 1 /end COMPU_METHOD
/begin MEASUREMENT P0569MALF "" UBYTE MC_P0569MALF 0 0 0 0 ECU_ADDRESS 0x3FB59D /end MEASUREMENT
/begin COMPU_METHOD MC_P0569MALF "P0569MALF conversion" RAT_FUNC "%3.0" "Unitless" COEFFS 0 1 0 0 0 1 /end COMPU_METHOD
/begin CHARACTERISTIC P0569SW "Calibratable switch for p-code" VALUE 0x5F194 SD_UBYTE 0 SC_P0569SW 0 255 /end CHARACTERISTIC
/begin COMPU_METHOD SC_P0569SW "P0569SW conversion" RAT_FUNC "%3.0" "unitless" COEFFS 0 1 0 0 0 1 /end COMPU_METHOD
/begin MEASUREMENT P0571MALF "" UBYTE MC_P0571MALF 0 0 0 0 ECU_ADDRESS 0x3FB59C /end MEASUREMENT
/begin COMPU_METHOD MC_P0571MALF "P0571MALF conversion" RAT_FUNC "%3.0" "Unitless" COEFFS 0 1 0 0 0 1 /end COMPU_METHOD
/begin CHARACTERISTIC P0571SW "0=cal_out; 1=non_mil; 2=mil" VALUE 0x5F193 SD_UBYTE 0 SC_P0571SW 0 255 /end CHARACTERISTIC
/begin COMPU_METHOD SC_P0571SW "P0571SW conversion" RAT_FUNC "%3.0" "Unitless" COEFFS 0 1 0 0 0 1 /end COMPU_METHOD
/begin CHARACTERISTIC P0602SW "0=cal_out; 1=non_mil; 2=mil" VALUE 0x5EF8D SD_UBYTE 0 SC_P0602SW 0 255 /end CHARACTERISTIC
/begin COMPU_METHOD SC_P0602SW "P0602SW conversion" RAT_FUNC "%3.0" "Unitless" COEFFS 0 1 0 0 0 1 /end COMPU_METHOD
/begin CHARACTERISTIC P0603SW "0=cal_out; 1=non_mil; 2=mil" VALUE 0x5EB11 SD_UBYTE 0 SC_P0603SW 0 255 /end CHARACTERISTIC
/begin COMPU_METHOD SC_P0603SW "P0603SW conversion" RAT_FUNC "%3.0" "Unitless" COEFFS 0 1 0 0 0 1 /end COMPU_METHOD
/begin CHARACTERISTIC P0605SW "0=cal_out; 1=non_mil; 2=mil" VALUE 0x5EB10 SD_UBYTE 0 SC_P0605SW 0 255 /end CHARACTERISTIC
/begin COMPU_METHOD SC_P0605SW "P0605SW conversion" RAT_FUNC "%3.0" "Unitless" COEFFS 0 1 0 0 0 1 /end COMPU_METHOD
/begin MEASUREMENT P0611MALF "FICM module memory failure malf flag" UBYTE MC_P0611MALF 0 0 0 0 ECU_ADDRESS 0x3FA4A1 /end MEASUREMENT
/begin COMPU_METHOD MC_P0611MALF "P0611MALF conversion" RAT_FUNC "%3.0" "Unitless" COEFFS 0 1 0 0 0 1 /end COMPU_METHOD
/begin CHARACTERISTIC P0611SW "FICM memory  fault switch: 0=cal_out; 1=non_mil; 2=mil" VALUE 0x5D774 SD_UBYTE 0 SC_P0611SW 0 255 /end CHARACTERISTIC
/begin COMPU_METHOD SC_P0611SW "P0611SW conversion" RAT_FUNC "%3.0" "Unitless" COEFFS 0 1 0 0 0 1 /end COMPU_METHOD
/begin MEASUREMENT P0611UPDATE "FICM module, memory failure test update flag" UBYTE MC_P0611UPDATE 0 0 0 0 ECU_ADDRESS 0x3FA4A0 /end MEASUREMENT
/begin COMPU_METHOD MC_P0611UPDATE "P0611UPDATE conversion" RAT_FUNC "%3.0" "Unitless" COEFFS 0 1 0 0 0 1 /end COMPU_METHOD
/begin MEASUREMENT P0611UPD_CNTR "IDM memory fault update - Counter" SLONG MC_P0611UPD_CNTR 0 0 0 0 ECU_ADDRESS 0x3FA470 /end MEASUREMENT
/begin COMPU_METHOD MC_P0611UPD_CNTR "P0611UPD_CNTR conversion" RAT_FUNC "%10.0" "Unitless" COEFFS 0 1 0 0 0 1 /end COMPU_METHOD
/begin CHARACTERISTIC P0620SW "Primary Alternator updation enable switch" VALUE 0x5ECB9 SD_UBYTE 0 SC_P0620SW 0 2 /end CHARACTERISTIC
/begin COMPU_METHOD SC_P0620SW "P0620SW conversion" RAT_FUNC "%3.0" "unitless" COEFFS 0 1 0 0 0 1 /end COMPU_METHOD
/begin CHARACTERISTIC P0623SW "Battery lamp updation enable switch" VALUE 0x5ECB6 SD_UBYTE 0 SC_P0623SW 0 2 /end CHARACTERISTIC
/begin COMPU_METHOD SC_P0623SW "P0623SW conversion" RAT_FUNC "%3.0" "unitless" COEFFS 0 1 0 0 0 1 /end COMPU_METHOD
/begin CHARACTERISTIC P0645SW "0=cal_out; 1=non_mil; 2=mil" VALUE 0x5CC68 SD_UBYTE 0 SC_P0645SW 0 255 /end CHARACTERISTIC
/begin COMPU_METHOD SC_P0645SW "P0645SW conversion" RAT_FUNC "%3.0" "Unitless" COEFFS 0 1 0 0 0 1 /end COMPU_METHOD
/begin MEASUREMENT P0645_TMR "Time which ACC OSM fault present." FLOAT32_IEEE MC_P0645_TMR 0 0 0 0 ECU_ADDRESS 0x3F9D80 /end MEASUREMENT
/begin COMPU_METHOD MC_P0645_TMR "P0645_TMR conversion" RAT_FUNC "%10.5" "Unitless" COEFFS 0 1 0 0 0 1 /end COMPU_METHOD
/begin CHARACTERISTIC P0645_TM_LMT "Time required to set code for A/C OSM fault." VALUE 0x5CC64 SD_FLOAT32_IEEE 0 SC_P0645_TM_LMT 0 31.875 /end CHARACTERISTIC
/begin COMPU_METHOD SC_P0645_TM_LMT "P0645_TM_LMT conversion" RAT_FUNC "%10.5" "s" COEFFS 0 1 0 0 0 1 /end COMPU_METHOD
/begin MEASUREMENT P0670MALF "" UBYTE MC_P0670MALF 0 0 0 0 ECU_ADDRESS 0x3FAC41 /end MEASUREMENT
/begin COMPU_METHOD MC_P0670MALF "P0670MALF conversion" RAT_FUNC "%3.0" "Unitless" COEFFS 0 1 0 0 0 1 /end COMPU_METHOD
/begin CHARACTERISTIC P0670SW "GPE fault record updation enable switch" VALUE 0x5E2C6 SD_UBYTE 0 SC_P0670SW 0 2 /end CHARACTERISTIC
/begin COMPU_METHOD SC_P0670SW "P0670SW conversion" RAT_FUNC "%3.0" "unitless" COEFFS 0 1 0 0 0 1 /end COMPU_METHOD
/begin MEASUREMENT P0670UPDATE "" UBYTE MC_P0670UPDATE 0 0 0 0 ECU_ADDRESS 0x3FAC36 /end MEASUREMENT
/begin COMPU_METHOD MC_P0670UPDATE "P0670UPDATE conversion" RAT_FUNC "%3.0" "Unitless" COEFFS 0 1 0 0 0 1 /end COMPU_METHOD
/begin MEASUREMENT P0671MALF "Glow plug monitor Flault Flag for cylinder 1" UBYTE MC_P0671MALF 0 0 0 0 ECU_ADDRESS 0x3FAC40 /end MEASUREMENT
/begin COMPU_METHOD MC_P0671MALF "P0671MALF conversion" RAT_FUNC "%3.0" "Unitless" COEFFS 0 1 0 0 0 1 /end COMPU_METHOD
/begin CHARACTERISTIC P0671SW "Glow plug monitor enable switch for cylinder 1" VALUE 0x5E2C5 SD_UBYTE 0 SC_P0671SW 0 2 /end CHARACTERISTIC
/begin COMPU_METHOD SC_P0671SW "P0671SW conversion" RAT_FUNC "%3.0" "unitless" COEFFS 0 1 0 0 0 1 /end COMPU_METHOD
/begin MEASUREMENT P0671UPDATE "Glow plug monitor update flag for cylinder 1" UBYTE MC_P0671UPDATE 0 0 0 0 ECU_ADDRESS 0x3FAC35 /end MEASUREMENT
/begin COMPU_METHOD MC_P0671UPDATE "P0671UPDATE conversion" RAT_FUNC "%3.0" "Unitless" COEFFS 0 1 0 0 0 1 /end COMPU_METHOD
/begin MEASUREMENT P0672MALF "Glow plug monitor Flault Flag for cylinder 2" UBYTE MC_P0672MALF 0 0 0 0 ECU_ADDRESS 0x3FAC3F /end MEASUREMENT
/begin COMPU_METHOD MC_P0672MALF "P0672MALF conversion" RAT_FUNC "%3.0" "Unitless" COEFFS 0 1 0 0 0 1 /end COMPU_METHOD
/begin CHARACTERISTIC P0672SW "Glow plug monitor enable switch for cylinder 2" VALUE 0x5E2C4 SD_UBYTE 0 SC_P0672SW 0 2 /end CHARACTERISTIC
/begin COMPU_METHOD SC_P0672SW "P0672SW conversion" RAT_FUNC "%3.0" "unitless" COEFFS 0 1 0 0 0 1 /end COMPU_METHOD
/begin MEASUREMENT P0672UPDATE "Glow plug monitor update flag for cylinder 2" UBYTE MC_P0672UPDATE 0 0 0 0 ECU_ADDRESS 0x3FAC34 /end MEASUREMENT
/begin COMPU_METHOD MC_P0672UPDATE "P0672UPDATE conversion" RAT_FUNC "%3.0" "Unitless" COEFFS 0 1 0 0 0 1 /end COMPU_METHOD
/begin MEASUREMENT P0673MALF "Glow plug monitor Flault Flag for cylinder 3" UBYTE MC_P0673MALF 0 0 0 0 ECU_ADDRESS 0x3FAC3E /end MEASUREMENT
/begin COMPU_METHOD MC_P0673MALF "P0673MALF conversion" RAT_FUNC "%3.0" "Unitless" COEFFS 0 1 0 0 0 1 /end COMPU_METHOD
/begin CHARACTERISTIC P0673SW "Glow plug monitor enable switch for cylinder 3" VALUE 0x5E2C3 SD_UBYTE 0 SC_P0673SW 0 2 /end CHARACTERISTIC
/begin COMPU_METHOD SC_P0673SW "P0673SW conversion" RAT_FUNC "%3.0" "unitless" COEFFS 0 1 0 0 0 1 /end COMPU_METHOD
/begin MEASUREMENT P0673UPDATE "Glow plug monitor update flag for cylinder 3" UBYTE MC_P0673UPDATE 0 0 0 0 ECU_ADDRESS 0x3FAC33 /end MEASUREMENT
/begin COMPU_METHOD MC_P0673UPDATE "P0673UPDATE conversion" RAT_FUNC "%3.0" "Unitless" COEFFS 0 1 0 0 0 1 /end COMPU_METHOD
/begin MEASUREMENT P0674MALF "Glow plug monitor Flault Flag for cylinder 4" UBYTE MC_P0674MALF 0 0 0 0 ECU_ADDRESS 0x3FAC3D /end MEASUREMENT
/begin COMPU_METHOD MC_P0674MALF "P0674MALF conversion" RAT_FUNC "%3.0" "Unitless" COEFFS 0 1 0 0 0 1 /end COMPU_METHOD
/begin CHARACTERISTIC P0674SW "" VALUE 0x5E2C2 SD_UBYTE 0 SC_P0674SW 0 2 /end CHARACTERISTIC
/begin COMPU_METHOD SC_P0674SW "P0674SW conversion" RAT_FUNC "%3.0" "unitless" COEFFS 0 1 0 0 0 1 /end COMPU_METHOD
/begin MEASUREMENT P0674UPDATE "Glow plug monitor update flag for cylinder 4" UBYTE MC_P0674UPDATE 0 0 0 0 ECU_ADDRESS 0x3FAC32 /end MEASUREMENT
/begin COMPU_METHOD MC_P0674UPDATE "P0674UPDATE conversion" RAT_FUNC "%3.0" "Unitless" COEFFS 0 1 0 0 0 1 /end COMPU_METHOD
/begin MEASUREMENT P0675MALF "Glow plug monitor Flault Flag for cylinder 5" UBYTE MC_P0675MALF 0 0 0 0 ECU_ADDRESS 0x3FAC3C /end MEASUREMENT
/begin COMPU_METHOD MC_P0675MALF "P0675MALF conversion" RAT_FUNC "%3.0" "Unitless" COEFFS 0 1 0 0 0 1 /end COMPU_METHOD
/begin CHARACTERISTIC P0675SW "Glow plug monitor enable switch for cylinder 5" VALUE 0x5E2C1 SD_UBYTE 0 SC_P0675SW 0 2 /end CHARACTERISTIC
/begin COMPU_METHOD SC_P0675SW "P0675SW conversion" RAT_FUNC "%3.0" "unitless" COEFFS 0 1 0 0 0 1 /end COMPU_METHOD
/begin MEASUREMENT P0675UPDATE "Glow plug monitor update flag for cylinder 5" UBYTE MC_P0675UPDATE 0 0 0 0 ECU_ADDRESS 0x3FAC31 /end MEASUREMENT
/begin COMPU_METHOD MC_P0675UPDATE "P0675UPDATE conversion" RAT_FUNC "%3.0" "Unitless" COEFFS 0 1 0 0 0 1 /end COMPU_METHOD
/begin MEASUREMENT P0676MALF "Glow plug monitor Flault Flag for cylinder 6" UBYTE MC_P0676MALF 0 0 0 0 ECU_ADDRESS 0x3FAC3B /end MEASUREMENT
/begin COMPU_METHOD MC_P0676MALF "P0676MALF conversion" RAT_FUNC "%3.0" "Unitless" COEFFS 0 1 0 0 0 1 /end COMPU_METHOD
/begin CHARACTERISTIC P0676SW "Glow plug monitor enable switch for cylinder 6" VALUE 0x5E2C0 SD_UBYTE 0 SC_P0676SW 0 2 /end CHARACTERISTIC
/begin COMPU_METHOD SC_P0676SW "P0676SW conversion" RAT_FUNC "%3.0" "unitless" COEFFS 0 1 0 0 0 1 /end COMPU_METHOD
/begin MEASUREMENT P0676UPDATE "Glow plug monitor update flag for cylinder 6" UBYTE MC_P0676UPDATE 0 0 0 0 ECU_ADDRESS 0x3FAC30 /end MEASUREMENT
/begin COMPU_METHOD MC_P0676UPDATE "P0676UPDATE conversion" RAT_FUNC "%3.0" "Unitless" COEFFS 0 1 0 0 0 1 /end COMPU_METHOD
/begin MEASUREMENT P0677MALF "Glow plug monitor Flault Flag for cylinder 7" UBYTE MC_P0677MALF 0 0 0 0 ECU_ADDRESS 0x3FAC3A /end MEASUREMENT
/begin COMPU_METHOD MC_P0677MALF "P0677MALF conversion" RAT_FUNC "%3.0" "Unitless" COEFFS 0 1 0 0 0 1 /end COMPU_METHOD
/begin CHARACTERISTIC P0677SW "Glow plug monitor enable switch for cylinder 7" VALUE 0x5E2BF SD_UBYTE 0 SC_P0677SW 0 2 /end CHARACTERISTIC
/begin COMPU_METHOD SC_P0677SW "P0677SW conversion" RAT_FUNC "%3.0" "unitless" COEFFS 0 1 0 0 0 1 /end COMPU_METHOD
/begin MEASUREMENT P0677UPDATE "Glow plug monitor update flag for cylinder 7" UBYTE MC_P0677UPDATE 0 0 0 0 ECU_ADDRESS 0x3FAC2F /end MEASUREMENT
/begin COMPU_METHOD MC_P0677UPDATE "P0677UPDATE conversion" RAT_FUNC "%3.0" "Unitless" COEFFS 0 1 0 0 0 1 /end COMPU_METHOD
/begin MEASUREMENT P0678MALF "Glow plug monitor Flault Flag for cylinder 8" UBYTE MC_P0678MALF 0 0 0 0 ECU_ADDRESS 0x3FAC39 /end MEASUREMENT
/begin COMPU_METHOD MC_P0678MALF "P0678MALF conversion" RAT_FUNC "%3.0" "Unitless" COEFFS 0 1 0 0 0 1 /end COMPU_METHOD
/begin CHARACTERISTIC P0678SW "Glow plug monitor enable switch for cylinder 8" VALUE 0x5E2BE SD_UBYTE 0 SC_P0678SW 0 2 /end CHARACTERISTIC
/begin COMPU_METHOD SC_P0678SW "P0678SW conversion" RAT_FUNC "%3.0" "unitless" COEFFS 0 1 0 0 0 1 /end COMPU_METHOD
/begin MEASUREMENT P0678UPDATE "Glow plug monitor update flag for cylinder 8" UBYTE MC_P0678UPDATE 0 0 0 0 ECU_ADDRESS 0x3FAC2E /end MEASUREMENT
/begin COMPU_METHOD MC_P0678UPDATE "P0678UPDATE conversion" RAT_FUNC "%3.0" "Unitless" COEFFS 0 1 0 0 0 1 /end COMPU_METHOD
/begin MEASUREMENT P0683MALF "" UBYTE MC_P0683MALF 0 0 0 0 ECU_ADDRESS 0x3FAC38 /end MEASUREMENT
/begin COMPU_METHOD MC_P0683MALF "P0683MALF conversion" RAT_FUNC "%3.0" "Unitless" COEFFS 0 1 0 0 0 1 /end COMPU_METHOD
/begin CHARACTERISTIC P0683SW "GPD fault record updation enable switch" VALUE 0x5E2BD SD_UBYTE 0 SC_P0683SW 0 2 /end CHARACTERISTIC
/begin COMPU_METHOD SC_P0683SW "P0683SW conversion" RAT_FUNC "%3.0" "unitless" COEFFS 0 1 0 0 0 1 /end COMPU_METHOD
/begin MEASUREMENT P0683UPDATE "" UBYTE MC_P0683UPDATE 0 0 0 0 ECU_ADDRESS 0x3FAC2D /end MEASUREMENT
/begin COMPU_METHOD MC_P0683UPDATE "P0683UPDATE conversion" RAT_FUNC "%3.0" "Unitless" COEFFS 0 1 0 0 0 1 /end COMPU_METHOD
/begin MEASUREMENT P0684MALF "" UBYTE MC_P0684MALF 0 0 0 0 ECU_ADDRESS 0x3FAC37 /end MEASUREMENT
/begin COMPU_METHOD MC_P0684MALF "P0684MALF conversion" RAT_FUNC "%3.0" "Unitless" COEFFS 0 1 0 0 0 1 /end COMPU_METHOD
/begin CHARACTERISTIC P0684SW "Glow Plug fault record updation enable switch" VALUE 0x5E2BC SD_UBYTE 0 SC_P0684SW 0 2 /end CHARACTERISTIC
/begin COMPU_METHOD SC_P0684SW "P0684SW conversion" RAT_FUNC "%3.0" "unitless" COEFFS 0 1 0 0 0 1 /end COMPU_METHOD
/begin MEASUREMENT P0684UPDATE "" UBYTE MC_P0684UPDATE 0 0 0 0 ECU_ADDRESS 0x3FAC2C /end MEASUREMENT
/begin COMPU_METHOD MC_P0684UPDATE "P0684UPDATE conversion" RAT_FUNC "%3.0" "Unitless" COEFFS 0 1 0 0 0 1 /end COMPU_METHOD
/begin CHARACTERISTIC P0700SW "0=cal_out; 1=non_mil; 2=mil" VALUE 0x5D44C SD_UBYTE 0 SC_P0700SW 0 255 /end CHARACTERISTIC
/begin COMPU_METHOD SC_P0700SW "P0700SW conversion" RAT_FUNC "%3.0" "Unitless" COEFFS 0 1 0 0 0 1 /end COMPU_METHOD
/begin MEASUREMENT P0703MALF "" UBYTE MC_P0703MALF 0 0 0 0 ECU_ADDRESS 0x3FB59B /end MEASUREMENT
/begin COMPU_METHOD MC_P0703MALF "P0703MALF conversion" RAT_FUNC "%3.0" "Unitless" COEFFS 0 1 0 0 0 1 /end COMPU_METHOD
/begin CHARACTERISTIC P0703SW "0=cal_out; 1=non_mil; 2=mil" VALUE 0x5F192 SD_UBYTE 0 SC_P0703SW 0 255 /end CHARACTERISTIC
/begin COMPU_METHOD SC_P0703SW "P0703SW conversion" RAT_FUNC "%3.0" "Unitless" COEFFS 0 1 0 0 0 1 /end COMPU_METHOD
/begin MEASUREMENT P0704MALF "" UBYTE MC_P0704MALF 0 0 0 0 ECU_ADDRESS 0x3FB59A /end MEASUREMENT
/begin COMPU_METHOD MC_P0704MALF "P0704MALF conversion" RAT_FUNC "%3.0" "Unitless" COEFFS 0 1 0 0 0 1 /end COMPU_METHOD
/begin CHARACTERISTIC P0704SW "0=cal_out; 1=non_mil; 2=mil" VALUE 0x5F191 SD_UBYTE 0 SC_P0704SW 0 255 /end CHARACTERISTIC
/begin COMPU_METHOD SC_P0704SW "P0704SW conversion" RAT_FUNC "%3.0" "Unitless" COEFFS 0 1 0 0 0 1 /end COMPU_METHOD
/begin CHARACTERISTIC P0705SW "0=cal_out; 1=non_mil; 2=mil" VALUE 0x5CB2B SD_UBYTE 0 SC_P0705SW 0 255 /end CHARACTERISTIC
/begin COMPU_METHOD SC_P0705SW "P0705SW conversion" RAT_FUNC "%3.0" "Unitless" COEFFS 0 1 0 0 0 1 /end COMPU_METHOD
/begin MEASUREMENT P1 "Multiplicative adaptive parameter for throttle flow model" FLOAT32_IEEE MC_P1 0 0 0 0 ECU_ADDRESS 0x3FA23C /end MEASUREMENT
/begin COMPU_METHOD MC_P1 "P1 conversion" RAT_FUNC "%10.5" "Unitless" COEFFS 0 1 0 0 0 1 /end COMPU_METHOD
/begin CHARACTERISTIC P1000SW "0=cal_out; 1=non_mil; 2=mil" VALUE 0x5CE64 SD_UBYTE 0 SC_P1000SW 0 255 /end CHARACTERISTIC
/begin COMPU_METHOD SC_P1000SW "P1000SW conversion" RAT_FUNC "%3.0" "Unitless" COEFFS 0 1 0 0 0 1 /end COMPU_METHOD
/begin MEASUREMENT P1001MALF "" UBYTE MC_P1001MALF 0 0 0 0 ECU_ADDRESS 0x3FB4F8 /end MEASUREMENT
/begin COMPU_METHOD MC_P1001MALF "P1001MALF conversion" RAT_FUNC "%3.0" "Unitless" COEFFS 0 1 0 0 0 1 /end COMPU_METHOD
/begin CHARACTERISTIC P1001SW "0=cal_out; 1=non_mil; 2=mil" VALUE 0x5F0B4 SD_UBYTE 0 SC_P1001SW 0 255 /end CHARACTERISTIC
/begin COMPU_METHOD SC_P1001SW "P1001SW conversion" RAT_FUNC "%3.0" "Unitless" COEFFS 0 1 0 0 0 1 /end COMPU_METHOD
/begin CHARACTERISTIC P1100SW "0=cal_out; 1=non_mil; 2=mil" VALUE 0x5CE50 SD_UBYTE 0 SC_P1100SW 0 255 /end CHARACTERISTIC
/begin COMPU_METHOD SC_P1100SW "P1100SW conversion" RAT_FUNC "%3.0" "Unitless" COEFFS 0 1 0 0 0 1 /end COMPU_METHOD
/begin MEASUREMENT P1102MALF "Maximum MAF out of range based on RPM malfunction flag" UBYTE MC_P1102MALF 0 0 0 0 ECU_ADDRESS 0x3FA157 /end MEASUREMENT
/begin COMPU_METHOD MC_P1102MALF "P1102MALF conversion" RAT_FUNC "%3.0" "Unitless" COEFFS 0 1 0 0 0 1 /end COMPU_METHOD
/begin CHARACTERISTIC P1102SW "0=cal_out; 1=non_mil; 2=mil" VALUE 0x5D790 SD_UBYTE 0 SC_P1102SW 0 255 /end CHARACTERISTIC
/begin COMPU_METHOD SC_P1102SW "P1102SW conversion" RAT_FUNC "%3.0" "Unitless" COEFFS 0 1 0 0 0 1 /end COMPU_METHOD
/begin MEASUREMENT P1102UPDATE "Maximum MAF out of range based on RPM update flag" UBYTE MC_P1102UPDATE 0 0 0 0 ECU_ADDRESS 0x3FA156 /end MEASUREMENT
/begin COMPU_METHOD MC_P1102UPDATE "P1102UPDATE conversion" RAT_FUNC "%3.0" "Unitless" COEFFS 0 1 0 0 0 1 /end COMPU_METHOD
/begin CHARACTERISTIC P1112SW "0=cal_out; 1=non_mil; 2=mil" VALUE 0x5CE4F SD_UBYTE 0 SC_P1112SW 0 255 /end CHARACTERISTIC
/begin COMPU_METHOD SC_P1112SW "P1112SW conversion" RAT_FUNC "%3.0" "Unitless" COEFFS 0 1 0 0 0 1 /end COMPU_METHOD
/begin CHARACTERISTIC P1117SW "0=cal_out; 1=non_mil; 2=mil" VALUE 0x5CE4E SD_UBYTE 0 SC_P1117SW 0 255 /end CHARACTERISTIC
/begin COMPU_METHOD SC_P1117SW "P1117SW conversion" RAT_FUNC "%3.0" "Unitless" COEFFS 0 1 0 0 0 1 /end COMPU_METHOD
/begin CHARACTERISTIC P1125SW "0=cal_out; 1=non_mil; 2=mil" VALUE 0x5CE4D SD_UBYTE 0 SC_P1125SW 0 255 /end CHARACTERISTIC
/begin COMPU_METHOD SC_P1125SW "P1125SW conversion" RAT_FUNC "%3.0" "Unitless" COEFFS 0 1 0 0 0 1 /end COMPU_METHOD
/begin CHARACTERISTIC P1131SW "0=cal_out; 1=non_mil; 2=mil" VALUE 0x5CB29 SD_UBYTE 0 SC_P1131SW 0 255 /end CHARACTERISTIC
/begin COMPU_METHOD SC_P1131SW "P1131SW conversion" RAT_FUNC "%3.0" "Unitless" COEFFS 0 1 0 0 0 1 /end COMPU_METHOD
/begin CHARACTERISTIC P1132SW "0=cal_out; 1=non_mil; 2=mil" VALUE 0x5CB28 SD_UBYTE 0 SC_P1132SW 0 255 /end CHARACTERISTIC
/begin COMPU_METHOD SC_P1132SW "P1132SW conversion" RAT_FUNC "%3.0" "Unitless" COEFFS 0 1 0 0 0 1 /end COMPU_METHOD
/begin CHARACTERISTIC P1137SW "0=cal_out; 1=non_mil; 2=mil" VALUE 0x5CB25 SD_UBYTE 0 SC_P1137SW 0 255 /end CHARACTERISTIC
/begin COMPU_METHOD SC_P1137SW "P1137SW conversion" RAT_FUNC "%3.0" "Unitless" COEFFS 0 1 0 0 0 1 /end COMPU_METHOD
/begin CHARACTERISTIC P1138SW "0=cal_out; 1=non_mil; 2=mil" VALUE 0x5CB24 SD_UBYTE 0 SC_P1138SW 0 255 /end CHARACTERISTIC
/begin COMPU_METHOD SC_P1138SW "P1138SW conversion" RAT_FUNC "%3.0" "Unitless" COEFFS 0 1 0 0 0 1 /end COMPU_METHOD
/begin CHARACTERISTIC P1139SW "Water in fuel indicator lamp failure P-code switch" VALUE 0x5D7C2 SD_UBYTE 0 SC_P1139SW 0 255 /end CHARACTERISTIC
/begin COMPU_METHOD SC_P1139SW "P1139SW conversion" RAT_FUNC "%3.0" "unitless" COEFFS 0 1 0 0 0 1 /end COMPU_METHOD
/begin CHARACTERISTIC P1148SW "Secondary Alternator updation enable switch" VALUE 0x5ECB8 SD_UBYTE 0 SC_P1148SW 0 2 /end CHARACTERISTIC
/begin COMPU_METHOD SC_P1148SW "P1148SW conversion" RAT_FUNC "%3.0" "unitless" COEFFS 0 1 0 0 0 1 /end COMPU_METHOD
/begin CHARACTERISTIC P1149SW "Alternator 2 P-code switch" VALUE 0x5ECB7 SD_UBYTE 0 SC_P1149SW 0 255 /end CHARACTERISTIC
/begin COMPU_METHOD SC_P1149SW "P1149SW conversion" RAT_FUNC "%3.0" "unitless" COEFFS 0 1 0 0 0 1 /end COMPU_METHOD
/begin CHARACTERISTIC P1151SW "0=cal_out; 1=non_mil; 2=mil" VALUE 0x5CB27 SD_UBYTE 0 SC_P1151SW 0 255 /end CHARACTERISTIC
/begin COMPU_METHOD SC_P1151SW "P1151SW conversion" RAT_FUNC "%3.0" "Unitless" COEFFS 0 1 0 0 0 1 /end COMPU_METHOD
/begin CHARACTERISTIC P1152SW "0=cal_out; 1=non_mil; 2=mil" VALUE 0x5CB26 SD_UBYTE 0 SC_P1152SW 0 255 /end CHARACTERISTIC
/begin COMPU_METHOD SC_P1152SW "P1152SW conversion" RAT_FUNC "%3.0" "Unitless" COEFFS 0 1 0 0 0 1 /end COMPU_METHOD
/begin CHARACTERISTIC P1157SW "0=cal_out; 1=non_mil; 2=mil" VALUE 0x5CB23 SD_UBYTE 0 SC_P1157SW 0 255 /end CHARACTERISTIC
/begin COMPU_METHOD SC_P1157SW "P1157SW conversion" RAT_FUNC "%3.0" "Unitless" COEFFS 0 1 0 0 0 1 /end COMPU_METHOD
/begin CHARACTERISTIC P1158SW "0=cal_out; 1=non_mil; 2=mil" VALUE 0x5CB22 SD_UBYTE 0 SC_P1158SW 0 255 /end CHARACTERISTIC
/begin COMPU_METHOD SC_P1158SW "P1158SW conversion" RAT_FUNC "%3.0" "Unitless" COEFFS 0 1 0 0 0 1 /end COMPU_METHOD
/begin MEASUREMENT P1184MALF "" UBYTE MC_P1184MALF 0 0 0 0 ECU_ADDRESS 0x3FB599 /end MEASUREMENT
/begin COMPU_METHOD MC_P1184MALF "P1184MALF conversion" RAT_FUNC "%3.0" "Unitless" COEFFS 0 1 0 0 0 1 /end COMPU_METHOD
/begin CHARACTERISTIC P1184SW "0=cal_out; 1=non_mil; 2=mil" VALUE 0x5F190 SD_UBYTE 0 SC_P1184SW 0 255 /end CHARACTERISTIC
/begin COMPU_METHOD SC_P1184SW "P1184SW conversion" RAT_FUNC "%3.0" "Unitless" COEFFS 0 1 0 0 0 1 /end COMPU_METHOD
/begin CHARACTERISTIC P1195SW "Calibratable switch for p-code" VALUE 0x5E860 SD_UBYTE 0 SC_P1195SW 0 255 /end CHARACTERISTIC
/begin COMPU_METHOD SC_P1195SW "P1195SW conversion" RAT_FUNC "%3.0" "unitless" COEFFS 0 1 0 0 0 1 /end COMPU_METHOD
/begin CHARACTERISTIC P1260SW "0=cal_out; 1=non_mil; 2=mil" VALUE 0x5CCE0 SD_UBYTE 0 SC_P1260SW 0 255 /end CHARACTERISTIC
/begin COMPU_METHOD SC_P1260SW "P1260SW conversion" RAT_FUNC "%3.0" "Unitless" COEFFS 0 1 0 0 0 1 /end COMPU_METHOD
/begin MEASUREMENT P1284MALF "" UBYTE MC_P1284MALF 0 0 0 0 ECU_ADDRESS 0x3FB598 /end MEASUREMENT
/begin COMPU_METHOD MC_P1284MALF "P1284MALF conversion" RAT_FUNC "%3.0" "Unitless" COEFFS 0 1 0 0 0 1 /end COMPU_METHOD
/begin CHARACTERISTIC P1284SW "Calibratable switch for p-code" VALUE 0x5F18F SD_UBYTE 0 SC_P1284SW 0 255 /end CHARACTERISTIC
/begin COMPU_METHOD SC_P1284SW "P1284SW conversion" RAT_FUNC "%3.0" "unitless" COEFFS 0 1 0 0 0 1 /end COMPU_METHOD
/begin MEASUREMENT P1334MALF "" UBYTE MC_P1334MALF 0 0 0 0 ECU_ADDRESS 0x3F9A41 /end MEASUREMENT
/begin COMPU_METHOD MC_P1334MALF "P1334MALF conversion" RAT_FUNC "%3.0" "Unitless" COEFFS 0 1 0 0 0 1 /end COMPU_METHOD
/begin CHARACTERISTIC P1334SW "" VALUE 0x5C810 SD_UBYTE 0 SC_P1334SW 0 1 /end CHARACTERISTIC
/begin COMPU_METHOD SC_P1334SW "P1334SW conversion" RAT_FUNC "%3.0" "unitless" COEFFS 0 1 0 0 0 1 /end COMPU_METHOD
/begin MEASUREMENT P1334UPDATE "" UBYTE MC_P1334UPDATE 0 0 0 0 ECU_ADDRESS 0x3F9A40 /end MEASUREMENT
/begin COMPU_METHOD MC_P1334UPDATE "P1334UPDATE conversion" RAT_FUNC "%3.0" "Unitless" COEFFS 0 1 0 0 0 1 /end COMPU_METHOD
/begin MEASUREMENT P1378MALF "FICM supply voltage circuit low failure flag" UBYTE MC_P1378MALF 0 0 0 0 ECU_ADDRESS 0x3FA4A7 /end MEASUREMENT
/begin COMPU_METHOD MC_P1378MALF "P1378MALF conversion" RAT_FUNC "%3.0" "Unitless" COEFFS 0 1 0 0 0 1 /end COMPU_METHOD
/begin CHARACTERISTIC P1378SW "0=cal_out; 1=non_mil; 2=mil" VALUE 0x5D781 SD_UBYTE 0 SC_P1378SW 0 2 /end CHARACTERISTIC
/begin COMPU_METHOD SC_P1378SW "P1378SW conversion" RAT_FUNC "%3.0" "Unitless" COEFFS 0 1 0 0 0 1 /end COMPU_METHOD
/begin MEASUREMENT P1378UPDATE "FICM supply voltage circuit low failure update flag." UBYTE MC_P1378UPDATE 0 0 0 0 ECU_ADDRESS 0x3FA4A6 /end MEASUREMENT
/begin COMPU_METHOD MC_P1378UPDATE "P1378UPDATE conversion" RAT_FUNC "%3.0" "Unitless" COEFFS 0 1 0 0 0 1 /end COMPU_METHOD
/begin MEASUREMENT P1378UPD_CNTR "p1378 malf update counter" SLONG MC_P1378UPD_CNTR 0 0 0 0 ECU_ADDRESS 0x3FA47C /end MEASUREMENT
/begin COMPU_METHOD MC_P1378UPD_CNTR "P1378UPD_CNTR conversion" RAT_FUNC "%10.0" "Unitless" COEFFS 0 1 0 0 0 1 /end COMPU_METHOD
/begin MEASUREMENT P1379MALF "FICM supply voltage circuit high failure flag" UBYTE MC_P1379MALF 0 0 0 0 ECU_ADDRESS 0x3FA4A5 /end MEASUREMENT
/begin COMPU_METHOD MC_P1379MALF "P1379MALF conversion" RAT_FUNC "%3.0" "Unitless" COEFFS 0 1 0 0 0 1 /end COMPU_METHOD
/begin CHARACTERISTIC P1379SW "0=cal_out; 1=non_mil; 2=mil" VALUE 0x5D780 SD_UBYTE 0 SC_P1379SW 0 2 /end CHARACTERISTIC
/begin COMPU_METHOD SC_P1379SW "P1379SW conversion" RAT_FUNC "%3.0" "Unitless" COEFFS 0 1 0 0 0 1 /end COMPU_METHOD
/begin MEASUREMENT P1379UPDATE "FICM supply voltage circuit high failure update flag." UBYTE MC_P1379UPDATE 0 0 0 0 ECU_ADDRESS 0x3FA4A4 /end MEASUREMENT
/begin COMPU_METHOD MC_P1379UPDATE "P1379UPDATE conversion" RAT_FUNC "%3.0" "Unitless" COEFFS 0 1 0 0 0 1 /end COMPU_METHOD
/begin MEASUREMENT P1379UPD_CNTR "p1379 malf update counter" SLONG MC_P1379UPD_CNTR 0 0 0 0 ECU_ADDRESS 0x3FA478 /end MEASUREMENT
/begin COMPU_METHOD MC_P1379UPD_CNTR "P1379UPD_CNTR conversion" RAT_FUNC "%10.0" "Unitless" COEFFS 0 1 0 0 0 1 /end COMPU_METHOD
/begin MEASUREMENT P1397MALF "" UBYTE MC_P1397MALF 0 0 0 0 ECU_ADDRESS 0x3FB597 /end MEASUREMENT
/begin COMPU_METHOD MC_P1397MALF "P1397MALF conversion" RAT_FUNC "%3.0" "Unitless" COEFFS 0 1 0 0 0 1 /end COMPU_METHOD
/begin CHARACTERISTIC P1397SW "0=cal_out; 1=non_mil; 2=mil" VALUE 0x5F18E SD_UBYTE 0 SC_P1397SW 0 255 /end CHARACTERISTIC
/begin COMPU_METHOD SC_P1397SW "P1397SW conversion" RAT_FUNC "%3.0" "Unitless" COEFFS 0 1 0 0 0 1 /end COMPU_METHOD
/begin CHARACTERISTIC P1400SW "0=cal_out; 1=non_mil; 2=mil" VALUE 0x5E85F SD_UBYTE 0 SC_P1400SW 0 255 /end CHARACTERISTIC
/begin COMPU_METHOD SC_P1400SW "P1400SW conversion" RAT_FUNC "%3.0" "Unitless" COEFFS 0 1 0 0 0 1 /end COMPU_METHOD
/begin CHARACTERISTIC P1401SW "0=cal_out; 1=non_mil; 2=mil" VALUE 0x5E85E SD_UBYTE 0 SC_P1401SW 0 255 /end CHARACTERISTIC
/begin COMPU_METHOD SC_P1401SW "P1401SW conversion" RAT_FUNC "%3.0" "Unitless" COEFFS 0 1 0 0 0 1 /end COMPU_METHOD
/begin MEASUREMENT P1408MALF "" UBYTE MC_P1408MALF 0 0 0 0 ECU_ADDRESS 0x3FB596 /end MEASUREMENT
/begin COMPU_METHOD MC_P1408MALF "P1408MALF conversion" RAT_FUNC "%3.0" "Unitless" COEFFS 0 1 0 0 0 1 /end COMPU_METHOD
/begin CHARACTERISTIC P1408SW "0=cal_out; 1=non_mil; 2=mil" VALUE 0x5F18D SD_UBYTE 0 SC_P1408SW 0 255 /end CHARACTERISTIC
/begin COMPU_METHOD SC_P1408SW "P1408SW conversion" RAT_FUNC "%3.0" "Unitless" COEFFS 0 1 0 0 0 1 /end COMPU_METHOD
/begin CHARACTERISTIC P1412SW "Calibratable switch for p-code" VALUE 0x5E85D SD_UBYTE 0 SC_P1412SW 0 255 /end CHARACTERISTIC
/begin COMPU_METHOD SC_P1412SW "P1412SW conversion" RAT_FUNC "%3.0" "unitless" COEFFS 0 1 0 0 0 1 /end COMPU_METHOD
/begin CHARACTERISTIC P1464SW "0=cal_out; 1=non_mil; 2=mil" VALUE 0x5CC14 SD_UBYTE 0 SC_P1464SW 0 255 /end CHARACTERISTIC
/begin COMPU_METHOD SC_P1464SW "P1464SW conversion" RAT_FUNC "%3.0" "Unitless" COEFFS 0 1 0 0 0 1 /end COMPU_METHOD
/begin MEASUREMENT P1464_TMR "Time A/C requested during selftest." FLOAT32_IEEE MC_P1464_TMR 0 0 0 0 ECU_ADDRESS 0x3F9D68 /end MEASUREMENT
/begin COMPU_METHOD MC_P1464_TMR "P1464_TMR conversion" RAT_FUNC "%10.5" "Unitless" COEFFS 0 1 0 0 0 1 /end COMPU_METHOD
/begin CHARACTERISTIC P1464_TM_LMT "Time A/C demand in selftest before setting code." VALUE 0x5CC10 SD_FLOAT32_IEEE 0 SC_P1464_TM_LMT 0 31.875 /end CHARACTERISTIC
/begin COMPU_METHOD SC_P1464_TM_LMT "P1464_TM_LMT conversion" RAT_FUNC "%10.5" "s" COEFFS 0 1 0 0 0 1 /end COMPU_METHOD
/begin CHARACTERISTIC P1500SW "0=cal_out; 1=non_mil; 2=mil" VALUE 0x5CE4C SD_UBYTE 0 SC_P1500SW 0 255 /end CHARACTERISTIC
/begin COMPU_METHOD SC_P1500SW "P1500SW conversion" RAT_FUNC "%3.0" "Unitless" COEFFS 0 1 0 0 0 1 /end COMPU_METHOD
/begin MEASUREMENT P1501MALF "" UBYTE MC_P1501MALF 0 0 0 0 ECU_ADDRESS 0x3FB595 /end MEASUREMENT
/begin COMPU_METHOD MC_P1501MALF "P1501MALF conversion" RAT_FUNC "%3.0" "Unitless" COEFFS 0 1 0 0 0 1 /end COMPU_METHOD
/begin CHARACTERISTIC P1501SW "0=cal_out; 1=non_mil; 2=mil" VALUE 0x5F18C SD_UBYTE 0 SC_P1501SW 0 255 /end CHARACTERISTIC
/begin COMPU_METHOD SC_P1501SW "P1501SW conversion" RAT_FUNC "%3.0" "Unitless" COEFFS 0 1 0 0 0 1 /end COMPU_METHOD
/begin MEASUREMENT P1502MALF "" UBYTE MC_P1502MALF 0 0 0 0 ECU_ADDRESS 0x3FB594 /end MEASUREMENT
/begin COMPU_METHOD MC_P1502MALF "P1502MALF conversion" RAT_FUNC "%3.0" "Unitless" COEFFS 0 1 0 0 0 1 /end COMPU_METHOD
/begin CHARACTERISTIC P1502SW "0=cal_out; 1=non_mil; 2=mil" VALUE 0x5F18B SD_UBYTE 0 SC_P1502SW 0 255 /end CHARACTERISTIC
/begin COMPU_METHOD SC_P1502SW "P1502SW conversion" RAT_FUNC "%3.0" "Unitless" COEFFS 0 1 0 0 0 1 /end COMPU_METHOD
/begin MEASUREMENT P1531MALF "" UBYTE MC_P1531MALF 0 0 0 0 ECU_ADDRESS 0x3FB593 /end MEASUREMENT
/begin COMPU_METHOD MC_P1531MALF "P1531MALF conversion" RAT_FUNC "%3.0" "Unitless" COEFFS 0 1 0 0 0 1 /end COMPU_METHOD
/begin CHARACTERISTIC P1531SW "Calibratable switch for p-code" VALUE 0x5F18A SD_UBYTE 0 SC_P1531SW 0 255 /end CHARACTERISTIC
/begin COMPU_METHOD SC_P1531SW "P1531SW conversion" RAT_FUNC "%3.0" "unitless" COEFFS 0 1 0 0 0 1 /end COMPU_METHOD
/begin MEASUREMENT P1536MALF "" UBYTE MC_P1536MALF 0 0 0 0 ECU_ADDRESS 0x3FB592 /end MEASUREMENT
/begin COMPU_METHOD MC_P1536MALF "P1536MALF conversion" RAT_FUNC "%3.0" "Unitless" COEFFS 0 1 0 0 0 1 /end COMPU_METHOD
/begin CHARACTERISTIC P1536SW "" VALUE 0x5F189 SD_UBYTE 0 SC_P1536SW 0 2 /end CHARACTERISTIC
/begin COMPU_METHOD SC_P1536SW "P1536SW conversion" RAT_FUNC "%3.0" "unitless" COEFFS 0 1 0 0 0 1 /end COMPU_METHOD
/begin CHARACTERISTIC P1633SW "0=cal_out; 1=non_mil; 2=mil" VALUE 0x5EB08 SD_UBYTE 0 SC_P1633SW 0 255 /end CHARACTERISTIC
/begin COMPU_METHOD SC_P1633SW "P1633SW conversion" RAT_FUNC "%3.0" "Unitless" COEFFS 0 1 0 0 0 1 /end COMPU_METHOD
/begin CHARACTERISTIC P1635SW "0=cal_out; 1=non_mil; 2=mil" VALUE 0x5EF8C SD_UBYTE 0 SC_P1635SW 0 255 /end CHARACTERISTIC
/begin COMPU_METHOD SC_P1635SW "P1635SW conversion" RAT_FUNC "%3.0" "Unitless" COEFFS 0 1 0 0 0 1 /end COMPU_METHOD
/begin MEASUREMENT P1703MALF "" UBYTE MC_P1703MALF 0 0 0 0 ECU_ADDRESS 0x3FB591 /end MEASUREMENT
/begin COMPU_METHOD MC_P1703MALF "P1703MALF conversion" RAT_FUNC "%3.0" "Unitless" COEFFS 0 1 0 0 0 1 /end COMPU_METHOD
/begin CHARACTERISTIC P1703SW "0=cal_out; 1=non_mil; 2=mil" VALUE 0x5F188 SD_UBYTE 0 SC_P1703SW 0 255 /end CHARACTERISTIC
/begin COMPU_METHOD SC_P1703SW "P1703SW conversion" RAT_FUNC "%3.0" "Unitless" COEFFS 0 1 0 0 0 1 /end COMPU_METHOD
/begin MEASUREMENT P1705MALF "" UBYTE MC_P1705MALF 0 0 0 0 ECU_ADDRESS 0x3FB590 /end MEASUREMENT
/begin COMPU_METHOD MC_P1705MALF "P1705MALF conversion" RAT_FUNC "%3.0" "Unitless" COEFFS 0 1 0 0 0 1 /end COMPU_METHOD
/begin CHARACTERISTIC P1705SW "0=cal_out; 1=non_mil; 2=mil" VALUE 0x5F187 SD_UBYTE 0 SC_P1705SW 0 255 /end CHARACTERISTIC
/begin COMPU_METHOD SC_P1705SW "P1705SW conversion" RAT_FUNC "%3.0" "Unitless" COEFFS 0 1 0 0 0 1 /end COMPU_METHOD
/begin MEASUREMENT P1725MALF "" UBYTE MC_P1725MALF 0 0 0 0 ECU_ADDRESS 0x3FB58F /end MEASUREMENT
/begin COMPU_METHOD MC_P1725MALF "P1725MALF conversion" RAT_FUNC "%3.0" "Unitless" COEFFS 0 1 0 0 0 1 /end COMPU_METHOD
/begin CHARACTERISTIC P1725SW "Calibratable switch for p-code" VALUE 0x5F186 SD_UBYTE 0 SC_P1725SW 0 255 /end CHARACTERISTIC
/begin COMPU_METHOD SC_P1725SW "P1725SW conversion" RAT_FUNC "%3.0" "unitless" COEFFS 0 1 0 0 0 1 /end COMPU_METHOD
/begin MEASUREMENT P1726MALF "" UBYTE MC_P1726MALF 0 0 0 0 ECU_ADDRESS 0x3FB58E /end MEASUREMENT
/begin COMPU_METHOD MC_P1726MALF "P1726MALF conversion" RAT_FUNC "%3.0" "Unitless" COEFFS 0 1 0 0 0 1 /end COMPU_METHOD
/begin CHARACTERISTIC P1726SW "Calibratable switch for p-code" VALUE 0x5F185 SD_UBYTE 0 SC_P1726SW 0 255 /end CHARACTERISTIC
/begin COMPU_METHOD SC_P1726SW "P1726SW conversion" RAT_FUNC "%3.0" "unitless" COEFFS 0 1 0 0 0 1 /end COMPU_METHOD
/begin MEASUREMENT P1P2FMFLG "PPS SENSOR COMPARISON TEST FAILURE" UBYTE MC_P1P2FMFLG 0 0 0 0 ECU_ADDRESS 0x3FA328 /end MEASUREMENT
/begin COMPU_METHOD MC_P1P2FMFLG "P1P2FMFLG conversion" RAT_FUNC "%3.0" "Unitless" COEFFS 0 1 0 0 0 1 /end COMPU_METHOD
/begin MEASUREMENT P1P2_CNT "PEDAL COMPARISON FAILURE COUNTER" UBYTE MC_P1P2_CNT 0 0 0 0 ECU_ADDRESS 0x3FA32F /end MEASUREMENT
/begin COMPU_METHOD MC_P1P2_CNT "P1P2_CNT conversion" RAT_FUNC "%3.0" "Unitless" COEFFS 0 1 0 0 0 1 /end COMPU_METHOD
/begin MEASUREMENT P1P3FMFLG "PPS SENSOR COMPARISON TEST FAILURE" UBYTE MC_P1P3FMFLG 0 0 0 0 ECU_ADDRESS 0x3FA327 /end MEASUREMENT
/begin COMPU_METHOD MC_P1P3FMFLG "P1P3FMFLG conversion" RAT_FUNC "%3.0" "Unitless" COEFFS 0 1 0 0 0 1 /end COMPU_METHOD
/begin MEASUREMENT P1P3_CNT "PEDAL COMPARISON FAILURE COUNTER" UBYTE MC_P1P3_CNT 0 0 0 0 ECU_ADDRESS 0x3FA32E /end MEASUREMENT
/begin COMPU_METHOD MC_P1P3_CNT "P1P3_CNT conversion" RAT_FUNC "%3.0" "Unitless" COEFFS 0 1 0 0 0 1 /end COMPU_METHOD
/begin MEASUREMENT P2 "Additive adaptive parameter for throttle flow model" FLOAT32_IEEE MC_P2 0 0 0 0 ECU_ADDRESS 0x3FA238 /end MEASUREMENT
/begin COMPU_METHOD MC_P2 "P2 conversion" RAT_FUNC "%10.5" "Unitless" COEFFS 0 1 0 0 0 1 /end COMPU_METHOD
/begin MEASUREMENT P2121MALF "OBDII pedal sensor #1 failed malf flag" UBYTE MC_P2121MALF 0 0 0 0 ECU_ADDRESS 0x3FA342 /end MEASUREMENT
/begin COMPU_METHOD MC_P2121MALF "P2121MALF conversion" RAT_FUNC "%3.0" "Unitless" COEFFS 0 1 0 0 0 1 /end COMPU_METHOD
/begin CHARACTERISTIC P2121SW_NGD "Pedal position sensor 1 failed - malf enable switch" VALUE 0x5D54F SD_UBYTE 0 SC_P2121SW_NGD 0 255 /end CHARACTERISTIC
/begin COMPU_METHOD SC_P2121SW_NGD "P2121SW_NGD conversion" RAT_FUNC "%3.0" "unitless" COEFFS 0 1 0 0 0 1 /end COMPU_METHOD
/begin MEASUREMENT P2122MALF "OBDII pedal sensor #1 out of range low malf flag" UBYTE MC_P2122MALF 0 0 0 0 ECU_ADDRESS 0x3FA33C /end MEASUREMENT
/begin COMPU_METHOD MC_P2122MALF "P2122MALF conversion" RAT_FUNC "%3.0" "Unitless" COEFFS 0 1 0 0 0 1 /end COMPU_METHOD
/begin RECORD_LAYOUT SD_UBYTE FNC_VALUES 1 UBYTE ROW_DIR DIRECT /end RECORD_LAYOUT
/begin RECORD_LAYOUT SD_UWORD FNC_VALUES 1 UWORD ROW_DIR DIRECT /end RECORD_LAYOUT
/begin RECORD_LAYOUT SD_ULONG FNC_VALUES 1 ULONG ROW_DIR DIRECT /end RECORD_LAYOUT
/begin RECORD_LAYOUT SD_FLOAT32_IEEE FNC_VALUES 1 FLOAT32_IEEE ROW_DIR DIRECT /end RECORD_LAYOUT
/end MODULE
/end PROJECT
