/begin PROJECT DPU-2XX "Visteon Diesel"
/* Keyword REQUIRED; value ignored*/
/begin HEADER " " VERSION "1" PROJECT_NO Global /end HEADER
/begin MODULE ENGINE "International Engine Controller"
/* Keyword REQUIRED; MODULE Name "LongIdentifier" */
/begin MOD_PAR "Engine" /* Keyword RECOMMENDED; MOD_PAR "Comment" */ VERSION "AP1" /* VERSION "Version Identifier" */ ADDR_EPK 0x7FFF0 /* start address of EPROM label;
/* value at addr read and cmp w/ below */ EPK " " /* value EPROM label */ CUSTOMER_NO " " /* CUSTOMER_NO "Customer Number" */ USER "Ford" /* USER "User" */ PHONE_NO "734-302-2059" /* PHONE_NO "Phone number of responsible engineer" */ CPU_TYPE "MPC555" /* CPU_TYPE "CPU" */ ECU "DPU-2XX" /* ECU "Control unit" */ /begin MEMORY_SEGMENT RTOS_rprg "" CODE FLASH INTERN 0x0 0x10000 -1 -1 -1 -1 -1 /end MEMORY_SEGMENT
 /begin MEMORY_SEGMENT Strategy "" CODE FLASH INTERN 0x10000 0x30000 -1 -1 -1 -1 -1 /end MEMORY_SEGMENT
 /begin MEMORY_SEGMENT Strategy "" CODE FLASH INTERN 0x60000 0X10000 -1 -1 -1 -1 -1 /end MEMORY_SEGMENT
 /begin MEMORY_SEGMENT Calibration "" DATA FLASH EXTERN 0x0040800 0x1F800 -1 -1 -1 -1 -1
  /begin IF_DATA ETK ADDRESS_MAPPING /*orig_adr:*/ 0x0040800 /*mapping_adr*/ 0x7FF80800 /*length*/ 0x1F800 /end IF_DATA
 /end MEMORY_SEGMENT
 /begin MEMORY_SEGMENT ExRAM "ExRAM for DISTAB" VARIABLES RAM EXTERN 0x7FF80000 0x800 -1 -1 -1 -1 -1 /end MEMORY_SEGMENT
 /begin MEMORY_SEGMENT RAM "" VARIABLES RAM INTERN 0x003f9800 0x6800 -1 -1 -1 -1 -1 /end MEMORY_SEGMENT
/end MOD_PAR
/begin MOD_COMMON " " BYTE_ORDER MSB_FIRST /end MOD_COMMON
/begin IF_DATA ETK
 /begin TP_BLOB /*version: fixed*/ 0x1000002 /*pba: Project Base Address*/ 0x0 /*reset_cfg: PPC only*/ 0x0
  /begin DISTAB_CFG /*dsptab: type number*/ 0xD /*dat_mod: */ 0x0111 /*rfg: 1=high byte first*/ 0x1 /*trgsegad: TrigSegAddr*/ 0x7FF80400 /*trg_cfg: */ 0x01010100 /*trg_mod: 3 rast*/ TRG_MOD 0x0 0x27 0x0 0x0 0x0 /end DISTAB_CFG
  CODE_CHK /*prg_data:*/ 0x0 /*prg_length:*/ 0x0 /*prg_eram:*/ 0x0 /*prg_length:*/ 0x0 /* Used for programs without code emulation to check compatibility with Project files*/ ETK_CFG 0xFF 0xFF 0xFF 0xFF 0xFF 0xFF 0xFF 0xFF 0xFF 0xFF 0xFF 0xFF 0xFF 0xFF 0xFF 0xFF 0xFF 0xFF 0xFF 0xFF 0xFF 0xFF 0xFF 0xFF /* no config string for ETKP2 */ /* no CRC-Check via display table use RESERVED ...Length_of_Distab13 = (maxnum+2)*4 */ /* RESERVED **start_addr:** 0x7E174 **length:** 0x300 EXTERN -1 -1 -1 -1 -1 */
  /begin ETK_PRESENCE_CHECK 0x7FF80040 /* This is the start address of the pattern */ ETK_PATTERN 0x5A 0x5A 0xA5 0x5A 0xFA 0x05 /* first 32bits Calvin Signature Value, next 16bits Command Code
= 0xFA05 remap cal space to expernal memory */ /end ETK_PRESENCE_CHECK
  ETK_MAILBOX /* used for ETK flashing */ /**pattern:**/ 0x55555555 /**page_ecu:**/ DATA /**ecu_adr:**/ 0x7FF80500 /**..length:**/ 0x8000 /**page_am:**/ EXRAM /**am_adr:**/ 0x7FF80500 /**..length:**/ 0x8000 /end TP_BLOB
 /begin SOURCE "PIP" 103 1 QP_BLOB 1 0x38 0x7FF80800 0x7FF80600 0x7FF80440 0 0 0 /end SOURCE
 /begin SOURCE "8ms" 4 1 QP_BLOB 2 0x58 0x7FF808E8 0x7FF80638 0x7FF80442 10 0 0 /end SOURCE
 /begin SOURCE "Background" 5 1 QP_BLOB 3 0x58 0x7FF80A50 0x7FF80690 0x7FF80444 100 0 0 /end SOURCE
/end IF_DATA
/* --- Object for CCP (ASAP V1.21), Version 1.0 31.7.98 --- */
/begin IF_DATA ASAP1B_CCP
 /begin SOURCE "PIP task, synchronous event channel" 103 /* PIP event channel number */ 1 /* PIP event channel number */ /begin QP_BLOB 0 LENGTH 16 CAN_ID_FIXED 0x6F8 RASTER 6 /end QP_BLOB /end SOURCE
 /begin RASTER "PIP task, engine synchronous" "PIP" 6 103 1 /end RASTER
 /begin SOURCE "8ms Task" 3 /* 8ms event channel number */ 8 /* 8ms event channel number */ /begin QP_BLOB 1 LENGTH 16 CAN_ID_FIXED 0x6F8 RASTER 5 /end QP_BLOB /end SOURCE
 /begin RASTER "8ms Task" "8ms" 5 3 8 /end RASTER
 /begin SOURCE "100ms Task" 5 /* 100ms event channel number */ 1 /* 100ms event channel number */ /begin QP_BLOB 2 LENGTH 16 CAN_ID_FIXED 0x6F8 RASTER 1 /end QP_BLOB /end SOURCE
 /begin RASTER "100ms Task" "100ms" 1 5 1 /end RASTER
 /begin SOURCE "30ms Task" 4 /* 30ms event channel number */ 5 /* 30ms event channel number */ /begin QP_BLOB 3 LENGTH 16 CAN_ID_FIXED 0x6F8 RASTER 3 /end QP_BLOB /end SOURCE
 /begin RASTER "30ms Task" "30ms" 3 4 5 /end RASTER
 /begin SEED_KEY /* seed&key dll for CAL privilege */ "" /* seed&key dll for DAQ privilege */ "" /* seed&key dll for PGM privilege */ "" /end SEED_KEY
 /begin TP_BLOB /* CCP version */ 0x201 /* Blob version */ 0x202 /* CAN msg ID - send */ 0x6F9 /* CAN msg ID - recv */ 0x6F8 /* station address */ 0x0 /* byte order */ 1 /* Byte-order: 1 - High-Byte-First (MOT)*/ /* 2 - Low-Byte-First(INTEL) */
  /begin CAN_PARAM /* crystal frequency */ 0x1F4 /* These values for 500K */ /* timing register 0 */ 0x41 /* timing register 1 */ 0x25 /end CAN_PARAM
  DAQ_MODE BURST CONSISTENCY ODT ADDRESS_EXTENSION ODT
  /begin CHECKSUM_PARAM /* algorithm */ 0xC004 /* M_32_BIT_BY_ADD16 */ /* limit */ 0xFFFFFFFF /* -1 max. checksum-length in ECU */ CHECKSUM_CALCULATION ACTIVE_PAGE /end CHECKSUM_PARAM
  /begin DEFINED_PAGES 2 "working page" /* address ext. */ 0x0 /* base address */ 0x50000 /* page length */ 0x20000 RAM RAM_INIT_BY_ECU /end DEFINED_PAGES
  OPTIONAL_CMD 0xC /* SET_S_STATUS */ OPTIONAL_CMD 0xD /* GET_S_STATUS */ OPTIONAL_CMD 0xE /* BUILD_CHKSUM */ /*OPTIONAL_CMD 0x11 SELECT_CAL_PAGE */ OPTIONAL_CMD 0x19 /* MOVE */ OPTIONAL_CMD 0x12 /* GET_SEED */ OPTIONAL_CMD 0x13 /* UNLOCK */ /end TP_BLOB
/end IF_DATA
/begin MEASUREMENT AAT "Ambient air temperature. (DEGREES C)" FLOAT32_IEEE MC_AAT 0 0 0 0 ECU_ADDRESS 0x3FA360 /end MEASUREMENT
/begin COMPU_METHOD MC_AAT "AAT conversion" RAT_FUNC "%10.5" "Unitless" COEFFS 0 1 0 0 0 1 /end COMPU_METHOD
/begin MEASUREMENT AAT_F_ORH "AAT Signal out-of_range high fault" UBYTE MC_AAT_F_ORH 0 0 0 0 ECU_ADDRESS 0x3FA36F /end MEASUREMENT
/begin COMPU_METHOD MC_AAT_F_ORH "AAT_F_ORH conversion" RAT_FUNC "%3.0" "Unitless" COEFFS 0 1 0 0 0 1 /end COMPU_METHOD
/begin MEASUREMENT AAT_F_ORL "AAT Signal out-of_range low fault" UBYTE MC_AAT_F_ORL 0 0 0 0 ECU_ADDRESS 0x3FA36E /end MEASUREMENT
/begin COMPU_METHOD MC_AAT_F_ORL "AAT_F_ORL conversion" RAT_FUNC "%3.0" "Unitless" COEFFS 0 1 0 0 0 1 /end COMPU_METHOD
/begin MEASUREMENT ABORT_REASON "IDM Injector disable test abort reason" UBYTE MC_ABORT_REASON 0 0 0 0 ECU_ADDRESS 0x3F995D /end MEASUREMENT
/begin COMPU_METHOD MC_ABORT_REASON "ABORT_REASON conversion" RAT_FUNC "%3.0" "Unitless" COEFFS 0 1 0 0 0 1 /end COMPU_METHOD
/begin CHARACTERISTIC ABS_PBA_LOCKOUT_TIME "ABS Lockout time for CP/SRC" VALUE 0x5EA68 SD_FLOAT32_IEEE 0 SC_ABS_PBA_LOCKOUT_TIME 0 100 /end CHARACTERISTIC
/begin COMPU_METHOD SC_ABS_PBA_LOCKOUT_TIME "ABS_PBA_LOCKOUT_TIME conversion" RAT_FUNC "%10.5" "s" COEFFS 0 1 0 0 0 1 /end COMPU_METHOD
/begin MEASUREMENT ABS_TQ_INC "ABS system torque increase" UBYTE MC_ABS_TQ_INC 0 0 0 0 ECU_ADDRESS 0x3FA2CA /end MEASUREMENT
/begin COMPU_METHOD MC_ABS_TQ_INC "ABS_TQ_INC conversion" RAT_FUNC "%3.0" "Unitless" COEFFS 0 1 0 0 0 1 /end COMPU_METHOD
/begin MEASUREMENT ABS_TQ_RED "ABS system torque reduction" UBYTE MC_ABS_TQ_RED 0 0 0 0 ECU_ADDRESS 0x3FA2C9 /end MEASUREMENT
/begin COMPU_METHOD MC_ABS_TQ_RED "ABS_TQ_RED conversion" RAT_FUNC "%3.0" "Unitless" COEFFS 0 1 0 0 0 1 /end COMPU_METHOD
/begin MEASUREMENT ACCEL_LST_[0] "List of the most recent Low Data Rate misfire crankshaft accelerations." FLOAT32_IEEE MC_ACCEL_LST_ 0 0 -4.75e-07 4.75e-07 ECU_ADDRESS 0x3FBE98 /end MEASUREMENT
/begin COMPU_METHOD MC_ACCEL_LST_ "ACCEL_LST_ conversion" RAT_FUNC "%10.5" "deg/s2" COEFFS 0 1 0 0 0 1 /end COMPU_METHOD
/begin MEASUREMENT ACCEL_LST_[10] "List of the most recent Low Data Rate misfire crankshaft accelerations." FLOAT32_IEEE MC_ACCEL_LST_ 0 0 -4.75e-07 4.75e-07 ECU_ADDRESS 0x3FBEC0 /end MEASUREMENT
/begin MEASUREMENT ACCEL_LST_[11] "List of the most recent Low Data Rate misfire crankshaft accelerations." FLOAT32_IEEE MC_ACCEL_LST_ 0 0 -4.75e-07 4.75e-07 ECU_ADDRESS 0x3FBEC4 /end MEASUREMENT
/begin MEASUREMENT ACCEL_LST_[12] "List of the most recent Low Data Rate misfire crankshaft accelerations." FLOAT32_IEEE MC_ACCEL_LST_ 0 0 -4.75e-07 4.75e-07 ECU_ADDRESS 0x3FBEC8 /end MEASUREMENT
/begin MEASUREMENT ACCEL_LST_[13] "List of the most recent Low Data Rate misfire crankshaft accelerations." FLOAT32_IEEE MC_ACCEL_LST_ 0 0 -4.75e-07 4.75e-07 ECU_ADDRESS 0x3FBECC /end MEASUREMENT
/begin MEASUREMENT ACCEL_LST_[14] "List of the most recent Low Data Rate misfire crankshaft accelerations." FLOAT32_IEEE MC_ACCEL_LST_ 0 0 -4.75e-07 4.75e-07 ECU_ADDRESS 0x3FBED0 /end MEASUREMENT
/begin MEASUREMENT ACCEL_LST_[15] "List of the most recent Low Data Rate misfire crankshaft accelerations." FLOAT32_IEEE MC_ACCEL_LST_ 0 0 -4.75e-07 4.75e-07 ECU_ADDRESS 0x3FBED4 /end MEASUREMENT
/begin MEASUREMENT ACCEL_LST_[1] "List of the most recent Low Data Rate misfire crankshaft accelerations." FLOAT32_IEEE MC_ACCEL_LST_ 0 0 -4.75e-07 4.75e-07 ECU_ADDRESS 0x3FBE9C /end MEASUREMENT
/begin MEASUREMENT ACCEL_LST_[2] "List of the most recent Low Data Rate misfire crankshaft accelerations." FLOAT32_IEEE MC_ACCEL_LST_ 0 0 -4.75e-07 4.75e-07 ECU_ADDRESS 0x3FBEA0 /end MEASUREMENT
/begin MEASUREMENT ACCEL_LST_[3] "List of the most recent Low Data Rate misfire crankshaft accelerations." FLOAT32_IEEE MC_ACCEL_LST_ 0 0 -4.75e-07 4.75e-07 ECU_ADDRESS 0x3FBEA4 /end MEASUREMENT
/begin MEASUREMENT ACCEL_LST_[4] "List of the most recent Low Data Rate misfire crankshaft accelerations." FLOAT32_IEEE MC_ACCEL_LST_ 0 0 -4.75e-07 4.75e-07 ECU_ADDRESS 0x3FBEA8 /end MEASUREMENT
/begin MEASUREMENT ACCEL_LST_[5] "List of the most recent Low Data Rate misfire crankshaft accelerations." FLOAT32_IEEE MC_ACCEL_LST_ 0 0 -4.75e-07 4.75e-07 ECU_ADDRESS 0x3FBEAC /end MEASUREMENT
/begin MEASUREMENT ACCEL_LST_[6] "List of the most recent Low Data Rate misfire crankshaft accelerations." FLOAT32_IEEE MC_ACCEL_LST_ 0 0 -4.75e-07 4.75e-07 ECU_ADDRESS 0x3FBEB0 /end MEASUREMENT
/begin MEASUREMENT ACCEL_LST_[7] "List of the most recent Low Data Rate misfire crankshaft accelerations." FLOAT32_IEEE MC_ACCEL_LST_ 0 0 -4.75e-07 4.75e-07 ECU_ADDRESS 0x3FBEB4 /end MEASUREMENT
/begin MEASUREMENT ACCEL_LST_[8] "List of the most recent Low Data Rate misfire crankshaft accelerations." FLOAT32_IEEE MC_ACCEL_LST_ 0 0 -4.75e-07 4.75e-07 ECU_ADDRESS 0x3FBEB8 /end MEASUREMENT
/begin MEASUREMENT ACCEL_LST_[9] "List of the most recent Low Data Rate misfire crankshaft accelerations." FLOAT32_IEEE MC_ACCEL_LST_ 0 0 -4.75e-07 4.75e-07 ECU_ADDRESS 0x3FBEBC /end MEASUREMENT
/begin MEASUREMENT ACCEL_MEDIAN "Median value in the sorted acceleration list." FLOAT32_IEEE MC_ACCEL_MEDIAN 0 0 0 0 ECU_ADDRESS 0x3FB300 /end MEASUREMENT
/begin COMPU_METHOD MC_ACCEL_MEDIAN "ACCEL_MEDIAN conversion" RAT_FUNC "%10.5" "Unitless" COEFFS 0 1 0 0 0 1 /end COMPU_METHOD
/begin MEASUREMENT ACCEL_MIDDLE "Middle value in the chronological acceleration list, this will be the accel under evaluation." FLOAT32_IEEE MC_ACCEL_MIDDLE 0 0 0 0 ECU_ADDRESS 0x3FB304 /end MEASUREMENT
/begin COMPU_METHOD MC_ACCEL_MIDDLE "ACCEL_MIDDLE conversion" RAT_FUNC "%10.5" "Unitless" COEFFS 0 1 0 0 0 1 /end COMPU_METHOD
/begin MEASUREMENT ACCFLG "A/C clutch status; 0 -> disengaged, 1 -> engaged." UBYTE MC_ACCFLG 0 0 0 0 ECU_ADDRESS 0x3F9D7F /end MEASUREMENT
/begin COMPU_METHOD MC_ACCFLG "ACCFLG conversion" RAT_FUNC "%3.0" "Unitless" COEFFS 0 1 0 0 0 1 /end COMPU_METHOD
/begin MEASUREMENT ACCFLG_LAST "Last pass value of ACCFLG." UBYTE MC_ACCFLG_LAST 0 0 0 0 ECU_ADDRESS 0x3F9D7E /end MEASUREMENT
/begin COMPU_METHOD MC_ACCFLG_LAST "ACCFLG_LAST conversion" RAT_FUNC "%3.0" "Unitless" COEFFS 0 1 0 0 0 1 /end COMPU_METHOD
/begin CHARACTERISTIC ACCR_NC "Status indicator, set if  the relay is normally closed" VALUE 0x5CC58 SD_UBYTE 0 SC_ACCR_NC 0 1 /end CHARACTERISTIC
/begin COMPU_METHOD SC_ACCR_NC "ACCR_NC conversion" RAT_FUNC "%3.0" "flag" COEFFS 0 1 0 0 0 1 /end COMPU_METHOD
/begin MEASUREMENT ACCS "A/C hardware input to module." UBYTE MC_ACCS 0 0 0 0 ECU_ADDRESS 0x3F98A2 /end MEASUREMENT
/begin COMPU_METHOD MC_ACCS "ACCS conversion" RAT_FUNC "%3.0" "Unitless" COEFFS 0 1 0 0 0 1 /end COMPU_METHOD
/begin CHARACTERISTIC ACCS_HP "Hardware present switch for A/C demand/Cycling hardware input to the module." VALUE 0x5CC15 SD_UBYTE 0 SC_ACCS_HP 0 1 /end CHARACTERISTIC
/begin COMPU_METHOD SC_ACCS_HP "ACCS_HP conversion" RAT_FUNC "%3.0" "unitless" COEFFS 0 1 0 0 0 1 /end COMPU_METHOD
/begin MEASUREMENT ACCS_SCP "ACCS input data as received on SCP; 1 -> request A/C ON." UBYTE MC_ACCS_SCP 0 0 0 0 ECU_ADDRESS 0x3F9D08 /end MEASUREMENT
/begin COMPU_METHOD MC_ACCS_SCP "ACCS_SCP conversion" RAT_FUNC "%3.0" "Unitless" COEFFS 0 1 0 0 0 1 /end COMPU_METHOD
/begin MEASUREMENT ACC_DELTA_SEC "A/C loop timer" FLOAT32_IEEE MC_ACC_DELTA_SEC 0 0 0 0 ECU_ADDRESS 0x3F9D74 /end MEASUREMENT
/begin COMPU_METHOD MC_ACC_DELTA_SEC "ACC_DELTA_SEC conversion" RAT_FUNC "%10.5" "Unitless" COEFFS 0 1 0 0 0 1 /end COMPU_METHOD
/begin MEASUREMENT ACC_KAM_FLG "KAM flag to signify that A/C has been engaged." UBYTE MC_ACC_KAM_FLG 0 0 0 0 ECU_ADDRESS 0x3FCC88 /end MEASUREMENT
/begin COMPU_METHOD MC_ACC_KAM_FLG "ACC_KAM_FLG conversion" RAT_FUNC "%3.0" "Unitless" COEFFS 0 1 0 0 0 1 /end COMPU_METHOD
/begin MEASUREMENT ACC_STATUS "ACC Smart output driver fault status." UBYTE MC_ACC_STATUS 0 0 0 0 ECU_ADDRESS 0x3F9854 /end MEASUREMENT
/begin COMPU_METHOD MC_ACC_STATUS "ACC_STATUS conversion" RAT_FUNC "%3.0" "Unitless" COEFFS 0 1 0 0 0 1 /end COMPU_METHOD
/begin MEASUREMENT ACD_SCP_HP "Hardware present flag for the A/C demand input received over the SCP Network." UBYTE MC_ACD_SCP_HP 0 0 0 0 ECU_ADDRESS 0x3FB751 /end MEASUREMENT
/begin COMPU_METHOD MC_ACD_SCP_HP "ACD_SCP_HP conversion" RAT_FUNC "%3.0" "Unitless" COEFFS 0 1 0 0 0 1 /end COMPU_METHOD
/begin CHARACTERISTIC ACECT_CL_DEGC "Minimum ECT to disable A/C clutch" VALUE 0x5CC08 SD_FLOAT32_IEEE 0 SC_ACECT_CL_DEGC -150 150 /end CHARACTERISTIC
/begin COMPU_METHOD SC_ACECT_CL_DEGC "ACECT_CL_DEGC conversion" RAT_FUNC "%10.5" "degC" COEFFS 0 1 0 0 0 1 /end COMPU_METHOD
/begin MEASUREMENT ACECT_FLG "High ECT or ECT sensor failed." UBYTE MC_ACECT_FLG 0 0 0 0 ECU_ADDRESS 0x3F9D62 /end MEASUREMENT
/begin COMPU_METHOD MC_ACECT_FLG "ACECT_FLG conversion" RAT_FUNC "%3.0" "Unitless" COEFFS 0 1 0 0 0 1 /end COMPU_METHOD
/begin CHARACTERISTIC ACECT_SH_DEGC "Maximum ECT for enabling  A/C clutch" VALUE 0x5CC04 SD_FLOAT32_IEEE 0 SC_ACECT_SH_DEGC -150 150 /end CHARACTERISTIC
/begin COMPU_METHOD SC_ACECT_SH_DEGC "ACECT_SH_DEGC conversion" RAT_FUNC "%10.5" "degC" COEFFS 0 1 0 0 0 1 /end COMPU_METHOD
/begin MEASUREMENT ACIOTMR "A/C off delay timer, for ISC." FLOAT32_IEEE MC_ACIOTMR 0 0 0 0 ECU_ADDRESS 0x3F9D54 /end MEASUREMENT
/begin COMPU_METHOD MC_ACIOTMR "ACIOTMR conversion" RAT_FUNC "%10.5" "Unitless" COEFFS 0 1 0 0 0 1 /end COMPU_METHOD
/begin MEASUREMENT ACIOTMR_UP "Flag to control the incrementing of the actuated timer aciotmr." UBYTE MC_ACIOTMR_UP 0 0 0 0 ECU_ADDRESS 0x3F9D61 /end MEASUREMENT
/begin COMPU_METHOD MC_ACIOTMR_UP "ACIOTMR_UP conversion" RAT_FUNC "%3.0" "Unitless" COEFFS 0 1 0 0 0 1 /end COMPU_METHOD
/begin MEASUREMENT ACITMR "A/C clutch idle turn on delay timer." FLOAT32_IEEE MC_ACITMR 0 0 0 0 ECU_ADDRESS 0x3F9D50 /end MEASUREMENT
/begin COMPU_METHOD MC_ACITMR "ACITMR conversion" RAT_FUNC "%10.5" "Unitless" COEFFS 0 1 0 0 0 1 /end COMPU_METHOD
/begin MEASUREMENT ACITMR_UP "Flag to control the incrementing of the actuated timer acitmr." UBYTE MC_ACITMR_UP 0 0 0 0 ECU_ADDRESS 0x3F9D60 /end MEASUREMENT
/begin COMPU_METHOD MC_ACITMR_UP "ACITMR_UP conversion" RAT_FUNC "%3.0" "Unitless" COEFFS 0 1 0 0 0 1 /end COMPU_METHOD
/begin MEASUREMENT ACLAUNCH_FLG "Hot launch A/C cut-out flag." UBYTE MC_ACLAUNCH_FLG 0 0 0 0 ECU_ADDRESS 0x3F9D5A /end MEASUREMENT
/begin COMPU_METHOD MC_ACLAUNCH_FLG "ACLAUNCH_FLG conversion" RAT_FUNC "%3.0" "Unitless" COEFFS 0 1 0 0 0 1 /end COMPU_METHOD
/begin CHARACTERISTIC ACL_TM_D "Maximum time that A/C launch cutout is allowed to function" VALUE 0x5CBBC SD_FLOAT32_IEEE 0 SC_ACL_TM_D 0 63.9999 /end CHARACTERISTIC
/begin COMPU_METHOD SC_ACL_TM_D "ACL_TM_D conversion" RAT_FUNC "%10.5" "s" COEFFS 0 1 0 0 0 1 /end COMPU_METHOD
/begin CHARACTERISTIC ACMNDT_PPS "Time delay to keep A/C disabled after leaving high pedal" VALUE 0x5CBE0 SD_FLOAT32_IEEE 0 SC_ACMNDT_PPS 0.5 10 /end CHARACTERISTIC
/begin COMPU_METHOD SC_ACMNDT_PPS "ACMNDT_PPS conversion" RAT_FUNC "%10.5" "s" COEFFS 0 1 0 0 0 1 /end COMPU_METHOD
/begin CHARACTERISTIC ACNHI_CL "RPM to shut off WAC RPM-based cutout." VALUE 0x5CC00 SD_FLOAT32_IEEE 0 SC_ACNHI_CL 1000 8000 /end CHARACTERISTIC
/begin COMPU_METHOD SC_ACNHI_CL "ACNHI_CL conversion" RAT_FUNC "%10.5" "RPM" COEFFS 0 1 0 0 0 1 /end COMPU_METHOD
/begin MEASUREMENT ACNHI_FLG "A/C engine speed too high." UBYTE MC_ACNHI_FLG 0 0 0 0 ECU_ADDRESS 0x3F9D5F /end MEASUREMENT
/begin COMPU_METHOD MC_ACNHI_FLG "ACNHI_FLG conversion" RAT_FUNC "%3.0" "Unitless" COEFFS 0 1 0 0 0 1 /end COMPU_METHOD
/begin CHARACTERISTIC ACNHI_SH "Max RPM to keep AC clutch enabled." VALUE 0x5CBFC SD_FLOAT32_IEEE 0 SC_ACNHI_SH 3500 8000 /end CHARACTERISTIC
/begin COMPU_METHOD SC_ACNHI_SH "ACNHI_SH conversion" RAT_FUNC "%10.5" "RPM" COEFFS 0 1 0 0 0 1 /end COMPU_METHOD
/begin CHARACTERISTIC ACNLO_CH "Max RPM to disable A/C clutch." VALUE 0x5CBF8 SD_FLOAT32_IEEE 0 SC_ACNLO_CH 0 1000 /end CHARACTERISTIC
/begin COMPU_METHOD SC_ACNLO_CH "ACNLO_CH conversion" RAT_FUNC "%10.5" "RPM" COEFFS 0 1 0 0 0 1 /end COMPU_METHOD
/begin MEASUREMENT ACNLO_FLG "A/C engine speed too low." UBYTE MC_ACNLO_FLG 0 0 0 0 ECU_ADDRESS 0x3F9D5E /end MEASUREMENT
/begin COMPU_METHOD MC_ACNLO_FLG "ACNLO_FLG conversion" RAT_FUNC "%3.0" "Unitless" COEFFS 0 1 0 0 0 1 /end COMPU_METHOD
/begin CHARACTERISTIC ACNLO_SL "Min RPM for enabing A/C clutch." VALUE 0x5CBF4 SD_FLOAT32_IEEE 0 SC_ACNLO_SL 0 1000 /end CHARACTERISTIC
/begin COMPU_METHOD SC_ACNLO_SL "ACNLO_SL conversion" RAT_FUNC "%10.5" "RPM" COEFFS 0 1 0 0 0 1 /end COMPU_METHOD
/begin MEASUREMENT ACPPSOFF_RQST "A/C high pedal cutout request" UBYTE MC_ACPPSOFF_RQST 0 0 0 0 ECU_ADDRESS 0x3F9D5C /end MEASUREMENT
/begin COMPU_METHOD MC_ACPPSOFF_RQST "ACPPSOFF_RQST conversion" RAT_FUNC "%3.0" "Unitless" COEFFS 0 1 0 0 0 1 /end COMPU_METHOD
/begin MEASUREMENT ACPPSOFF_TMR "A/C high pedal cutout timer" FLOAT32_IEEE MC_ACPPSOFF_TMR 0 0 0 0 ECU_ADDRESS 0x3F9D48 /end MEASUREMENT
/begin COMPU_METHOD MC_ACPPSOFF_TMR "ACPPSOFF_TMR conversion" RAT_FUNC "%10.5" "Unitless" COEFFS 0 1 0 0 0 1 /end COMPU_METHOD
/begin MEASUREMENT ACPPSTMR2 "A/C clutch not at high pedal timer" FLOAT32_IEEE MC_ACPPSTMR2 0 0 0 0 ECU_ADDRESS 0x3F9D4C /end MEASUREMENT
/begin COMPU_METHOD MC_ACPPSTMR2 "ACPPSTMR2 conversion" RAT_FUNC "%10.5" "Unitless" COEFFS 0 1 0 0 0 1 /end COMPU_METHOD
/begin CHARACTERISTIC ACPPS_CL "Maximum PPS to increment acppstmr2" VALUE 0x5CBE8 SD_FLOAT32_IEEE 0 SC_ACPPS_CL 100 1023 /end CHARACTERISTIC
/begin COMPU_METHOD SC_ACPPS_CL "ACPPS_CL conversion" RAT_FUNC "%10.5" "ADct" COEFFS 0 1 0 0 0 1 /end COMPU_METHOD
/begin MEASUREMENT ACPPS_FLG "A/C pedal position flag" UBYTE MC_ACPPS_FLG 0 0 0 0 ECU_ADDRESS 0x3F9D5B /end MEASUREMENT
/begin COMPU_METHOD MC_ACPPS_FLG "ACPPS_FLG conversion" RAT_FUNC "%3.0" "Unitless" COEFFS 0 1 0 0 0 1 /end COMPU_METHOD
/begin CHARACTERISTIC ACPPS_SH "Maximum PPS to enable A/C clutch" VALUE 0x5CBE4 SD_FLOAT32_IEEE 0 SC_ACPPS_SH 500 1023 /end CHARACTERISTIC
/begin COMPU_METHOD SC_ACPPS_SH "ACPPS_SH conversion" RAT_FUNC "%10.5" "ADct" COEFFS 0 1 0 0 0 1 /end COMPU_METHOD
/begin MEASUREMENT ACPRES "A/C head pressure." FLOAT32_IEEE MC_ACPRES 0 0 0 0 ECU_ADDRESS 0x3F9C9C /end MEASUREMENT
/begin COMPU_METHOD MC_ACPRES "ACPRES conversion" RAT_FUNC "%10.5" "Unitless" COEFFS 0 1 0 0 0 1 /end COMPU_METHOD
/begin MEASUREMENT ACPSW "AC medium pressure switch input; 1 -> AC pressure high." UBYTE MC_ACPSW 0 0 0 0 ECU_ADDRESS 0x3F99EE /end MEASUREMENT
/begin COMPU_METHOD MC_ACPSW "ACPSW conversion" RAT_FUNC "%3.0" "Unitless" COEFFS 0 1 0 0 0 1 /end COMPU_METHOD
/begin CHARACTERISTIC ACPSW_HP "AC Pressure Switch Hardware Present." VALUE 0x5C794 SD_UBYTE 0 SC_ACPSW_HP 0 1 /end CHARACTERISTIC
/begin COMPU_METHOD SC_ACPSW_HP "ACPSW_HP conversion" RAT_FUNC "%3.0" "enumerated" COEFFS 0 1 0 0 0 1 /end COMPU_METHOD
/begin MEASUREMENT ACR "A/C output; 1 -> relay energised." UBYTE MC_ACR 0 0 0 0 ECU_ADDRESS 0x3FB65F /end MEASUREMENT
/begin COMPU_METHOD MC_ACR "ACR conversion" RAT_FUNC "%3.0" "Unitless" COEFFS 0 1 0 0 0 1 /end COMPU_METHOD
/begin MEASUREMENT ACRQST "A/C requested (pre delays); 1 -> request." UBYTE MC_ACRQST 0 0 0 0 ECU_ADDRESS 0x3F9D5D /end MEASUREMENT
/begin COMPU_METHOD MC_ACRQST "ACRQST conversion" RAT_FUNC "%3.0" "Unitless" COEFFS 0 1 0 0 0 1 /end COMPU_METHOD
/begin MEASUREMENT ACRQ_SLG_FLG "A/C de-slug A/C clutch request; 1 -> clutch on." UBYTE MC_ACRQ_SLG_FLG 0 0 0 0 ECU_ADDRESS 0x3F9D3A /end MEASUREMENT
/begin COMPU_METHOD MC_ACRQ_SLG_FLG "ACRQ_SLG_FLG conversion" RAT_FUNC "%3.0" "Unitless" COEFFS 0 1 0 0 0 1 /end COMPU_METHOD
/begin MEASUREMENT ACRQ_SLG_LST "Last pass value of ACRQ_SLG_FLG." UBYTE MC_ACRQ_SLG_LST 0 0 0 0 ECU_ADDRESS 0x3F9D39 /end MEASUREMENT
/begin COMPU_METHOD MC_ACRQ_SLG_LST "ACRQ_SLG_LST conversion" RAT_FUNC "%3.0" "Unitless" COEFFS 0 1 0 0 0 1 /end COMPU_METHOD
/begin CHARACTERISTIC ACR_HP "Hardware present switch to indicate A/C clutch relay is controlled by PCM hardware pin." VALUE 0x5CC59 SD_UBYTE 0 SC_ACR_HP 0 1 /end CHARACTERISTIC
/begin COMPU_METHOD SC_ACR_HP "ACR_HP conversion" RAT_FUNC "%3.0" "flag" COEFFS 0 1 0 0 0 1 /end COMPU_METHOD
/begin CHARACTERISTIC ACSTRD "Max seconds to keep AC disabled after start." VALUE 0x5CBF0 SD_FLOAT32_IEEE 0 SC_ACSTRD 0 255 /end CHARACTERISTIC
/begin COMPU_METHOD SC_ACSTRD "ACSTRD conversion" RAT_FUNC "%10.5" "S" COEFFS 0 1 0 0 0 1 /end COMPU_METHOD
/begin MEASUREMENT ACSW "A/C switch input status; 1 -> A/C on, (copy of ACCS or ACCS_SCP)." UBYTE MC_ACSW 0 0 0 0 ECU_ADDRESS 0x3F9D6C /end MEASUREMENT
/begin COMPU_METHOD MC_ACSW "ACSW conversion" RAT_FUNC "%3.0" "Unitless" COEFFS 0 1 0 0 0 1 /end COMPU_METHOD
/begin MEASUREMENT ACT "Air charge temperature, deg F." FLOAT32_IEEE MC_ACT 0 0 0 0 ECU_ADDRESS 0x3FA298 /end MEASUREMENT
/begin COMPU_METHOD MC_ACT "ACT conversion" RAT_FUNC "%10.5" "Unitless" COEFFS 0 1 0 0 0 1 /end COMPU_METHOD
/begin MEASUREMENT ACT_FIL "Intermittent fault filter for the ACT sensor" UBYTE MC_ACT_FIL 0 0 0 0 ECU_ADDRESS 0x3F9E57 /end MEASUREMENT
/begin COMPU_METHOD MC_ACT_FIL "ACT_FIL conversion" RAT_FUNC "%3.0" "Unitless" COEFFS 0 1 0 0 0 1 /end COMPU_METHOD
/begin MEASUREMENT ACT_FIL_MAX "HIGHEST VALUE THE FAULT FILTER ACT_FIL SEES." UBYTE MC_ACT_FIL_MAX 0 0 0 0 ECU_ADDRESS 0x3FCD01 /end MEASUREMENT
/begin COMPU_METHOD MC_ACT_FIL_MAX "ACT_FIL_MAX conversion" RAT_FUNC "%3.0" "Unitless" COEFFS 0 1 0 0 0 1 /end COMPU_METHOD
/begin MEASUREMENT ACT_INT "Flag set when intermittent is detected on the CAT sensor." UBYTE MC_ACT_INT 0 0 0 0 ECU_ADDRESS 0x3F9E56 /end MEASUREMENT
/begin COMPU_METHOD MC_ACT_INT "ACT_INT conversion" RAT_FUNC "%3.0" "Unitless" COEFFS 0 1 0 0 0 1 /end COMPU_METHOD
/begin CHARACTERISTIC ACT_LVL "Fault level for intermittent ACT snesor." VALUE 0x5CE57 SD_UBYTE 0 SC_ACT_LVL 0 255 /end CHARACTERISTIC
/begin COMPU_METHOD SC_ACT_LVL "ACT_LVL conversion" RAT_FUNC "%3.0" "LEVEL" COEFFS 0 1 0 0 0 1 /end COMPU_METHOD
/begin MEASUREMENT AC_CYCLE_FLG "Flag to indicate that the AC is cycling." UBYTE MC_AC_CYCLE_FLG 0 0 0 0 ECU_ADDRESS 0x3F9D7D /end MEASUREMENT
/begin COMPU_METHOD MC_AC_CYCLE_FLG "AC_CYCLE_FLG conversion" RAT_FUNC "%3.0" "Unitless" COEFFS 0 1 0 0 0 1 /end COMPU_METHOD
/begin MEASUREMENT AC_DESLG_KAM "KAM flag to signify that CASS has been engaged during life cycle." UBYTE MC_AC_DESLG_KAM 0 0 0 0 ECU_ADDRESS 0x3FCC84 /end MEASUREMENT
/begin COMPU_METHOD MC_AC_DESLG_KAM "AC_DESLG_KAM conversion" RAT_FUNC "%3.0" "Unitless" COEFFS 0 1 0 0 0 1 /end COMPU_METHOD
/begin MEASUREMENT AC_DESLG_TMR "Time since engine started to rotate, used in A/C deslugging routine." FLOAT32_IEEE MC_AC_DESLG_TMR 0 0 0 0 ECU_ADDRESS 0x3F9D34 /end MEASUREMENT
/begin COMPU_METHOD MC_AC_DESLG_TMR "AC_DESLG_TMR conversion" RAT_FUNC "%10.5" "Unitless" COEFFS 0 1 0 0 0 1 /end COMPU_METHOD
/begin MEASUREMENT AC_ENG_REVS "RPM integrated during A/C deslugging  for revolution counter." FLOAT32_IEEE MC_AC_ENG_REVS 0 0 0 0 ECU_ADDRESS 0x3F9D30 /end MEASUREMENT
/begin COMPU_METHOD MC_AC_ENG_REVS "AC_ENG_REVS conversion" RAT_FUNC "%10.5" "Unitless" COEFFS 0 1 0 0 0 1 /end COMPU_METHOD
/begin MEASUREMENT AC_EN_TRANS "Flag to delay A/C activation process; 0 -> delay." UBYTE MC_AC_EN_TRANS 0 0 0 0 ECU_ADDRESS 0x3FB740 /end MEASUREMENT
/begin COMPU_METHOD MC_AC_EN_TRANS "AC_EN_TRANS conversion" RAT_FUNC "%3.0" "Unitless" COEFFS 0 1 0 0 0 1 /end COMPU_METHOD
/begin CHARACTERISTIC AC_LCH_MPH "Vehicle speed above which to enable A/C  launch" VALUE 0x5CBC8 SD_FLOAT32_IEEE 0 SC_AC_LCH_MPH 0 127.998 /end CHARACTERISTIC
/begin COMPU_METHOD SC_AC_LCH_MPH "AC_LCH_MPH conversion" RAT_FUNC "%10.5" "MPH" COEFFS 0 1 0 0 0 1 /end COMPU_METHOD
/begin MEASUREMENT AC_LCH_TMR_D "Time that A/C launch cutout has been active" FLOAT32_IEEE MC_AC_LCH_TMR_D 0 0 0 0 ECU_ADDRESS 0x3F9D44 /end MEASUREMENT
/begin COMPU_METHOD MC_AC_LCH_TMR_D "AC_LCH_TMR_D conversion" RAT_FUNC "%10.5" "Unitless" COEFFS 0 1 0 0 0 1 /end COMPU_METHOD
/begin CHARACTERISTIC AC_MN_FT "Min. time to run low speed EDF after A/C clutch is disengaged." VALUE 0x5CC54 SD_FLOAT32_IEEE 0 SC_AC_MN_FT 0 62 /end CHARACTERISTIC
/begin COMPU_METHOD SC_AC_MN_FT "AC_MN_FT conversion" RAT_FUNC "%10.5" "s" COEFFS 0 1 0 0 0 1 /end COMPU_METHOD
/begin CHARACTERISTIC AC_NEW_RPM "Max RPM to enable a new A/C compressor to be engaged." VALUE 0x5CBEC SD_FLOAT32_IEEE 0 SC_AC_NEW_RPM 0 16383 /end CHARACTERISTIC
/begin COMPU_METHOD SC_AC_NEW_RPM "AC_NEW_RPM conversion" RAT_FUNC "%10.5" "RPM" COEFFS 0 1 0 0 0 1 /end COMPU_METHOD
/begin MEASUREMENT AC_PPM_RQST "Request that the ISC adds air to compensate for AC loading." UBYTE MC_AC_PPM_RQST 0 0 0 0 ECU_ADDRESS 0x3F9D7C /end MEASUREMENT
/begin COMPU_METHOD MC_AC_PPM_RQST "AC_PPM_RQST conversion" RAT_FUNC "%3.0" "Unitless" COEFFS 0 1 0 0 0 1 /end COMPU_METHOD
/begin MEASUREMENT AC_PRERQST "A/C Requested prior to transmission shift override logic, 1 = request" UBYTE MC_AC_PRERQST 0 0 0 0 ECU_ADDRESS 0x3F9D59 /end MEASUREMENT
/begin COMPU_METHOD MC_AC_PRERQST "AC_PRERQST conversion" RAT_FUNC "%3.0" "Unitless" COEFFS 0 1 0 0 0 1 /end COMPU_METHOD
/begin CHARACTERISTIC AC_SLG_BATV "Do not run A/C de-slugging strategy if the VBAT 'EVER' falls below this." VALUE 0x5CB80 SD_FLOAT32_IEEE 0 SC_AC_SLG_BATV 0 15.9375 /end CHARACTERISTIC
/begin COMPU_METHOD SC_AC_SLG_BATV "AC_SLG_BATV conversion" RAT_FUNC "%10.5" "V" COEFFS 0 1 0 0 0 1 /end COMPU_METHOD
/begin CHARACTERISTIC AC_SLG_LO_DEGC "Normal A/C start if ambient temperature is below this value" VALUE 0x5CB7C SD_FLOAT32_IEEE 0 SC_AC_SLG_LO_DEGC -110 110 /end CHARACTERISTIC
/begin COMPU_METHOD SC_AC_SLG_LO_DEGC "AC_SLG_LO_DEGC conversion" RAT_FUNC "%10.5" "degC" COEFFS 0 1 0 0 0 1 /end COMPU_METHOD
/begin CHARACTERISTIC AC_SLG_NO "A/C on for this number of engine revolutions to de-slug." VALUE 0x5CB74 SD_FLOAT32_IEEE 0 SC_AC_SLG_NO 0 1023.98 /end CHARACTERISTIC
/begin COMPU_METHOD SC_AC_SLG_NO "AC_SLG_NO conversion" RAT_FUNC "%10.5" "rev" COEFFS 0 1 0 0 0 1 /end COMPU_METHOD
/begin CHARACTERISTIC AC_SLG_ON_TM "A/C on time during crank to de-slug." VALUE 0x5CB78 SD_FLOAT32_IEEE 0 SC_AC_SLG_ON_TM 0 63.999 /end CHARACTERISTIC
/begin COMPU_METHOD SC_AC_SLG_ON_TM "AC_SLG_ON_TM conversion" RAT_FUNC "%10.5" "s" COEFFS 0 1 0 0 0 1 /end COMPU_METHOD
/begin CHARACTERISTIC AC_SLG_RPM "A/C on below this engine speed to de-slug." VALUE 0x5CB70 SD_FLOAT32_IEEE 0 SC_AC_SLG_RPM 0 16383.8 /end CHARACTERISTIC
/begin COMPU_METHOD SC_AC_SLG_RPM "AC_SLG_RPM conversion" RAT_FUNC "%10.5" "RPM" COEFFS 0 1 0 0 0 1 /end COMPU_METHOD
/begin MEASUREMENT AC_SLG_SOAK "CASS copied soak time from ENG_OFF_TMR,  duration in minutes." FLOAT32_IEEE MC_AC_SLG_SOAK 0 0 0 0 ECU_ADDRESS 0x3FCC80 /end MEASUREMENT
/begin COMPU_METHOD MC_AC_SLG_SOAK "AC_SLG_SOAK conversion" RAT_FUNC "%10.5" "Unitless" COEFFS 0 1 0 0 0 1 /end COMPU_METHOD
/begin CHARACTERISTIC AC_SLG_TM "A/C off period below which use normal A/C start." VALUE 0x5CB6C SD_FLOAT32_IEEE 0 SC_AC_SLG_TM 0 32767.5 /end CHARACTERISTIC
/begin COMPU_METHOD SC_AC_SLG_TM "AC_SLG_TM conversion" RAT_FUNC "%10.5" "min" COEFFS 0 1 0 0 0 1 /end COMPU_METHOD
/begin MEASUREMENT AC_TQ_ENG__A "Air conditioning torque referenced to crank for powertrain torque model." FLOAT32_IEEE MC_AC_TQ_ENG__A 0 0 0 0 ECU_ADDRESS 0x3F9D78 /end MEASUREMENT
/begin COMPU_METHOD MC_AC_TQ_ENG__A "AC_TQ_ENG__A conversion" RAT_FUNC "%10.5" "Unitless" COEFFS 0 1 0 0 0 1 /end COMPU_METHOD
/begin MEASUREMENT AC_VBAT_FLG "VBAT latch flag applied when VBAT falls below AC_SLG_BATV." UBYTE MC_AC_VBAT_FLG 0 0 0 0 ECU_ADDRESS 0x3F9D38 /end MEASUREMENT
/begin COMPU_METHOD MC_AC_VBAT_FLG "AC_VBAT_FLG conversion" RAT_FUNC "%3.0" "Unitless" COEFFS 0 1 0 0 0 1 /end COMPU_METHOD
/begin CHARACTERISTIC ADAPTIVE_ECT_DEF "Default engine coolant temperature for adaptive cooling logic for ect sensor failure." VALUE 0x5DD48 SD_FLOAT32_IEEE 0 SC_ADAPTIVE_ECT_DEF -4096 4095.88 /end CHARACTERISTIC
/begin COMPU_METHOD SC_ADAPTIVE_ECT_DEF "ADAPTIVE_ECT_DEF conversion" RAT_FUNC "%10.5" "degC" COEFFS 0 1 0 0 0 1 /end COMPU_METHOD
/begin MEASUREMENT AD_ROC_PPS "Accelerator pedal position sensor rate of change value." FLOAT32_IEEE MC_AD_ROC_PPS 0 0 0 0 ECU_ADDRESS 0x3FA2FC /end MEASUREMENT
/begin COMPU_METHOD MC_AD_ROC_PPS "AD_ROC_PPS conversion" RAT_FUNC "%10.5" "Unitless" COEFFS 0 1 0 0 0 1 /end COMPU_METHOD
/begin CHARACTERISTIC AFR_MIN "MINIMUM VALUE OF AIR/FUEL RATIO." VALUE 0x3FA824 SD_FLOAT32_IEEE 0 SC_AFR_MIN 0 15.99 /end CHARACTERISTIC
/begin COMPU_METHOD SC_AFR_MIN "AFR_MIN conversion" RAT_FUNC "%10.5" "UNITLESS" COEFFS 0 1 0 0 0 1 /end COMPU_METHOD
/begin MEASUREMENT AFR_MIN_PI "" FLOAT32_IEEE MC_AFR_MIN_PI 0 0 0 0 ECU_ADDRESS 0x3FA838 /end MEASUREMENT
/begin COMPU_METHOD MC_AFR_MIN_PI "AFR_MIN_PI conversion" RAT_FUNC "%10.5" "Unitless" COEFFS 0 1 0 0 0 1 /end COMPU_METHOD
/begin MEASUREMENT AFR_MIN_PI_HI_ALT "Output of table fn_afrmnph" FLOAT32_IEEE MC_AFR_MIN_PI_HI_ALT 0 0 0 0 ECU_ADDRESS 0x3FA7F0 /end MEASUREMENT
/begin COMPU_METHOD MC_AFR_MIN_PI_HI_ALT "AFR_MIN_PI_HI_ALT conversion" RAT_FUNC "%10.5" "Unitless" COEFFS 0 1 0 0 0 1 /end COMPU_METHOD
/begin MEASUREMENT AFR_MIN_PI_LO_ALT "" FLOAT32_IEEE MC_AFR_MIN_PI_LO_ALT 0 0 0 0 ECU_ADDRESS 0x3FA858 /end MEASUREMENT
/begin COMPU_METHOD MC_AFR_MIN_PI_LO_ALT "AFR_MIN_PI_LO_ALT conversion" RAT_FUNC "%10.5" "Unitless" COEFFS 0 1 0 0 0 1 /end COMPU_METHOD
/begin MEASUREMENT AFR_MIN_SS "" FLOAT32_IEEE MC_AFR_MIN_SS 0 0 0 0 ECU_ADDRESS 0x3FA83C /end MEASUREMENT
/begin COMPU_METHOD MC_AFR_MIN_SS "AFR_MIN_SS conversion" RAT_FUNC "%10.5" "Unitless" COEFFS 0 1 0 0 0 1 /end COMPU_METHOD
/begin MEASUREMENT AFR_MIN_SS_HI_ALT "" FLOAT32_IEEE MC_AFR_MIN_SS_HI_ALT 0 0 0 0 ECU_ADDRESS 0x3FA860 /end MEASUREMENT
/begin COMPU_METHOD MC_AFR_MIN_SS_HI_ALT "AFR_MIN_SS_HI_ALT conversion" RAT_FUNC "%10.5" "Unitless" COEFFS 0 1 0 0 0 1 /end COMPU_METHOD
/begin MEASUREMENT AFR_MIN_SS_LO_ALT "" FLOAT32_IEEE MC_AFR_MIN_SS_LO_ALT 0 0 0 0 ECU_ADDRESS 0x3FA85C /end MEASUREMENT
/begin COMPU_METHOD MC_AFR_MIN_SS_LO_ALT "AFR_MIN_SS_LO_ALT conversion" RAT_FUNC "%10.5" "Unitless" COEFFS 0 1 0 0 0 1 /end COMPU_METHOD
/begin MEASUREMENT ALLOW_CRUISE "Bit from Power Monitor indicating cruise mode is allowed" UBYTE MC_ALLOW_CRUISE 0 0 0 0 ECU_ADDRESS 0x3FB738 /end MEASUREMENT
/begin COMPU_METHOD MC_ALLOW_CRUISE "ALLOW_CRUISE conversion" RAT_FUNC "%3.0" "Unitless" COEFFS 0 1 0 0 0 1 /end COMPU_METHOD
/begin CHARACTERISTIC ALPHAMIS "Filter constant for misfire test rolling average fault filters" VALUE 0x5EF40 SD_FLOAT32_IEEE 0 SC_ALPHAMIS 0 0.015625 /end CHARACTERISTIC
/begin COMPU_METHOD SC_ALPHAMIS "ALPHAMIS conversion" RAT_FUNC "%10.5" "unitless" COEFFS 0 1 0 0 0 1 /end COMPU_METHOD
/begin CHARACTERISTIC ALT1_F_TM0 "Maximum time delay before Primary Alternator fault detection KOEO" VALUE 0x5EC9C SD_ULONG 0 SC_ALT1_F_TM0 0 1e+06 /end CHARACTERISTIC
/begin COMPU_METHOD SC_ALT1_F_TM0 "ALT1_F_TM0 conversion" RAT_FUNC "%10.0" "ms" COEFFS 0 1 0 0 0 1 /end COMPU_METHOD
/begin CHARACTERISTIC ALT1_F_TM2 "Maximum time delay before Primary Alternator fault detection KOER" VALUE 0x5ECAC SD_ULONG 0 SC_ALT1_F_TM2 0 1e+06 /end CHARACTERISTIC
/begin COMPU_METHOD SC_ALT1_F_TM2 "ALT1_F_TM2 conversion" RAT_FUNC "%10.0" "ms" COEFFS 0 1 0 0 0 1 /end COMPU_METHOD
/begin MEASUREMENT ALT1_F_TMR "Primary Alternator fault timer" ULONG MC_ALT1_F_TMR 0 0 0 0 ECU_ADDRESS 0x3FB270 /end MEASUREMENT
/begin COMPU_METHOD MC_ALT1_F_TMR "ALT1_F_TMR conversion" RAT_FUNC "%10.0" "Unitless" COEFFS 0 1 0 0 0 1 /end COMPU_METHOD
/begin MEASUREMENT ALT1_MON_F "Primary Alternator  fault flag" UBYTE MC_ALT1_MON_F 0 0 0 0 ECU_ADDRESS 0x3FB287 /end MEASUREMENT
/begin COMPU_METHOD MC_ALT1_MON_F "ALT1_MON_F conversion" RAT_FUNC "%3.0" "Unitless" COEFFS 0 1 0 0 0 1 /end COMPU_METHOD
/begin CHARACTERISTIC ALT2_F_TM0 "Maximum time before Secondary alternator fault detection KOEO" VALUE 0x5EC98 SD_ULONG 0 SC_ALT2_F_TM0 0 1e+06 /end CHARACTERISTIC
/begin COMPU_METHOD SC_ALT2_F_TM0 "ALT2_F_TM0 conversion" RAT_FUNC "%10.0" "ms" COEFFS 0 1 0 0 0 1 /end COMPU_METHOD
/begin CHARACTERISTIC ALT2_F_TM2 "Maximum time delay before Secondary Alternator fault detection KOER" VALUE 0x5ECA4 SD_ULONG 0 SC_ALT2_F_TM2 0 1e+06 /end CHARACTERISTIC
/begin COMPU_METHOD SC_ALT2_F_TM2 "ALT2_F_TM2 conversion" RAT_FUNC "%10.0" "ms" COEFFS 0 1 0 0 0 1 /end COMPU_METHOD
/begin MEASUREMENT ALT2_F_TMR "Secondary Alternator run timer" ULONG MC_ALT2_F_TMR 0 0 0 0 ECU_ADDRESS 0x3FB26C /end MEASUREMENT
/begin COMPU_METHOD MC_ALT2_F_TMR "ALT2_F_TMR conversion" RAT_FUNC "%10.0" "Unitless" COEFFS 0 1 0 0 0 1 /end COMPU_METHOD
/begin MEASUREMENT ALT2_MON_F "Secondary Alternator fault flag" UBYTE MC_ALT2_MON_F 0 0 0 0 ECU_ADDRESS 0x3FB286 /end MEASUREMENT
/begin COMPU_METHOD MC_ALT2_MON_F "ALT2_MON_F conversion" RAT_FUNC "%3.0" "Unitless" COEFFS 0 1 0 0 0 1 /end COMPU_METHOD
/begin CHARACTERISTIC ALT2_PRE_TM0 "Maximum time to delay before Secondary alternator detection KOEO" VALUE 0x5EC90 SD_ULONG 0 SC_ALT2_PRE_TM0 0 1e+06 /end CHARACTERISTIC
/begin COMPU_METHOD SC_ALT2_PRE_TM0 "ALT2_PRE_TM0 conversion" RAT_FUNC "%10.0" "ms" COEFFS 0 1 0 0 0 1 /end COMPU_METHOD
/begin MEASUREMENT ALTDET_COUNT "Alternator hardware detect giveup looking count" UBYTE MC_ALTDET_COUNT 0 0 0 0 ECU_ADDRESS 0x3FCFB0 /end MEASUREMENT
/begin COMPU_METHOD MC_ALTDET_COUNT "ALTDET_COUNT conversion" RAT_FUNC "%3.0" "Unitless" COEFFS 0 1 0 0 0 1 /end COMPU_METHOD
/begin MEASUREMENT ALTDET_TMR "Alternator detection timer" ULONG MC_ALTDET_TMR 0 0 0 0 ECU_ADDRESS 0x3FB25C /end MEASUREMENT
/begin COMPU_METHOD MC_ALTDET_TMR "ALTDET_TMR conversion" RAT_FUNC "%10.0" "Unitless" COEFFS 0 1 0 0 0 1 /end COMPU_METHOD
/begin MEASUREMENT ALTIVPWR "Calculated IVPWR  from engine speed" FLOAT32_IEEE MC_ALTIVPWR 0 0 0 0 ECU_ADDRESS 0x3FB27C /end MEASUREMENT
/begin COMPU_METHOD MC_ALTIVPWR "ALTIVPWR conversion" RAT_FUNC "%10.5" "Unitless" COEFFS 0 1 0 0 0 1 /end COMPU_METHOD
/begin CHARACTERISTIC ALTOPT_1A "Software control switch to force presence of Secondary alternator" VALUE 0x5ECBB SD_UBYTE 0 SC_ALTOPT_1A 0 2 /end CHARACTERISTIC
/begin COMPU_METHOD SC_ALTOPT_1A "ALTOPT_1A conversion" RAT_FUNC "%3.0" "unitless" COEFFS 0 1 0 0 0 1 /end COMPU_METHOD
/begin MEASUREMENT ALTREFADD_DELTA_SEC "ARA loop time" FLOAT32_IEEE MC_ALTREFADD_DELTA_SEC 0 0 0 0 ECU_ADDRESS 0x3FA4BC /end MEASUREMENT
/begin COMPU_METHOD MC_ALTREFADD_DELTA_SEC "ALTREFADD_DELTA_SEC conversion" RAT_FUNC "%10.5" "Unitless" COEFFS 0 1 0 0 0 1 /end COMPU_METHOD
/begin MEASUREMENT ALTSCP "SCP message register of system fault status" UBYTE MC_ALTSCP 0 0 0 0 ECU_ADDRESS 0x3F9CFD /end MEASUREMENT
/begin COMPU_METHOD MC_ALTSCP "ALTSCP conversion" RAT_FUNC "%3.0" "Unitless" COEFFS 0 1 0 0 0 1 /end COMPU_METHOD
/begin CHARACTERISTIC ALT_AUTO_DET "Switch to enable auto detection of alternator hardware" VALUE 0x5ECBA SD_UBYTE 0 SC_ALT_AUTO_DET 0 2 /end CHARACTERISTIC
/begin COMPU_METHOD SC_ALT_AUTO_DET "ALT_AUTO_DET conversion" RAT_FUNC "%3.0" "unitless" COEFFS 0 1 0 0 0 1 /end COMPU_METHOD
/begin MEASUREMENT ALT_CONOBD_TMR "Minimum time delay before Alternator Control driver OBDII diagnosis done" ULONG MC_ALT_CONOBD_TMR 0 0 0 0 ECU_ADDRESS 0x3FB264 /end MEASUREMENT
/begin COMPU_METHOD MC_ALT_CONOBD_TMR "ALT_CONOBD_TMR conversion" RAT_FUNC "%10.0" "Unitless" COEFFS 0 1 0 0 0 1 /end COMPU_METHOD
/begin CHARACTERISTIC ALT_CONTMOBD "Minimum time delay before Alternator Control Driver OBDII update" VALUE 0x5EC88 SD_ULONG 0 SC_ALT_CONTMOBD 0 1e+06 /end CHARACTERISTIC
/begin COMPU_METHOD SC_ALT_CONTMOBD "ALT_CONTMOBD conversion" RAT_FUNC "%10.0" "ms" COEFFS 0 1 0 0 0 1 /end COMPU_METHOD
/begin MEASUREMENT ALT_CON_F "Alternator lower circuit fault flag" UBYTE MC_ALT_CON_F 0 0 0 0 ECU_ADDRESS 0x3FB284 /end MEASUREMENT
/begin COMPU_METHOD MC_ALT_CON_F "ALT_CON_F conversion" RAT_FUNC "%3.0" "Unitless" COEFFS 0 1 0 0 0 1 /end COMPU_METHOD
/begin CHARACTERISTIC ALT_CON_TM0 "Alternator run timer" VALUE 0x5ECA0 SD_ULONG 0 SC_ALT_CON_TM0 0 1e+06 /end CHARACTERISTIC
/begin COMPU_METHOD SC_ALT_CON_TM0 "ALT_CON_TM0 conversion" RAT_FUNC "%10.0" "ms" COEFFS 0 1 0 0 0 1 /end COMPU_METHOD
/begin MEASUREMENT ALT_CON_TMR "Alternator control fault detection timer" ULONG MC_ALT_CON_TMR 0 0 0 0 ECU_ADDRESS 0x3FB268 /end MEASUREMENT
/begin COMPU_METHOD MC_ALT_CON_TMR "ALT_CON_TMR conversion" RAT_FUNC "%10.0" "Unitless" COEFFS 0 1 0 0 0 1 /end COMPU_METHOD
/begin MEASUREMENT ALT_DET "Alternator detection flag" UBYTE MC_ALT_DET 0 0 0 0 ECU_ADDRESS 0x3FCFB1 /end MEASUREMENT
/begin COMPU_METHOD MC_ALT_DET "ALT_DET conversion" RAT_FUNC "%3.0" "Unitless" COEFFS 0 1 0 0 0 1 /end COMPU_METHOD
/begin CHARACTERISTIC ALT_DET_CNT "Maximum number of tries for autodetection" VALUE 0x5ECBD SD_UBYTE 0 SC_ALT_DET_CNT 0 255 /end CHARACTERISTIC
/begin COMPU_METHOD SC_ALT_DET_CNT "ALT_DET_CNT conversion" RAT_FUNC "%3.0" "unitless" COEFFS 0 1 0 0 0 1 /end COMPU_METHOD
/begin MEASUREMENT ALT_DET_COMP "Alternator detection complete flag" UBYTE MC_ALT_DET_COMP 0 0 0 0 ECU_ADDRESS 0x3FCFAF /end MEASUREMENT
/begin COMPU_METHOD MC_ALT_DET_COMP "ALT_DET_COMP conversion" RAT_FUNC "%3.0" "Unitless" COEFFS 0 1 0 0 0 1 /end COMPU_METHOD
/begin CHARACTERISTIC ALT_DET_TM "Time that alternate calibration requset signal must be detected for." VALUE 0x5ECB4 SD_UWORD 0 SC_ALT_DET_TM 0 65535 /end CHARACTERISTIC
/begin COMPU_METHOD SC_ALT_DET_TM "ALT_DET_TM conversion" RAT_FUNC "%5.0" "ms" COEFFS 0 1 0 0 0 1 /end COMPU_METHOD
/begin MEASUREMENT ALT_DET_TMR "Time since alternate calibration request signal was first detected." UWORD MC_ALT_DET_TMR 0 0 0 0 ECU_ADDRESS 0x3FB280 /end MEASUREMENT
/begin COMPU_METHOD MC_ALT_DET_TMR "ALT_DET_TMR conversion" RAT_FUNC "%5.0" "Unitless" COEFFS 0 1 0 0 0 1 /end COMPU_METHOD
/begin CHARACTERISTIC ALT_EN_CON "Alternator control enable" VALUE 0x5ECBC SD_UBYTE 0 SC_ALT_EN_CON 0 1 /end CHARACTERISTIC
/begin COMPU_METHOD SC_ALT_EN_CON "ALT_EN_CON conversion" RAT_FUNC "%3.0" "unitless" COEFFS 0 1 0 0 0 1 /end COMPU_METHOD
/begin MEASUREMENT ALT_FUEL_STAT "Alternative fuel status" UBYTE MC_ALT_FUEL_STAT 0 0 0 0 ECU_ADDRESS 0x3F9CF5 /end MEASUREMENT
/begin COMPU_METHOD MC_ALT_FUEL_STAT "ALT_FUEL_STAT conversion" RAT_FUNC "%3.0" "Unitless" COEFFS 0 1 0 0 0 1 /end COMPU_METHOD
/begin CHARACTERISTIC ALT_IVPWRH "Alternator RPM IVPWR voltage high limit" VALUE 0x5EC8C SD_FLOAT32_IEEE 0 SC_ALT_IVPWRH 0 25.2 /end CHARACTERISTIC
/begin COMPU_METHOD SC_ALT_IVPWRH "ALT_IVPWRH conversion" RAT_FUNC "%10.5" "V" COEFFS 0 1 0 0 0 1 /end COMPU_METHOD
/begin CHARACTERISTIC ALT_PUDET_TM "Maximum time for autodetect of Alternator hardware after powerup" VALUE 0x5EC94 SD_FLOAT32_IEEE 0 SC_ALT_PUDET_TM 0 1000 /end CHARACTERISTIC
/begin COMPU_METHOD SC_ALT_PUDET_TM "ALT_PUDET_TM conversion" RAT_FUNC "%10.5" "s" COEFFS 0 1 0 0 0 1 /end COMPU_METHOD
/begin MEASUREMENT ALT_PWRH_TMR "Alternator run timer" ULONG MC_ALT_PWRH_TMR 0 0 0 0 ECU_ADDRESS 0x3FB274 /end MEASUREMENT
/begin COMPU_METHOD MC_ALT_PWRH_TMR "ALT_PWRH_TMR conversion" RAT_FUNC "%10.0" "Unitless" COEFFS 0 1 0 0 0 1 /end COMPU_METHOD
/begin CHARACTERISTIC ALT_PWR_TM "Maximum time delay before Alternator RPM IVPWR fault detection" VALUE 0x5ECA8 SD_ULONG 0 SC_ALT_PWR_TM 0 1e+06 /end CHARACTERISTIC
/begin COMPU_METHOD SC_ALT_PWR_TM "ALT_PWR_TM conversion" RAT_FUNC "%10.0" "ms" COEFFS 0 1 0 0 0 1 /end COMPU_METHOD
/begin MEASUREMENT ALT_PWR_TMR "Maximum time delay before Alternator RPM IVPWR FAULT detection" ULONG MC_ALT_PWR_TMR 0 0 0 0 ECU_ADDRESS 0x3FB278 /end MEASUREMENT
/begin COMPU_METHOD MC_ALT_PWR_TMR "ALT_PWR_TMR conversion" RAT_FUNC "%10.0" "Unitless" COEFFS 0 1 0 0 0 1 /end COMPU_METHOD
/begin CHARACTERISTIC ALT_QADC_MON_THR "Alternator monitor threshold count for QADC" VALUE 0x5C3F0 SD_UWORD 0 SC_ALT_QADC_MON_THR 0 1024 /end CHARACTERISTIC
/begin COMPU_METHOD SC_ALT_QADC_MON_THR "ALT_QADC_MON_THR conversion" RAT_FUNC "%5.0" "unitless" COEFFS 0 1 0 0 0 1 /end COMPU_METHOD
/begin MEASUREMENT ALT_STATUS "Alternator input fault status register.  1-> Low, 2->Hi, 4-> no edges." UBYTE MC_ALT_STATUS 0 0 0 0 ECU_ADDRESS 0x3FA2C7 /end MEASUREMENT
/begin COMPU_METHOD MC_ALT_STATUS "ALT_STATUS conversion" RAT_FUNC "%3.0" "Unitless" COEFFS 0 1 0 0 0 1 /end COMPU_METHOD
/begin MEASUREMENT ALT_WARNING "Alternator circuit failure warning flag" UBYTE MC_ALT_WARNING 0 0 0 0 ECU_ADDRESS 0x3FCFAD /end MEASUREMENT
/begin COMPU_METHOD MC_ALT_WARNING "ALT_WARNING conversion" RAT_FUNC "%3.0" "Unitless" COEFFS 0 1 0 0 0 1 /end COMPU_METHOD
/begin CHARACTERISTIC ALT_WARN_TM "Maximum time delay before Alternator warning lamp on detection" VALUE 0x5ECB0 SD_ULONG 0 SC_ALT_WARN_TM 0 1e+06 /end CHARACTERISTIC
/begin COMPU_METHOD SC_ALT_WARN_TM "ALT_WARN_TM conversion" RAT_FUNC "%10.0" "ms" COEFFS 0 1 0 0 0 1 /end COMPU_METHOD
/begin MEASUREMENT ALT_WARN_TMR "Time delay for Alternator warning lamp on detection" ULONG MC_ALT_WARN_TMR 0 0 0 0 ECU_ADDRESS 0x3FB260 /end MEASUREMENT
/begin COMPU_METHOD MC_ALT_WARN_TMR "ALT_WARN_TMR conversion" RAT_FUNC "%10.0" "Unitless" COEFFS 0 1 0 0 0 1 /end COMPU_METHOD
/begin CHARACTERISTIC ANC_CP "flag to enable CP" VALUE 0x5EA76 SD_UBYTE 0 SC_ANC_CP 0 1 /end CHARACTERISTIC
/begin COMPU_METHOD SC_ANC_CP "ANC_CP conversion" RAT_FUNC "%3.0" "unitless" COEFFS 0 1 0 0 0 1 /end COMPU_METHOD
/begin CHARACTERISTIC ANC_LEG_TME "Lockout time for CP/SRC" VALUE 0x5EA70 SD_FLOAT32_IEEE 0 SC_ANC_LEG_TME 0 100 /end CHARACTERISTIC
/begin COMPU_METHOD SC_ANC_LEG_TME "ANC_LEG_TME conversion" RAT_FUNC "%10.5" "s" COEFFS 0 1 0 0 0 1 /end COMPU_METHOD
/begin MEASUREMENT ANC_LEG_TMR "Lockout timer for CP/SRC" FLOAT32_IEEE MC_ANC_LEG_TMR 0 0 0 0 ECU_ADDRESS 0x3FB16C /end MEASUREMENT
/begin COMPU_METHOD MC_ANC_LEG_TMR "ANC_LEG_TMR conversion" RAT_FUNC "%10.5" "Unitless" COEFFS 0 1 0 0 0 1 /end COMPU_METHOD
/begin CHARACTERISTIC ANC_PTO "flag to enable PTO" VALUE 0x5EA74 SD_UBYTE 0 SC_ANC_PTO 0 1 /end CHARACTERISTIC
/begin COMPU_METHOD SC_ANC_PTO "ANC_PTO conversion" RAT_FUNC "%3.0" "unitless" COEFFS 0 1 0 0 0 1 /end COMPU_METHOD
/begin CHARACTERISTIC ANC_SRC "flag to enable SRC" VALUE 0x5EA75 SD_UBYTE 0 SC_ANC_SRC 0 1 /end CHARACTERISTIC
/begin COMPU_METHOD SC_ANC_SRC "ANC_SRC conversion" RAT_FUNC "%3.0" "unitless" COEFFS 0 1 0 0 0 1 /end COMPU_METHOD
/begin MEASUREMENT ANT_PCM_ID[0] "Copy of PCM_ID held in RAM.  Used in ANTI-THEFT strategy." UBYTE MC_ANT_PCM_ID 0 0 0 255 ECU_ADDRESS 0x3F9DD4 /end MEASUREMENT
/begin COMPU_METHOD MC_ANT_PCM_ID "ANT_PCM_ID conversion" RAT_FUNC "%3.0" "Unitless" COEFFS 0 1 0 0 0 1 /end COMPU_METHOD
/begin MEASUREMENT ANT_PCM_ID[1] "Copy of PCM_ID held in RAM.  Used in ANTI-THEFT strategy." UBYTE MC_ANT_PCM_ID 0 0 0 255 ECU_ADDRESS 0x3F9DD5 /end MEASUREMENT
/begin MEASUREMENT ANT_PCM_ID[2] "Copy of PCM_ID held in RAM.  Used in ANTI-THEFT strategy." UBYTE MC_ANT_PCM_ID 0 0 0 255 ECU_ADDRESS 0x3F9DD6 /end MEASUREMENT
/begin MEASUREMENT ANT_PCM_ID[3] "Copy of PCM_ID held in RAM.  Used in ANTI-THEFT strategy." UBYTE MC_ANT_PCM_ID 0 0 0 255 ECU_ADDRESS 0x3F9DD7 /end MEASUREMENT
/begin MEASUREMENT ANT_PCM_ID[4] "Copy of PCM_ID held in RAM.  Used in ANTI-THEFT strategy." UBYTE MC_ANT_PCM_ID 0 0 0 255 ECU_ADDRESS 0x3F9DD8 /end MEASUREMENT
/begin MEASUREMENT ANT_PCM_ID[5] "Copy of PCM_ID held in RAM.  Used in ANTI-THEFT strategy." UBYTE MC_ANT_PCM_ID 0 0 0 255 ECU_ADDRESS 0x3F9DD9 /end MEASUREMENT
/begin MEASUREMENT ANT_PCM_ID[6] "Copy of PCM_ID held in RAM.  Used in ANTI-THEFT strategy." UBYTE MC_ANT_PCM_ID 0 0 0 255 ECU_ADDRESS 0x3F9DDA /end MEASUREMENT
/begin MEASUREMENT ANT_PCM_ID[7] "Copy of PCM_ID held in RAM.  Used in ANTI-THEFT strategy." UBYTE MC_ANT_PCM_ID 0 0 0 255 ECU_ADDRESS 0x3F9DDB /end MEASUREMENT
/begin MEASUREMENT ANT_SCAN_FLG "Flag indicating error in anti-theft challenge-response sequence; possible attempt to scan codes. 1 -> scan attempt." UBYTE MC_ANT_SCAN_FLG 0 0 0 0 ECU_ADDRESS 0x3FCC9C /end MEASUREMENT
/begin COMPU_METHOD MC_ANT_SCAN_FLG "ANT_SCAN_FLG conversion" RAT_FUNC "%3.0" "Unitless" COEFFS 0 1 0 0 0 1 /end COMPU_METHOD
/begin MEASUREMENT ANT_SCAN_TMR "Timer used in anti_theft to provide delay if incorrect response code is received." FLOAT32_IEEE MC_ANT_SCAN_TMR 0 0 0 0 ECU_ADDRESS 0x3F9DBC /end MEASUREMENT
/begin COMPU_METHOD MC_ANT_SCAN_TMR "ANT_SCAN_TMR conversion" RAT_FUNC "%10.5" "Unitless" COEFFS 0 1 0 0 0 1 /end COMPU_METHOD
/begin MEASUREMENT APP "Pedal mode flag; -1 -> closed, 0 -> part, 1 -> wide open." SBYTE MC_APP 0 0 0 0 ECU_ADDRESS 0x3FA332 /end MEASUREMENT
/begin COMPU_METHOD MC_APP "APP conversion" RAT_FUNC "%3.0" "Unitless" COEFFS 0 1 0 0 0 1 /end COMPU_METHOD
/begin MEASUREMENT APP_ENG_A[0] "Array OF PPS Values for PPS sensors before any FMEM action." FLOAT32_IEEE MC_APP_ENG_A 0 0 0 1023 ECU_ADDRESS 0x3FBCA8 /end MEASUREMENT
/begin COMPU_METHOD MC_APP_ENG_A "APP_ENG_A conversion" RAT_FUNC "%10.5" "ADct/V" COEFFS 0 1 0 0 0 1 /end COMPU_METHOD
/begin MEASUREMENT APP_ENG_A[1] "Array OF PPS Values for PPS sensors before any FMEM action." FLOAT32_IEEE MC_APP_ENG_A 0 0 0 1023 ECU_ADDRESS 0x3FBCAC /end MEASUREMENT
/begin MEASUREMENT APP_ENG_A[2] "Array OF PPS Values for PPS sensors before any FMEM action." FLOAT32_IEEE MC_APP_ENG_A 0 0 0 1023 ECU_ADDRESS 0x3FBCB0 /end MEASUREMENT
/begin MEASUREMENT APP_RAW[0] "Absolute angular position of  acclerator pedal" FLOAT32_IEEE MC_APP_RAW 0 0 0 100 ECU_ADDRESS 0x3FB8CC /end MEASUREMENT
/begin COMPU_METHOD MC_APP_RAW "APP_RAW conversion" RAT_FUNC "%10.5" "deg" COEFFS 0 1 0 0 0 1 /end COMPU_METHOD
/begin MEASUREMENT APP_RAW[1] "Absolute angular position of  acclerator pedal" FLOAT32_IEEE MC_APP_RAW 0 0 0 100 ECU_ADDRESS 0x3FB8D0 /end MEASUREMENT
/begin MEASUREMENT APP_RAW[2] "Absolute angular position of  acclerator pedal" FLOAT32_IEEE MC_APP_RAW 0 0 0 100 ECU_ADDRESS 0x3FB8D4 /end MEASUREMENT
/begin MEASUREMENT APP_REL "Pedal percentage (0-100%) sent to transmission" FLOAT32_IEEE MC_APP_REL 0 0 0 0 ECU_ADDRESS 0x3FA294 /end MEASUREMENT
/begin COMPU_METHOD MC_APP_REL "APP_REL conversion" RAT_FUNC "%10.5" "Unitless" COEFFS 0 1 0 0 0 1 /end COMPU_METHOD
/begin MEASUREMENT APP_REL_ROC "Accelerator pedal position sensor rate of change value." FLOAT32_IEEE MC_APP_REL_ROC 0 0 0 0 ECU_ADDRESS 0x3FA28C /end MEASUREMENT
/begin COMPU_METHOD MC_APP_REL_ROC "APP_REL_ROC conversion" RAT_FUNC "%10.5" "Unitless" COEFFS 0 1 0 0 0 1 /end COMPU_METHOD
/begin MEASUREMENT APP_STATUS[0] "Status of Accelerator Pedal Position input ( 0 = ok )" UBYTE MC_APP_STATUS 0 0 0 255 ECU_ADDRESS 0x3F9894 /end MEASUREMENT
/begin COMPU_METHOD MC_APP_STATUS "APP_STATUS conversion" RAT_FUNC "%3.0" "unitless" COEFFS 0 1 0 0 0 1 /end COMPU_METHOD
/begin MEASUREMENT APP_STATUS[1] "Status of Accelerator Pedal Position input ( 0 = ok )" UBYTE MC_APP_STATUS 0 0 0 255 ECU_ADDRESS 0x3F9895 /end MEASUREMENT
/begin MEASUREMENT APP_STATUS[2] "Status of Accelerator Pedal Position input ( 0 = ok )" UBYTE MC_APP_STATUS 0 0 0 255 ECU_ADDRESS 0x3F9896 /end MEASUREMENT
/begin MEASUREMENT APP_VOLTS[0] "Accelerator pedal position  input voltage" FLOAT32_IEEE MC_APP_VOLTS 0 0 0 5 ECU_ADDRESS 0x3FB8C0 /end MEASUREMENT
/begin COMPU_METHOD MC_APP_VOLTS "APP_VOLTS conversion" RAT_FUNC "%10.5" "V" COEFFS 0 1 0 0 0 1 /end COMPU_METHOD
/begin MEASUREMENT APP_VOLTS[1] "Accelerator pedal position  input voltage" FLOAT32_IEEE MC_APP_VOLTS 0 0 0 5 ECU_ADDRESS 0x3FB8C4 /end MEASUREMENT
/begin MEASUREMENT APP_VOLTS[2] "Accelerator pedal position  input voltage" FLOAT32_IEEE MC_APP_VOLTS 0 0 0 5 ECU_ADDRESS 0x3FB8C8 /end MEASUREMENT
/begin MEASUREMENT APT "Thottle mode flag; -1 -> closed, 0 -> part, 1 -> wide open." SBYTE MC_APT 0 0 0 0 ECU_ADDRESS 0x3F9CFE /end MEASUREMENT
/begin COMPU_METHOD MC_APT "APT conversion" RAT_FUNC "%3.0" "Unitless" COEFFS 0 1 0 0 0 1 /end COMPU_METHOD
/begin MEASUREMENT ARA_EN_CONDN_FAILED "1-> Indicates, ARA sensor relative diff. values are not with in allowed tolerance band" UBYTE MC_ARA_EN_CONDN_FAILED 0 0 0 0 ECU_ADDRESS 0x3FA4E2 /end MEASUREMENT
/begin COMPU_METHOD MC_ARA_EN_CONDN_FAILED "ARA_EN_CONDN_FAILED conversion" RAT_FUNC "%3.0" "Unitless" COEFFS 0 1 0 0 0 1 /end COMPU_METHOD
/begin CHARACTERISTIC ARA_F_DEC "ARA malf and malf update decrement value" VALUE 0x5D6E4 SD_SLONG 0 SC_ARA_F_DEC 0 10000 /end CHARACTERISTIC
/begin COMPU_METHOD SC_ARA_F_DEC "ARA_F_DEC conversion" RAT_FUNC "%10.0" "unitless" COEFFS 0 1 0 0 0 1 /end COMPU_METHOD
/begin CHARACTERISTIC ARA_F_INC "ARA malf and malf update increment value" VALUE 0x5D6E8 SD_SLONG 0 SC_ARA_F_INC 0 10000 /end CHARACTERISTIC
/begin COMPU_METHOD SC_ARA_F_INC "ARA_F_INC conversion" RAT_FUNC "%10.0" "unitless" COEFFS 0 1 0 0 0 1 /end COMPU_METHOD
/begin MEASUREMENT ARA_MALFUPD_EN_CONDN "Engine conditions okay for cal. of altitude references" UBYTE MC_ARA_MALFUPD_EN_CONDN 0 0 0 0 ECU_ADDRESS 0x3FA4E4 /end MEASUREMENT
/begin COMPU_METHOD MC_ARA_MALFUPD_EN_CONDN "ARA_MALFUPD_EN_CONDN conversion" RAT_FUNC "%3.0" "Unitless" COEFFS 0 1 0 0 0 1 /end COMPU_METHOD
/begin MEASUREMENT ARA_MALF_CNTR "ARA input components tolerance FMEM malf counter" SLONG MC_ARA_MALF_CNTR 0 0 0 0 ECU_ADDRESS 0x3FA4DC /end MEASUREMENT
/begin COMPU_METHOD MC_ARA_MALF_CNTR "ARA_MALF_CNTR conversion" RAT_FUNC "%10.0" "Unitless" COEFFS 0 1 0 0 0 1 /end COMPU_METHOD
/begin MEASUREMENT ARA_MALF_UPD_CNTR "ARA malf update counter" SLONG MC_ARA_MALF_UPD_CNTR 0 0 0 0 ECU_ADDRESS 0x3FA4D8 /end MEASUREMENT
/begin COMPU_METHOD MC_ARA_MALF_UPD_CNTR "ARA_MALF_UPD_CNTR conversion" RAT_FUNC "%10.0" "Unitless" COEFFS 0 1 0 0 0 1 /end COMPU_METHOD
/begin CHARACTERISTIC ARA_VGT_DTY_MIN "VGT max. limit value for ARA" VALUE 0x5D6B4 SD_FLOAT32_IEEE 0 SC_ARA_VGT_DTY_MIN 0 2 /end CHARACTERISTIC
/begin COMPU_METHOD SC_ARA_VGT_DTY_MIN "ARA_VGT_DTY_MIN conversion" RAT_FUNC "%10.5" "unitless" COEFFS 0 1 0 0 0 1 /end COMPU_METHOD
/begin MEASUREMENT ARA_VGT_LMT_OK "1-> indicates VGT is with in limits for Altitude reference calc." UBYTE MC_ARA_VGT_LMT_OK 0 0 0 0 ECU_ADDRESS 0x3FA4E3 /end MEASUREMENT
/begin COMPU_METHOD MC_ARA_VGT_LMT_OK "ARA_VGT_LMT_OK conversion" RAT_FUNC "%3.0" "Unitless" COEFFS 0 1 0 0 0 1 /end COMPU_METHOD
/begin MEASUREMENT ARC_MF_SNPSHT "snap shotted isochronous mass fuelcal." FLOAT32_IEEE MC_ARC_MF_SNPSHT 0 0 0 0 ECU_ADDRESS 0x3FA72C /end MEASUREMENT
/begin COMPU_METHOD MC_ARC_MF_SNPSHT "ARC_MF_SNPSHT conversion" RAT_FUNC "%10.5" "Unitless" COEFFS 0 1 0 0 0 1 /end COMPU_METHOD
/begin MEASUREMENT ARC_MULT "" FLOAT32_IEEE MC_ARC_MULT 0 0 0 0 ECU_ADDRESS 0x3FA734 /end MEASUREMENT
/begin COMPU_METHOD MC_ARC_MULT "ARC_MULT conversion" RAT_FUNC "%10.5" "Unitless" COEFFS 0 1 0 0 0 1 /end COMPU_METHOD
/begin MEASUREMENT ARC_RMP_MULT "" FLOAT32_IEEE MC_ARC_RMP_MULT 0 0 0 0 ECU_ADDRESS 0x3FA730 /end MEASUREMENT
/begin COMPU_METHOD MC_ARC_RMP_MULT "ARC_RMP_MULT conversion" RAT_FUNC "%10.5" "Unitless" COEFFS 0 1 0 0 0 1 /end COMPU_METHOD
/begin MEASUREMENT ARC_RMP_TMR "Fuel ramp timer." ULONG MC_ARC_RMP_TMR 0 0 0 0 ECU_ADDRESS 0x3FA718 /end MEASUREMENT
/begin COMPU_METHOD MC_ARC_RMP_TMR "ARC_RMP_TMR conversion" RAT_FUNC "%10.0" "Unitless" COEFFS 0 1 0 0 0 1 /end COMPU_METHOD
/begin MEASUREMENT ASP_PEDPCNT "Pedal percentage (0-100%) sent to transmission" FLOAT32_IEEE MC_ASP_PEDPCNT 0 0 0 0 ECU_ADDRESS 0x3FA300 /end MEASUREMENT
/begin COMPU_METHOD MC_ASP_PEDPCNT "ASP_PEDPCNT conversion" RAT_FUNC "%10.5" "Unitless" COEFFS 0 1 0 0 0 1 /end COMPU_METHOD
/begin MEASUREMENT ATMR1 "Time since engine start." FLOAT32_IEEE MC_ATMR1 0 0 0 0 ECU_ADDRESS 0x3FB5EC /end MEASUREMENT
/begin COMPU_METHOD MC_ATMR1 "ATMR1 conversion" RAT_FUNC "%10.5" "Unitless" COEFFS 0 1 0 0 0 1 /end COMPU_METHOD
/begin MEASUREMENT ATMR1_LST "Last calculated value of ATMR1 from previous calculation." FLOAT32_IEEE MC_ATMR1_LST 0 0 0 0 ECU_ADDRESS 0x3FB5F0 /end MEASUREMENT
/begin COMPU_METHOD MC_ATMR1_LST "ATMR1_LST conversion" RAT_FUNC "%10.5" "Unitless" COEFFS 0 1 0 0 0 1 /end COMPU_METHOD
/begin MEASUREMENT ATMR2 "TIME SINCE ENGINE TEMP > TEMPFB" FLOAT32_IEEE MC_ATMR2 0 0 0 0 ECU_ADDRESS 0x3FB5E8 /end MEASUREMENT
/begin COMPU_METHOD MC_ATMR2 "ATMR2 conversion" RAT_FUNC "%10.5" "Unitless" COEFFS 0 1 0 0 0 1 /end COMPU_METHOD
/begin MEASUREMENT ATMR3 "TIME IN RUN MODE" FLOAT32_IEEE MC_ATMR3 0 0 0 0 ECU_ADDRESS 0x3FB5E4 /end MEASUREMENT
/begin COMPU_METHOD MC_ATMR3 "ATMR3 conversion" RAT_FUNC "%10.5" "Unitless" COEFFS 0 1 0 0 0 1 /end COMPU_METHOD
/begin CHARACTERISTIC AUTO_TRNS_SW "Calibratiion switch to allow selection between auto and manual transmission logic; 0 -> manual, 1 -> auto" VALUE 0x5D448 SD_ULONG 0 SC_AUTO_TRNS_SW 0 1 /end CHARACTERISTIC
/begin COMPU_METHOD SC_AUTO_TRNS_SW "AUTO_TRNS_SW conversion" RAT_FUNC "%10.0" "Unitless" COEFFS 0 1 0 0 0 1 /end COMPU_METHOD
/begin MEASUREMENT AUT_PCMID_TX "Auto send PCMID without secure access.  Bit copied from SWID Block on powerup." UBYTE MC_AUT_PCMID_TX 0 0 0 0 ECU_ADDRESS 0x3F9DEE /end MEASUREMENT
/begin COMPU_METHOD MC_AUT_PCMID_TX "AUT_PCMID_TX conversion" RAT_FUNC "%3.0" "Unitless" COEFFS 0 1 0 0 0 1 /end COMPU_METHOD
/begin CHARACTERISTIC AXLE_RATIO_F "Fractional portion of Axle Ratio; BCD encoded for SCP. Hi Nibble=Tenths, Lo Nibble=Hundredths multip" VALUE 0x5EF90 SD_UBYTE 0 SC_AXLE_RATIO_F 0 255 /end CHARACTERISTIC
/begin COMPU_METHOD SC_AXLE_RATIO_F "AXLE_RATIO_F conversion" RAT_FUNC "%3.0" "BCD UNITS" COEFFS 0 1 0 0 0 1 /end COMPU_METHOD
/begin CHARACTERISTIC AXLE_RATIO_I "Integer portion of Axle Ratio; BCD encoded for SCP: Hi Nibble=Tens, Lo Nibble=Ones multiplier." VALUE 0x5EF91 SD_UBYTE 0 SC_AXLE_RATIO_I 0 255 /end CHARACTERISTIC
/begin COMPU_METHOD SC_AXLE_RATIO_I "AXLE_RATIO_I conversion" RAT_FUNC "%3.0" "BCD UNITS" COEFFS 0 1 0 0 0 1 /end COMPU_METHOD
/begin MEASUREMENT A_RATE_ENA "Flag set when Type A Packets are requested on SCP (~12.5 msec updates)" UBYTE MC_A_RATE_ENA 0 0 0 0 ECU_ADDRESS 0x3FB438 /end MEASUREMENT
/begin COMPU_METHOD MC_A_RATE_ENA "A_RATE_ENA conversion" RAT_FUNC "%3.0" "Unitless" COEFFS 0 1 0 0 0 1 /end COMPU_METHOD
/begin MEASUREMENT BANK1_EXPLIC "Once per 200 revs misfire rate for cylinder bank 1" FLOAT32_IEEE MC_BANK1_EXPLIC 0 0 0 0 ECU_ADDRESS 0x3FB3C8 /end MEASUREMENT
/begin COMPU_METHOD MC_BANK1_EXPLIC "BANK1_EXPLIC conversion" RAT_FUNC "%10.5" "Unitless" COEFFS 0 1 0 0 0 1 /end COMPU_METHOD
/begin MEASUREMENT BANK2_EXPLIC "Once per 200 revs misfire rate for cylinder bank 2" FLOAT32_IEEE MC_BANK2_EXPLIC 0 0 0 0 ECU_ADDRESS 0x3FB3C4 /end MEASUREMENT
/begin COMPU_METHOD MC_BANK2_EXPLIC "BANK2_EXPLIC conversion" RAT_FUNC "%10.5" "Unitless" COEFFS 0 1 0 0 0 1 /end COMPU_METHOD
/begin MEASUREMENT BANKMISFIL1 "Rolling average misfire rate for bank 1." FLOAT32_IEEE MC_BANKMISFIL1 0 0 0 0 ECU_ADDRESS 0x3FB3A0 /end MEASUREMENT
/begin COMPU_METHOD MC_BANKMISFIL1 "BANKMISFIL1 conversion" RAT_FUNC "%10.5" "Unitless" COEFFS 0 1 0 0 0 1 /end COMPU_METHOD
/begin MEASUREMENT BANKMISFIL2 "Rolling average misfire rate for bank 2." FLOAT32_IEEE MC_BANKMISFIL2 0 0 0 0 ECU_ADDRESS 0x3FB39C /end MEASUREMENT
/begin COMPU_METHOD MC_BANKMISFIL2 "BANKMISFIL2 conversion" RAT_FUNC "%10.5" "Unitless" COEFFS 0 1 0 0 0 1 /end COMPU_METHOD
/begin CHARACTERISTIC BATTLMPFTM "Alternator run timer" VALUE 0x5EC84 SD_ULONG 0 SC_BATTLMPFTM 0 1e+06 /end CHARACTERISTIC
/begin COMPU_METHOD SC_BATTLMPFTM "BATTLMPFTM conversion" RAT_FUNC "%10.0" "ms" COEFFS 0 1 0 0 0 1 /end COMPU_METHOD
/begin MEASUREMENT BATTLMP_F "" UBYTE MC_BATTLMP_F 0 0 0 0 ECU_ADDRESS 0x3FB285 /end MEASUREMENT
/begin COMPU_METHOD MC_BATTLMP_F "BATTLMP_F conversion" RAT_FUNC "%3.0" "Unitless" COEFFS 0 1 0 0 0 1 /end COMPU_METHOD
/begin MEASUREMENT BATTLMP_F_TMR "Alternator detection timer" ULONG MC_BATTLMP_F_TMR 0 0 0 0 ECU_ADDRESS 0x3FB258 /end MEASUREMENT
/begin COMPU_METHOD MC_BATTLMP_F_TMR "BATTLMP_F_TMR conversion" RAT_FUNC "%10.0" "Unitless" COEFFS 0 1 0 0 0 1 /end COMPU_METHOD
/begin MEASUREMENT BATTL_F_FLG "" UBYTE MC_BATTL_F_FLG 0 0 0 0 ECU_ADDRESS 0x3F9CF9 /end MEASUREMENT
/begin COMPU_METHOD MC_BATTL_F_FLG "BATTL_F_FLG conversion" RAT_FUNC "%3.0" "Unitless" COEFFS 0 1 0 0 0 1 /end COMPU_METHOD
/begin MEASUREMENT BATTL_POD "Alternator battery lamp" UBYTE MC_BATTL_POD 0 0 0 0 ECU_ADDRESS 0x3FB288 /end MEASUREMENT
/begin COMPU_METHOD MC_BATTL_POD "BATTL_POD conversion" RAT_FUNC "%3.0" "Unitless" COEFFS 0 1 0 0 0 1 /end COMPU_METHOD
/begin MEASUREMENT BCSDC_OUT "BCSDC output to the DUCE chip" FLOAT32_IEEE MC_BCSDC_OUT 0 0 0 0 ECU_ADDRESS 0x3F9C50 /end MEASUREMENT
/begin COMPU_METHOD MC_BCSDC_OUT "BCSDC_OUT conversion" RAT_FUNC "%10.5" "Unitless" COEFFS 0 1 0 0 0 1 /end COMPU_METHOD
/begin CHARACTERISTIC BETAMISHI "Upper clip for the progressively weighted filter constant used to calculate average misfire rates (startup default)." VALUE 0x5EEC4 SD_FLOAT32_IEEE 0 SC_BETAMISHI 0 0.999985 /end CHARACTERISTIC
/begin COMPU_METHOD SC_BETAMISHI "BETAMISHI conversion" RAT_FUNC "%10.5" "unitless" COEFFS 0 1 0 0 0 1 /end COMPU_METHOD
/begin CHARACTERISTIC BETAMISLO "Lower clip for the progressively weighted filter constant used to calculate average misfire rates (steady state default)." VALUE 0x5EEC8 SD_FLOAT32_IEEE 0 SC_BETAMISLO 0 0.999985 /end CHARACTERISTIC
/begin COMPU_METHOD SC_BETAMISLO "BETAMISLO conversion" RAT_FUNC "%10.5" "unitless" COEFFS 0 1 0 0 0 1 /end COMPU_METHOD
/begin MEASUREMENT BIFLG "BRAKE ON" UBYTE MC_BIFLG 0 0 0 0 ECU_ADDRESS 0x3FA2C5 /end MEASUREMENT
/begin COMPU_METHOD MC_BIFLG "BIFLG conversion" RAT_FUNC "%3.0" "Unitless" COEFFS 0 1 0 0 0 1 /end COMPU_METHOD
/begin CHARACTERISTIC BLANKING_RATIO_V8 "Blanking ratio for CKP noise rejection in TPU eng pos driver" VALUE 0x5C47C SD_FLOAT32_IEEE 0 SC_BLANKING_RATIO_V8 0 100 /end CHARACTERISTIC
/begin COMPU_METHOD SC_BLANKING_RATIO_V8 "BLANKING_RATIO_V8 conversion" RAT_FUNC "%10.5" "unitless" COEFFS 0 1 0 0 0 1 /end COMPU_METHOD
/begin MEASUREMENT BOOFLG "Brake pedal switch failed" UBYTE MC_BOOFLG 0 0 0 0 ECU_ADDRESS 0x3FA2C4 /end MEASUREMENT
/begin COMPU_METHOD MC_BOOFLG "BOOFLG conversion" RAT_FUNC "%3.0" "Unitless" COEFFS 0 1 0 0 0 1 /end COMPU_METHOD
/begin MEASUREMENT BOOST_DASH "boost wahser adder" FLOAT32_IEEE MC_BOOST_DASH 0 0 0 0 ECU_ADDRESS 0x3FA900 /end MEASUREMENT
/begin COMPU_METHOD MC_BOOST_DASH "BOOST_DASH conversion" RAT_FUNC "%10.5" "Unitless" COEFFS 0 1 0 0 0 1 /end COMPU_METHOD
/begin CHARACTERISTIC BOOST_DASH_EN "boost washer adder  enable switch." VALUE 0x5DE41 SD_UBYTE 0 SC_BOOST_DASH_EN 0 1 /end CHARACTERISTIC
/begin COMPU_METHOD SC_BOOST_DASH_EN "BOOST_DASH_EN conversion" RAT_FUNC "%3.0" "unitless" COEFFS 0 1 0 0 0 1 /end COMPU_METHOD
/begin CHARACTERISTIC BOOST_DIT "boost adder selection switch." VALUE 0x5DE42 SD_UBYTE 0 SC_BOOST_DIT 0 1 /end CHARACTERISTIC
/begin COMPU_METHOD SC_BOOST_DIT "BOOST_DIT conversion" RAT_FUNC "%3.0" "unitless" COEFFS 0 1 0 0 0 1 /end COMPU_METHOD
/begin MEASUREMENT BOOST_OVER_MIN " no_boost - map_kpa" FLOAT32_IEEE MC_BOOST_OVER_MIN 0 0 0 0 ECU_ADDRESS 0x3FA908 /end MEASUREMENT
/begin COMPU_METHOD MC_BOOST_OVER_MIN "BOOST_OVER_MIN conversion" RAT_FUNC "%10.5" "Unitless" COEFFS 0 1 0 0 0 1 /end COMPU_METHOD
/begin MEASUREMENT BOO_SW "brake on/off switch" UBYTE MC_BOO_SW 0 0 0 0 ECU_ADDRESS 0x3F9901 /end MEASUREMENT
/begin COMPU_METHOD MC_BOO_SW "BOO_SW conversion" RAT_FUNC "%3.0" "Unitless" COEFFS 0 1 0 0 0 1 /end COMPU_METHOD
/begin MEASUREMENT BP "Barometric Pressure. (Note: Upper byte of BP_WORD.)" FLOAT32_IEEE MC_BP 0 0 0 0 ECU_ADDRESS 0x3FA288 /end MEASUREMENT
/begin COMPU_METHOD MC_BP "BP conversion" RAT_FUNC "%10.5" "Unitless" COEFFS 0 1 0 0 0 1 /end COMPU_METHOD
/begin MEASUREMENT BPS "Brake pressure indicator flag, 1 - pedal is depressed" UBYTE MC_BPS 0 0 0 0 ECU_ADDRESS 0x3F9900 /end MEASUREMENT
/begin COMPU_METHOD MC_BPS "BPS conversion" RAT_FUNC "%3.0" "Unitless" COEFFS 0 1 0 0 0 1 /end COMPU_METHOD
/begin CHARACTERISTIC BPS_ABORT_TM "" VALUE 0x5F180 SD_FLOAT32_IEEE 0 SC_BPS_ABORT_TM 0 200000 /end CHARACTERISTIC
/begin COMPU_METHOD SC_BPS_ABORT_TM "BPS_ABORT_TM conversion" RAT_FUNC "%10.5" "unitless" COEFFS 0 1 0 0 0 1 /end COMPU_METHOD
/begin MEASUREMENT BPS_ABORT_TMR "" FLOAT32_IEEE MC_BPS_ABORT_TMR 0 0 0 0 ECU_ADDRESS 0x3FB588 /end MEASUREMENT
/begin COMPU_METHOD MC_BPS_ABORT_TMR "BPS_ABORT_TMR conversion" RAT_FUNC "%10.5" "Unitless" COEFFS 0 1 0 0 0 1 /end COMPU_METHOD
/begin MEASUREMENT BP_ACQ_TMR "BP acquire timer" FLOAT32_IEEE MC_BP_ACQ_TMR 0 0 0 0 ECU_ADDRESS 0x3FA174 /end MEASUREMENT
/begin COMPU_METHOD MC_BP_ACQ_TMR "BP_ACQ_TMR conversion" RAT_FUNC "%10.5" "Unitless" COEFFS 0 1 0 0 0 1 /end COMPU_METHOD
/begin CHARACTERISTIC BP_AD_TC "Barometric Pressure filter time constant" VALUE 0x5CF10 SD_FLOAT32_IEEE 0 SC_BP_AD_TC 0 64 /end CHARACTERISTIC
/begin COMPU_METHOD SC_BP_AD_TC "BP_AD_TC conversion" RAT_FUNC "%10.5" "s" COEFFS 0 1 0 0 0 1 /end COMPU_METHOD
/begin CHARACTERISTIC BP_DEF "Default FMEM value for barometric pressure" VALUE 0x5CF14 SD_FLOAT32_IEEE 0 SC_BP_DEF 0 300 /end CHARACTERISTIC
/begin COMPU_METHOD SC_BP_DEF "BP_DEF conversion" RAT_FUNC "%10.5" "kPa" COEFFS 0 1 0 0 0 1 /end COMPU_METHOD
/begin MEASUREMENT BP_ENG_KPA "raw barometric pressure without any compensation, kPA" FLOAT32_IEEE MC_BP_ENG_KPA 0 0 0 0 ECU_ADDRESS 0x3F98F4 /end MEASUREMENT
/begin COMPU_METHOD MC_BP_ENG_KPA "BP_ENG_KPA conversion" RAT_FUNC "%10.5" "Unitless" COEFFS 0 1 0 0 0 1 /end COMPU_METHOD
/begin MEASUREMENT BP_ENG_KPA_OFFS "BP Engineering Value with offset" FLOAT32_IEEE MC_BP_ENG_KPA_OFFS 0 0 0 0 ECU_ADDRESS 0x3F9EC0 /end MEASUREMENT
/begin COMPU_METHOD MC_BP_ENG_KPA_OFFS "BP_ENG_KPA_OFFS conversion" RAT_FUNC "%10.5" "Unitless" COEFFS 0 1 0 0 0 1 /end COMPU_METHOD
/begin MEASUREMENT BP_FILT_TIME_CONST "BP filter time constant" FLOAT32_IEEE MC_BP_FILT_TIME_CONST 0 0 0 0 ECU_ADDRESS 0x3F9EBC /end MEASUREMENT
/begin COMPU_METHOD MC_BP_FILT_TIME_CONST "BP_FILT_TIME_CONST conversion" RAT_FUNC "%10.5" "Unitless" COEFFS 0 1 0 0 0 1 /end COMPU_METHOD
/begin MEASUREMENT BP_FLT_RECOVERY_FLG "1-> Indicates BP fault recovery is occuring" UBYTE MC_BP_FLT_RECOVERY_FLG 0 0 0 0 ECU_ADDRESS 0x3F9EC8 /end MEASUREMENT
/begin COMPU_METHOD MC_BP_FLT_RECOVERY_FLG "BP_FLT_RECOVERY_FLG conversion" RAT_FUNC "%3.0" "Unitless" COEFFS 0 1 0 0 0 1 /end COMPU_METHOD
/begin CHARACTERISTIC BP_F_DEC "BP malf failure/update counter decrement value" VALUE 0x5CF44 SD_SLONG 0 SC_BP_F_DEC 0 65535 /end CHARACTERISTIC
/begin COMPU_METHOD SC_BP_F_DEC "BP_F_DEC conversion" RAT_FUNC "%10.0" "unitless" COEFFS 0 1 0 0 0 1 /end COMPU_METHOD
/begin CHARACTERISTIC BP_F_INC "BP ORH/ORL failure counter increment value" VALUE 0x5CF48 SD_SLONG 0 SC_BP_F_INC 0 65535 /end CHARACTERISTIC
/begin COMPU_METHOD SC_BP_F_INC "BP_F_INC conversion" RAT_FUNC "%10.0" "unitless" COEFFS 0 1 0 0 0 1 /end COMPU_METHOD
/begin CHARACTERISTIC BP_KOEO_TM "Timer threshold for capturing bp and map key on value" VALUE 0x5D320 SD_FLOAT32_IEEE 0 SC_BP_KOEO_TM 0 500 /end CHARACTERISTIC
/begin COMPU_METHOD SC_BP_KOEO_TM "BP_KOEO_TM conversion" RAT_FUNC "%10.5" "s" COEFFS 0 1 0 0 0 1 /end COMPU_METHOD
/begin MEASUREMENT BP_KPA "Barometric Pressure (in KPA)" FLOAT32_IEEE MC_BP_KPA 0 0 0 0 ECU_ADDRESS 0x3F9EC4 /end MEASUREMENT
/begin COMPU_METHOD MC_BP_KPA "BP_KPA conversion" RAT_FUNC "%10.5" "Unitless" COEFFS 0 1 0 0 0 1 /end COMPU_METHOD
/begin MEASUREMENT BP_KPA_KON "BP (kPa) at key on" FLOAT32_IEEE MC_BP_KPA_KON 0 0 0 0 ECU_ADDRESS 0x3FA188 /end MEASUREMENT
/begin COMPU_METHOD MC_BP_KPA_KON "BP_KPA_KON conversion" RAT_FUNC "%10.5" "Unitless" COEFFS 0 1 0 0 0 1 /end COMPU_METHOD
/begin MEASUREMENT BP_KPA_KYO "Barometric Pressure (kpa) at key on" FLOAT32_IEEE MC_BP_KPA_KYO 0 0 0 0 ECU_ADDRESS 0x3FA1A4 /end MEASUREMENT
/begin COMPU_METHOD MC_BP_KPA_KYO "BP_KPA_KYO conversion" RAT_FUNC "%10.5" "Unitless" COEFFS 0 1 0 0 0 1 /end COMPU_METHOD
/begin MEASUREMENT BP_KPA_PID "Barometric Pressure (in Hg) for PID interface" FLOAT32_IEEE MC_BP_KPA_PID 0 0 0 0 ECU_ADDRESS 0x3F9EA0 /end MEASUREMENT
/begin COMPU_METHOD MC_BP_KPA_PID "BP_KPA_PID conversion" RAT_FUNC "%10.5" "Unitless" COEFFS 0 1 0 0 0 1 /end COMPU_METHOD
/begin MEASUREMENT BP_MALF_SET "Indicate BP malf  high or low failure" UBYTE MC_BP_MALF_SET 0 0 0 0 ECU_ADDRESS 0x3F9ECA /end MEASUREMENT
/begin COMPU_METHOD MC_BP_MALF_SET "BP_MALF_SET conversion" RAT_FUNC "%3.0" "Unitless" COEFFS 0 1 0 0 0 1 /end COMPU_METHOD
/begin MEASUREMENT BP_MPA "" FLOAT32_IEEE MC_BP_MPA 0 0 0 0 ECU_ADDRESS 0x3F9920 /end MEASUREMENT
/begin COMPU_METHOD MC_BP_MPA "BP_MPA conversion" RAT_FUNC "%10.5" "Unitless" COEFFS 0 1 0 0 0 1 /end COMPU_METHOD
/begin MEASUREMENT BP_MULT "BP multiplier" FLOAT32_IEEE MC_BP_MULT 0 0 0 0 ECU_ADDRESS 0x3F9C98 /end MEASUREMENT
/begin COMPU_METHOD MC_BP_MULT "BP_MULT conversion" RAT_FUNC "%10.5" "Unitless" COEFFS 0 1 0 0 0 1 /end COMPU_METHOD
/begin MEASUREMENT BP_ORH_CNTR "Barometric Pressure out of range high counter" SLONG MC_BP_ORH_CNTR 0 0 0 0 ECU_ADDRESS 0x3F9EB8 /end MEASUREMENT
/begin COMPU_METHOD MC_BP_ORH_CNTR "BP_ORH_CNTR conversion" RAT_FUNC "%10.0" "Unitless" COEFFS 0 1 0 0 0 1 /end COMPU_METHOD
/begin MEASUREMENT BP_ORL_CNTR "Barometric Pressure out of range low counter" SLONG MC_BP_ORL_CNTR 0 0 0 0 ECU_ADDRESS 0x3F9EB4 /end MEASUREMENT
/begin COMPU_METHOD MC_BP_ORL_CNTR "BP_ORL_CNTR conversion" RAT_FUNC "%10.0" "Unitless" COEFFS 0 1 0 0 0 1 /end COMPU_METHOD
/begin CHARACTERISTIC BP_RAW_KPA_TC "Filter time constant for bp raw eng. value" VALUE 0x5CF40 SD_FLOAT32_IEEE 0 SC_BP_RAW_KPA_TC 0 64 /end CHARACTERISTIC
/begin COMPU_METHOD SC_BP_RAW_KPA_TC "BP_RAW_KPA_TC conversion" RAT_FUNC "%10.5" "s" COEFFS 0 1 0 0 0 1 /end COMPU_METHOD
/begin CHARACTERISTIC BP_REC_INC "BP fault recovery counter increment value" VALUE 0x5CF0C SD_SLONG 0 SC_BP_REC_INC 0 65535 /end CHARACTERISTIC
/begin COMPU_METHOD SC_BP_REC_INC "BP_REC_INC conversion" RAT_FUNC "%10.0" "unitless" COEFFS 0 1 0 0 0 1 /end COMPU_METHOD
/begin MEASUREMENT BP_STATUS "bp sensor input status;  1 = low voltage error;  2 = high voltage error" UBYTE MC_BP_STATUS 0 0 0 0 ECU_ADDRESS 0x3F98F8 /end MEASUREMENT
/begin COMPU_METHOD MC_BP_STATUS "BP_STATUS conversion" RAT_FUNC "%3.0" "Unitless" COEFFS 0 1 0 0 0 1 /end COMPU_METHOD
/begin CHARACTERISTIC BP_TCREC_SEL "Switch to select  BP filter time constant during fault recovery and during fault occurance before malf is set" VALUE 0x5CF18 SD_UBYTE 0 SC_BP_TCREC_SEL 0 1 /end CHARACTERISTIC
/begin COMPU_METHOD SC_BP_TCREC_SEL "BP_TCREC_SEL conversion" RAT_FUNC "%3.0" "unitless" COEFFS 0 1 0 0 0 1 /end COMPU_METHOD
/begin CHARACTERISTIC BP_VMAX "Acceptable maximum voltage limit for bp sensor" VALUE 0x5C598 SD_FLOAT32_IEEE 0 SC_BP_VMAX 0 5 /end CHARACTERISTIC
/begin COMPU_METHOD SC_BP_VMAX "BP_VMAX conversion" RAT_FUNC "%10.5" "V" COEFFS 0 1 0 0 0 1 /end COMPU_METHOD
/begin CHARACTERISTIC BP_VMIN "Acceptable minimum voltage limit for bp sensor" VALUE 0x5C59C SD_FLOAT32_IEEE 0 SC_BP_VMIN 0 5 /end CHARACTERISTIC
/begin COMPU_METHOD SC_BP_VMIN "BP_VMIN conversion" RAT_FUNC "%10.5" "V" COEFFS 0 1 0 0 0 1 /end COMPU_METHOD
/begin MEASUREMENT BP_VOLTAGE "Acceptable minimum voltage limit for bp sensor" FLOAT32_IEEE MC_BP_VOLTAGE 0 0 0 0 ECU_ADDRESS 0x3F98F0 /end MEASUREMENT
/begin COMPU_METHOD MC_BP_VOLTAGE "BP_VOLTAGE conversion" RAT_FUNC "%10.5" "Unitless" COEFFS 0 1 0 0 0 1 /end COMPU_METHOD
/begin MEASUREMENT BP_WAS_DEAD "We lost BP and replaced it with MAP" UBYTE MC_BP_WAS_DEAD 0 0 0 0 ECU_ADDRESS 0x3FA1DD /end MEASUREMENT
/begin COMPU_METHOD MC_BP_WAS_DEAD "BP_WAS_DEAD conversion" RAT_FUNC "%3.0" "Unitless" COEFFS 0 1 0 0 0 1 /end COMPU_METHOD
/begin MEASUREMENT BUZZ_IDM_RESP_TOUT "The response from IDM on Buzz test  timed out" UBYTE MC_BUZZ_IDM_RESP_TOUT 0 0 0 0 ECU_ADDRESS 0x3FB5C8 /end MEASUREMENT
/begin COMPU_METHOD MC_BUZZ_IDM_RESP_TOUT "BUZZ_IDM_RESP_TOUT conversion" RAT_FUNC "%3.0" "Unitless" COEFFS 0 1 0 0 0 1 /end COMPU_METHOD
/begin MEASUREMENT BUZZ_IDM_RESP_WAIT_TMR "Timer showing the PCM waiting time for a response from the IDM on buzz test" ULONG MC_BUZZ_IDM_RESP_WAIT_TMR 0 0 0 0 ECU_ADDRESS 0x3FB5C4 /end MEASUREMENT
/begin COMPU_METHOD MC_BUZZ_IDM_RESP_WAIT_TMR "BUZZ_IDM_RESP_WAIT_TMR conversion" RAT_FUNC "%10.0" "Unitless" COEFFS 0 1 0 0 0 1 /end COMPU_METHOD
/begin CHARACTERISTIC BYPS_BRKPNT "threshold of value returned from FNMISOK for decision to test or not for misfire" VALUE 0x5EE98 SD_FLOAT32_IEEE 0 SC_BYPS_BRKPNT 0 1 /end CHARACTERISTIC
/begin COMPU_METHOD SC_BYPS_BRKPNT "BYPS_BRKPNT conversion" RAT_FUNC "%10.5" "unitless" COEFFS 0 1 0 0 0 1 /end COMPU_METHOD
/begin MEASUREMENT CAL_VER_CMP "Encrypted checksum calculation complete flag, 1 = complete" UBYTE MC_CAL_VER_CMP 0 0 0 0 ECU_ADDRESS 0x3FB624 /end MEASUREMENT
/begin COMPU_METHOD MC_CAL_VER_CMP "CAL_VER_CMP conversion" RAT_FUNC "%3.0" "Unitless" COEFFS 0 1 0 0 0 1 /end COMPU_METHOD
/begin CHARACTERISTIC CAMLVLEXP "CAM failure fault filter threshold for export use" VALUE 0x5ECFC SD_UBYTE 0 SC_CAMLVLEXP 0 255 /end CHARACTERISTIC
/begin COMPU_METHOD SC_CAMLVLEXP "CAMLVLEXP conversion" RAT_FUNC "%3.0" "COUNTS" COEFFS 0 1 0 0 0 1 /end COMPU_METHOD
/begin MEASUREMENT CAMPINLEVEL2_NEW "copy of CamPinLevel2" UBYTE MC_CAMPINLEVEL2_NEW 0 0 0 0 ECU_ADDRESS 0x3FB290 /end MEASUREMENT
/begin COMPU_METHOD MC_CAMPINLEVEL2_NEW "CAMPINLEVEL2_NEW conversion" RAT_FUNC "%3.0" "Unitless" COEFFS 0 1 0 0 0 1 /end COMPU_METHOD
/begin MEASUREMENT CAMTOOTH "" UBYTE MC_CAMTOOTH 0 0 0 0 ECU_ADDRESS 0x3FB669 /end MEASUREMENT
/begin COMPU_METHOD MC_CAMTOOTH "CAMTOOTH conversion" RAT_FUNC "%3.0" "Unitless" COEFFS 0 1 0 0 0 1 /end COMPU_METHOD
/begin MEASUREMENT CAMTOOTH2_NEW "copy of CamTooth2" UBYTE MC_CAMTOOTH2_NEW 0 0 0 0 ECU_ADDRESS 0x3FB291 /end MEASUREMENT
/begin COMPU_METHOD MC_CAMTOOTH2_NEW "CAMTOOTH2_NEW conversion" RAT_FUNC "%3.0" "Unitless" COEFFS 0 1 0 0 0 1 /end COMPU_METHOD
/begin CHARACTERISTIC CAMTOOTH_NUM "" VALUE 0x5C489 SD_UBYTE 0 SC_CAMTOOTH_NUM 0 59 /end CHARACTERISTIC
/begin COMPU_METHOD SC_CAMTOOTH_NUM "CAMTOOTH_NUM conversion" RAT_FUNC "%3.0" "unitless" COEFFS 0 1 0 0 0 1 /end COMPU_METHOD
/begin MEASUREMENT CAMTSTFIL "Cam circuit failure fault filter" UBYTE MC_CAMTSTFIL 0 0 0 0 ECU_ADDRESS 0x3FB292 /end MEASUREMENT
/begin COMPU_METHOD MC_CAMTSTFIL "CAMTSTFIL conversion" RAT_FUNC "%3.0" "Unitless" COEFFS 0 1 0 0 0 1 /end COMPU_METHOD
/begin CHARACTERISTIC CAMTSTLVL1 "Hard fault filter threshold crank" VALUE 0x5ECF5 SD_UBYTE 0 SC_CAMTSTLVL1 0 255 /end CHARACTERISTIC
/begin COMPU_METHOD SC_CAMTSTLVL1 "CAMTSTLVL1 conversion" RAT_FUNC "%3.0" "unitless" COEFFS 0 1 0 0 0 1 /end COMPU_METHOD
/begin CHARACTERISTIC CAMTSTLVL2 "Hard fault filter threshold run" VALUE 0x5ECF4 SD_UBYTE 0 SC_CAMTSTLVL2 0 255 /end CHARACTERISTIC
/begin COMPU_METHOD SC_CAMTSTLVL2 "CAMTSTLVL2 conversion" RAT_FUNC "%3.0" "unitless" COEFFS 0 1 0 0 0 1 /end COMPU_METHOD
/begin CHARACTERISTIC CAMUP1 "hard cam fault filter increment crank" VALUE 0x5ECED SD_UBYTE 0 SC_CAMUP1 0 255 /end CHARACTERISTIC
/begin COMPU_METHOD SC_CAMUP1 "CAMUP1 conversion" RAT_FUNC "%3.0" "unitless" COEFFS 0 1 0 0 0 1 /end COMPU_METHOD
/begin CHARACTERISTIC CAMUP2 "hard cam fault filter increment run" VALUE 0x5ECEC SD_UBYTE 0 SC_CAMUP2 0 255 /end CHARACTERISTIC
/begin COMPU_METHOD SC_CAMUP2 "CAMUP2 conversion" RAT_FUNC "%3.0" "unitless" COEFFS 0 1 0 0 0 1 /end COMPU_METHOD
/begin MEASUREMENT CAN_EOT "Engine oil temperature (DEGREES C) for CAN" FLOAT32_IEEE MC_CAN_EOT 0 0 0 0 ECU_ADDRESS 0x3F9F28 /end MEASUREMENT
/begin COMPU_METHOD MC_CAN_EOT "CAN_EOT conversion" RAT_FUNC "%10.5" "Unitless" COEFFS 0 1 0 0 0 1 /end COMPU_METHOD
/begin MEASUREMENT CAN_ICP "Injection Control Pressure (in MPa) for CAN" FLOAT32_IEEE MC_CAN_ICP 0 0 0 0 ECU_ADDRESS 0x3FA0DC /end MEASUREMENT
/begin COMPU_METHOD MC_CAN_ICP "CAN_ICP conversion" RAT_FUNC "%10.5" "Unitless" COEFFS 0 1 0 0 0 1 /end COMPU_METHOD
/begin MEASUREMENT CAN_IDM_CAL[0] "IDM Calibration level (hex-encoded ASCII)" UBYTE MC_CAN_IDM_CAL 0 0 0 255 ECU_ADDRESS 0x3FB704 /end MEASUREMENT
/begin COMPU_METHOD MC_CAN_IDM_CAL "CAN_IDM_CAL conversion" RAT_FUNC "%3.0" "unitless" COEFFS 0 1 0 0 0 1 /end COMPU_METHOD
/begin MEASUREMENT CAN_IDM_CAL[1] "IDM Calibration level (hex-encoded ASCII)" UBYTE MC_CAN_IDM_CAL 0 0 0 255 ECU_ADDRESS 0x3FB705 /end MEASUREMENT
/begin MEASUREMENT CAN_IDM_CAL[2] "IDM Calibration level (hex-encoded ASCII)" UBYTE MC_CAN_IDM_CAL 0 0 0 255 ECU_ADDRESS 0x3FB706 /end MEASUREMENT
/begin MEASUREMENT CAN_IDM_CAL[3] "IDM Calibration level (hex-encoded ASCII)" UBYTE MC_CAN_IDM_CAL 0 0 0 255 ECU_ADDRESS 0x3FB707 /end MEASUREMENT
/begin MEASUREMENT CAN_IDM_CAL[4] "IDM Calibration level (hex-encoded ASCII)" UBYTE MC_CAN_IDM_CAL 0 0 0 255 ECU_ADDRESS 0x3FB708 /end MEASUREMENT
/begin MEASUREMENT CAN_IDM_CAL[5] "IDM Calibration level (hex-encoded ASCII)" UBYTE MC_CAN_IDM_CAL 0 0 0 255 ECU_ADDRESS 0x3FB709 /end MEASUREMENT
/begin MEASUREMENT CAN_IDM_CAL[6] "IDM Calibration level (hex-encoded ASCII)" UBYTE MC_CAN_IDM_CAL 0 0 0 255 ECU_ADDRESS 0x3FB70A /end MEASUREMENT
/begin MEASUREMENT CAN_IDM_CAL[7] "IDM Calibration level (hex-encoded ASCII)" UBYTE MC_CAN_IDM_CAL 0 0 0 255 ECU_ADDRESS 0x3FB70B /end MEASUREMENT
/begin MEASUREMENT CAN_IDM_CVN[0] "IDM Calibration Verification Numbers (hex-encoded ASCII)" UBYTE MC_CAN_IDM_CVN 0 0 0 255 ECU_ADDRESS 0x3FB70C /end MEASUREMENT
/begin COMPU_METHOD MC_CAN_IDM_CVN "CAN_IDM_CVN conversion" RAT_FUNC "%3.0" "unitless" COEFFS 0 1 0 0 0 1 /end COMPU_METHOD
/begin MEASUREMENT CAN_IDM_CVN[1] "IDM Calibration Verification Numbers (hex-encoded ASCII)" UBYTE MC_CAN_IDM_CVN 0 0 0 255 ECU_ADDRESS 0x3FB70D /end MEASUREMENT
/begin MEASUREMENT CAN_IDM_CVN[2] "IDM Calibration Verification Numbers (hex-encoded ASCII)" UBYTE MC_CAN_IDM_CVN 0 0 0 255 ECU_ADDRESS 0x3FB70E /end MEASUREMENT
/begin MEASUREMENT CAN_IDM_CVN[3] "IDM Calibration Verification Numbers (hex-encoded ASCII)" UBYTE MC_CAN_IDM_CVN 0 0 0 255 ECU_ADDRESS 0x3FB70F /end MEASUREMENT
/begin MEASUREMENT CAN_IDM_SW[0] "IDM Software level (hex-encoded ASCII)" UBYTE MC_CAN_IDM_SW 0 0 0 255 ECU_ADDRESS 0x3FB6FC /end MEASUREMENT
/begin COMPU_METHOD MC_CAN_IDM_SW "CAN_IDM_SW conversion" RAT_FUNC "%3.0" "unitless" COEFFS 0 1 0 0 0 1 /end COMPU_METHOD
/begin MEASUREMENT CAN_IDM_SW[1] "IDM Software level (hex-encoded ASCII)" UBYTE MC_CAN_IDM_SW 0 0 0 255 ECU_ADDRESS 0x3FB6FD /end MEASUREMENT
/begin MEASUREMENT CAN_IDM_SW[2] "IDM Software level (hex-encoded ASCII)" UBYTE MC_CAN_IDM_SW 0 0 0 255 ECU_ADDRESS 0x3FB6FE /end MEASUREMENT
/begin MEASUREMENT CAN_IDM_SW[3] "IDM Software level (hex-encoded ASCII)" UBYTE MC_CAN_IDM_SW 0 0 0 255 ECU_ADDRESS 0x3FB6FF /end MEASUREMENT
/begin MEASUREMENT CAN_IDM_SW[4] "IDM Software level (hex-encoded ASCII)" UBYTE MC_CAN_IDM_SW 0 0 0 255 ECU_ADDRESS 0x3FB700 /end MEASUREMENT
/begin MEASUREMENT CAN_IDM_SW[5] "IDM Software level (hex-encoded ASCII)" UBYTE MC_CAN_IDM_SW 0 0 0 255 ECU_ADDRESS 0x3FB701 /end MEASUREMENT
/begin MEASUREMENT CAN_IDM_SW[6] "IDM Software level (hex-encoded ASCII)" UBYTE MC_CAN_IDM_SW 0 0 0 255 ECU_ADDRESS 0x3FB702 /end MEASUREMENT
/begin MEASUREMENT CAN_IDM_SW[7] "IDM Software level (hex-encoded ASCII)" UBYTE MC_CAN_IDM_SW 0 0 0 255 ECU_ADDRESS 0x3FB703 /end MEASUREMENT
/begin MEASUREMENT CAN_PARAM_RESET "Flag indicating CAN has requested that the id sent flag in the module must be cleared, and a new pcm id generated" UBYTE MC_CAN_PARAM_RESET 0 0 0 0 ECU_ADDRESS 0x3FB4AD /end MEASUREMENT
/begin COMPU_METHOD MC_CAN_PARAM_RESET "CAN_PARAM_RESET conversion" RAT_FUNC "%3.0" "Unitless" COEFFS 0 1 0 0 0 1 /end COMPU_METHOD
/begin MEASUREMENT CAN_UPDATE_ERR "" UBYTE MC_CAN_UPDATE_ERR 0 0 0 0 ECU_ADDRESS 0x3FB6D4 /end MEASUREMENT
/begin COMPU_METHOD MC_CAN_UPDATE_ERR "CAN_UPDATE_ERR conversion" RAT_FUNC "%3.0" "Unitless" COEFFS 0 1 0 0 0 1 /end COMPU_METHOD
/begin MEASUREMENT CAT_COUNT "Count of the number of complete catalyst test since KAM reset." UBYTE MC_CAT_COUNT 0 0 0 0 ECU_ADDRESS 0x3FCD0E /end MEASUREMENT
/begin COMPU_METHOD MC_CAT_COUNT "CAT_COUNT conversion" RAT_FUNC "%3.0" "Unitless" COEFFS 0 1 0 0 0 1 /end COMPU_METHOD
/begin MEASUREMENT CAT_FMEM "CAT system FMEM flag.  1 -> don't run CAT system due to FMEM." UBYTE MC_CAT_FMEM 0 0 0 0 ECU_ADDRESS 0x3F9E5F /end MEASUREMENT
/begin COMPU_METHOD MC_CAT_FMEM "CAT_FMEM conversion" RAT_FUNC "%3.0" "Unitless" COEFFS 0 1 0 0 0 1 /end COMPU_METHOD
/begin MEASUREMENT CAT_MON "OBDII monitor flag for catalyst; 1=>all catalyst faults have been monitored since power-up" UBYTE MC_CAT_MON 0 0 0 0 ECU_ADDRESS 0x3F9CDE /end MEASUREMENT
/begin COMPU_METHOD MC_CAT_MON "CAT_MON conversion" RAT_FUNC "%3.0" "Unitless" COEFFS 0 1 0 0 0 1 /end COMPU_METHOD
/begin MEASUREMENT CAT_TST_ENA "OBD-II Catalyst Test enable flag. (1 => test enabled)" UBYTE MC_CAT_TST_ENA 0 0 0 0 ECU_ADDRESS 0x3F9E3F /end MEASUREMENT
/begin COMPU_METHOD MC_CAT_TST_ENA "CAT_TST_ENA conversion" RAT_FUNC "%3.0" "Unitless" COEFFS 0 1 0 0 0 1 /end COMPU_METHOD
/begin MEASUREMENT CAT_TST_RDY "CAT test ready flag; 1 ->  all  local  conditions have been met; ready to run CAT test." UBYTE MC_CAT_TST_RDY 0 0 0 0 ECU_ADDRESS 0x3F9CD8 /end MEASUREMENT
/begin COMPU_METHOD MC_CAT_TST_RDY "CAT_TST_RDY conversion" RAT_FUNC "%3.0" "Unitless" COEFFS 0 1 0 0 0 1 /end COMPU_METHOD
/begin CHARACTERISTIC CBF_EOT_MIN "EOT threshold for cylinder balance test" VALUE 0x5D88C SD_FLOAT32_IEEE 0 SC_CBF_EOT_MIN -40 250 /end CHARACTERISTIC
/begin COMPU_METHOD SC_CBF_EOT_MIN "CBF_EOT_MIN conversion" RAT_FUNC "%10.5" "degC" COEFFS 0 1 0 0 0 1 /end COMPU_METHOD
/begin CHARACTERISTIC CCCT_CAL "" VALUE 0x5DC04 SD_UBYTE 0 SC_CCCT_CAL 0 3 /end CHARACTERISTIC
/begin COMPU_METHOD SC_CCCT_CAL "CCCT_CAL conversion" RAT_FUNC "%3.0" "unitless" COEFFS 0 1 0 0 0 1 /end COMPU_METHOD
/begin MEASUREMENT CCMDIAGX_MLFUPD_EN "Diagnostic enable flag" UBYTE MC_CCMDIAGX_MLFUPD_EN 0 0 0 0 ECU_ADDRESS 0x3F9E9B /end MEASUREMENT
/begin COMPU_METHOD MC_CCMDIAGX_MLFUPD_EN "CCMDIAGX_MLFUPD_EN conversion" RAT_FUNC "%3.0" "Unitless" COEFFS 0 1 0 0 0 1 /end COMPU_METHOD
/begin MEASUREMENT CCMDIAGX_RESET_EN "Diagnostic  enable flag based on system reset flags" UBYTE MC_CCMDIAGX_RESET_EN 0 0 0 0 ECU_ADDRESS 0x3F9E9C /end MEASUREMENT
/begin COMPU_METHOD MC_CCMDIAGX_RESET_EN "CCMDIAGX_RESET_EN conversion" RAT_FUNC "%3.0" "Unitless" COEFFS 0 1 0 0 0 1 /end COMPU_METHOD
/begin MEASUREMENT CCM_ENA_FLG "CCM_* test is enabled; 1-> CCM_TST_ENA = 1 or CCM_EO_ENA 1, or CCM_ER_ENA = 1." UBYTE MC_CCM_ENA_FLG 0 0 0 0 ECU_ADDRESS 0x3F9E30 /end MEASUREMENT
/begin COMPU_METHOD MC_CCM_ENA_FLG "CCM_ENA_FLG conversion" RAT_FUNC "%3.0" "Unitless" COEFFS 0 1 0 0 0 1 /end COMPU_METHOD
/begin MEASUREMENT CCM_EO_ENA "Engine off on demand test for CCM enabled." UBYTE MC_CCM_EO_ENA 0 0 0 0 ECU_ADDRESS 0x3FB4E9 /end MEASUREMENT
/begin COMPU_METHOD MC_CCM_EO_ENA "CCM_EO_ENA conversion" RAT_FUNC "%3.0" "Unitless" COEFFS 0 1 0 0 0 1 /end COMPU_METHOD
/begin CHARACTERISTIC CCM_EO_WAIT "Value of EO_STATUS when waiting for engine off CCM test to complete" VALUE 0x5F0E3 SD_UBYTE 0 SC_CCM_EO_WAIT 0 100 /end CHARACTERISTIC
/begin COMPU_METHOD SC_CCM_EO_WAIT "CCM_EO_WAIT conversion" RAT_FUNC "%3.0" "unitless" COEFFS 0 1 0 0 0 1 /end COMPU_METHOD
/begin MEASUREMENT CCM_ER_ENA "Engine running on demand test for CCM enabled." UBYTE MC_CCM_ER_ENA 0 0 0 0 ECU_ADDRESS 0x3FB508 /end MEASUREMENT
/begin COMPU_METHOD MC_CCM_ER_ENA "CCM_ER_ENA conversion" RAT_FUNC "%3.0" "Unitless" COEFFS 0 1 0 0 0 1 /end COMPU_METHOD
/begin MEASUREMENT CCM_FMEM "CCM system FMEM flag.  1 -> don't run CCM due to FMEM." UBYTE MC_CCM_FMEM 0 0 0 0 ECU_ADDRESS 0x3F9E5E /end MEASUREMENT
/begin COMPU_METHOD MC_CCM_FMEM "CCM_FMEM conversion" RAT_FUNC "%3.0" "Unitless" COEFFS 0 1 0 0 0 1 /end COMPU_METHOD
/begin CHARACTERISTIC CCM_GP_IVPMN "Minimum IVPWR necessary to enable glow plug monitoring" VALUE 0x5F17C SD_FLOAT32_IEEE 0 SC_CCM_GP_IVPMN 0 20 /end CHARACTERISTIC
/begin COMPU_METHOD SC_CCM_GP_IVPMN "CCM_GP_IVPMN conversion" RAT_FUNC "%10.5" "V" COEFFS 0 1 0 0 0 1 /end COMPU_METHOD
/begin CHARACTERISTIC CCM_GP_IVPMX "Maximum IVPWR necessary for enabling glow plug monitoring" VALUE 0x5F178 SD_FLOAT32_IEEE 0 SC_CCM_GP_IVPMX 0 20 /end CHARACTERISTIC
/begin COMPU_METHOD SC_CCM_GP_IVPMX "CCM_GP_IVPMX conversion" RAT_FUNC "%10.5" "V" COEFFS 0 1 0 0 0 1 /end COMPU_METHOD
/begin CHARACTERISTIC CCM_IVPWR_MAX "Maximum system voltage threshold above which diagnostics tests are disabled" VALUE 0x5CEF8 SD_FLOAT32_IEEE 0 SC_CCM_IVPWR_MAX 0 30 /end CHARACTERISTIC
/begin COMPU_METHOD SC_CCM_IVPWR_MAX "CCM_IVPWR_MAX conversion" RAT_FUNC "%10.5" "V" COEFFS 0 1 0 0 0 1 /end COMPU_METHOD
/begin CHARACTERISTIC CCM_IVPWR_MIN "Minimum system voltage threshold below which diagnostics are disabled" VALUE 0x5CEF4 SD_FLOAT32_IEEE 0 SC_CCM_IVPWR_MIN 0 30 /end CHARACTERISTIC
/begin COMPU_METHOD SC_CCM_IVPWR_MIN "CCM_IVPWR_MIN conversion" RAT_FUNC "%10.5" "V" COEFFS 0 1 0 0 0 1 /end COMPU_METHOD
/begin MEASUREMENT CCM_MON "OBDII monitor flag for comp components. 1=>all CCM faults have been monitored since power-up" UBYTE MC_CCM_MON 0 0 0 0 ECU_ADDRESS 0x3F9CDD /end MEASUREMENT
/begin COMPU_METHOD MC_CCM_MON "CCM_MON conversion" RAT_FUNC "%3.0" "Unitless" COEFFS 0 1 0 0 0 1 /end COMPU_METHOD
/begin CHARACTERISTIC CCM_MON_DLY "" VALUE 0x5E858 SD_FLOAT32_IEEE 0 SC_CCM_MON_DLY 0 1024 /end CHARACTERISTIC
/begin COMPU_METHOD SC_CCM_MON_DLY "CCM_MON_DLY conversion" RAT_FUNC "%10.5" "s" COEFFS 0 1 0 0 0 1 /end COMPU_METHOD
/begin MEASUREMENT CCM_MON_TMR "" FLOAT32_IEEE MC_CCM_MON_TMR 0 0 0 0 ECU_ADDRESS 0x3FAF74 /end MEASUREMENT
/begin COMPU_METHOD MC_CCM_MON_TMR "CCM_MON_TMR conversion" RAT_FUNC "%10.5" "Unitless" COEFFS 0 1 0 0 0 1 /end COMPU_METHOD
/begin CHARACTERISTIC CCM_PUTM "Diagnostic enable time" VALUE 0x5CEFC SD_FLOAT32_IEEE 0 SC_CCM_PUTM 0 63.999 /end CHARACTERISTIC
/begin COMPU_METHOD SC_CCM_PUTM "CCM_PUTM conversion" RAT_FUNC "%10.5" "s" COEFFS 0 1 0 0 0 1 /end COMPU_METHOD
/begin MEASUREMENT CCM_TST_ENA "OBD-II Comprehensive Component Test enable flag; 1 -> test enabled." UBYTE MC_CCM_TST_ENA 0 0 0 0 ECU_ADDRESS 0x3F9E3E /end MEASUREMENT
/begin COMPU_METHOD MC_CCM_TST_ENA "CCM_TST_ENA conversion" RAT_FUNC "%3.0" "Unitless" COEFFS 0 1 0 0 0 1 /end COMPU_METHOD
/begin MEASUREMENT CDP_RX_COUNT "Indicates when we have received CAN Diagnostic messages" UBYTE MC_CDP_RX_COUNT 0 0 0 0 ECU_ADDRESS 0x3F982A /end MEASUREMENT
/begin COMPU_METHOD MC_CDP_RX_COUNT "CDP_RX_COUNT conversion" RAT_FUNC "%3.0" "Unitless" COEFFS 0 1 0 0 0 1 /end COMPU_METHOD
/begin MEASUREMENT CDP_TX_COUNT "Indicates when a CAN Diagnostic message has been sent" UBYTE MC_CDP_TX_COUNT 0 0 0 0 ECU_ADDRESS 0x3F982E /end MEASUREMENT
/begin COMPU_METHOD MC_CDP_TX_COUNT "CDP_TX_COUNT conversion" RAT_FUNC "%3.0" "Unitless" COEFFS 0 1 0 0 0 1 /end COMPU_METHOD
/begin MEASUREMENT CES_SW "Manual transmission Clutch Engaged Switch" UBYTE MC_CES_SW 0 0 0 0 ECU_ADDRESS 0x3F99EB /end MEASUREMENT
/begin COMPU_METHOD MC_CES_SW "CES_SW conversion" RAT_FUNC "%3.0" "Unitless" COEFFS 0 1 0 0 0 1 /end COMPU_METHOD
/begin MEASUREMENT CES_SW_PID "Manual transmission Clutch Engaged Switch created for PID interface" UBYTE MC_CES_SW_PID 0 0 0 0 ECU_ADDRESS 0x3FA2AA /end MEASUREMENT
/begin COMPU_METHOD MC_CES_SW_PID "CES_SW_PID conversion" RAT_FUNC "%3.0" "Unitless" COEFFS 0 1 0 0 0 1 /end COMPU_METHOD
/begin MEASUREMENT CFMFLG "ECT failure mode (FMEM) flag." UBYTE MC_CFMFLG 0 0 0 0 ECU_ADDRESS 0x3F9F9B /end MEASUREMENT
/begin COMPU_METHOD MC_CFMFLG "CFMFLG conversion" RAT_FUNC "%3.0" "Unitless" COEFFS 0 1 0 0 0 1 /end COMPU_METHOD
/begin MEASUREMENT CF_ACCS_OLD "Previous value of ""accflg"" flag, used by profile correction logic to detect when the A/C compressor turns on/off." UBYTE MC_CF_ACCS_OLD 0 0 0 0 ECU_ADDRESS 0x3FB3B1 /end MEASUREMENT
/begin COMPU_METHOD MC_CF_ACCS_OLD "CF_ACCS_OLD conversion" RAT_FUNC "%3.0" "Unitless" COEFFS 0 1 0 0 0 1 /end COMPU_METHOD
/begin MEASUREMENT CF_ACC_FLG "Toggles profile learning if accflg changes state." UBYTE MC_CF_ACC_FLG 0 0 0 0 ECU_ADDRESS 0x3FB3AE /end MEASUREMENT
/begin COMPU_METHOD MC_CF_ACC_FLG "CF_ACC_FLG conversion" RAT_FUNC "%3.0" "Unitless" COEFFS 0 1 0 0 0 1 /end COMPU_METHOD
/begin CHARACTERISTIC CF_BCSDC_MAX "If BCSDC output is above this limit, infer the torque convertor is locked and enable profile learning." VALUE 0x5EED8 SD_FLOAT32_IEEE 0 SC_CF_BCSDC_MAX 0 1.99997 /end CHARACTERISTIC
/begin COMPU_METHOD SC_CF_BCSDC_MAX "CF_BCSDC_MAX conversion" RAT_FUNC "%10.5" "fraction" COEFFS 0 1 0 0 0 1 /end COMPU_METHOD
/begin CHARACTERISTIC CF_BCSDC_MIN "If BCSDC output is below this limit, infer the torque convertor is unlocked and enable profile learning." VALUE 0x5EEDC SD_FLOAT32_IEEE 0 SC_CF_BCSDC_MIN 0 1.99997 /end CHARACTERISTIC
/begin COMPU_METHOD SC_CF_BCSDC_MIN "CF_BCSDC_MIN conversion" RAT_FUNC "%10.5" "fraction" COEFFS 0 1 0 0 0 1 /end COMPU_METHOD
/begin MEASUREMENT CF_BIFLG_ENA "Flag set to enable checking the ""biflg"" input during profile learning, allows profile to learn if ""biflg"" stuck high." UBYTE MC_CF_BIFLG_ENA 0 0 0 0 ECU_ADDRESS 0x3FB3B2 /end MEASUREMENT
/begin COMPU_METHOD MC_CF_BIFLG_ENA "CF_BIFLG_ENA conversion" RAT_FUNC "%3.0" "Unitless" COEFFS 0 1 0 0 0 1 /end COMPU_METHOD
/begin MEASUREMENT CF_CHECKSUM "Profile coefficient kam memory checksum calculation." ULONG MC_CF_CHECKSUM 0 0 0 0 ECU_ADDRESS 0x3FD030 /end MEASUREMENT
/begin COMPU_METHOD MC_CF_CHECKSUM "CF_CHECKSUM conversion" RAT_FUNC "%10.0" "Unitless" COEFFS 0 1 0 0 0 1 /end COMPU_METHOD
/begin MEASUREMENT CF_CONDS_FLG "Flag set when speed/load conditions are met for learning profile." UBYTE MC_CF_CONDS_FLG 0 0 0 0 ECU_ADDRESS 0x3FB3AF /end MEASUREMENT
/begin COMPU_METHOD MC_CF_CONDS_FLG "CF_CONDS_FLG conversion" RAT_FUNC "%3.0" "Unitless" COEFFS 0 1 0 0 0 1 /end COMPU_METHOD
/begin MEASUREMENT CF_DFSO "When = 1, enables profile correction to learn CFs in DFSO mode" UBYTE MC_CF_DFSO 0 0 0 0 ECU_ADDRESS 0x3FB3B3 /end MEASUREMENT
/begin COMPU_METHOD MC_CF_DFSO "CF_DFSO conversion" RAT_FUNC "%3.0" "Unitless" COEFFS 0 1 0 0 0 1 /end COMPU_METHOD
/begin CHARACTERISTIC CF_DFSO_IGNR "If set, enables learning of CFs regardless of the state of DFSO mode." VALUE 0x5EF04 SD_UBYTE 0 SC_CF_DFSO_IGNR 0 1 /end CHARACTERISTIC
/begin COMPU_METHOD SC_CF_DFSO_IGNR "CF_DFSO_IGNR conversion" RAT_FUNC "%3.0" "Unitless" COEFFS 0 1 0 0 0 1 /end COMPU_METHOD
/begin CHARACTERISTIC CF_DNDTI_MAX "Stop profile learning if dn/dt increases above this upper limit during a dfso coastdown." VALUE 0x5EEF4 SD_FLOAT32_IEEE 0 SC_CF_DNDTI_MAX -8192 8191.75 /end CHARACTERISTIC
/begin COMPU_METHOD SC_CF_DNDTI_MAX "CF_DNDTI_MAX conversion" RAT_FUNC "%10.5" "RPM/S" COEFFS 0 1 0 0 0 1 /end COMPU_METHOD
/begin CHARACTERISTIC CF_DNDTI_MIN "Stop profile learning if dn/dt falls below this lower limit during a dfso coastdown." VALUE 0x5EEF0 SD_FLOAT32_IEEE 0 SC_CF_DNDTI_MIN -8192 8191.75 /end CHARACTERISTIC
/begin COMPU_METHOD SC_CF_DNDTI_MIN "CF_DNDTI_MIN conversion" RAT_FUNC "%10.5" "RPM/S" COEFFS 0 1 0 0 0 1 /end COMPU_METHOD
/begin CHARACTERISTIC CF_EOL_MIN "Number of profile acquisitions to learn profile during EOL/SBDS test mode." VALUE 0x5EDB4 SD_UWORD 0 SC_CF_EOL_MIN 0 65535 /end CHARACTERISTIC
/begin COMPU_METHOD SC_CF_EOL_MIN "CF_EOL_MIN conversion" RAT_FUNC "%5.0" "events" COEFFS 0 1 0 0 0 1 /end COMPU_METHOD
/begin MEASUREMENT CF_EOL_RAM "Set  equal to the SCP ODU RAM block address used to activate alternate profile learning logic for EOL (allows RCON viewing)." UWORD MC_CF_EOL_RAM 0 0 0 0 ECU_ADDRESS 0x3FB3B8 /end MEASUREMENT
/begin COMPU_METHOD MC_CF_EOL_RAM "CF_EOL_RAM conversion" RAT_FUNC "%5.0" "Unitless" COEFFS 0 1 0 0 0 1 /end COMPU_METHOD
/begin CHARACTERISTIC CF_EOL_SW "Switch to enable SCP ODU RAM activation of alternate branch of profile learning logic for EOL testing." VALUE 0x5EF08 SD_UBYTE 0 SC_CF_EOL_SW 0 1 /end CHARACTERISTIC
/begin COMPU_METHOD SC_CF_EOL_SW "CF_EOL_SW conversion" RAT_FUNC "%3.0" "unitless" COEFFS 0 1 0 0 0 1 /end COMPU_METHOD
/begin MEASUREMENT CF_FC "It contains the value of CF_FK_FAST or CF_FK_SLOW or CF_FK." FLOAT32_IEEE MC_CF_FC 0 0 0 0 ECU_ADDRESS 0x3FB2E0 /end MEASUREMENT
/begin COMPU_METHOD MC_CF_FC "CF_FC conversion" RAT_FUNC "%10.5" "Unitless" COEFFS 0 1 0 0 0 1 /end COMPU_METHOD
/begin MEASUREMENT CF_FDGE_FCTR "profile CF normalizing (i.e. causes sum of CFs to equal 4) factor" FLOAT32_IEEE MC_CF_FDGE_FCTR 0 0 0 0 ECU_ADDRESS 0x3FB2DC /end MEASUREMENT
/begin COMPU_METHOD MC_CF_FDGE_FCTR "CF_FDGE_FCTR conversion" RAT_FUNC "%10.5" "Unitless" COEFFS 0 1 0 0 0 1 /end COMPU_METHOD
/begin MEASUREMENT CF_HW_FM "Profile hw fault flag, set if profile learning retry counter exceeds fault limit." UBYTE MC_CF_HW_FM 0 0 0 0 ECU_ADDRESS 0x3FB2E9 /end MEASUREMENT
/begin COMPU_METHOD MC_CF_HW_FM "CF_HW_FM conversion" RAT_FUNC "%3.0" "Unitless" COEFFS 0 1 0 0 0 1 /end COMPU_METHOD
/begin MEASUREMENT CF_HW_FMO "Last pass value of ""cf_hw_fm"" flag." UBYTE MC_CF_HW_FMO 0 0 0 0 ECU_ADDRESS 0x3FB784 /end MEASUREMENT
/begin COMPU_METHOD MC_CF_HW_FMO "CF_HW_FMO conversion" RAT_FUNC "%3.0" "Unitless" COEFFS 0 1 0 0 0 1 /end COMPU_METHOD
/begin CHARACTERISTIC CF_INIT[0] "Initial values for Low Data Rate profile correction factors." VALUE 0x59B7C SD_FLOAT32_IEEE 0 SC_CF_INIT 0 1.99997 /end CHARACTERISTIC
/begin COMPU_METHOD SC_CF_INIT "CF_INIT conversion" RAT_FUNC "%10.5" "unitless" COEFFS 0 1 0 0 0 1 /end COMPU_METHOD
/begin CHARACTERISTIC CF_INIT[1] "Initial values for Low Data Rate profile correction factors." VALUE 0x59B80 SD_FLOAT32_IEEE 0 SC_CF_INIT 0 1.99997 /end CHARACTERISTIC
/begin CHARACTERISTIC CF_INIT[2] "Initial values for Low Data Rate profile correction factors." VALUE 0x59B84 SD_FLOAT32_IEEE 0 SC_CF_INIT 0 1.99997 /end CHARACTERISTIC
/begin CHARACTERISTIC CF_INIT[3] "Initial values for Low Data Rate profile correction factors." VALUE 0x59B88 SD_FLOAT32_IEEE 0 SC_CF_INIT 0 1.99997 /end CHARACTERISTIC
/begin CHARACTERISTIC CF_INIT[4] "Initial values for Low Data Rate profile correction factors." VALUE 0x59B8C SD_FLOAT32_IEEE 0 SC_CF_INIT 0 1.99997 /end CHARACTERISTIC
/begin CHARACTERISTIC CF_INIT[5] "Initial values for Low Data Rate profile correction factors." VALUE 0x59B90 SD_FLOAT32_IEEE 0 SC_CF_INIT 0 1.99997 /end CHARACTERISTIC
/begin CHARACTERISTIC CF_INIT[6] "Initial values for Low Data Rate profile correction factors." VALUE 0x59B94 SD_FLOAT32_IEEE 0 SC_CF_INIT 0 1.99997 /end CHARACTERISTIC
/begin CHARACTERISTIC CF_INIT[7] "Initial values for Low Data Rate profile correction factors." VALUE 0x59B98 SD_FLOAT32_IEEE 0 SC_CF_INIT 0 1.99997 /end CHARACTERISTIC
/begin CHARACTERISTIC CF_INIT[8] "Initial values for Low Data Rate profile correction factors." VALUE 0x59B9C SD_FLOAT32_IEEE 0 SC_CF_INIT 0 1.99997 /end CHARACTERISTIC
/begin CHARACTERISTIC CF_INIT[9] "Initial values for Low Data Rate profile correction factors." VALUE 0x59BA0 SD_FLOAT32_IEEE 0 SC_CF_INIT 0 1.99997 /end CHARACTERISTIC
/begin MEASUREMENT CF_KAM_ERROR "Flag set to 1 if a profile coefficient checksum error is detected, indicating possible profile kam corruption." UBYTE MC_CF_KAM_ERROR 0 0 0 0 ECU_ADDRESS 0x3FB2E6 /end MEASUREMENT
/begin COMPU_METHOD MC_CF_KAM_ERROR "CF_KAM_ERROR conversion" RAT_FUNC "%3.0" "Unitless" COEFFS 0 1 0 0 0 1 /end COMPU_METHOD
/begin MEASUREMENT CF_KAM_MTR "When = 1, indicates that the KAM has matured CFs." UBYTE MC_CF_KAM_MTR 0 0 0 0 ECU_ADDRESS 0x3FD038 /end MEASUREMENT
/begin COMPU_METHOD MC_CF_KAM_MTR "CF_KAM_MTR conversion" RAT_FUNC "%3.0" "Unitless" COEFFS 0 1 0 0 0 1 /end COMPU_METHOD
/begin CHARACTERISTIC CF_LOAD_MAX "max load for profile correction factor updates" VALUE 0x5EEFC SD_FLOAT32_IEEE 0 SC_CF_LOAD_MAX 0 1.99997 /end CHARACTERISTIC
/begin COMPU_METHOD SC_CF_LOAD_MAX "CF_LOAD_MAX conversion" RAT_FUNC "%10.5" "Unitless" COEFFS 0 1 0 0 0 1 /end COMPU_METHOD
/begin CHARACTERISTIC CF_LOAD_MIN "min load for profile correction factor update" VALUE 0x5EEF8 SD_FLOAT32_IEEE 0 SC_CF_LOAD_MIN 0 1.99997 /end CHARACTERISTIC
/begin COMPU_METHOD SC_CF_LOAD_MIN "CF_LOAD_MIN conversion" RAT_FUNC "%10.5" "Unitless" COEFFS 0 1 0 0 0 1 /end COMPU_METHOD
/begin MEASUREMENT CF_LOOPS "number of positions in the profile correction data array (cf_tm_stmp[]) remaining to be filled with" UBYTE MC_CF_LOOPS 0 0 0 0 ECU_ADDRESS 0x3FB337 /end MEASUREMENT
/begin COMPU_METHOD MC_CF_LOOPS "CF_LOOPS conversion" RAT_FUNC "%3.0" "Unitless" COEFFS 0 1 0 0 0 1 /end COMPU_METHOD
/begin MEASUREMENT CF_MTR_CNT "Counts number of profile acquisitions which have been averaged during profile cf learning." UWORD MC_CF_MTR_CNT 0 0 0 0 ECU_ADDRESS 0x3FB2E4 /end MEASUREMENT
/begin COMPU_METHOD MC_CF_MTR_CNT "CF_MTR_CNT conversion" RAT_FUNC "%5.0" "Unitless" COEFFS 0 1 0 0 0 1 /end COMPU_METHOD
/begin CHARACTERISTIC CF_MTR_MIN "Number of profile acquisitions to average to ""mature"" coefficients." VALUE 0x5EDB6 SD_UWORD 0 SC_CF_MTR_MIN 0 65535 /end CHARACTERISTIC
/begin COMPU_METHOD SC_CF_MTR_MIN "CF_MTR_MIN conversion" RAT_FUNC "%5.0" "events" COEFFS 0 1 0 0 0 1 /end COMPU_METHOD
/begin MEASUREMENT CF_NEW_ERROR "Flag set to 1 if new profile acquisition data falls outside out of learning tolerance." UBYTE MC_CF_NEW_ERROR 0 0 0 0 ECU_ADDRESS 0x3FB2E7 /end MEASUREMENT
/begin COMPU_METHOD MC_CF_NEW_ERROR "CF_NEW_ERROR conversion" RAT_FUNC "%3.0" "Unitless" COEFFS 0 1 0 0 0 1 /end COMPU_METHOD
/begin CHARACTERISTIC CF_N_MAX "max rpm for profile correction factor update" VALUE 0x5EEEC SD_FLOAT32_IEEE 0 SC_CF_N_MAX 0 16383.8 /end CHARACTERISTIC
/begin COMPU_METHOD SC_CF_N_MAX "CF_N_MAX conversion" RAT_FUNC "%10.5" "RPM" COEFFS 0 1 0 0 0 1 /end COMPU_METHOD
/begin CHARACTERISTIC CF_N_MIN "min rpm for profile correction factor update" VALUE 0x5EEE8 SD_FLOAT32_IEEE 0 SC_CF_N_MIN 0 16383.8 /end CHARACTERISTIC
/begin COMPU_METHOD SC_CF_N_MIN "CF_N_MIN conversion" RAT_FUNC "%10.5" "RPM" COEFFS 0 1 0 0 0 1 /end COMPU_METHOD
/begin MEASUREMENT CF_PRO_RQST "Flag set to 1 to signal the start of a profile acquisition." UBYTE MC_CF_PRO_RQST 0 0 0 0 ECU_ADDRESS 0x3FB336 /end MEASUREMENT
/begin COMPU_METHOD MC_CF_PRO_RQST "CF_PRO_RQST conversion" RAT_FUNC "%3.0" "Unitless" COEFFS 0 1 0 0 0 1 /end COMPU_METHOD
/begin MEASUREMENT CF_RDY "when equal to 1, allows update of profile correction factors" UBYTE MC_CF_RDY 0 0 0 0 ECU_ADDRESS 0x3FB3B4 /end MEASUREMENT
/begin COMPU_METHOD MC_CF_RDY "CF_RDY conversion" RAT_FUNC "%3.0" "Unitless" COEFFS 0 1 0 0 0 1 /end COMPU_METHOD
/begin MEASUREMENT CF_RETRY "Profile learning retry counter, counts # of times profile learning is re-started due to noisy cfs." UBYTE MC_CF_RETRY 0 0 0 0 ECU_ADDRESS 0x3FB2E8 /end MEASUREMENT
/begin COMPU_METHOD MC_CF_RETRY "CF_RETRY conversion" RAT_FUNC "%3.0" "Unitless" COEFFS 0 1 0 0 0 1 /end COMPU_METHOD
/begin CHARACTERISTIC CF_RETRY_MAX "Profile learning retry limit, before declaring a profile hw fault code." VALUE 0x5EDB9 SD_UBYTE 0 SC_CF_RETRY_MAX 0 255 /end CHARACTERISTIC
/begin COMPU_METHOD SC_CF_RETRY_MAX "CF_RETRY_MAX conversion" RAT_FUNC "%3.0" "events" COEFFS 0 1 0 0 0 1 /end COMPU_METHOD
/begin MEASUREMENT CF_STOP_CNT "Counter which allows re-entry into profile learning after brakes released." UWORD MC_CF_STOP_CNT 0 0 0 0 ECU_ADDRESS 0x3FB3AC /end MEASUREMENT
/begin COMPU_METHOD MC_CF_STOP_CNT "CF_STOP_CNT conversion" RAT_FUNC "%5.0" "Unitless" COEFFS 0 1 0 0 0 1 /end COMPU_METHOD
/begin MEASUREMENT CF_STOP_FLG "Flag set to 1 to stop profile learning if a transient braking or clutch condition is detected during a coastdown." UBYTE MC_CF_STOP_FLG 0 0 0 0 ECU_ADDRESS 0x3FB3B0 /end MEASUREMENT
/begin COMPU_METHOD MC_CF_STOP_FLG "CF_STOP_FLG conversion" RAT_FUNC "%3.0" "Unitless" COEFFS 0 1 0 0 0 1 /end COMPU_METHOD
/begin CHARACTERISTIC CF_STOP_MIN "Number of bg passes to allow re-entry into profile learning." VALUE 0x5EF02 SD_UWORD 0 SC_CF_STOP_MIN 0 65535 /end CHARACTERISTIC
/begin COMPU_METHOD SC_CF_STOP_MIN "CF_STOP_MIN conversion" RAT_FUNC "%5.0" "events" COEFFS 0 1 0 0 0 1 /end COMPU_METHOD
/begin MEASUREMENT CF_SYNC "Set equal to the current value of the sync counter, used by the profile correction logic." UBYTE MC_CF_SYNC 0 0 0 0 ECU_ADDRESS 0x3FB339 /end MEASUREMENT
/begin COMPU_METHOD MC_CF_SYNC "CF_SYNC conversion" RAT_FUNC "%3.0" "Unitless" COEFFS 0 1 0 0 0 1 /end COMPU_METHOD
/begin CHARACTERISTIC CF_TOLERANCE "Maximum variance allowed between new and kam profile cfs during learning." VALUE 0x5EDB0 SD_FLOAT32_IEEE 0 SC_CF_TOLERANCE 0 1.9999 /end CHARACTERISTIC
/begin COMPU_METHOD SC_CF_TOLERANCE "CF_TOLERANCE conversion" RAT_FUNC "%10.5" "unitless" COEFFS 0 1 0 0 0 1 /end COMPU_METHOD
/begin MEASUREMENT CF_VARIANCE "Largest variance seen between new and kam profile coefficients during the learning process." FLOAT32_IEEE MC_CF_VARIANCE 0 0 0 0 ECU_ADDRESS 0x3FD034 /end MEASUREMENT
/begin COMPU_METHOD MC_CF_VARIANCE "CF_VARIANCE conversion" RAT_FUNC "%10.5" "Unitless" COEFFS 0 1 0 0 0 1 /end COMPU_METHOD
/begin CHARACTERISTIC CF_VSBARMAX "Maximum speed for CFs update" VALUE 0x5EEE4 SD_FLOAT32_IEEE 0 SC_CF_VSBARMAX 0 127.5 /end CHARACTERISTIC
/begin COMPU_METHOD SC_CF_VSBARMAX "CF_VSBARMAX conversion" RAT_FUNC "%10.5" "RPM" COEFFS 0 1 0 0 0 1 /end COMPU_METHOD
/begin CHARACTERISTIC CF_VSBARMIN "Minimium speed for CFs update" VALUE 0x5EEE0 SD_FLOAT32_IEEE 0 SC_CF_VSBARMIN 0 127.5 /end CHARACTERISTIC
/begin COMPU_METHOD SC_CF_VSBARMIN "CF_VSBARMIN conversion" RAT_FUNC "%10.5" "Unitless" COEFFS 0 1 0 0 0 1 /end COMPU_METHOD
/begin MEASUREMENT CHKD_FLAGS "bit0=cat_chkd;bit2=purg_chkd;bit3=sair_chkd;bit5;ego_chkd;bit6=egr_chkd" UBYTE MC_CHKD_FLAGS 0 0 0 0 ECU_ADDRESS 0x3FCD08 /end MEASUREMENT
/begin COMPU_METHOD MC_CHKD_FLAGS "CHKD_FLAGS conversion" RAT_FUNC "%3.0" "Unitless" COEFFS 0 1 0 0 0 1 /end COMPU_METHOD
/begin MEASUREMENT CHL_RPT_TIM "Time at which to resend Challenge response message, when no repsonse received.  None" FLOAT32_IEEE MC_CHL_RPT_TIM 0 0 0 0 ECU_ADDRESS 0x3F9DCC /end MEASUREMENT
/begin COMPU_METHOD MC_CHL_RPT_TIM "CHL_RPT_TIM conversion" RAT_FUNC "%10.5" "Unitless" COEFFS 0 1 0 0 0 1 /end COMPU_METHOD
/begin MEASUREMENT CHL_TMR "Timer indicating time expired since ANTI-THEFT challenge code was sent, seconds." FLOAT32_IEEE MC_CHL_TMR 0 0 0 0 ECU_ADDRESS 0x3F9DC0 /end MEASUREMENT
/begin COMPU_METHOD MC_CHL_TMR "CHL_TMR conversion" RAT_FUNC "%10.5" "Unitless" COEFFS 0 1 0 0 0 1 /end COMPU_METHOD
/begin CHARACTERISTIC CIDLVLEXP "CID failure fault filter threshold for export use" VALUE 0x5ECFD SD_UBYTE 0 SC_CIDLVLEXP 0 255 /end CHARACTERISTIC
/begin COMPU_METHOD SC_CIDLVLEXP "CIDLVLEXP conversion" RAT_FUNC "%3.0" "COUNTS" COEFFS 0 1 0 0 0 1 /end COMPU_METHOD
/begin MEASUREMENT CIDTSTFIL "CID circuit failure fault filter" UBYTE MC_CIDTSTFIL 0 0 0 0 ECU_ADDRESS 0x3FB293 /end MEASUREMENT
/begin COMPU_METHOD MC_CIDTSTFIL "CIDTSTFIL conversion" RAT_FUNC "%3.0" "Unitless" COEFFS 0 1 0 0 0 1 /end COMPU_METHOD
/begin CHARACTERISTIC CIDTSTLVL1 "Intermittent PIP fault filter threshold crank" VALUE 0x5ECF7 SD_UBYTE 0 SC_CIDTSTLVL1 0 255 /end CHARACTERISTIC
/begin COMPU_METHOD SC_CIDTSTLVL1 "CIDTSTLVL1 conversion" RAT_FUNC "%3.0" "unitless" COEFFS 0 1 0 0 0 1 /end COMPU_METHOD
/begin CHARACTERISTIC CIDTSTLVL2 "Intermittent PIP fault filter threshold run" VALUE 0x5ECF6 SD_UBYTE 0 SC_CIDTSTLVL2 0 255 /end CHARACTERISTIC
/begin COMPU_METHOD SC_CIDTSTLVL2 "CIDTSTLVL2 conversion" RAT_FUNC "%3.0" "unitless" COEFFS 0 1 0 0 0 1 /end COMPU_METHOD
/begin CHARACTERISTIC CIDUP1 "intermittent cid fault filter increment crank" VALUE 0x5ECEF SD_UBYTE 0 SC_CIDUP1 0 255 /end CHARACTERISTIC
/begin COMPU_METHOD SC_CIDUP1 "CIDUP1 conversion" RAT_FUNC "%3.0" "unitless" COEFFS 0 1 0 0 0 1 /end COMPU_METHOD
/begin CHARACTERISTIC CIDUP2 "intermittent cid fault filter increment run" VALUE 0x5ECEE SD_UBYTE 0 SC_CIDUP2 0 255 /end CHARACTERISTIC
/begin COMPU_METHOD SC_CIDUP2 "CIDUP2 conversion" RAT_FUNC "%3.0" "unitless" COEFFS 0 1 0 0 0 1 /end COMPU_METHOD
/begin CHARACTERISTIC CKP_F_DEC "Crank  signal fault update counter decrement value" VALUE 0x5D890 SD_SLONG 0 SC_CKP_F_DEC 0 65535 /end CHARACTERISTIC
/begin COMPU_METHOD SC_CKP_F_DEC "CKP_F_DEC conversion" RAT_FUNC "%10.0" "unitless" COEFFS 0 1 0 0 0 1 /end COMPU_METHOD
/begin CHARACTERISTIC CKP_F_INC "Crank  signal fault update counter increment value" VALUE 0x5D894 SD_SLONG 0 SC_CKP_F_INC 0 65535 /end CHARACTERISTIC
/begin COMPU_METHOD SC_CKP_F_INC "CKP_F_INC conversion" RAT_FUNC "%10.0" "unitless" COEFFS 0 1 0 0 0 1 /end COMPU_METHOD
/begin CHARACTERISTIC CMP_F_DEC "Cam  signal fault update counter decrement value" VALUE 0x5D898 SD_SLONG 0 SC_CMP_F_DEC 0 65535 /end CHARACTERISTIC
/begin COMPU_METHOD SC_CMP_F_DEC "CMP_F_DEC conversion" RAT_FUNC "%10.0" "unitless" COEFFS 0 1 0 0 0 1 /end COMPU_METHOD
/begin CHARACTERISTIC CMP_F_INC "Cam signal fault update counter increment value" VALUE 0x5D89C SD_SLONG 0 SC_CMP_F_INC 0 65535 /end CHARACTERISTIC
/begin COMPU_METHOD SC_CMP_F_INC "CMP_F_INC conversion" RAT_FUNC "%10.0" "unitless" COEFFS 0 1 0 0 0 1 /end COMPU_METHOD
/begin MEASUREMENT CODANTSCAN_K "Flag indicating that an incorrect PATS incode has been entered. stored in KAM." UBYTE MC_CODANTSCAN_K 0 0 0 0 ECU_ADDRESS 0x3FCC94 /end MEASUREMENT
/begin COMPU_METHOD MC_CODANTSCAN_K "CODANTSCAN_K conversion" RAT_FUNC "%3.0" "Unitless" COEFFS 0 1 0 0 0 1 /end COMPU_METHOD
/begin MEASUREMENT CODED_STATE "Coded Access State Transition Diagram State, 1= Waiting for Incode, 2=Incode Received, 3=Access Granted. 4=Access Denied" UBYTE MC_CODED_STATE 0 0 0 0 ECU_ADDRESS 0x3FCC93 /end MEASUREMENT
/begin COMPU_METHOD MC_CODED_STATE "CODED_STATE conversion" RAT_FUNC "%3.0" "Unitless" COEFFS 0 1 0 0 0 1 /end COMPU_METHOD
/begin MEASUREMENT CODES_CHECKD "Flag indicating the warm-up counters for OBD-II codes have been checked." UBYTE MC_CODES_CHECKD 0 0 0 0 ECU_ADDRESS 0x3F9E14 /end MEASUREMENT
/begin COMPU_METHOD MC_CODES_CHECKD "CODES_CHECKD conversion" RAT_FUNC "%3.0" "Unitless" COEFFS 0 1 0 0 0 1 /end COMPU_METHOD
/begin MEASUREMENT CODES_COUNT "Count of total number of fault codes and pending codes (MIL and NO_MIL) stored by the EEC." UBYTE MC_CODES_COUNT 0 0 0 0 ECU_ADDRESS 0x3FCCE0 /end MEASUREMENT
/begin COMPU_METHOD MC_CODES_COUNT "CODES_COUNT conversion" RAT_FUNC "%3.0" "Unitless" COEFFS 0 1 0 0 0 1 /end COMPU_METHOD
/begin MEASUREMENT CODSCNTMR_UP "Flag  used to control the PATS cod_scn_tmr. 1 = count up 0 = freeze" UBYTE MC_CODSCNTMR_UP 0 0 0 0 ECU_ADDRESS 0x3F9DA7 /end MEASUREMENT
/begin COMPU_METHOD MC_CODSCNTMR_UP "CODSCNTMR_UP conversion" RAT_FUNC "%3.0" "Unitless" COEFFS 0 1 0 0 0 1 /end COMPU_METHOD
/begin MEASUREMENT COD_ANT_SCAN "Flag indicating that an incorrect PATS incode has been entered." UBYTE MC_COD_ANT_SCAN 0 0 0 0 ECU_ADDRESS 0x3FB753 /end MEASUREMENT
/begin COMPU_METHOD MC_COD_ANT_SCAN "COD_ANT_SCAN conversion" RAT_FUNC "%3.0" "Unitless" COEFFS 0 1 0 0 0 1 /end COMPU_METHOD
/begin MEASUREMENT COD_SCN_TMR "PATS CODE anti scan timer" FLOAT32_IEEE MC_COD_SCN_TMR 0 0 0 0 ECU_ADDRESS 0x3F9DA0 /end MEASUREMENT
/begin COMPU_METHOD MC_COD_SCN_TMR "COD_SCN_TMR conversion" RAT_FUNC "%10.5" "Unitless" COEFFS 0 1 0 0 0 1 /end COMPU_METHOD
/begin MEASUREMENT COLDIDLEBPGMLT "Output of the function fncoldidlebpgmlt" FLOAT32_IEEE MC_COLDIDLEBPGMLT 0 0 0 0 ECU_ADDRESS 0x3FA704 /end MEASUREMENT
/begin COMPU_METHOD MC_COLDIDLEBPGMLT "COLDIDLEBPGMLT conversion" RAT_FUNC "%10.5" "Unitless" COEFFS 0 1 0 0 0 1 /end COMPU_METHOD
/begin MEASUREMENT COLDIDLEMLT "Output from FNCOLIDLMLT" FLOAT32_IEEE MC_COLDIDLEMLT 0 0 0 0 ECU_ADDRESS 0x3FA6FC /end MEASUREMENT
/begin COMPU_METHOD MC_COLDIDLEMLT "COLDIDLEMLT conversion" RAT_FUNC "%10.5" "Unitless" COEFFS 0 1 0 0 0 1 /end COMPU_METHOD
/begin MEASUREMENT COLDIDLETMR "Cold idle timer" FLOAT32_IEEE MC_COLDIDLETMR 0 0 0 0 ECU_ADDRESS 0x3FA700 /end MEASUREMENT
/begin COMPU_METHOD MC_COLDIDLETMR "COLDIDLETMR conversion" RAT_FUNC "%10.5" "Unitless" COEFFS 0 1 0 0 0 1 /end COMPU_METHOD
/begin MEASUREMENT COOLING_MODE "Fail Safe Cooling Mode status" UBYTE MC_COOLING_MODE 0 0 0 0 ECU_ADDRESS 0x3F9CF4 /end MEASUREMENT
/begin COMPU_METHOD MC_COOLING_MODE "COOLING_MODE conversion" RAT_FUNC "%3.0" "Unitless" COEFFS 0 1 0 0 0 1 /end COMPU_METHOD
/begin MEASUREMENT COOL_FLG "Overtemp flag; 1 -> overtemp condition." UBYTE MC_COOL_FLG 0 0 0 0 ECU_ADDRESS 0x3FA2C6 /end MEASUREMENT
/begin COMPU_METHOD MC_COOL_FLG "COOL_FLG conversion" RAT_FUNC "%3.0" "Unitless" COEFFS 0 1 0 0 0 1 /end COMPU_METHOD
/begin MEASUREMENT COOL_MIL_ON "MIL status flag for fail safe cooling." UBYTE MC_COOL_MIL_ON 0 0 0 0 ECU_ADDRESS 0x3FCCDE /end MEASUREMENT
/begin COMPU_METHOD MC_COOL_MIL_ON "COOL_MIL_ON conversion" RAT_FUNC "%3.0" "Unitless" COEFFS 0 1 0 0 0 1 /end COMPU_METHOD
/begin CHARACTERISTIC COOL_MIL_SW "Fail safe cooling MIL enable switch." VALUE 0x5CDF3 SD_UBYTE 0 SC_COOL_MIL_SW 0 1 /end CHARACTERISTIC
/begin COMPU_METHOD SC_COOL_MIL_SW "COOL_MIL_SW conversion" RAT_FUNC "%3.0" "SWITCH" COEFFS 0 1 0 0 0 1 /end COMPU_METHOD
/begin MEASUREMENT COPY_ALT_DET "Previous Alternator detected state in KAM" UBYTE MC_COPY_ALT_DET 0 0 0 0 ECU_ADDRESS 0x3FCFAC /end MEASUREMENT
/begin COMPU_METHOD MC_COPY_ALT_DET "COPY_ALT_DET conversion" RAT_FUNC "%3.0" "Unitless" COEFFS 0 1 0 0 0 1 /end COMPU_METHOD
/begin CHARACTERISTIC CPS_NMAX "Upper rpm limit for running the intermittent fault PIP test." VALUE 0x5ECC4 SD_FLOAT32_IEEE 0 SC_CPS_NMAX 0 16383.8 /end CHARACTERISTIC
/begin COMPU_METHOD SC_CPS_NMAX "CPS_NMAX conversion" RAT_FUNC "%10.5" "RPM" COEFFS 0 1 0 0 0 1 /end COMPU_METHOD
/begin CHARACTERISTIC CPS_NMIN "Lower rpm limit for running the intermittent fault PIP test." VALUE 0x5ECC8 SD_FLOAT32_IEEE 0 SC_CPS_NMIN 0 16383.8 /end CHARACTERISTIC
/begin COMPU_METHOD SC_CPS_NMIN "CPS_NMIN conversion" RAT_FUNC "%10.5" "RPM" COEFFS 0 1 0 0 0 1 /end COMPU_METHOD
/begin MEASUREMENT CP_CONTROLLING "" UBYTE MC_CP_CONTROLLING 0 0 0 0 ECU_ADDRESS 0x3FB188 /end MEASUREMENT
/begin COMPU_METHOD MC_CP_CONTROLLING "CP_CONTROLLING conversion" RAT_FUNC "%3.0" "Unitless" COEFFS 0 1 0 0 0 1 /end COMPU_METHOD
/begin MEASUREMENT CP_LGL_FLG "Charge Protect control (CP) Legal flag" UBYTE MC_CP_LGL_FLG 0 0 0 0 ECU_ADDRESS 0x3FB187 /end MEASUREMENT
/begin COMPU_METHOD MC_CP_LGL_FLG "CP_LGL_FLG conversion" RAT_FUNC "%3.0" "Unitless" COEFFS 0 1 0 0 0 1 /end COMPU_METHOD
/begin MEASUREMENT CP_STATE "Charge Protect RPM Control (CP) State ( 1 = ON )" UBYTE MC_CP_STATE 0 0 0 0 ECU_ADDRESS 0x3F9D02 /end MEASUREMENT
/begin COMPU_METHOD MC_CP_STATE "CP_STATE conversion" RAT_FUNC "%3.0" "Unitless" COEFFS 0 1 0 0 0 1 /end COMPU_METHOD
/begin MEASUREMENT CRANK_ANGLE "Cylinder Position expressed as degrees of crank." FLOAT32_IEEE MC_CRANK_ANGLE 0 0 0 0 ECU_ADDRESS 0x3F987C /end MEASUREMENT
/begin COMPU_METHOD MC_CRANK_ANGLE "CRANK_ANGLE conversion" RAT_FUNC "%10.5" "Unitless" COEFFS 0 1 0 0 0 1 /end COMPU_METHOD
/begin MEASUREMENT CRANK_FLG "engine in crank" UBYTE MC_CRANK_FLG 0 0 0 0 ECU_ADDRESS 0x3FA8B2 /end MEASUREMENT
/begin COMPU_METHOD MC_CRANK_FLG "CRANK_FLG conversion" RAT_FUNC "%3.0" "Unitless" COEFFS 0 1 0 0 0 1 /end COMPU_METHOD
/begin MEASUREMENT CRANK_TMR "FMEM - Time since crank mode entered" FLOAT32_IEEE MC_CRANK_TMR 0 0 0 0 ECU_ADDRESS 0x3FA8D0 /end MEASUREMENT
/begin COMPU_METHOD MC_CRANK_TMR "CRANK_TMR conversion" RAT_FUNC "%10.5" "Unitless" COEFFS 0 1 0 0 0 1 /end COMPU_METHOD
/begin MEASUREMENT CRKFLG "Crank Flag; 1 -> In Crank Mode, 0 -> Not in Crank Mode." UBYTE MC_CRKFLG 0 0 0 0 ECU_ADDRESS 0x3FA2CB /end MEASUREMENT
/begin COMPU_METHOD MC_CRKFLG "CRKFLG conversion" RAT_FUNC "%3.0" "Unitless" COEFFS 0 1 0 0 0 1 /end COMPU_METHOD
/begin CHARACTERISTIC CRKLVLEXP "Fault filter threshold for setting ffg_pip FMEM flag during crank mode hard fault PIP test." VALUE 0x5ECFE SD_UBYTE 0 SC_CRKLVLEXP 0 255 /end CHARACTERISTIC
/begin COMPU_METHOD SC_CRKLVLEXP "CRKLVLEXP conversion" RAT_FUNC "%3.0" "COUNTS" COEFFS 0 1 0 0 0 1 /end COMPU_METHOD
/begin MEASUREMENT CRKTSTFIL "fault filter for crank mode hard fault PIP test." UBYTE MC_CRKTSTFIL 0 0 0 0 ECU_ADDRESS 0x3FB294 /end MEASUREMENT
/begin COMPU_METHOD MC_CRKTSTFIL "CRKTSTFIL conversion" RAT_FUNC "%3.0" "Unitless" COEFFS 0 1 0 0 0 1 /end COMPU_METHOD
/begin CHARACTERISTIC CRKTSTLVL1 "Hard fault filter threshold crank" VALUE 0x5ECF9 SD_UBYTE 0 SC_CRKTSTLVL1 0 255 /end CHARACTERISTIC
/begin COMPU_METHOD SC_CRKTSTLVL1 "CRKTSTLVL1 conversion" RAT_FUNC "%3.0" "unitless" COEFFS 0 1 0 0 0 1 /end COMPU_METHOD
/begin CHARACTERISTIC CRKTSTLVL2 "Hard fault filter threshold run" VALUE 0x5ECF8 SD_UBYTE 0 SC_CRKTSTLVL2 0 255 /end CHARACTERISTIC
/begin COMPU_METHOD SC_CRKTSTLVL2 "CRKTSTLVL2 conversion" RAT_FUNC "%3.0" "unitless" COEFFS 0 1 0 0 0 1 /end COMPU_METHOD
/begin CHARACTERISTIC CRKUP1 "hard crk fault filter increment crank" VALUE 0x5ECF1 SD_UBYTE 0 SC_CRKUP1 0 255 /end CHARACTERISTIC
/begin COMPU_METHOD SC_CRKUP1 "CRKUP1 conversion" RAT_FUNC "%3.0" "unitless" COEFFS 0 1 0 0 0 1 /end COMPU_METHOD
/begin CHARACTERISTIC CRKUP2 "hard crk fault filter increment run" VALUE 0x5ECF0 SD_UBYTE 0 SC_CRKUP2 0 255 /end CHARACTERISTIC
/begin COMPU_METHOD SC_CRKUP2 "CRKUP2 conversion" RAT_FUNC "%3.0" "unitless" COEFFS 0 1 0 0 0 1 /end COMPU_METHOD
/begin MEASUREMENT CRK_CMP_FLT_CNTR "Crank and CAM fault error counter." UWORD MC_CRK_CMP_FLT_CNTR 0 0 0 0 ECU_ADDRESS 0x3F9A98 /end MEASUREMENT
/begin COMPU_METHOD MC_CRK_CMP_FLT_CNTR "CRK_CMP_FLT_CNTR conversion" RAT_FUNC "%5.0" "Unitless" COEFFS 0 1 0 0 0 1 /end COMPU_METHOD
/begin CHARACTERISTIC CRK_CMP_FLT_LMT "Crank Cam fault counter limit" VALUE 0x5C88C SD_UWORD 0 SC_CRK_CMP_FLT_LMT 0 65535 /end CHARACTERISTIC
/begin COMPU_METHOD SC_CRK_CMP_FLT_LMT "CRK_CMP_FLT_LMT conversion" RAT_FUNC "%5.0" "unitless" COEFFS 0 1 0 0 0 1 /end COMPU_METHOD
/begin MEASUREMENT CRNK_TMR "Time since last crankshaft interrupt (PIP)" ULONG MC_CRNK_TMR 0 0 0 0 ECU_ADDRESS 0x3FA8D4 /end MEASUREMENT
/begin COMPU_METHOD MC_CRNK_TMR "CRNK_TMR conversion" RAT_FUNC "%10.0" "Unitless" COEFFS 0 1 0 0 0 1 /end COMPU_METHOD
/begin MEASUREMENT CRPYICP_ADDR "Engine speed/Output Shaft Speed based ICP adder" FLOAT32_IEEE MC_CRPYICP_ADDR 0 0 0 0 ECU_ADDRESS 0x3FAA44 /end MEASUREMENT
/begin COMPU_METHOD MC_CRPYICP_ADDR "CRPYICP_ADDR conversion" RAT_FUNC "%10.5" "Unitless" COEFFS 0 1 0 0 0 1 /end COMPU_METHOD
/begin MEASUREMENT CRPYICP_ROC "Engine speed based ICP adder" FLOAT32_IEEE MC_CRPYICP_ROC 0 0 0 0 ECU_ADDRESS 0x3FAA40 /end MEASUREMENT
/begin COMPU_METHOD MC_CRPYICP_ROC "CRPYICP_ROC conversion" RAT_FUNC "%10.5" "Unitless" COEFFS 0 1 0 0 0 1 /end COMPU_METHOD
/begin CHARACTERISTIC CRUFST "" VALUE 0x5DC07 SD_UBYTE 0 SC_CRUFST 0 1 /end CHARACTERISTIC
/begin COMPU_METHOD SC_CRUFST "CRUFST conversion" RAT_FUNC "%3.0" "unitless" COEFFS 0 1 0 0 0 1 /end COMPU_METHOD
/begin MEASUREMENT CRUISE_CONTROLLING "" UBYTE MC_CRUISE_CONTROLLING 0 0 0 0 ECU_ADDRESS 0x3FB18C /end MEASUREMENT
/begin COMPU_METHOD MC_CRUISE_CONTROLLING "CRUISE_CONTROLLING conversion" RAT_FUNC "%3.0" "Unitless" COEFFS 0 1 0 0 0 1 /end COMPU_METHOD
/begin MEASUREMENT CRUISE_ENT_REQ "Cruise control entry request (to diesel Power Monitor)" UBYTE MC_CRUISE_ENT_REQ 0 0 0 0 ECU_ADDRESS 0x3FA2C3 /end MEASUREMENT
/begin COMPU_METHOD MC_CRUISE_ENT_REQ "CRUISE_ENT_REQ conversion" RAT_FUNC "%3.0" "Unitless" COEFFS 0 1 0 0 0 1 /end COMPU_METHOD
/begin MEASUREMENT CRUISE_STATUS "Cruise control status" UBYTE MC_CRUISE_STATUS 0 0 0 0 ECU_ADDRESS 0x3FA2A8 /end MEASUREMENT
/begin COMPU_METHOD MC_CRUISE_STATUS "CRUISE_STATUS conversion" RAT_FUNC "%3.0" "Unitless" COEFFS 0 1 0 0 0 1 /end COMPU_METHOD
/begin MEASUREMENT CRU_LGL_FLG "Cruise (Speed) Control Legal flag" UBYTE MC_CRU_LGL_FLG 0 0 0 0 ECU_ADDRESS 0x3FB18B /end MEASUREMENT
/begin COMPU_METHOD MC_CRU_LGL_FLG "CRU_LGL_FLG conversion" RAT_FUNC "%3.0" "Unitless" COEFFS 0 1 0 0 0 1 /end COMPU_METHOD
/begin CHARACTERISTIC CSTDWN_LOAD "LOAD value below which the vehicle is inferred to be in a coast down mode -> vehicle should be moving" VALUE 0x5D90C SD_FLOAT32_IEEE 0 SC_CSTDWN_LOAD 0 1.99997 /end CHARACTERISTIC
/begin COMPU_METHOD SC_CSTDWN_LOAD "CSTDWN_LOAD conversion" RAT_FUNC "%10.5" "UNITLESS" COEFFS 0 1 0 0 0 1 /end COMPU_METHOD
/begin MEASUREMENT CTTMR "AT CLOSED THROTTLE TIMER" FLOAT32_IEEE MC_CTTMR 0 0 0 0 ECU_ADDRESS 0x3FB5D8 /end MEASUREMENT
/begin COMPU_METHOD MC_CTTMR "CTTMR conversion" RAT_FUNC "%10.5" "Unitless" COEFFS 0 1 0 0 0 1 /end COMPU_METHOD
/begin CHARACTERISTIC CYL1GPF_INC "Glow plug monitor fault counter increment value for cylinder 1" VALUE 0x5E2B0 SD_SLONG 0 SC_CYL1GPF_INC 0 65535 /end CHARACTERISTIC
/begin COMPU_METHOD SC_CYL1GPF_INC "CYL1GPF_INC conversion" RAT_FUNC "%10.0" "unitless" COEFFS 0 1 0 0 0 1 /end COMPU_METHOD
/begin CHARACTERISTIC CYL1GPR_DEC "Glow plug monitor fault counter decrement value for cylinder 1" VALUE 0x5E284 SD_SLONG 0 SC_CYL1GPR_DEC 0 65535 /end CHARACTERISTIC
/begin COMPU_METHOD SC_CYL1GPR_DEC "CYL1GPR_DEC conversion" RAT_FUNC "%10.0" "unitless" COEFFS 0 1 0 0 0 1 /end COMPU_METHOD
/begin CHARACTERISTIC CYL2GPF_INC "Glow plug monitor fault counter increment value for cylinder 2" VALUE 0x5E2AC SD_SLONG 0 SC_CYL2GPF_INC 0 65535 /end CHARACTERISTIC
/begin COMPU_METHOD SC_CYL2GPF_INC "CYL2GPF_INC conversion" RAT_FUNC "%10.0" "unitless" COEFFS 0 1 0 0 0 1 /end COMPU_METHOD
/begin CHARACTERISTIC CYL2GPR_DEC "Glow plug monitor fault counter decrement value for cylinder 2" VALUE 0x5E280 SD_SLONG 0 SC_CYL2GPR_DEC 0 65535 /end CHARACTERISTIC
/begin COMPU_METHOD SC_CYL2GPR_DEC "CYL2GPR_DEC conversion" RAT_FUNC "%10.0" "unitless" COEFFS 0 1 0 0 0 1 /end COMPU_METHOD
/begin CHARACTERISTIC CYL3GPF_INC "Glow plug monitor fault counter increment value for cylinder 3" VALUE 0x5E2A8 SD_SLONG 0 SC_CYL3GPF_INC 0 65535 /end CHARACTERISTIC
/begin COMPU_METHOD SC_CYL3GPF_INC "CYL3GPF_INC conversion" RAT_FUNC "%10.0" "unitless" COEFFS 0 1 0 0 0 1 /end COMPU_METHOD
/begin CHARACTERISTIC CYL3GPR_DEC "Glow plug monitor fault counter decrement value for cylinder 3" VALUE 0x5E27C SD_SLONG 0 SC_CYL3GPR_DEC 0 65535 /end CHARACTERISTIC
/begin COMPU_METHOD SC_CYL3GPR_DEC "CYL3GPR_DEC conversion" RAT_FUNC "%10.0" "unitless" COEFFS 0 1 0 0 0 1 /end COMPU_METHOD
/begin CHARACTERISTIC CYL4GPF_INC "Glow plug monitor fault counter increment value for cylinder 4" VALUE 0x5E2A4 SD_SLONG 0 SC_CYL4GPF_INC 0 65535 /end CHARACTERISTIC
/begin COMPU_METHOD SC_CYL4GPF_INC "CYL4GPF_INC conversion" RAT_FUNC "%10.0" "unitless" COEFFS 0 1 0 0 0 1 /end COMPU_METHOD
/begin CHARACTERISTIC CYL4GPR_DEC "Glow plug monitor fault counter decrement value for cylinder 4" VALUE 0x5E278 SD_SLONG 0 SC_CYL4GPR_DEC 0 65535 /end CHARACTERISTIC
/begin COMPU_METHOD SC_CYL4GPR_DEC "CYL4GPR_DEC conversion" RAT_FUNC "%10.0" "unitless" COEFFS 0 1 0 0 0 1 /end COMPU_METHOD
/begin CHARACTERISTIC CYL5GPF_INC "Glow plug monitor fault counter increment value for cylinder 5" VALUE 0x5E2A0 SD_SLONG 0 SC_CYL5GPF_INC 0 65535 /end CHARACTERISTIC
/begin COMPU_METHOD SC_CYL5GPF_INC "CYL5GPF_INC conversion" RAT_FUNC "%10.0" "unitless" COEFFS 0 1 0 0 0 1 /end COMPU_METHOD
/begin CHARACTERISTIC CYL5GPR_DEC "Glow plug monitor fault counter decrement value for cylinder 5" VALUE 0x5E274 SD_SLONG 0 SC_CYL5GPR_DEC 0 65535 /end CHARACTERISTIC
/begin COMPU_METHOD SC_CYL5GPR_DEC "CYL5GPR_DEC conversion" RAT_FUNC "%10.0" "unitless" COEFFS 0 1 0 0 0 1 /end COMPU_METHOD
/begin CHARACTERISTIC CYL6GPF_INC "Glow plug monitor fault counter increment value for cylinder 6" VALUE 0x5E29C SD_SLONG 0 SC_CYL6GPF_INC 0 65535 /end CHARACTERISTIC
/begin COMPU_METHOD SC_CYL6GPF_INC "CYL6GPF_INC conversion" RAT_FUNC "%10.0" "unitless" COEFFS 0 1 0 0 0 1 /end COMPU_METHOD
/begin CHARACTERISTIC CYL6GPR_DEC "Glow plug monitor fault counter decrement value for cylinder 6" VALUE 0x5E270 SD_SLONG 0 SC_CYL6GPR_DEC 0 65535 /end CHARACTERISTIC
/begin COMPU_METHOD SC_CYL6GPR_DEC "CYL6GPR_DEC conversion" RAT_FUNC "%10.0" "unitless" COEFFS 0 1 0 0 0 1 /end COMPU_METHOD
/begin CHARACTERISTIC CYL7GPF_INC "" VALUE 0x5E298 SD_SLONG 0 SC_CYL7GPF_INC 0 65535 /end CHARACTERISTIC
/begin COMPU_METHOD SC_CYL7GPF_INC "CYL7GPF_INC conversion" RAT_FUNC "%10.0" "unitless" COEFFS 0 1 0 0 0 1 /end COMPU_METHOD
/begin CHARACTERISTIC CYL7GPR_DEC "Glow plug monitor fault counter decrement value for cylinder 7" VALUE 0x5E26C SD_SLONG 0 SC_CYL7GPR_DEC 0 65535 /end CHARACTERISTIC
/begin COMPU_METHOD SC_CYL7GPR_DEC "CYL7GPR_DEC conversion" RAT_FUNC "%10.0" "unitless" COEFFS 0 1 0 0 0 1 /end COMPU_METHOD
/begin CHARACTERISTIC CYL8GPF_INC "Glow plug monitor fault counter increment value for cylinder 8" VALUE 0x5E294 SD_SLONG 0 SC_CYL8GPF_INC 0 65535 /end CHARACTERISTIC
/begin COMPU_METHOD SC_CYL8GPF_INC "CYL8GPF_INC conversion" RAT_FUNC "%10.0" "unitless" COEFFS 0 1 0 0 0 1 /end COMPU_METHOD
/begin CHARACTERISTIC CYL8GPR_DEC "Glow plug monitor fault counter decrement value for cylinder 8" VALUE 0x5E268 SD_SLONG 0 SC_CYL8GPR_DEC 0 65535 /end CHARACTERISTIC
/begin COMPU_METHOD SC_CYL8GPR_DEC "CYL8GPR_DEC conversion" RAT_FUNC "%10.0" "unitless" COEFFS 0 1 0 0 0 1 /end COMPU_METHOD
/begin MEASUREMENT CYLBGTOBG[0] "Holds the value of the ""v_cyl_tot"" counters for each bg pass." UBYTE MC_CYLBGTOBG 0 0 0 255 ECU_ADDRESS 0x3FBFF4 /end MEASUREMENT
/begin COMPU_METHOD MC_CYLBGTOBG "CYLBGTOBG conversion" RAT_FUNC "%3.0" "events" COEFFS 0 1 0 0 0 1 /end COMPU_METHOD
/begin MEASUREMENT CYLBGTOBG[1] "Holds the value of the ""v_cyl_tot"" counters for each bg pass." UBYTE MC_CYLBGTOBG 0 0 0 255 ECU_ADDRESS 0x3FBFF5 /end MEASUREMENT
/begin MEASUREMENT CYLBGTOBG[2] "Holds the value of the ""v_cyl_tot"" counters for each bg pass." UBYTE MC_CYLBGTOBG 0 0 0 255 ECU_ADDRESS 0x3FBFF6 /end MEASUREMENT
/begin MEASUREMENT CYLBGTOBG[3] "Holds the value of the ""v_cyl_tot"" counters for each bg pass." UBYTE MC_CYLBGTOBG 0 0 0 255 ECU_ADDRESS 0x3FBFF7 /end MEASUREMENT
/begin MEASUREMENT CYLBGTOBG[4] "Holds the value of the ""v_cyl_tot"" counters for each bg pass." UBYTE MC_CYLBGTOBG 0 0 0 255 ECU_ADDRESS 0x3FBFF8 /end MEASUREMENT
/begin MEASUREMENT CYLBGTOBG[5] "Holds the value of the ""v_cyl_tot"" counters for each bg pass." UBYTE MC_CYLBGTOBG 0 0 0 255 ECU_ADDRESS 0x3FBFF9 /end MEASUREMENT
/begin MEASUREMENT CYLBGTOBG[6] "Holds the value of the ""v_cyl_tot"" counters for each bg pass." UBYTE MC_CYLBGTOBG 0 0 0 255 ECU_ADDRESS 0x3FBFFA /end MEASUREMENT
/begin MEASUREMENT CYLBGTOBG[7] "Holds the value of the ""v_cyl_tot"" counters for each bg pass." UBYTE MC_CYLBGTOBG 0 0 0 255 ECU_ADDRESS 0x3FBFFB /end MEASUREMENT
/begin MEASUREMENT CYLBGTOBG[8] "Holds the value of the ""v_cyl_tot"" counters for each bg pass." UBYTE MC_CYLBGTOBG 0 0 0 255 ECU_ADDRESS 0x3FBFFC /end MEASUREMENT
/begin MEASUREMENT CYLBGTOBG[9] "Holds the value of the ""v_cyl_tot"" counters for each bg pass." UBYTE MC_CYLBGTOBG 0 0 0 255 ECU_ADDRESS 0x3FBFFD /end MEASUREMENT
/begin MEASUREMENT CYLINDER_1_CCT "" UBYTE MC_CYLINDER_1_CCT 0 0 0 0 ECU_ADDRESS 0x3FB6C3 /end MEASUREMENT
/begin COMPU_METHOD MC_CYLINDER_1_CCT "CYLINDER_1_CCT conversion" RAT_FUNC "%3.0" "Unitless" COEFFS 0 1 0 0 0 1 /end COMPU_METHOD
/begin MEASUREMENT CYLINDER_2_CCT "" UBYTE MC_CYLINDER_2_CCT 0 0 0 0 ECU_ADDRESS 0x3FB6C4 /end MEASUREMENT
/begin COMPU_METHOD MC_CYLINDER_2_CCT "CYLINDER_2_CCT conversion" RAT_FUNC "%3.0" "Unitless" COEFFS 0 1 0 0 0 1 /end COMPU_METHOD
/begin MEASUREMENT CYLINDER_3_CCT "" UBYTE MC_CYLINDER_3_CCT 0 0 0 0 ECU_ADDRESS 0x3FB6C5 /end MEASUREMENT
/begin COMPU_METHOD MC_CYLINDER_3_CCT "CYLINDER_3_CCT conversion" RAT_FUNC "%3.0" "Unitless" COEFFS 0 1 0 0 0 1 /end COMPU_METHOD
/begin MEASUREMENT CYLINDER_4_CCT "" UBYTE MC_CYLINDER_4_CCT 0 0 0 0 ECU_ADDRESS 0x3FB6C6 /end MEASUREMENT
/begin COMPU_METHOD MC_CYLINDER_4_CCT "CYLINDER_4_CCT conversion" RAT_FUNC "%3.0" "Unitless" COEFFS 0 1 0 0 0 1 /end COMPU_METHOD
/begin MEASUREMENT CYLINDER_5_CCT "" UBYTE MC_CYLINDER_5_CCT 0 0 0 0 ECU_ADDRESS 0x3FB6C7 /end MEASUREMENT
/begin COMPU_METHOD MC_CYLINDER_5_CCT "CYLINDER_5_CCT conversion" RAT_FUNC "%3.0" "Unitless" COEFFS 0 1 0 0 0 1 /end COMPU_METHOD
/begin MEASUREMENT CYLINDER_6_CCT "" UBYTE MC_CYLINDER_6_CCT 0 0 0 0 ECU_ADDRESS 0x3FB6C8 /end MEASUREMENT
/begin COMPU_METHOD MC_CYLINDER_6_CCT "CYLINDER_6_CCT conversion" RAT_FUNC "%3.0" "Unitless" COEFFS 0 1 0 0 0 1 /end COMPU_METHOD
/begin MEASUREMENT CYLINDER_7_CCT "" UBYTE MC_CYLINDER_7_CCT 0 0 0 0 ECU_ADDRESS 0x3FB6C9 /end MEASUREMENT
/begin COMPU_METHOD MC_CYLINDER_7_CCT "CYLINDER_7_CCT conversion" RAT_FUNC "%3.0" "Unitless" COEFFS 0 1 0 0 0 1 /end COMPU_METHOD
/begin MEASUREMENT CYLINDER_8_CCT "" UBYTE MC_CYLINDER_8_CCT 0 0 0 0 ECU_ADDRESS 0x3FB6CA /end MEASUREMENT
/begin COMPU_METHOD MC_CYLINDER_8_CCT "CYLINDER_8_CCT conversion" RAT_FUNC "%3.0" "Unitless" COEFFS 0 1 0 0 0 1 /end COMPU_METHOD
/begin MEASUREMENT DACCEL7C "LDR misfire de-acceleration value, after correction by previous daccel7, used for 50% misfire detection." FLOAT32_IEEE MC_DACCEL7C 0 0 0 0 ECU_ADDRESS 0x3FB320 /end MEASUREMENT
/begin COMPU_METHOD MC_DACCEL7C "DACCEL7C conversion" RAT_FUNC "%10.5" "Unitless" COEFFS 0 1 0 0 0 1 /end COMPU_METHOD
/begin MEASUREMENT DACCEL7_LAST "LDR misfire daccel7 value from previous cylinder event." FLOAT32_IEEE MC_DACCEL7_LAST 0 0 0 0 ECU_ADDRESS 0x3FB2FC /end MEASUREMENT
/begin COMPU_METHOD MC_DACCEL7_LAST "DACCEL7_LAST conversion" RAT_FUNC "%10.5" "Unitless" COEFFS 0 1 0 0 0 1 /end COMPU_METHOD
/begin MEASUREMENT DACCEL_36 "result of MEDIAN - a(0) in misifre test" FLOAT32_IEEE MC_DACCEL_36 0 0 0 0 ECU_ADDRESS 0x3FB32C /end MEASUREMENT
/begin COMPU_METHOD MC_DACCEL_36 "DACCEL_36 conversion" RAT_FUNC "%10.5" "Unitless" COEFFS 0 1 0 0 0 1 /end COMPU_METHOD
/begin CHARACTERISTIC DACCEL_CALIB "adjusts 100% loss level to the level of expected deviant acceleration under misfire" VALUE 0x5EE20 SD_FLOAT32_IEEE 0 SC_DACCEL_CALIB 0 262140 /end CHARACTERISTIC
/begin COMPU_METHOD SC_DACCEL_CALIB "DACCEL_CALIB conversion" RAT_FUNC "%10.5" "DEG/TIC^2/F#" COEFFS 0 1 0 0 0 1 /end COMPU_METHOD
/begin MEASUREMENT DACCEL_MULT "Misfire parameter which scales engine torque calculation to set the base misfire threshold." FLOAT32_IEEE MC_DACCEL_MULT 0 0 0 0 ECU_ADDRESS 0x3FB364 /end MEASUREMENT
/begin COMPU_METHOD MC_DACCEL_MULT "DACCEL_MULT conversion" RAT_FUNC "%10.5" "Unitless" COEFFS 0 1 0 0 0 1 /end COMPU_METHOD
/begin MEASUREMENT DC48V_F_ORH "" UBYTE MC_DC48V_F_ORH 0 0 0 0 ECU_ADDRESS 0x3FB6EE /end MEASUREMENT
/begin COMPU_METHOD MC_DC48V_F_ORH "DC48V_F_ORH conversion" RAT_FUNC "%3.0" "Unitless" COEFFS 0 1 0 0 0 1 /end COMPU_METHOD
/begin MEASUREMENT DC48V_F_ORL "" UBYTE MC_DC48V_F_ORL 0 0 0 0 ECU_ADDRESS 0x3FB6EF /end MEASUREMENT
/begin COMPU_METHOD MC_DC48V_F_ORL "DC48V_F_ORL conversion" RAT_FUNC "%3.0" "Unitless" COEFFS 0 1 0 0 0 1 /end COMPU_METHOD
/begin CHARACTERISTIC DCHK_MAX_EGRTP "Intake Throttle Position limit for dechoke logic." VALUE 0x5DD38 SD_FLOAT32_IEEE 0 SC_DCHK_MAX_EGRTP 0 1 /end CHARACTERISTIC
/begin COMPU_METHOD SC_DCHK_MAX_EGRTP "DCHK_MAX_EGRTP conversion" RAT_FUNC "%10.5" "unitless" COEFFS 0 1 0 0 0 1 /end COMPU_METHOD
/begin CHARACTERISTIC DCHK_MAX_N "IO Control desired engine speed Limit for dechoke logic." VALUE 0x5DD44 SD_FLOAT32_IEEE 0 SC_DCHK_MAX_N 0 6000 /end CHARACTERISTIC
/begin COMPU_METHOD SC_DCHK_MAX_N "DCHK_MAX_N conversion" RAT_FUNC "%10.5" "RPM" COEFFS 0 1 0 0 0 1 /end COMPU_METHOD
/begin CHARACTERISTIC DCHK_MAX_N_TM "Dechoke maximum engine rpm timer limit." VALUE 0x5DD40 SD_FLOAT32_IEEE 0 SC_DCHK_MAX_N_TM 0 50000 /end CHARACTERISTIC
/begin COMPU_METHOD SC_DCHK_MAX_N_TM "DCHK_MAX_N_TM conversion" RAT_FUNC "%10.5" "unitless" COEFFS 0 1 0 0 0 1 /end COMPU_METHOD
/begin MEASUREMENT DCHK_MAX_N_TMR "Dechooke maximum engine rpm timer." FLOAT32_IEEE MC_DCHK_MAX_N_TMR 0 0 0 0 ECU_ADDRESS 0x3FA7F8 /end MEASUREMENT
/begin COMPU_METHOD MC_DCHK_MAX_N_TMR "DCHK_MAX_N_TMR conversion" RAT_FUNC "%10.5" "Unitless" COEFFS 0 1 0 0 0 1 /end COMPU_METHOD
/begin CHARACTERISTIC DCHK_MAX_VSS "Filtered vehicle speed limit for dechoke logic." VALUE 0x5DD3C SD_FLOAT32_IEEE 0 SC_DCHK_MAX_VSS 0 127 /end CHARACTERISTIC
/begin COMPU_METHOD SC_DCHK_MAX_VSS "DCHK_MAX_VSS conversion" RAT_FUNC "%10.5" "MPH" COEFFS 0 1 0 0 0 1 /end COMPU_METHOD
/begin MEASUREMENT DECHOKE_F "Dechoke enable/disable flag." UBYTE MC_DECHOKE_F 0 0 0 0 ECU_ADDRESS 0x3FA8AD /end MEASUREMENT
/begin COMPU_METHOD MC_DECHOKE_F "DECHOKE_F conversion" RAT_FUNC "%3.0" "Unitless" COEFFS 0 1 0 0 0 1 /end COMPU_METHOD
/begin CHARACTERISTIC DELTA_TEETH_LIM8 "" VALUE 0x5C488 SD_UBYTE 0 SC_DELTA_TEETH_LIM8 0 20 /end CHARACTERISTIC
/begin COMPU_METHOD SC_DELTA_TEETH_LIM8 "DELTA_TEETH_LIM8 conversion" RAT_FUNC "%3.0" "unitless" COEFFS 0 1 0 0 0 1 /end COMPU_METHOD
/begin MEASUREMENT DEMAND_ABORT "Flag indicating that an on demand test is in the progress of a abort" UBYTE MC_DEMAND_ABORT 0 0 0 0 ECU_ADDRESS 0x3FB507 /end MEASUREMENT
/begin COMPU_METHOD MC_DEMAND_ABORT "DEMAND_ABORT conversion" RAT_FUNC "%3.0" "Unitless" COEFFS 0 1 0 0 0 1 /end COMPU_METHOD
/begin MEASUREMENT DEMAND_MODE "Flag set when an On-Demand self test mode is active." UBYTE MC_DEMAND_MODE 0 0 0 0 ECU_ADDRESS 0x3F9E36 /end MEASUREMENT
/begin COMPU_METHOD MC_DEMAND_MODE "DEMAND_MODE conversion" RAT_FUNC "%3.0" "Unitless" COEFFS 0 1 0 0 0 1 /end COMPU_METHOD
/begin MEASUREMENT DEMAND_TIMER "Utility timer for sequenced on demand tests." FLOAT32_IEEE MC_DEMAND_TIMER 0 0 0 0 ECU_ADDRESS 0x3FB4E4 /end MEASUREMENT
/begin COMPU_METHOD MC_DEMAND_TIMER "DEMAND_TIMER conversion" RAT_FUNC "%10.5" "Unitless" COEFFS 0 1 0 0 0 1 /end COMPU_METHOD
/begin CHARACTERISTIC DENSITY "Standard diesel fuel density (mg/mm**3)" VALUE 0x5DC48 SD_FLOAT32_IEEE 0 SC_DENSITY 0.8 0.9 /end CHARACTERISTIC
/begin COMPU_METHOD SC_DENSITY "DENSITY conversion" RAT_FUNC "%10.5" "unitless" COEFFS 0 1 0 0 0 1 /end COMPU_METHOD
/begin MEASUREMENT DENSITY_MULT "Fuel density adjustment" FLOAT32_IEEE MC_DENSITY_MULT 0 0 0 0 ECU_ADDRESS 0x3FA7E0 /end MEASUREMENT
/begin COMPU_METHOD MC_DENSITY_MULT "DENSITY_MULT conversion" RAT_FUNC "%10.5" "Unitless" COEFFS 0 1 0 0 0 1 /end COMPU_METHOD
/begin MEASUREMENT DFSFLG "Decel fuel shutoff requested flag." UBYTE MC_DFSFLG 0 0 0 0 ECU_ADDRESS 0x3F9CE4 /end MEASUREMENT
/begin COMPU_METHOD MC_DFSFLG "DFSFLG conversion" RAT_FUNC "%3.0" "Unitless" COEFFS 0 1 0 0 0 1 /end COMPU_METHOD
/begin MEASUREMENT DIAGX_RESET "1 = The OBD diagnostic system reset is requested." UBYTE MC_DIAGX_RESET 0 0 0 0 ECU_ADDRESS 0x3F9E10 /end MEASUREMENT
/begin COMPU_METHOD MC_DIAGX_RESET "DIAGX_RESET conversion" RAT_FUNC "%3.0" "Unitless" COEFFS 0 1 0 0 0 1 /end COMPU_METHOD
/begin MEASUREMENT DIAG_MODE "Diagnostic Session Identifier" UBYTE MC_DIAG_MODE 0 0 0 0 ECU_ADDRESS 0x3FB4AF /end MEASUREMENT
/begin COMPU_METHOD MC_DIAG_MODE "DIAG_MODE conversion" RAT_FUNC "%3.0" "Unitless" COEFFS 0 1 0 0 0 1 /end COMPU_METHOD
/begin MEASUREMENT DIAG_NO_CKP_SGNL_CNTR "No crank signal  fault counter during eng. run" UBYTE MC_DIAG_NO_CKP_SGNL_CNTR 0 0 0 0 ECU_ADDRESS 0x3FA651 /end MEASUREMENT
/begin COMPU_METHOD MC_DIAG_NO_CKP_SGNL_CNTR "DIAG_NO_CKP_SGNL_CNTR conversion" RAT_FUNC "%3.0" "Unitless" COEFFS 0 1 0 0 0 1 /end COMPU_METHOD
/begin MEASUREMENT DIAG_NO_CMP_SGNL_CNTR "No cam signal fault counter during eng. run" UBYTE MC_DIAG_NO_CMP_SGNL_CNTR 0 0 0 0 ECU_ADDRESS 0x3FA653 /end MEASUREMENT
/begin COMPU_METHOD MC_DIAG_NO_CMP_SGNL_CNTR "DIAG_NO_CMP_SGNL_CNTR conversion" RAT_FUNC "%3.0" "Unitless" COEFFS 0 1 0 0 0 1 /end COMPU_METHOD
/begin MEASUREMENT DIAG_SYNC_LOSS_CKP_CNTR "Crank sync. loss  fault counter during eng. run" UBYTE MC_DIAG_SYNC_LOSS_CKP_CNTR 0 0 0 0 ECU_ADDRESS 0x3FA650 /end MEASUREMENT
/begin COMPU_METHOD MC_DIAG_SYNC_LOSS_CKP_CNTR "DIAG_SYNC_LOSS_CKP_CNTR conversion" RAT_FUNC "%3.0" "Unitless" COEFFS 0 1 0 0 0 1 /end COMPU_METHOD
/begin MEASUREMENT DIAG_SYNC_LOSS_CMP_CNTR "cam sync. loss  fault counter during eng. run" UBYTE MC_DIAG_SYNC_LOSS_CMP_CNTR 0 0 0 0 ECU_ADDRESS 0x3FA652 /end MEASUREMENT
/begin COMPU_METHOD MC_DIAG_SYNC_LOSS_CMP_CNTR "DIAG_SYNC_LOSS_CMP_CNTR conversion" RAT_FUNC "%3.0" "Unitless" COEFFS 0 1 0 0 0 1 /end COMPU_METHOD
/begin CHARACTERISTIC DIAG_TEST_ON "" VALUE 0x5F184 SD_UBYTE 0 SC_DIAG_TEST_ON 0 1 /end CHARACTERISTIC
/begin COMPU_METHOD SC_DIAG_TEST_ON "DIAG_TEST_ON conversion" RAT_FUNC "%3.0" "unitless" COEFFS 0 1 0 0 0 1 /end COMPU_METHOD
/begin MEASUREMENT DIAG_TIMER "Utility timer for sequenced on demand tests." FLOAT32_IEEE MC_DIAG_TIMER 0 0 0 0 ECU_ADDRESS 0x3FB4DC /end MEASUREMENT
/begin COMPU_METHOD MC_DIAG_TIMER "DIAG_TIMER conversion" RAT_FUNC "%10.5" "Unitless" COEFFS 0 1 0 0 0 1 /end COMPU_METHOD
/begin MEASUREMENT DIAG_TMR "" FLOAT32_IEEE MC_DIAG_TMR 0 0 0 0 ECU_ADDRESS 0x3FB584 /end MEASUREMENT
/begin COMPU_METHOD MC_DIAG_TMR "DIAG_TMR conversion" RAT_FUNC "%10.5" "Unitless" COEFFS 0 1 0 0 0 1 /end COMPU_METHOD
/begin MEASUREMENT DIAG_TOOL_REQ_INJOFF_TEST "Indicates Diagnostic tool has requested for injector output control" UBYTE MC_DIAG_TOOL_REQ_INJOFF_TEST 0 0 0 0 ECU_ADDRESS 0x3F9E94 /end MEASUREMENT
/begin COMPU_METHOD MC_DIAG_TOOL_REQ_INJOFF_TEST "DIAG_TOOL_REQ_INJOFF_TEST conversion" RAT_FUNC "%3.0" "Unitless" COEFFS 0 1 0 0 0 1 /end COMPU_METHOD
/begin MEASUREMENT DIAG_TST_STP "Navistar Diesel KOEO step pointer." UBYTE MC_DIAG_TST_STP 0 0 0 0 ECU_ADDRESS 0x3FB5B4 /end MEASUREMENT
/begin COMPU_METHOD MC_DIAG_TST_STP "DIAG_TST_STP conversion" RAT_FUNC "%3.0" "Unitless" COEFFS 0 1 0 0 0 1 /end COMPU_METHOD
/begin CHARACTERISTIC DISPL_LITERS "Engine displacement in liters. Calibrate as 10*Displacement (example: 3.8L == 38 decimal) for SCP>" VALUE 0x5EF96 SD_UBYTE 0 SC_DISPL_LITERS 0 255 /end CHARACTERISTIC
/begin COMPU_METHOD SC_DISPL_LITERS "DISPL_LITERS conversion" RAT_FUNC "%3.0" "LITERS" COEFFS 0 1 0 0 0 1 /end COMPU_METHOD
/begin MEASUREMENT DIS_FMEM "HDR DIS strategy controlled FMEM flag." UBYTE MC_DIS_FMEM 0 0 0 0 ECU_ADDRESS 0x3F9CE6 /end MEASUREMENT
/begin COMPU_METHOD MC_DIS_FMEM "DIS_FMEM conversion" RAT_FUNC "%3.0" "Unitless" COEFFS 0 1 0 0 0 1 /end COMPU_METHOD
/begin MEASUREMENT DITDES "Desired engine timing degrees (Crank Deg/BTDC)" FLOAT32_IEEE MC_DITDES 0 0 0 0 ECU_ADDRESS 0x3FA968 /end MEASUREMENT
/begin COMPU_METHOD MC_DITDES "DITDES conversion" RAT_FUNC "%10.5" "Unitless" COEFFS 0 1 0 0 0 1 /end COMPU_METHOD
/begin CHARACTERISTIC DITDES_LMN "Direct Injection Timing Desired Minimum" VALUE 0x5DE20 SD_FLOAT32_IEEE 0 SC_DITDES_LMN -128 5 /end CHARACTERISTIC
/begin COMPU_METHOD SC_DITDES_LMN "DITDES_LMN conversion" RAT_FUNC "%10.5" "deg" COEFFS 0 1 0 0 0 1 /end COMPU_METHOD
/begin CHARACTERISTIC DITDES_LMX "Direct Injection Timing Desired Maximum" VALUE 0x5DE1C SD_FLOAT32_IEEE 0 SC_DITDES_LMX -128 135 /end CHARACTERISTIC
/begin COMPU_METHOD SC_DITDES_LMX "DITDES_LMX conversion" RAT_FUNC "%10.5" "deg" COEFFS 0 1 0 0 0 1 /end COMPU_METHOD
/begin MEASUREMENT DITDES_TBL "desired DIT" FLOAT32_IEEE MC_DITDES_TBL 0 0 0 0 ECU_ADDRESS 0x3FA8FC /end MEASUREMENT
/begin COMPU_METHOD MC_DITDES_TBL "DITDES_TBL conversion" RAT_FUNC "%10.5" "Unitless" COEFFS 0 1 0 0 0 1 /end COMPU_METHOD
/begin CHARACTERISTIC DITDSHKF "DIT MFDSH filter gain constant" VALUE 0x5DE10 SD_FLOAT32_IEEE 0 SC_DITDSHKF 0 1 /end CHARACTERISTIC
/begin COMPU_METHOD SC_DITDSHKF "DITDSHKF conversion" RAT_FUNC "%10.5" "unitless" COEFFS 0 1 0 0 0 1 /end COMPU_METHOD
/begin CHARACTERISTIC DITOFST "Calibratable Direct Injection Timing Desired Offset" VALUE 0x5DE14 SD_FLOAT32_IEEE 0 SC_DITOFST -128 63.9 /end CHARACTERISTIC
/begin COMPU_METHOD SC_DITOFST "DITOFST conversion" RAT_FUNC "%10.5" "deg" COEFFS 0 1 0 0 0 1 /end COMPU_METHOD
/begin MEASUREMENT DIT_BOOST_ADDER "DIT boost adder" FLOAT32_IEEE MC_DIT_BOOST_ADDER 0 0 0 0 ECU_ADDRESS 0x3FA904 /end MEASUREMENT
/begin COMPU_METHOD MC_DIT_BOOST_ADDER "DIT_BOOST_ADDER conversion" RAT_FUNC "%10.5" "Unitless" COEFFS 0 1 0 0 0 1 /end COMPU_METHOD
/begin MEASUREMENT DIT_DASH_ADDR "DIT transient detection adder" FLOAT32_IEEE MC_DIT_DASH_ADDR 0 0 0 0 ECU_ADDRESS 0x3FA944 /end MEASUREMENT
/begin COMPU_METHOD MC_DIT_DASH_ADDR "DIT_DASH_ADDR conversion" RAT_FUNC "%10.5" "Unitless" COEFFS 0 1 0 0 0 1 /end COMPU_METHOD
/begin CHARACTERISTIC DIT_DASH_CAL "DIT dash calibratable" VALUE 0x5DDFC SD_FLOAT32_IEEE 0 SC_DIT_DASH_CAL -15 15 /end CHARACTERISTIC
/begin COMPU_METHOD SC_DIT_DASH_CAL "DIT_DASH_CAL conversion" RAT_FUNC "%10.5" "unitless" COEFFS 0 1 0 0 0 1 /end COMPU_METHOD
/begin CHARACTERISTIC DIT_DASH_LMN "DIT MFDSH minimum" VALUE 0x5DE00 SD_FLOAT32_IEEE 0 SC_DIT_DASH_LMN -15 0 /end CHARACTERISTIC
/begin COMPU_METHOD SC_DIT_DASH_LMN "DIT_DASH_LMN conversion" RAT_FUNC "%10.5" "unitless" COEFFS 0 1 0 0 0 1 /end COMPU_METHOD
/begin CHARACTERISTIC DIT_DASH_LMX "DIT MFDSH maximum" VALUE 0x5DE04 SD_FLOAT32_IEEE 0 SC_DIT_DASH_LMX 0 15 /end CHARACTERISTIC
/begin COMPU_METHOD SC_DIT_DASH_LMX "DIT_DASH_LMX conversion" RAT_FUNC "%10.5" "unitless" COEFFS 0 1 0 0 0 1 /end COMPU_METHOD
/begin CHARACTERISTIC DIT_DASH_SW "DIT dash switch" VALUE 0x5DE43 SD_UBYTE 0 SC_DIT_DASH_SW 0 1 /end CHARACTERISTIC
/begin COMPU_METHOD SC_DIT_DASH_SW "DIT_DASH_SW conversion" RAT_FUNC "%3.0" "unitless" COEFFS 0 1 0 0 0 1 /end COMPU_METHOD
/begin MEASUREMENT DIT_FULL_BOOST "DIT full boost adder" FLOAT32_IEEE MC_DIT_FULL_BOOST 0 0 0 0 ECU_ADDRESS 0x3FA914 /end MEASUREMENT
/begin COMPU_METHOD MC_DIT_FULL_BOOST "DIT_FULL_BOOST conversion" RAT_FUNC "%10.5" "Unitless" COEFFS 0 1 0 0 0 1 /end COMPU_METHOD
/begin MEASUREMENT DIT_HI_ALT "DIT for high altitude (Crank Deg/BTDC)" FLOAT32_IEEE MC_DIT_HI_ALT 0 0 0 0 ECU_ADDRESS 0x3FA998 /end MEASUREMENT
/begin COMPU_METHOD MC_DIT_HI_ALT "DIT_HI_ALT conversion" RAT_FUNC "%10.5" "Unitless" COEFFS 0 1 0 0 0 1 /end COMPU_METHOD
/begin MEASUREMENT DIT_HI_COLD_ADV "" FLOAT32_IEEE MC_DIT_HI_COLD_ADV 0 0 0 0 ECU_ADDRESS 0x3FA9A0 /end MEASUREMENT
/begin COMPU_METHOD MC_DIT_HI_COLD_ADV "DIT_HI_COLD_ADV conversion" RAT_FUNC "%10.5" "Unitless" COEFFS 0 1 0 0 0 1 /end COMPU_METHOD
/begin MEASUREMENT DIT_LO_ALT "DIT for low altitude (Crank Deg/BTDC)" FLOAT32_IEEE MC_DIT_LO_ALT 0 0 0 0 ECU_ADDRESS 0x3FA99C /end MEASUREMENT
/begin COMPU_METHOD MC_DIT_LO_ALT "DIT_LO_ALT conversion" RAT_FUNC "%10.5" "Unitless" COEFFS 0 1 0 0 0 1 /end COMPU_METHOD
/begin MEASUREMENT DIT_LO_COLD_ADV "" FLOAT32_IEEE MC_DIT_LO_COLD_ADV 0 0 0 0 ECU_ADDRESS 0x3FA9A4 /end MEASUREMENT
/begin COMPU_METHOD MC_DIT_LO_COLD_ADV "DIT_LO_COLD_ADV conversion" RAT_FUNC "%10.5" "Unitless" COEFFS 0 1 0 0 0 1 /end COMPU_METHOD
/begin MEASUREMENT DIT_MFDES_FILT "Filtered mfdes for calculating transient adder." FLOAT32_IEEE MC_DIT_MFDES_FILT 0 0 0 0 ECU_ADDRESS 0x3FA940 /end MEASUREMENT
/begin COMPU_METHOD MC_DIT_MFDES_FILT "DIT_MFDES_FILT conversion" RAT_FUNC "%10.5" "Unitless" COEFFS 0 1 0 0 0 1 /end COMPU_METHOD
/begin CHARACTERISTIC DIT_MFDSHLMN "DIT MFDSH minimum" VALUE 0x5DE08 SD_FLOAT32_IEEE 0 SC_DIT_MFDSHLMN -15 0 /end CHARACTERISTIC
/begin COMPU_METHOD SC_DIT_MFDSHLMN "DIT_MFDSHLMN conversion" RAT_FUNC "%10.5" "unitless" COEFFS 0 1 0 0 0 1 /end COMPU_METHOD
/begin CHARACTERISTIC DIT_MFDSHLMX "DIT MFDSH maximum" VALUE 0x5DE0C SD_FLOAT32_IEEE 0 SC_DIT_MFDSHLMX 0 15 /end CHARACTERISTIC
/begin COMPU_METHOD SC_DIT_MFDSHLMX "DIT_MFDSHLMX conversion" RAT_FUNC "%10.5" "unitless" COEFFS 0 1 0 0 0 1 /end COMPU_METHOD
/begin MEASUREMENT DIT_MFD_MULT "DIT transient detection multiplier" FLOAT32_IEEE MC_DIT_MFD_MULT 0 0 0 0 ECU_ADDRESS 0x3FA948 /end MEASUREMENT
/begin COMPU_METHOD MC_DIT_MFD_MULT "DIT_MFD_MULT conversion" RAT_FUNC "%10.5" "Unitless" COEFFS 0 1 0 0 0 1 /end COMPU_METHOD
/begin MEASUREMENT DIT_MFN_KDSH "DIT transient detection factor." FLOAT32_IEEE MC_DIT_MFN_KDSH 0 0 0 0 ECU_ADDRESS 0x3FA928 /end MEASUREMENT
/begin COMPU_METHOD MC_DIT_MFN_KDSH "DIT_MFN_KDSH conversion" RAT_FUNC "%10.5" "Unitless" COEFFS 0 1 0 0 0 1 /end COMPU_METHOD
/begin MEASUREMENT DIT_MF_DIFF_FILT "DIT transient detection filter" FLOAT32_IEEE MC_DIT_MF_DIFF_FILT 0 0 0 0 ECU_ADDRESS 0x3FA958 /end MEASUREMENT
/begin COMPU_METHOD MC_DIT_MF_DIFF_FILT "DIT_MF_DIFF_FILT conversion" RAT_FUNC "%10.5" "Unitless" COEFFS 0 1 0 0 0 1 /end COMPU_METHOD
/begin MEASUREMENT DIT_NO_BOOST "DIT no boost adder" FLOAT32_IEEE MC_DIT_NO_BOOST 0 0 0 0 ECU_ADDRESS 0x3FA910 /end MEASUREMENT
/begin COMPU_METHOD MC_DIT_NO_BOOST "DIT_NO_BOOST conversion" RAT_FUNC "%10.5" "Unitless" COEFFS 0 1 0 0 0 1 /end COMPU_METHOD
/begin MEASUREMENT DIT_N_DIFF_FILT "Difference of  Engine RPM and Filterd Engine speed ." FLOAT32_IEEE MC_DIT_N_DIFF_FILT 0 0 0 0 ECU_ADDRESS 0x3FA954 /end MEASUREMENT
/begin COMPU_METHOD MC_DIT_N_DIFF_FILT "DIT_N_DIFF_FILT conversion" RAT_FUNC "%10.5" "Unitless" COEFFS 0 1 0 0 0 1 /end COMPU_METHOD
/begin MEASUREMENT DIT_N_FILT "Filterd Engine speed (RPM)." FLOAT32_IEEE MC_DIT_N_FILT 0 0 0 0 ECU_ADDRESS 0x3FA93C /end MEASUREMENT
/begin COMPU_METHOD MC_DIT_N_FILT "DIT_N_FILT conversion" RAT_FUNC "%10.5" "Unitless" COEFFS 0 1 0 0 0 1 /end COMPU_METHOD
/begin MEASUREMENT DIT_N_MAT_HI "" FLOAT32_IEEE MC_DIT_N_MAT_HI 0 0 0 0 ECU_ADDRESS 0x3FA95C /end MEASUREMENT
/begin COMPU_METHOD MC_DIT_N_MAT_HI "DIT_N_MAT_HI conversion" RAT_FUNC "%10.5" "Unitless" COEFFS 0 1 0 0 0 1 /end COMPU_METHOD
/begin MEASUREMENT DIT_N_MAT_LO "" FLOAT32_IEEE MC_DIT_N_MAT_LO 0 0 0 0 ECU_ADDRESS 0x3FA960 /end MEASUREMENT
/begin COMPU_METHOD MC_DIT_N_MAT_LO "DIT_N_MAT_LO conversion" RAT_FUNC "%10.5" "Unitless" COEFFS 0 1 0 0 0 1 /end COMPU_METHOD
/begin MEASUREMENT DLOAD_EXEC_KEY "Command Key byte to enable execution of a program downloaded from ODU" UWORD MC_DLOAD_EXEC_KEY 0 0 0 0 ECU_ADDRESS 0x3FB47A /end MEASUREMENT
/begin COMPU_METHOD MC_DLOAD_EXEC_KEY "DLOAD_EXEC_KEY conversion" RAT_FUNC "%5.0" "Unitless" COEFFS 0 1 0 0 0 1 /end COMPU_METHOD
/begin MEASUREMENT DNDTI "DERIVITIVE OF RPM (UNFILTERED)" FLOAT32_IEEE MC_DNDTI 0 0 0 0 ECU_ADDRESS 0x3F9C48 /end MEASUREMENT
/begin COMPU_METHOD MC_DNDTI "DNDTI conversion" RAT_FUNC "%10.5" "Unitless" COEFFS 0 1 0 0 0 1 /end COMPU_METHOD
/begin MEASUREMENT DNDT_RAW "Engine acceleration from engine position input driver (RPM/S)." FLOAT32_IEEE MC_DNDT_RAW 0 0 0 0 ECU_ADDRESS 0x3F9880 /end MEASUREMENT
/begin COMPU_METHOD MC_DNDT_RAW "DNDT_RAW conversion" RAT_FUNC "%10.5" "Unitless" COEFFS 0 1 0 0 0 1 /end COMPU_METHOD
/begin CHARACTERISTIC DNDT_THRESHOLD "" VALUE 0x5C478 SD_FLOAT32_IEEE 0 SC_DNDT_THRESHOLD 0 20000 /end CHARACTERISTIC
/begin COMPU_METHOD SC_DNDT_THRESHOLD "DNDT_THRESHOLD conversion" RAT_FUNC "%10.5" "RPM" COEFFS 0 1 0 0 0 1 /end COMPU_METHOD
/begin MEASUREMENT DNDT_TQI "Derivative of engine RPM for use in transmission input torque calculation, RPM/second." FLOAT32_IEEE MC_DNDT_TQI 0 0 0 0 ECU_ADDRESS 0x3FA66C /end MEASUREMENT
/begin COMPU_METHOD MC_DNDT_TQI "DNDT_TQI conversion" RAT_FUNC "%10.5" "Unitless" COEFFS 0 1 0 0 0 1 /end COMPU_METHOD
/begin MEASUREMENT DNEFMFLG "Engine speed rate of change calculation failure" UBYTE MC_DNEFMFLG 0 0 0 0 ECU_ADDRESS 0x3FA2C2 /end MEASUREMENT
/begin COMPU_METHOD MC_DNEFMFLG "DNEFMFLG conversion" RAT_FUNC "%3.0" "Unitless" COEFFS 0 1 0 0 0 1 /end COMPU_METHOD
/begin MEASUREMENT DN_FF_TMRCTL "Governor 'FF' term for D/N timer flag (1=count)" UBYTE MC_DN_FF_TMRCTL 0 0 0 0 ECU_ADDRESS 0x3FA7B8 /end MEASUREMENT
/begin COMPU_METHOD MC_DN_FF_TMRCTL "DN_FF_TMRCTL conversion" RAT_FUNC "%3.0" "Unitless" COEFFS 0 1 0 0 0 1 /end COMPU_METHOD
/begin MEASUREMENT DOL_COUNT "DOL COUNTS" UWORD MC_DOL_COUNT 0 0 0 0 ECU_ADDRESS 0x3FA7E4 /end MEASUREMENT
/begin COMPU_METHOD MC_DOL_COUNT "DOL_COUNT conversion" RAT_FUNC "%5.0" "Unitless" COEFFS 0 1 0 0 0 1 /end COMPU_METHOD
/begin MEASUREMENT DOT_NE "Engine speed derivative over time, rpm/sec." FLOAT32_IEEE MC_DOT_NE 0 0 0 0 ECU_ADDRESS 0x3FA284 /end MEASUREMENT
/begin COMPU_METHOD MC_DOT_NE "DOT_NE conversion" RAT_FUNC "%10.5" "Unitless" COEFFS 0 1 0 0 0 1 /end COMPU_METHOD
/begin MEASUREMENT DOT_VFD_FAN_N "Derivative value of the fan speed." FLOAT32_IEEE MC_DOT_VFD_FAN_N 0 0 0 0 ECU_ADDRESS 0x3FAA64 /end MEASUREMENT
/begin COMPU_METHOD MC_DOT_VFD_FAN_N "DOT_VFD_FAN_N conversion" RAT_FUNC "%10.5" "Unitless" COEFFS 0 1 0 0 0 1 /end COMPU_METHOD
/begin CHARACTERISTIC DPEGRDIFKF "" VALUE 0x5E550 SD_FLOAT32_IEEE 0 SC_DPEGRDIFKF 0 2 /end CHARACTERISTIC
/begin COMPU_METHOD SC_DPEGRDIFKF "DPEGRDIFKF conversion" RAT_FUNC "%10.5" "unitless" COEFFS 0 1 0 0 0 1 /end COMPU_METHOD
/begin MEASUREMENT DPFE_PRES "When = 1, indicates that dpfe hw is present.  Based on pfehp__a status." UBYTE MC_DPFE_PRES 0 0 0 0 ECU_ADDRESS 0x3FB785 /end MEASUREMENT
/begin COMPU_METHOD MC_DPFE_PRES "DPFE_PRES conversion" RAT_FUNC "%3.0" "Unitless" COEFFS 0 1 0 0 0 1 /end COMPU_METHOD
/begin MEASUREMENT DP_ANTI_FOUL_MLT "" FLOAT32_IEEE MC_DP_ANTI_FOUL_MLT 0 0 0 0 ECU_ADDRESS 0x3FADA0 /end MEASUREMENT
/begin COMPU_METHOD MC_DP_ANTI_FOUL_MLT "DP_ANTI_FOUL_MLT conversion" RAT_FUNC "%10.5" "Unitless" COEFFS 0 1 0 0 0 1 /end COMPU_METHOD
/begin MEASUREMENT DP_ANTI_FOUL_MULT "" FLOAT32_IEEE MC_DP_ANTI_FOUL_MULT 0 0 0 0 ECU_ADDRESS 0x3FADA4 /end MEASUREMENT
/begin COMPU_METHOD MC_DP_ANTI_FOUL_MULT "DP_ANTI_FOUL_MULT conversion" RAT_FUNC "%10.5" "Unitless" COEFFS 0 1 0 0 0 1 /end COMPU_METHOD
/begin MEASUREMENT DP_ANTI_FOUL_TMR "" FLOAT32_IEEE MC_DP_ANTI_FOUL_TMR 0 0 0 0 ECU_ADDRESS 0x3FAD9C /end MEASUREMENT
/begin COMPU_METHOD MC_DP_ANTI_FOUL_TMR "DP_ANTI_FOUL_TMR conversion" RAT_FUNC "%10.5" "Unitless" COEFFS 0 1 0 0 0 1 /end COMPU_METHOD
/begin CHARACTERISTIC DP_CLD_EN "" VALUE 0x5E610 SD_UBYTE 0 SC_DP_CLD_EN 0 1 /end CHARACTERISTIC
/begin COMPU_METHOD SC_DP_CLD_EN "DP_CLD_EN conversion" RAT_FUNC "%3.0" "g/cm3" COEFFS 0 1 0 0 0 1 /end COMPU_METHOD
/begin CHARACTERISTIC DP_COLD_TM1 "" VALUE 0x5E54C SD_FLOAT32_IEEE 0 SC_DP_COLD_TM1 0 100000 /end CHARACTERISTIC
/begin COMPU_METHOD SC_DP_COLD_TM1 "DP_COLD_TM1 conversion" RAT_FUNC "%10.5" "s" COEFFS 0 1 0 0 0 1 /end COMPU_METHOD
/begin CHARACTERISTIC DP_COLD_TM2 "" VALUE 0x5E548 SD_FLOAT32_IEEE 0 SC_DP_COLD_TM2 0 100000 /end CHARACTERISTIC
/begin COMPU_METHOD SC_DP_COLD_TM2 "DP_COLD_TM2 conversion" RAT_FUNC "%10.5" "s" COEFFS 0 1 0 0 0 1 /end COMPU_METHOD
/begin MEASUREMENT DP_COLD_TMR "" FLOAT32_IEEE MC_DP_COLD_TMR 0 0 0 0 ECU_ADDRESS 0x3FAD98 /end MEASUREMENT
/begin COMPU_METHOD MC_DP_COLD_TMR "DP_COLD_TMR conversion" RAT_FUNC "%10.5" "Unitless" COEFFS 0 1 0 0 0 1 /end COMPU_METHOD
/begin MEASUREMENT DP_DP "" FLOAT32_IEEE MC_DP_DP 0 0 0 0 ECU_ADDRESS 0x3FAD94 /end MEASUREMENT
/begin COMPU_METHOD MC_DP_DP "DP_DP conversion" RAT_FUNC "%10.5" "Unitless" COEFFS 0 1 0 0 0 1 /end COMPU_METHOD
/begin MEASUREMENT DP_EGRP_DES "" FLOAT32_IEEE MC_DP_EGRP_DES 0 0 0 0 ECU_ADDRESS 0x3FAD40 /end MEASUREMENT
/begin COMPU_METHOD MC_DP_EGRP_DES "DP_EGRP_DES conversion" RAT_FUNC "%10.5" "Unitless" COEFFS 0 1 0 0 0 1 /end COMPU_METHOD
/begin MEASUREMENT DP_EGRP_ERR "" FLOAT32_IEEE MC_DP_EGRP_ERR 0 0 0 0 ECU_ADDRESS 0x3FAD3C /end MEASUREMENT
/begin COMPU_METHOD MC_DP_EGRP_ERR "DP_EGRP_ERR conversion" RAT_FUNC "%10.5" "Unitless" COEFFS 0 1 0 0 0 1 /end COMPU_METHOD
/begin MEASUREMENT DP_EGRP_ERR_DER "" FLOAT32_IEEE MC_DP_EGRP_ERR_DER 0 0 0 0 ECU_ADDRESS 0x3FAD38 /end MEASUREMENT
/begin COMPU_METHOD MC_DP_EGRP_ERR_DER "DP_EGRP_ERR_DER conversion" RAT_FUNC "%10.5" "Unitless" COEFFS 0 1 0 0 0 1 /end COMPU_METHOD
/begin MEASUREMENT DP_EGRP_ERR_DER_DIFF "" FLOAT32_IEEE MC_DP_EGRP_ERR_DER_DIFF 0 0 0 0 ECU_ADDRESS 0x3FAD34 /end MEASUREMENT
/begin COMPU_METHOD MC_DP_EGRP_ERR_DER_DIFF "DP_EGRP_ERR_DER_DIFF conversion" RAT_FUNC "%10.5" "Unitless" COEFFS 0 1 0 0 0 1 /end COMPU_METHOD
/begin MEASUREMENT DP_EGRP_ERR_FILT "" FLOAT32_IEEE MC_DP_EGRP_ERR_FILT 0 0 0 0 ECU_ADDRESS 0x3FAD30 /end MEASUREMENT
/begin COMPU_METHOD MC_DP_EGRP_ERR_FILT "DP_EGRP_ERR_FILT conversion" RAT_FUNC "%10.5" "Unitless" COEFFS 0 1 0 0 0 1 /end COMPU_METHOD
/begin MEASUREMENT DP_EGRVP_DES "" FLOAT32_IEEE MC_DP_EGRVP_DES 0 0 0 0 ECU_ADDRESS 0x3FAD2C /end MEASUREMENT
/begin COMPU_METHOD MC_DP_EGRVP_DES "DP_EGRVP_DES conversion" RAT_FUNC "%10.5" "Unitless" COEFFS 0 1 0 0 0 1 /end COMPU_METHOD
/begin CHARACTERISTIC DP_EGR_COND_CAL "" VALUE 0x5E544 SD_FLOAT32_IEEE 0 SC_DP_EGR_COND_CAL 0 1 /end CHARACTERISTIC
/begin COMPU_METHOD SC_DP_EGR_COND_CAL "DP_EGR_COND_CAL conversion" RAT_FUNC "%10.5" "unitless" COEFFS 0 1 0 0 0 1 /end COMPU_METHOD
/begin CHARACTERISTIC DP_EGR_COND_SEL "" VALUE 0x5E60F SD_UBYTE 0 SC_DP_EGR_COND_SEL 0 1 /end CHARACTERISTIC
/begin COMPU_METHOD SC_DP_EGR_COND_SEL "DP_EGR_COND_SEL conversion" RAT_FUNC "%3.0" "unitless" COEFFS 0 1 0 0 0 1 /end COMPU_METHOD
/begin MEASUREMENT DP_EGR_DTY "" FLOAT32_IEEE MC_DP_EGR_DTY 0 0 0 0 ECU_ADDRESS 0x3FAD8C /end MEASUREMENT
/begin COMPU_METHOD MC_DP_EGR_DTY "DP_EGR_DTY conversion" RAT_FUNC "%10.5" "Unitless" COEFFS 0 1 0 0 0 1 /end COMPU_METHOD
/begin CHARACTERISTIC DP_EGR_DTY_CAL "" VALUE 0x5E538 SD_FLOAT32_IEEE 0 SC_DP_EGR_DTY_CAL 0 1 /end CHARACTERISTIC
/begin COMPU_METHOD SC_DP_EGR_DTY_CAL "DP_EGR_DTY_CAL conversion" RAT_FUNC "%10.5" "unitless" COEFFS 0 1 0 0 0 1 /end COMPU_METHOD
/begin CHARACTERISTIC DP_EGR_DTY_LMN "" VALUE 0x5E534 SD_FLOAT32_IEEE 0 SC_DP_EGR_DTY_LMN -1 1 /end CHARACTERISTIC
/begin COMPU_METHOD SC_DP_EGR_DTY_LMN "DP_EGR_DTY_LMN conversion" RAT_FUNC "%10.5" "unitless" COEFFS 0 1 0 0 0 1 /end COMPU_METHOD
/begin CHARACTERISTIC DP_EGR_DTY_LMX "" VALUE 0x5E530 SD_FLOAT32_IEEE 0 SC_DP_EGR_DTY_LMX 0 2 /end CHARACTERISTIC
/begin COMPU_METHOD SC_DP_EGR_DTY_LMX "DP_EGR_DTY_LMX conversion" RAT_FUNC "%10.5" "unitless" COEFFS 0 1 0 0 0 1 /end COMPU_METHOD
/begin MEASUREMENT DP_EGR_DUTY "" FLOAT32_IEEE MC_DP_EGR_DUTY 0 0 0 0 ECU_ADDRESS 0x3FAD88 /end MEASUREMENT
/begin COMPU_METHOD MC_DP_EGR_DUTY "DP_EGR_DUTY conversion" RAT_FUNC "%10.5" "Unitless" COEFFS 0 1 0 0 0 1 /end COMPU_METHOD
/begin CHARACTERISTIC DP_EGR_D_DTY_LMN "" VALUE 0x5E540 SD_FLOAT32_IEEE 0 SC_DP_EGR_D_DTY_LMN -1 2 /end CHARACTERISTIC
/begin COMPU_METHOD SC_DP_EGR_D_DTY_LMN "DP_EGR_D_DTY_LMN conversion" RAT_FUNC "%10.5" "unitless" COEFFS 0 1 0 0 0 1 /end COMPU_METHOD
/begin CHARACTERISTIC DP_EGR_D_DTY_LMX "" VALUE 0x5E53C SD_FLOAT32_IEEE 0 SC_DP_EGR_D_DTY_LMX 0 2 /end CHARACTERISTIC
/begin COMPU_METHOD SC_DP_EGR_D_DTY_LMX "DP_EGR_D_DTY_LMX conversion" RAT_FUNC "%10.5" "unitless" COEFFS 0 1 0 0 0 1 /end COMPU_METHOD
/begin MEASUREMENT DP_EGR_D_DUTY "" FLOAT32_IEEE MC_DP_EGR_D_DUTY 0 0 0 0 ECU_ADDRESS 0x3FAD90 /end MEASUREMENT
/begin COMPU_METHOD MC_DP_EGR_D_DUTY "DP_EGR_D_DUTY conversion" RAT_FUNC "%10.5" "Unitless" COEFFS 0 1 0 0 0 1 /end COMPU_METHOD
/begin MEASUREMENT DP_EGR_FF_DUTY "" FLOAT32_IEEE MC_DP_EGR_FF_DUTY 0 0 0 0 ECU_ADDRESS 0x3FAD84 /end MEASUREMENT
/begin COMPU_METHOD MC_DP_EGR_FF_DUTY "DP_EGR_FF_DUTY conversion" RAT_FUNC "%10.5" "Unitless" COEFFS 0 1 0 0 0 1 /end COMPU_METHOD
/begin MEASUREMENT DP_EGR_I "" FLOAT32_IEEE MC_DP_EGR_I 0 0 0 0 ECU_ADDRESS 0x3FAD80 /end MEASUREMENT
/begin COMPU_METHOD MC_DP_EGR_I "DP_EGR_I conversion" RAT_FUNC "%10.5" "Unitless" COEFFS 0 1 0 0 0 1 /end COMPU_METHOD
/begin MEASUREMENT DP_EGR_I_DUTY "" FLOAT32_IEEE MC_DP_EGR_I_DUTY 0 0 0 0 ECU_ADDRESS 0x3FAD7C /end MEASUREMENT
/begin COMPU_METHOD MC_DP_EGR_I_DUTY "DP_EGR_I_DUTY conversion" RAT_FUNC "%10.5" "Unitless" COEFFS 0 1 0 0 0 1 /end COMPU_METHOD
/begin MEASUREMENT DP_EGR_I_ERR "" FLOAT32_IEEE MC_DP_EGR_I_ERR 0 0 0 0 ECU_ADDRESS 0x3FAD78 /end MEASUREMENT
/begin COMPU_METHOD MC_DP_EGR_I_ERR "DP_EGR_I_ERR conversion" RAT_FUNC "%10.5" "Unitless" COEFFS 0 1 0 0 0 1 /end COMPU_METHOD
/begin CHARACTERISTIC DP_EGR_I_LMN "" VALUE 0x5E52C SD_FLOAT32_IEEE 0 SC_DP_EGR_I_LMN -1 1 /end CHARACTERISTIC
/begin COMPU_METHOD SC_DP_EGR_I_LMN "DP_EGR_I_LMN conversion" RAT_FUNC "%10.5" "unitless" COEFFS 0 1 0 0 0 1 /end COMPU_METHOD
/begin CHARACTERISTIC DP_EGR_I_LMX "" VALUE 0x5E528 SD_FLOAT32_IEEE 0 SC_DP_EGR_I_LMX 0 1 /end CHARACTERISTIC
/begin COMPU_METHOD SC_DP_EGR_I_LMX "DP_EGR_I_LMX conversion" RAT_FUNC "%10.5" "unitless" COEFFS 0 1 0 0 0 1 /end COMPU_METHOD
/begin CHARACTERISTIC DP_EGR_LI_ACTV "" VALUE 0x5E60E SD_UBYTE 0 SC_DP_EGR_LI_ACTV 0 1 /end CHARACTERISTIC
/begin COMPU_METHOD SC_DP_EGR_LI_ACTV "DP_EGR_LI_ACTV conversion" RAT_FUNC "%3.0" "unitless" COEFFS 0 1 0 0 0 1 /end COMPU_METHOD
/begin CHARACTERISTIC DP_EGR_LI_ACTV_TM "" VALUE 0x5E524 SD_FLOAT32_IEEE 0 SC_DP_EGR_LI_ACTV_TM 0 5 /end CHARACTERISTIC
/begin COMPU_METHOD SC_DP_EGR_LI_ACTV_TM "DP_EGR_LI_ACTV_TM conversion" RAT_FUNC "%10.5" "unitless" COEFFS 0 1 0 0 0 1 /end COMPU_METHOD
/begin MEASUREMENT DP_EGR_LI_ACTV_TMR "" FLOAT32_IEEE MC_DP_EGR_LI_ACTV_TMR 0 0 0 0 ECU_ADDRESS 0x3FAD74 /end MEASUREMENT
/begin COMPU_METHOD MC_DP_EGR_LI_ACTV_TMR "DP_EGR_LI_ACTV_TMR conversion" RAT_FUNC "%10.5" "Unitless" COEFFS 0 1 0 0 0 1 /end COMPU_METHOD
/begin MEASUREMENT DP_EGR_LI_DUTY "" FLOAT32_IEEE MC_DP_EGR_LI_DUTY 0 0 0 0 ECU_ADDRESS 0x3FAD70 /end MEASUREMENT
/begin COMPU_METHOD MC_DP_EGR_LI_DUTY "DP_EGR_LI_DUTY conversion" RAT_FUNC "%10.5" "Unitless" COEFFS 0 1 0 0 0 1 /end COMPU_METHOD
/begin CHARACTERISTIC DP_EGR_LI_ERR_BAND "" VALUE 0x5E520 SD_FLOAT32_IEEE 0 SC_DP_EGR_LI_ERR_BAND -1 1 /end CHARACTERISTIC
/begin COMPU_METHOD SC_DP_EGR_LI_ERR_BAND "DP_EGR_LI_ERR_BAND conversion" RAT_FUNC "%10.5" "unitless" COEFFS 0 1 0 0 0 1 /end COMPU_METHOD
/begin MEASUREMENT DP_EGR_MAF_SENSOR_FAULT "" UBYTE MC_DP_EGR_MAF_SENSOR_FAULT 0 0 0 0 ECU_ADDRESS 0x3FAE13 /end MEASUREMENT
/begin COMPU_METHOD MC_DP_EGR_MAF_SENSOR_FAULT "DP_EGR_MAF_SENSOR_FAULT conversion" RAT_FUNC "%3.0" "Unitless" COEFFS 0 1 0 0 0 1 /end COMPU_METHOD
/begin MEASUREMENT DP_EGR_MAP_EBP_SENSOR_FAULT "" UBYTE MC_DP_EGR_MAP_EBP_SENSOR_FAULT 0 0 0 0 ECU_ADDRESS 0x3FAE12 /end MEASUREMENT
/begin COMPU_METHOD MC_DP_EGR_MAP_EBP_SENSOR_FAULT "DP_EGR_MAP_EBP_SENSOR_FAULT conversion" RAT_FUNC "%3.0" "Unitless" COEFFS 0 1 0 0 0 1 /end COMPU_METHOD
/begin MEASUREMENT DP_EGR_MFLOW_DES "" FLOAT32_IEEE MC_DP_EGR_MFLOW_DES 0 0 0 0 ECU_ADDRESS 0x3FAD6C /end MEASUREMENT
/begin COMPU_METHOD MC_DP_EGR_MFLOW_DES "DP_EGR_MFLOW_DES conversion" RAT_FUNC "%10.5" "Unitless" COEFFS 0 1 0 0 0 1 /end COMPU_METHOD
/begin MEASUREMENT DP_EGR_MFLW "" FLOAT32_IEEE MC_DP_EGR_MFLW 0 0 0 0 ECU_ADDRESS 0x3FAD68 /end MEASUREMENT
/begin COMPU_METHOD MC_DP_EGR_MFLW "DP_EGR_MFLW conversion" RAT_FUNC "%10.5" "Unitless" COEFFS 0 1 0 0 0 1 /end COMPU_METHOD
/begin CHARACTERISTIC DP_EGR_MFLW_CAL "" VALUE 0x5E51C SD_FLOAT32_IEEE 0 SC_DP_EGR_MFLW_CAL 0 10000 /end CHARACTERISTIC
/begin COMPU_METHOD SC_DP_EGR_MFLW_CAL "DP_EGR_MFLW_CAL conversion" RAT_FUNC "%10.5" "unitless" COEFFS 0 1 0 0 0 1 /end COMPU_METHOD
/begin MEASUREMENT DP_EGR_N_DIFF_FILT "" FLOAT32_IEEE MC_DP_EGR_N_DIFF_FILT 0 0 0 0 ECU_ADDRESS 0x3FAD64 /end MEASUREMENT
/begin COMPU_METHOD MC_DP_EGR_N_DIFF_FILT "DP_EGR_N_DIFF_FILT conversion" RAT_FUNC "%10.5" "Unitless" COEFFS 0 1 0 0 0 1 /end COMPU_METHOD
/begin MEASUREMENT DP_EGR_N_FILT "" FLOAT32_IEEE MC_DP_EGR_N_FILT 0 0 0 0 ECU_ADDRESS 0x3FAD60 /end MEASUREMENT
/begin COMPU_METHOD MC_DP_EGR_N_FILT "DP_EGR_N_FILT conversion" RAT_FUNC "%10.5" "Unitless" COEFFS 0 1 0 0 0 1 /end COMPU_METHOD
/begin MEASUREMENT DP_EGR_PCT "" FLOAT32_IEEE MC_DP_EGR_PCT 0 0 0 0 ECU_ADDRESS 0x3FAD58 /end MEASUREMENT
/begin COMPU_METHOD MC_DP_EGR_PCT "DP_EGR_PCT conversion" RAT_FUNC "%10.5" "Unitless" COEFFS 0 1 0 0 0 1 /end COMPU_METHOD
/begin CHARACTERISTIC DP_EGR_PCT_CAL "" VALUE 0x5E518 SD_FLOAT32_IEEE 0 SC_DP_EGR_PCT_CAL 0 1 /end CHARACTERISTIC
/begin COMPU_METHOD SC_DP_EGR_PCT_CAL "DP_EGR_PCT_CAL conversion" RAT_FUNC "%10.5" "unitless" COEFFS 0 1 0 0 0 1 /end COMPU_METHOD
/begin MEASUREMENT DP_EGR_PCT_DES "" FLOAT32_IEEE MC_DP_EGR_PCT_DES 0 0 0 0 ECU_ADDRESS 0x3FAD54 /end MEASUREMENT
/begin COMPU_METHOD MC_DP_EGR_PCT_DES "DP_EGR_PCT_DES conversion" RAT_FUNC "%10.5" "Unitless" COEFFS 0 1 0 0 0 1 /end COMPU_METHOD
/begin MEASUREMENT DP_EGR_PCT_DES_HI "" FLOAT32_IEEE MC_DP_EGR_PCT_DES_HI 0 0 0 0 ECU_ADDRESS 0x3FAD50 /end MEASUREMENT
/begin COMPU_METHOD MC_DP_EGR_PCT_DES_HI "DP_EGR_PCT_DES_HI conversion" RAT_FUNC "%10.5" "Unitless" COEFFS 0 1 0 0 0 1 /end COMPU_METHOD
/begin MEASUREMENT DP_EGR_PCT_DES_LO "" FLOAT32_IEEE MC_DP_EGR_PCT_DES_LO 0 0 0 0 ECU_ADDRESS 0x3FAD4C /end MEASUREMENT
/begin COMPU_METHOD MC_DP_EGR_PCT_DES_LO "DP_EGR_PCT_DES_LO conversion" RAT_FUNC "%10.5" "Unitless" COEFFS 0 1 0 0 0 1 /end COMPU_METHOD
/begin MEASUREMENT DP_EGR_PCT_LMX "" FLOAT32_IEEE MC_DP_EGR_PCT_LMX 0 0 0 0 ECU_ADDRESS 0x3FAD48 /end MEASUREMENT
/begin COMPU_METHOD MC_DP_EGR_PCT_LMX "DP_EGR_PCT_LMX conversion" RAT_FUNC "%10.5" "Unitless" COEFFS 0 1 0 0 0 1 /end COMPU_METHOD
/begin MEASUREMENT DP_EGR_PCT_TBL "" FLOAT32_IEEE MC_DP_EGR_PCT_TBL 0 0 0 0 ECU_ADDRESS 0x3FAD44 /end MEASUREMENT
/begin COMPU_METHOD MC_DP_EGR_PCT_TBL "DP_EGR_PCT_TBL conversion" RAT_FUNC "%10.5" "Unitless" COEFFS 0 1 0 0 0 1 /end COMPU_METHOD
/begin CHARACTERISTIC DP_EGR_PID_KD "" VALUE 0x5E514 SD_FLOAT32_IEEE 0 SC_DP_EGR_PID_KD 0 1 /end CHARACTERISTIC
/begin COMPU_METHOD SC_DP_EGR_PID_KD "DP_EGR_PID_KD conversion" RAT_FUNC "%10.5" "unitless" COEFFS 0 1 0 0 0 1 /end COMPU_METHOD
/begin CHARACTERISTIC DP_EGR_PID_KI "" VALUE 0x5E510 SD_FLOAT32_IEEE 0 SC_DP_EGR_PID_KI 0 1 /end CHARACTERISTIC
/begin COMPU_METHOD SC_DP_EGR_PID_KI "DP_EGR_PID_KI conversion" RAT_FUNC "%10.5" "unitless" COEFFS 0 1 0 0 0 1 /end COMPU_METHOD
/begin CHARACTERISTIC DP_EGR_PID_KP "" VALUE 0x5E50C SD_FLOAT32_IEEE 0 SC_DP_EGR_PID_KP 0 1 /end CHARACTERISTIC
/begin COMPU_METHOD SC_DP_EGR_PID_KP "DP_EGR_PID_KP conversion" RAT_FUNC "%10.5" "unitless" COEFFS 0 1 0 0 0 1 /end COMPU_METHOD
/begin MEASUREMENT DP_EGR_P_DUTY "" FLOAT32_IEEE MC_DP_EGR_P_DUTY 0 0 0 0 ECU_ADDRESS 0x3FAD5C /end MEASUREMENT
/begin COMPU_METHOD MC_DP_EGR_P_DUTY "DP_EGR_P_DUTY conversion" RAT_FUNC "%10.5" "Unitless" COEFFS 0 1 0 0 0 1 /end COMPU_METHOD
/begin CHARACTERISTIC DP_EGR_SEL "" VALUE 0x5E60D SD_UBYTE 0 SC_DP_EGR_SEL 0 4 /end CHARACTERISTIC
/begin COMPU_METHOD SC_DP_EGR_SEL "DP_EGR_SEL conversion" RAT_FUNC "%3.0" "unitless" COEFFS 0 1 0 0 0 1 /end COMPU_METHOD
/begin CHARACTERISTIC DP_EGR_VP_CAL "" VALUE 0x5E508 SD_FLOAT32_IEEE 0 SC_DP_EGR_VP_CAL 0 1 /end CHARACTERISTIC
/begin COMPU_METHOD SC_DP_EGR_VP_CAL "DP_EGR_VP_CAL conversion" RAT_FUNC "%10.5" "unitless" COEFFS 0 1 0 0 0 1 /end COMPU_METHOD
/begin CHARACTERISTIC DP_FLT_COF_A "" VALUE 0x5E504 SD_FLOAT32_IEEE 0 SC_DP_FLT_COF_A -2 2 /end CHARACTERISTIC
/begin COMPU_METHOD SC_DP_FLT_COF_A "DP_FLT_COF_A conversion" RAT_FUNC "%10.5" "unitless" COEFFS 0 1 0 0 0 1 /end COMPU_METHOD
/begin CHARACTERISTIC DP_FLT_COF_B "" VALUE 0x5E500 SD_FLOAT32_IEEE 0 SC_DP_FLT_COF_B -2 2 /end CHARACTERISTIC
/begin COMPU_METHOD SC_DP_FLT_COF_B "DP_FLT_COF_B conversion" RAT_FUNC "%10.5" "unitless" COEFFS 0 1 0 0 0 1 /end COMPU_METHOD
/begin CHARACTERISTIC DP_FLT_COF_C "" VALUE 0x5E4FC SD_FLOAT32_IEEE 0 SC_DP_FLT_COF_C -2 2 /end CHARACTERISTIC
/begin COMPU_METHOD SC_DP_FLT_COF_C "DP_FLT_COF_C conversion" RAT_FUNC "%10.5" "unitless" COEFFS 0 1 0 0 0 1 /end COMPU_METHOD
/begin CHARACTERISTIC DP_FLT_COF_D "" VALUE 0x5E4F8 SD_FLOAT32_IEEE 0 SC_DP_FLT_COF_D -2 2 /end CHARACTERISTIC
/begin COMPU_METHOD SC_DP_FLT_COF_D "DP_FLT_COF_D conversion" RAT_FUNC "%10.5" "unitless" COEFFS 0 1 0 0 0 1 /end COMPU_METHOD
/begin CHARACTERISTIC DP_FLT_COF_E "" VALUE 0x5E4F4 SD_FLOAT32_IEEE 0 SC_DP_FLT_COF_E -2 2 /end CHARACTERISTIC
/begin COMPU_METHOD SC_DP_FLT_COF_E "DP_FLT_COF_E conversion" RAT_FUNC "%10.5" "unitless" COEFFS 0 1 0 0 0 1 /end COMPU_METHOD
/begin CHARACTERISTIC DP_FLT_COF_F "" VALUE 0x5E4F0 SD_FLOAT32_IEEE 0 SC_DP_FLT_COF_F -2 2 /end CHARACTERISTIC
/begin COMPU_METHOD SC_DP_FLT_COF_F "DP_FLT_COF_F conversion" RAT_FUNC "%10.5" "unitless" COEFFS 0 1 0 0 0 1 /end COMPU_METHOD
/begin CHARACTERISTIC DP_ITH_COND_SEL "" VALUE 0x5E609 SD_UBYTE 0 SC_DP_ITH_COND_SEL 0 1 /end CHARACTERISTIC
/begin COMPU_METHOD SC_DP_ITH_COND_SEL "DP_ITH_COND_SEL conversion" RAT_FUNC "%3.0" "unitless" COEFFS 0 1 0 0 0 1 /end COMPU_METHOD
/begin MEASUREMENT DP_MAF_TRNS_MULT "" FLOAT32_IEEE MC_DP_MAF_TRNS_MULT 0 0 0 0 ECU_ADDRESS 0x3FAD28 /end MEASUREMENT
/begin COMPU_METHOD MC_DP_MAF_TRNS_MULT "DP_MAF_TRNS_MULT conversion" RAT_FUNC "%10.5" "Unitless" COEFFS 0 1 0 0 0 1 /end COMPU_METHOD
/begin MEASUREMENT DP_MAT_MULT "" FLOAT32_IEEE MC_DP_MAT_MULT 0 0 0 0 ECU_ADDRESS 0x3FAD24 /end MEASUREMENT
/begin COMPU_METHOD MC_DP_MAT_MULT "DP_MAT_MULT conversion" RAT_FUNC "%10.5" "Unitless" COEFFS 0 1 0 0 0 1 /end COMPU_METHOD
/begin MEASUREMENT DP_MFDES_DIFF "" FLOAT32_IEEE MC_DP_MFDES_DIFF 0 0 0 0 ECU_ADDRESS 0x3FAD20 /end MEASUREMENT
/begin COMPU_METHOD MC_DP_MFDES_DIFF "DP_MFDES_DIFF conversion" RAT_FUNC "%10.5" "Unitless" COEFFS 0 1 0 0 0 1 /end COMPU_METHOD
/begin MEASUREMENT DP_MFDES_FILT "" FLOAT32_IEEE MC_DP_MFDES_FILT 0 0 0 0 ECU_ADDRESS 0x3FAD1C /end MEASUREMENT
/begin COMPU_METHOD MC_DP_MFDES_FILT "DP_MFDES_FILT conversion" RAT_FUNC "%10.5" "Unitless" COEFFS 0 1 0 0 0 1 /end COMPU_METHOD
/begin CHARACTERISTIC DP_MF_TRNS_KF "" VALUE 0x5E4EC SD_FLOAT32_IEEE 0 SC_DP_MF_TRNS_KF 0 10 /end CHARACTERISTIC
/begin COMPU_METHOD SC_DP_MF_TRNS_KF "DP_MF_TRNS_KF conversion" RAT_FUNC "%10.5" "unitless" COEFFS 0 1 0 0 0 1 /end COMPU_METHOD
/begin MEASUREMENT DP_MF_TRNS_MULT "" FLOAT32_IEEE MC_DP_MF_TRNS_MULT 0 0 0 0 ECU_ADDRESS 0x3FAD18 /end MEASUREMENT
/begin COMPU_METHOD MC_DP_MF_TRNS_MULT "DP_MF_TRNS_MULT conversion" RAT_FUNC "%10.5" "Unitless" COEFFS 0 1 0 0 0 1 /end COMPU_METHOD
/begin CHARACTERISTIC DP_NERR_LIMIT "" VALUE 0x5E4E4 SD_FLOAT32_IEEE 0 SC_DP_NERR_LIMIT 0 1000 /end CHARACTERISTIC
/begin COMPU_METHOD SC_DP_NERR_LIMIT "DP_NERR_LIMIT conversion" RAT_FUNC "%10.5" "RPM" COEFFS 0 1 0 0 0 1 /end COMPU_METHOD
/begin CHARACTERISTIC DP_N_IDLE_MX "" VALUE 0x5E4E8 SD_FLOAT32_IEEE 0 SC_DP_N_IDLE_MX 0 2000 /end CHARACTERISTIC
/begin COMPU_METHOD SC_DP_N_IDLE_MX "DP_N_IDLE_MX conversion" RAT_FUNC "%10.5" "RPM" COEFFS 0 1 0 0 0 1 /end COMPU_METHOD
/begin MEASUREMENT DP_PLUS "" FLOAT32_IEEE MC_DP_PLUS 0 0 0 0 ECU_ADDRESS 0x3FAD14 /end MEASUREMENT
/begin COMPU_METHOD MC_DP_PLUS "DP_PLUS conversion" RAT_FUNC "%10.5" "Unitless" COEFFS 0 1 0 0 0 1 /end COMPU_METHOD
/begin CHARACTERISTIC DP_SS_EGR_ERR_LMT "" VALUE 0x5D0BC SD_FLOAT32_IEEE 0 SC_DP_SS_EGR_ERR_LMT 0 5000 /end CHARACTERISTIC
/begin COMPU_METHOD SC_DP_SS_EGR_ERR_LMT "DP_SS_EGR_ERR_LMT conversion" RAT_FUNC "%10.5" "unitless" COEFFS 0 1 0 0 0 1 /end COMPU_METHOD
/begin CHARACTERISTIC DP_SS_EGR_ERR_TM "" VALUE 0x5D0C0 SD_FLOAT32_IEEE 0 SC_DP_SS_EGR_ERR_TM 0 65535 /end CHARACTERISTIC
/begin COMPU_METHOD SC_DP_SS_EGR_ERR_TM "DP_SS_EGR_ERR_TM conversion" RAT_FUNC "%10.5" "s" COEFFS 0 1 0 0 0 1 /end COMPU_METHOD
/begin MEASUREMENT DP_SS_EGR_TMR "" FLOAT32_IEEE MC_DP_SS_EGR_TMR 0 0 0 0 ECU_ADDRESS 0x3F9FA8 /end MEASUREMENT
/begin COMPU_METHOD MC_DP_SS_EGR_TMR "DP_SS_EGR_TMR conversion" RAT_FUNC "%10.5" "Unitless" COEFFS 0 1 0 0 0 1 /end COMPU_METHOD
/begin MEASUREMENT DP_SS_EGR_UPD_TMR "" FLOAT32_IEEE MC_DP_SS_EGR_UPD_TMR 0 0 0 0 ECU_ADDRESS 0x3F9FA4 /end MEASUREMENT
/begin COMPU_METHOD MC_DP_SS_EGR_UPD_TMR "DP_SS_EGR_UPD_TMR conversion" RAT_FUNC "%10.5" "Unitless" COEFFS 0 1 0 0 0 1 /end COMPU_METHOD
/begin MEASUREMENT DP_TOT_MASS_FLOW "" FLOAT32_IEEE MC_DP_TOT_MASS_FLOW 0 0 0 0 ECU_ADDRESS 0x3FAD10 /end MEASUREMENT
/begin COMPU_METHOD MC_DP_TOT_MASS_FLOW "DP_TOT_MASS_FLOW conversion" RAT_FUNC "%10.5" "Unitless" COEFFS 0 1 0 0 0 1 /end COMPU_METHOD
/begin MEASUREMENT DP_VOL_EFF_TBL "" FLOAT32_IEEE MC_DP_VOL_EFF_TBL 0 0 0 0 ECU_ADDRESS 0x3FAD0C /end MEASUREMENT
/begin COMPU_METHOD MC_DP_VOL_EFF_TBL "DP_VOL_EFF_TBL conversion" RAT_FUNC "%10.5" "Unitless" COEFFS 0 1 0 0 0 1 /end COMPU_METHOD
/begin MEASUREMENT DRIVE_COUNT "Count of number of OBD-II drive cycles completed." UWORD MC_DRIVE_COUNT 0 0 0 0 ECU_ADDRESS 0x3FCCA0 /end MEASUREMENT
/begin COMPU_METHOD MC_DRIVE_COUNT "DRIVE_COUNT conversion" RAT_FUNC "%5.0" "Unitless" COEFFS 0 1 0 0 0 1 /end COMPU_METHOD
/begin MEASUREMENT DRIVE_CYCLE "Flag indicating if out of crank this powerup" UBYTE MC_DRIVE_CYCLE 0 0 0 0 ECU_ADDRESS 0x3FCCA2 /end MEASUREMENT
/begin COMPU_METHOD MC_DRIVE_CYCLE "DRIVE_CYCLE conversion" RAT_FUNC "%3.0" "Unitless" COEFFS 0 1 0 0 0 1 /end COMPU_METHOD
/begin CHARACTERISTIC DSFP_EO_DT_SW "switch to enable FP primary test during KOEO" VALUE 0x5EACB SD_UBYTE 0 SC_DSFP_EO_DT_SW 0 1 /end CHARACTERISTIC
/begin COMPU_METHOD SC_DSFP_EO_DT_SW "DSFP_EO_DT_SW conversion" RAT_FUNC "%3.0" "unitless" COEFFS 0 1 0 0 0 1 /end COMPU_METHOD
/begin CHARACTERISTIC DSFP_EO_ST_SW "switch to enable FP secondary test during KOEO" VALUE 0x5EACA SD_UBYTE 0 SC_DSFP_EO_ST_SW 0 1 /end CHARACTERISTIC
/begin COMPU_METHOD SC_DSFP_EO_ST_SW "DSFP_EO_ST_SW conversion" RAT_FUNC "%3.0" "unitless" COEFFS 0 1 0 0 0 1 /end COMPU_METHOD
/begin CHARACTERISTIC DSFP_ER_DT_SW "switch to enable FP primary test during KOER" VALUE 0x5EAC9 SD_UBYTE 0 SC_DSFP_ER_DT_SW 0 1 /end CHARACTERISTIC
/begin COMPU_METHOD SC_DSFP_ER_DT_SW "DSFP_ER_DT_SW conversion" RAT_FUNC "%3.0" "unitless" COEFFS 0 1 0 0 0 1 /end COMPU_METHOD
/begin CHARACTERISTIC DSFP_ER_ST_SW "switch to enable FP secondary test during KOER" VALUE 0x5EAC8 SD_UBYTE 0 SC_DSFP_ER_ST_SW 0 1 /end CHARACTERISTIC
/begin COMPU_METHOD SC_DSFP_ER_ST_SW "DSFP_ER_ST_SW conversion" RAT_FUNC "%3.0" "unitless" COEFFS 0 1 0 0 0 1 /end COMPU_METHOD
/begin CHARACTERISTIC DSFP_OSM_ENA "switch to enable FP OSM test" VALUE 0x5EACD SD_UBYTE 0 SC_DSFP_OSM_ENA 0 1 /end CHARACTERISTIC
/begin COMPU_METHOD SC_DSFP_OSM_ENA "DSFP_OSM_ENA conversion" RAT_FUNC "%3.0" "unitless" COEFFS 0 1 0 0 0 1 /end COMPU_METHOD
/begin CHARACTERISTIC DSFP_OT_DT_SW "switch to enable FP primary circuit test when OSM_EO_ON == 1" VALUE 0x5EAC7 SD_UBYTE 0 SC_DSFP_OT_DT_SW 0 1 /end CHARACTERISTIC
/begin COMPU_METHOD SC_DSFP_OT_DT_SW "DSFP_OT_DT_SW conversion" RAT_FUNC "%3.0" "unitless" COEFFS 0 1 0 0 0 1 /end COMPU_METHOD
/begin CHARACTERISTIC DSFP_OT_ST_SW "switch to enable FP secondary circuit test when OSM_EO_ON == 1" VALUE 0x5EAC6 SD_UBYTE 0 SC_DSFP_OT_ST_SW 0 1 /end CHARACTERISTIC
/begin COMPU_METHOD SC_DSFP_OT_ST_SW "DSFP_OT_ST_SW conversion" RAT_FUNC "%3.0" "unitless" COEFFS 0 1 0 0 0 1 /end COMPU_METHOD
/begin CHARACTERISTIC DSFP_PU_DT_SW "switch to enable FP primary circuit test on power up." VALUE 0x5EAC5 SD_UBYTE 0 SC_DSFP_PU_DT_SW 0 1 /end CHARACTERISTIC
/begin COMPU_METHOD SC_DSFP_PU_DT_SW "DSFP_PU_DT_SW conversion" RAT_FUNC "%3.0" "unitless" COEFFS 0 1 0 0 0 1 /end COMPU_METHOD
/begin CHARACTERISTIC DSFP_PU_ST_SW "switch to enable FP secondary circuit test on power up." VALUE 0x5EAC4 SD_UBYTE 0 SC_DSFP_PU_ST_SW 0 1 /end CHARACTERISTIC
/begin COMPU_METHOD SC_DSFP_PU_ST_SW "DSFP_PU_ST_SW conversion" RAT_FUNC "%3.0" "unitless" COEFFS 0 1 0 0 0 1 /end COMPU_METHOD
/begin CHARACTERISTIC DSFP_PU_TM "EEC stabilization time before testing fuel pump" VALUE 0x5EAA0 SD_FLOAT32_IEEE 0 SC_DSFP_PU_TM 0 64 /end CHARACTERISTIC
/begin COMPU_METHOD SC_DSFP_PU_TM "DSFP_PU_TM conversion" RAT_FUNC "%10.5" "s" COEFFS 0 1 0 0 0 1 /end COMPU_METHOD
/begin MEASUREMENT DSSPD_ACCEL_RATE "" FLOAT32_IEEE MC_DSSPD_ACCEL_RATE 0 0 0 0 ECU_ADDRESS 0x3FB14C /end MEASUREMENT
/begin COMPU_METHOD MC_DSSPD_ACCEL_RATE "DSSPD_ACCEL_RATE conversion" RAT_FUNC "%10.5" "Unitless" COEFFS 0 1 0 0 0 1 /end COMPU_METHOD
/begin CHARACTERISTIC DSSPD_ACCL_OFF "Span between dsspd_mph_hold and dsspd_mph_sp, which will cause accl rate to be scaled." VALUE 0x5EA40 SD_FLOAT32_IEEE 0 SC_DSSPD_ACCL_OFF 0 10 /end CHARACTERISTIC
/begin COMPU_METHOD SC_DSSPD_ACCL_OFF "DSSPD_ACCL_OFF conversion" RAT_FUNC "%10.5" "unitless" COEFFS 0 1 0 0 0 1 /end COMPU_METHOD
/begin MEASUREMENT DSSPD_ANC_ACTIVE "" UBYTE MC_DSSPD_ANC_ACTIVE 0 0 0 0 ECU_ADDRESS 0x3FB18E /end MEASUREMENT
/begin COMPU_METHOD MC_DSSPD_ANC_ACTIVE "DSSPD_ANC_ACTIVE conversion" RAT_FUNC "%3.0" "Unitless" COEFFS 0 1 0 0 0 1 /end COMPU_METHOD
/begin CHARACTERISTIC DSSPD_ANC_CONF "" VALUE 0x5EA77 SD_UBYTE 0 SC_DSSPD_ANC_CONF 0 255 /end CHARACTERISTIC
/begin COMPU_METHOD SC_DSSPD_ANC_CONF "DSSPD_ANC_CONF conversion" RAT_FUNC "%3.0" "unitless" COEFFS 0 1 0 0 0 1 /end COMPU_METHOD
/begin MEASUREMENT DSSPD_ANC_NDES "Desired anciaalry Engine speed (RPM)" FLOAT32_IEEE MC_DSSPD_ANC_NDES 0 0 0 0 ECU_ADDRESS 0x3FB180 /end MEASUREMENT
/begin COMPU_METHOD MC_DSSPD_ANC_NDES "DSSPD_ANC_NDES conversion" RAT_FUNC "%10.5" "Unitless" COEFFS 0 1 0 0 0 1 /end COMPU_METHOD
/begin MEASUREMENT DSSPD_ANC_STATUS "" UWORD MC_DSSPD_ANC_STATUS 0 0 0 0 ECU_ADDRESS 0x3FB184 /end MEASUREMENT
/begin COMPU_METHOD MC_DSSPD_ANC_STATUS "DSSPD_ANC_STATUS conversion" RAT_FUNC "%5.0" "Unitless" COEFFS 0 1 0 0 0 1 /end COMPU_METHOD
/begin MEASUREMENT DSSPD_ANC_TLAST "timer for last value in anc control." ULONG MC_DSSPD_ANC_TLAST 0 0 0 0 ECU_ADDRESS 0x3FB164 /end MEASUREMENT
/begin COMPU_METHOD MC_DSSPD_ANC_TLAST "DSSPD_ANC_TLAST conversion" RAT_FUNC "%10.0" "Unitless" COEFFS 0 1 0 0 0 1 /end COMPU_METHOD
/begin MEASUREMENT DSSPD_ARCRMP_RESEED "" UBYTE MC_DSSPD_ARCRMP_RESEED 0 0 0 0 ECU_ADDRESS 0x3FB15E /end MEASUREMENT
/begin COMPU_METHOD MC_DSSPD_ARCRMP_RESEED "DSSPD_ARCRMP_RESEED conversion" RAT_FUNC "%3.0" "Unitless" COEFFS 0 1 0 0 0 1 /end COMPU_METHOD
/begin MEASUREMENT DSSPD_BAILOUT_HND "" UBYTE MC_DSSPD_BAILOUT_HND 0 0 0 0 ECU_ADDRESS 0x3FB15F /end MEASUREMENT
/begin COMPU_METHOD MC_DSSPD_BAILOUT_HND "DSSPD_BAILOUT_HND conversion" RAT_FUNC "%3.0" "Unitless" COEFFS 0 1 0 0 0 1 /end COMPU_METHOD
/begin MEASUREMENT DSSPD_CMND_LST "" UBYTE MC_DSSPD_CMND_LST 0 0 0 0 ECU_ADDRESS 0x3FB161 /end MEASUREMENT
/begin COMPU_METHOD MC_DSSPD_CMND_LST "DSSPD_CMND_LST conversion" RAT_FUNC "%3.0" "Unitless" COEFFS 0 1 0 0 0 1 /end COMPU_METHOD
/begin MEASUREMENT DSSPD_FN426 "" FLOAT32_IEEE MC_DSSPD_FN426 0 0 0 0 ECU_ADDRESS 0x3FB130 /end MEASUREMENT
/begin COMPU_METHOD MC_DSSPD_FN426 "DSSPD_FN426 conversion" RAT_FUNC "%10.5" "Unitless" COEFFS 0 1 0 0 0 1 /end COMPU_METHOD
/begin MEASUREMENT DSSPD_FN427 "" FLOAT32_IEEE MC_DSSPD_FN427 0 0 0 0 ECU_ADDRESS 0x3FB12C /end MEASUREMENT
/begin COMPU_METHOD MC_DSSPD_FN427 "DSSPD_FN427 conversion" RAT_FUNC "%10.5" "Unitless" COEFFS 0 1 0 0 0 1 /end COMPU_METHOD
/begin MEASUREMENT DSSPD_HND "" UWORD MC_DSSPD_HND 0 0 0 0 ECU_ADDRESS 0x3FB15C /end MEASUREMENT
/begin COMPU_METHOD MC_DSSPD_HND "DSSPD_HND conversion" RAT_FUNC "%5.0" "Unitless" COEFFS 0 1 0 0 0 1 /end COMPU_METHOD
/begin CHARACTERISTIC DSSPD_KACL_FINAL "" VALUE 0x5EA38 SD_FLOAT32_IEEE 0 SC_DSSPD_KACL_FINAL 0 1 /end CHARACTERISTIC
/begin COMPU_METHOD SC_DSSPD_KACL_FINAL "DSSPD_KACL_FINAL conversion" RAT_FUNC "%10.5" "unitless" COEFFS 0 1 0 0 0 1 /end COMPU_METHOD
/begin MEASUREMENT DSSPD_KP "" FLOAT32_IEEE MC_DSSPD_KP 0 0 0 0 ECU_ADDRESS 0x3FB154 /end MEASUREMENT
/begin COMPU_METHOD MC_DSSPD_KP "DSSPD_KP conversion" RAT_FUNC "%10.5" "Unitless" COEFFS 0 1 0 0 0 1 /end COMPU_METHOD
/begin MEASUREMENT DSSPD_K_ARC_RMP_TMR "" FLOAT32_IEEE MC_DSSPD_K_ARC_RMP_TMR 0 0 0 0 ECU_ADDRESS 0x3FB118 /end MEASUREMENT
/begin COMPU_METHOD MC_DSSPD_K_ARC_RMP_TMR "DSSPD_K_ARC_RMP_TMR conversion" RAT_FUNC "%10.5" "Unitless" COEFFS 0 1 0 0 0 1 /end COMPU_METHOD
/begin MEASUREMENT DSSPD_LGL_FLG "" UBYTE MC_DSSPD_LGL_FLG 0 0 0 0 ECU_ADDRESS 0x3FB18F /end MEASUREMENT
/begin COMPU_METHOD MC_DSSPD_LGL_FLG "DSSPD_LGL_FLG conversion" RAT_FUNC "%3.0" "Unitless" COEFFS 0 1 0 0 0 1 /end COMPU_METHOD
/begin CHARACTERISTIC DSSPD_MPHDCL_RATE "Dcl rate for Engine speed in Speed control." VALUE 0x5EA3C SD_FLOAT32_IEEE 0 SC_DSSPD_MPHDCL_RATE 0 20 /end CHARACTERISTIC
/begin COMPU_METHOD SC_DSSPD_MPHDCL_RATE "DSSPD_MPHDCL_RATE conversion" RAT_FUNC "%10.5" "MPH/s" COEFFS 0 1 0 0 0 1 /end COMPU_METHOD
/begin MEASUREMENT DSSPD_MPHERR " vehicle speed error in miles per hour" FLOAT32_IEEE MC_DSSPD_MPHERR 0 0 0 0 ECU_ADDRESS 0x3FB13C /end MEASUREMENT
/begin COMPU_METHOD MC_DSSPD_MPHERR "DSSPD_MPHERR conversion" RAT_FUNC "%10.5" "Unitless" COEFFS 0 1 0 0 0 1 /end COMPU_METHOD
/begin MEASUREMENT DSSPD_MPHERRCO_TMR "" FLOAT32_IEEE MC_DSSPD_MPHERRCO_TMR 0 0 0 0 ECU_ADDRESS 0x3FB114 /end MEASUREMENT
/begin COMPU_METHOD MC_DSSPD_MPHERRCO_TMR "DSSPD_MPHERRCO_TMR conversion" RAT_FUNC "%10.5" "Unitless" COEFFS 0 1 0 0 0 1 /end COMPU_METHOD
/begin MEASUREMENT DSSPD_MPHERR_COEF "" FLOAT32_IEEE MC_DSSPD_MPHERR_COEF 0 0 0 0 ECU_ADDRESS 0x3FB138 /end MEASUREMENT
/begin COMPU_METHOD MC_DSSPD_MPHERR_COEF "DSSPD_MPHERR_COEF conversion" RAT_FUNC "%10.5" "Unitless" COEFFS 0 1 0 0 0 1 /end COMPU_METHOD
/begin MEASUREMENT DSSPD_MPHERR_FILT "filtered vehicle speed error in miles per hour" FLOAT32_IEEE MC_DSSPD_MPHERR_FILT 0 0 0 0 ECU_ADDRESS 0x3FB140 /end MEASUREMENT
/begin COMPU_METHOD MC_DSSPD_MPHERR_FILT "DSSPD_MPHERR_FILT conversion" RAT_FUNC "%10.5" "Unitless" COEFFS 0 1 0 0 0 1 /end COMPU_METHOD
/begin CHARACTERISTIC DSSPD_MPHERR_K "" VALUE 0x5EA2C SD_FLOAT32_IEEE 0 SC_DSSPD_MPHERR_K 0 1 /end CHARACTERISTIC
/begin COMPU_METHOD SC_DSSPD_MPHERR_K "DSSPD_MPHERR_K conversion" RAT_FUNC "%10.5" "unitless" COEFFS 0 1 0 0 0 1 /end COMPU_METHOD
/begin MEASUREMENT DSSPD_MPHERR_KF "" FLOAT32_IEEE MC_DSSPD_MPHERR_KF 0 0 0 0 ECU_ADDRESS 0x3FB128 /end MEASUREMENT
/begin COMPU_METHOD MC_DSSPD_MPHERR_KF "DSSPD_MPHERR_KF conversion" RAT_FUNC "%10.5" "Unitless" COEFFS 0 1 0 0 0 1 /end COMPU_METHOD
/begin CHARACTERISTIC DSSPD_MPHSP_LIM "Max. limit for dsspd_mph_sp." VALUE 0x5EA44 SD_FLOAT32_IEEE 0 SC_DSSPD_MPHSP_LIM 0 10 /end CHARACTERISTIC
/begin COMPU_METHOD SC_DSSPD_MPHSP_LIM "DSSPD_MPHSP_LIM conversion" RAT_FUNC "%10.5" "MPH" COEFFS 0 1 0 0 0 1 /end COMPU_METHOD
/begin MEASUREMENT DSSPD_MPH_HOLD "vehicle speed for RESUME in miles per hour" FLOAT32_IEEE MC_DSSPD_MPH_HOLD 0 0 0 0 ECU_ADDRESS 0x3FB144 /end MEASUREMENT
/begin COMPU_METHOD MC_DSSPD_MPH_HOLD "DSSPD_MPH_HOLD conversion" RAT_FUNC "%10.5" "Unitless" COEFFS 0 1 0 0 0 1 /end COMPU_METHOD
/begin CHARACTERISTIC DSSPD_MPH_MAX "Max allowed vehicle speed for speed control  in miles per hour" VALUE 0x5EA48 SD_FLOAT32_IEEE 0 SC_DSSPD_MPH_MAX 60 125 /end CHARACTERISTIC
/begin COMPU_METHOD SC_DSSPD_MPH_MAX "DSSPD_MPH_MAX conversion" RAT_FUNC "%10.5" "MPH" COEFFS 0 1 0 0 0 1 /end COMPU_METHOD
/begin CHARACTERISTIC DSSPD_MPH_MIN "MIN allowed vehicle speed for speed control  in  miles per hour" VALUE 0x5EA4C SD_FLOAT32_IEEE 0 SC_DSSPD_MPH_MIN 20 40 /end CHARACTERISTIC
/begin COMPU_METHOD SC_DSSPD_MPH_MIN "DSSPD_MPH_MIN conversion" RAT_FUNC "%10.5" "MPH" COEFFS 0 1 0 0 0 1 /end COMPU_METHOD
/begin CHARACTERISTIC DSSPD_MPH_OFF "offset in miles per hour" VALUE 0x5EA50 SD_FLOAT32_IEEE 0 SC_DSSPD_MPH_OFF 0 256 /end CHARACTERISTIC
/begin COMPU_METHOD SC_DSSPD_MPH_OFF "DSSPD_MPH_OFF conversion" RAT_FUNC "%10.5" "MPH" COEFFS 0 1 0 0 0 1 /end COMPU_METHOD
/begin MEASUREMENT DSSPD_MPH_SP "Setpoint for vehicle speed in miles per hour" FLOAT32_IEEE MC_DSSPD_MPH_SP 0 0 0 0 ECU_ADDRESS 0x3FB148 /end MEASUREMENT
/begin COMPU_METHOD MC_DSSPD_MPH_SP "DSSPD_MPH_SP conversion" RAT_FUNC "%10.5" "Unitless" COEFFS 0 1 0 0 0 1 /end COMPU_METHOD
/begin MEASUREMENT DSSPD_NDES_TMP "" FLOAT32_IEEE MC_DSSPD_NDES_TMP 0 0 0 0 ECU_ADDRESS 0x3FB134 /end MEASUREMENT
/begin COMPU_METHOD MC_DSSPD_NDES_TMP "DSSPD_NDES_TMP conversion" RAT_FUNC "%10.5" "Unitless" COEFFS 0 1 0 0 0 1 /end COMPU_METHOD
/begin CHARACTERISTIC DSSPD_NVERR_MAX "" VALUE 0x5EA34 SD_FLOAT32_IEEE 0 SC_DSSPD_NVERR_MAX -100 100 /end CHARACTERISTIC
/begin COMPU_METHOD SC_DSSPD_NVERR_MAX "DSSPD_NVERR_MAX conversion" RAT_FUNC "%10.5" "unitless" COEFFS 0 1 0 0 0 1 /end COMPU_METHOD
/begin CHARACTERISTIC DSSPD_NVERR_MIN "" VALUE 0x5EA30 SD_FLOAT32_IEEE 0 SC_DSSPD_NVERR_MIN -100 100 /end CHARACTERISTIC
/begin COMPU_METHOD SC_DSSPD_NVERR_MIN "DSSPD_NVERR_MIN conversion" RAT_FUNC "%10.5" "unitless" COEFFS 0 1 0 0 0 1 /end COMPU_METHOD
/begin MEASUREMENT DSSPD_NV_HIGH "" FLOAT32_IEEE MC_DSSPD_NV_HIGH 0 0 0 0 ECU_ADDRESS 0x3FB120 /end MEASUREMENT
/begin COMPU_METHOD MC_DSSPD_NV_HIGH "DSSPD_NV_HIGH conversion" RAT_FUNC "%10.5" "Unitless" COEFFS 0 1 0 0 0 1 /end COMPU_METHOD
/begin MEASUREMENT DSSPD_NV_LOW "" FLOAT32_IEEE MC_DSSPD_NV_LOW 0 0 0 0 ECU_ADDRESS 0x3FB124 /end MEASUREMENT
/begin COMPU_METHOD MC_DSSPD_NV_LOW "DSSPD_NV_LOW conversion" RAT_FUNC "%10.5" "Unitless" COEFFS 0 1 0 0 0 1 /end COMPU_METHOD
/begin CHARACTERISTIC DSSPD_NV_MUL "" VALUE 0x5EA54 SD_FLOAT32_IEEE 0 SC_DSSPD_NV_MUL 0 1 /end CHARACTERISTIC
/begin COMPU_METHOD SC_DSSPD_NV_MUL "DSSPD_NV_MUL conversion" RAT_FUNC "%10.5" "unitless" COEFFS 0 1 0 0 0 1 /end COMPU_METHOD
/begin MEASUREMENT DSSPD_NV_RATIO "" FLOAT32_IEEE MC_DSSPD_NV_RATIO 0 0 0 0 ECU_ADDRESS 0x3FB150 /end MEASUREMENT
/begin COMPU_METHOD MC_DSSPD_NV_RATIO "DSSPD_NV_RATIO conversion" RAT_FUNC "%10.5" "Unitless" COEFFS 0 1 0 0 0 1 /end COMPU_METHOD
/begin CHARACTERISTIC DSSPD_RMP_DWN "" VALUE 0x5EA28 SD_FLOAT32_IEEE 0 SC_DSSPD_RMP_DWN 0 10 /end CHARACTERISTIC
/begin COMPU_METHOD SC_DSSPD_RMP_DWN "DSSPD_RMP_DWN conversion" RAT_FUNC "%10.5" "s" COEFFS 0 1 0 0 0 1 /end COMPU_METHOD
/begin CHARACTERISTIC DSSPD_RMP_UP "" VALUE 0x5EA24 SD_FLOAT32_IEEE 0 SC_DSSPD_RMP_UP 0 10 /end CHARACTERISTIC
/begin COMPU_METHOD SC_DSSPD_RMP_UP "DSSPD_RMP_UP conversion" RAT_FUNC "%10.5" "s" COEFFS 0 1 0 0 0 1 /end COMPU_METHOD
/begin MEASUREMENT DSSPD_SC_NDES "" FLOAT32_IEEE MC_DSSPD_SC_NDES 0 0 0 0 ECU_ADDRESS 0x3FB17C /end MEASUREMENT
/begin COMPU_METHOD MC_DSSPD_SC_NDES "DSSPD_SC_NDES conversion" RAT_FUNC "%10.5" "Unitless" COEFFS 0 1 0 0 0 1 /end COMPU_METHOD
/begin MEASUREMENT DSSPD_SP_HND "" UBYTE MC_DSSPD_SP_HND 0 0 0 0 ECU_ADDRESS 0x3FB162 /end MEASUREMENT
/begin COMPU_METHOD MC_DSSPD_SP_HND "DSSPD_SP_HND conversion" RAT_FUNC "%3.0" "Unitless" COEFFS 0 1 0 0 0 1 /end COMPU_METHOD
/begin MEASUREMENT DSSPD_STATE "" UBYTE MC_DSSPD_STATE 0 0 0 0 ECU_ADDRESS 0x3FB163 /end MEASUREMENT
/begin COMPU_METHOD MC_DSSPD_STATE "DSSPD_STATE conversion" RAT_FUNC "%3.0" "Unitless" COEFFS 0 1 0 0 0 1 /end COMPU_METHOD
/begin MEASUREMENT DSSPD_STATE_LST "" UBYTE MC_DSSPD_STATE_LST 0 0 0 0 ECU_ADDRESS 0x3FB160 /end MEASUREMENT
/begin COMPU_METHOD MC_DSSPD_STATE_LST "DSSPD_STATE_LST conversion" RAT_FUNC "%3.0" "Unitless" COEFFS 0 1 0 0 0 1 /end COMPU_METHOD
/begin CHARACTERISTIC DSSPD_TAP_DLY "" VALUE 0x5EA58 SD_UBYTE 0 SC_DSSPD_TAP_DLY 0 255 /end CHARACTERISTIC
/begin COMPU_METHOD SC_DSSPD_TAP_DLY "DSSPD_TAP_DLY conversion" RAT_FUNC "%3.0" "unitless" COEFFS 0 1 0 0 0 1 /end COMPU_METHOD
/begin CHARACTERISTIC DTA_CAL "" VALUE 0x5C487 SD_UBYTE 0 SC_DTA_CAL 0 255 /end CHARACTERISTIC
/begin COMPU_METHOD SC_DTA_CAL "DTA_CAL conversion" RAT_FUNC "%3.0" "unitless" COEFFS 0 1 0 0 0 1 /end COMPU_METHOD
/begin CHARACTERISTIC DUAL_ALT_CRK_SW "Calibration flag to enable extra crank fuel for dual alt trucks" VALUE 0x5DC09 SD_UBYTE 0 SC_DUAL_ALT_CRK_SW 0 1 /end CHARACTERISTIC
/begin COMPU_METHOD SC_DUAL_ALT_CRK_SW "DUAL_ALT_CRK_SW conversion" RAT_FUNC "%3.0" "unitless" COEFFS 0 1 0 0 0 1 /end COMPU_METHOD
/begin MEASUREMENT DUAL_ALT_DET "Secondary alternator detected flag" UBYTE MC_DUAL_ALT_DET 0 0 0 0 ECU_ADDRESS 0x3FCFAE /end MEASUREMENT
/begin COMPU_METHOD MC_DUAL_ALT_DET "DUAL_ALT_DET conversion" RAT_FUNC "%3.0" "Unitless" COEFFS 0 1 0 0 0 1 /end COMPU_METHOD
/begin MEASUREMENT EBP "Exhaust Back Pressure absolute pressure(in KPA)" FLOAT32_IEEE MC_EBP 0 0 0 0 ECU_ADDRESS 0x3FA3B4 /end MEASUREMENT
/begin COMPU_METHOD MC_EBP "EBP conversion" RAT_FUNC "%10.5" "Unitless" COEFFS 0 1 0 0 0 1 /end COMPU_METHOD
/begin CHARACTERISTIC EBPBP_TOLERR "Differential limit of EBP and BP for ARA FMEM" VALUE 0x5D6F0 SD_FLOAT32_IEEE 0 SC_EBPBP_TOLERR 0 100 /end CHARACTERISTIC
/begin COMPU_METHOD SC_EBPBP_TOLERR "EBPBP_TOLERR conversion" RAT_FUNC "%10.5" "kPa" COEFFS 0 1 0 0 0 1 /end COMPU_METHOD
/begin MEASUREMENT EBPG "Exhaust Back Pressure Gage pressure (in KPA)" FLOAT32_IEEE MC_EBPG 0 0 0 0 ECU_ADDRESS 0x3FA3B0 /end MEASUREMENT
/begin COMPU_METHOD MC_EBPG "EBPG conversion" RAT_FUNC "%10.5" "Unitless" COEFFS 0 1 0 0 0 1 /end COMPU_METHOD
/begin MEASUREMENT EBPG_CRANK_KOEO "ebpg latched during crank/koeo" FLOAT32_IEEE MC_EBPG_CRANK_KOEO 0 0 0 0 ECU_ADDRESS 0x3FA378 /end MEASUREMENT
/begin COMPU_METHOD MC_EBPG_CRANK_KOEO "EBPG_CRANK_KOEO conversion" RAT_FUNC "%10.5" "Unitless" COEFFS 0 1 0 0 0 1 /end COMPU_METHOD
/begin CHARACTERISTIC EBPG_VGT_DTY_DEF "" VALUE 0x5E9D4 SD_FLOAT32_IEEE 0 SC_EBPG_VGT_DTY_DEF 0 1 /end CHARACTERISTIC
/begin COMPU_METHOD SC_EBPG_VGT_DTY_DEF "EBPG_VGT_DTY_DEF conversion" RAT_FUNC "%10.5" "unitless" COEFFS 0 1 0 0 0 1 /end COMPU_METHOD
/begin CHARACTERISTIC EBPG_XS "Run mode excessive ebp failure threshold" VALUE 0x5D5B8 SD_FLOAT32_IEEE 0 SC_EBPG_XS 0 400 /end CHARACTERISTIC
/begin COMPU_METHOD SC_EBPG_XS "EBPG_XS conversion" RAT_FUNC "%10.5" "kPa" COEFFS 0 1 0 0 0 1 /end COMPU_METHOD
/begin CHARACTERISTIC EBP_AD_TC "Exhaust Back Pressure filter time constant" VALUE 0x5D5C8 SD_FLOAT32_IEEE 0 SC_EBP_AD_TC 0 64 /end CHARACTERISTIC
/begin COMPU_METHOD SC_EBP_AD_TC "EBP_AD_TC conversion" RAT_FUNC "%10.5" "s" COEFFS 0 1 0 0 0 1 /end COMPU_METHOD
/begin MEASUREMENT EBP_CNTS "Exhaust back pressure sensor A/D counts" SLONG MC_EBP_CNTS 0 0 0 0 ECU_ADDRESS 0x3F99E0 /end MEASUREMENT
/begin COMPU_METHOD MC_EBP_CNTS "EBP_CNTS conversion" RAT_FUNC "%10.0" "Unitless" COEFFS 0 1 0 0 0 1 /end COMPU_METHOD
/begin CHARACTERISTIC EBP_DEF "Default FMEM value for exhaust back pressure" VALUE 0x5D5D8 SD_FLOAT32_IEEE 0 SC_EBP_DEF 100 400 /end CHARACTERISTIC
/begin COMPU_METHOD SC_EBP_DEF "EBP_DEF conversion" RAT_FUNC "%10.5" "kPa" COEFFS 0 1 0 0 0 1 /end COMPU_METHOD
/begin CHARACTERISTIC EBP_DEL_EGRP_MX "" VALUE 0x5D5A0 SD_FLOAT32_IEEE 0 SC_EBP_DEL_EGRP_MX 0 1 /end CHARACTERISTIC
/begin COMPU_METHOD SC_EBP_DEL_EGRP_MX "EBP_DEL_EGRP_MX conversion" RAT_FUNC "%10.5" "%" COEFFS 0 1 0 0 0 1 /end COMPU_METHOD
/begin CHARACTERISTIC EBP_DEL_N_MN "Engine speed threshold for engine speed based EBP changed test" VALUE 0x5D5B4 SD_FLOAT32_IEEE 0 SC_EBP_DEL_N_MN 0 8000 /end CHARACTERISTIC
/begin COMPU_METHOD SC_EBP_DEL_N_MN "EBP_DEL_N_MN conversion" RAT_FUNC "%10.5" "RPM" COEFFS 0 1 0 0 0 1 /end COMPU_METHOD
/begin CHARACTERISTIC EBP_DEL_N_MN2 "" VALUE 0x5D5A4 SD_FLOAT32_IEEE 0 SC_EBP_DEL_N_MN2 0 4000 /end CHARACTERISTIC
/begin COMPU_METHOD SC_EBP_DEL_N_MN2 "EBP_DEL_N_MN2 conversion" RAT_FUNC "%10.5" "RPM" COEFFS 0 1 0 0 0 1 /end COMPU_METHOD
/begin CHARACTERISTIC EBP_DEL_THLD "EBP delta threshold" VALUE 0x5D5BC SD_FLOAT32_IEEE 0 SC_EBP_DEL_THLD 0 400 /end CHARACTERISTIC
/begin COMPU_METHOD SC_EBP_DEL_THLD "EBP_DEL_THLD conversion" RAT_FUNC "%10.5" "kPa" COEFFS 0 1 0 0 0 1 /end COMPU_METHOD
/begin CHARACTERISTIC EBP_DEL_TM "Engine speed based EBP changed test timer value" VALUE 0x5D5AC SD_FLOAT32_IEEE 0 SC_EBP_DEL_TM 0 524288 /end CHARACTERISTIC
/begin COMPU_METHOD SC_EBP_DEL_TM "EBP_DEL_TM conversion" RAT_FUNC "%10.5" "s" COEFFS 0 1 0 0 0 1 /end COMPU_METHOD
/begin MEASUREMENT EBP_DEL_TMR "FMEM-speed based EBP delta change test timer" FLOAT32_IEEE MC_EBP_DEL_TMR 0 0 0 0 ECU_ADDRESS 0x3FA388 /end MEASUREMENT
/begin COMPU_METHOD MC_EBP_DEL_TMR "EBP_DEL_TMR conversion" RAT_FUNC "%10.5" "Unitless" COEFFS 0 1 0 0 0 1 /end COMPU_METHOD
/begin MEASUREMENT EBP_DEL_UPDATE_TMR "FMEM-speed based EBP delta change test update  timer" FLOAT32_IEEE MC_EBP_DEL_UPDATE_TMR 0 0 0 0 ECU_ADDRESS 0x3FA384 /end MEASUREMENT
/begin COMPU_METHOD MC_EBP_DEL_UPDATE_TMR "EBP_DEL_UPDATE_TMR conversion" RAT_FUNC "%10.5" "Unitless" COEFFS 0 1 0 0 0 1 /end COMPU_METHOD
/begin MEASUREMENT EBP_ENG_KPA "Raw exhaust back pressure without any compensation, kPA" FLOAT32_IEEE MC_EBP_ENG_KPA 0 0 0 0 ECU_ADDRESS 0x3F99DC /end MEASUREMENT
/begin COMPU_METHOD MC_EBP_ENG_KPA "EBP_ENG_KPA conversion" RAT_FUNC "%10.5" "Unitless" COEFFS 0 1 0 0 0 1 /end COMPU_METHOD
/begin MEASUREMENT EBP_FILT_TIME_CONST "EBP filter time constant" FLOAT32_IEEE MC_EBP_FILT_TIME_CONST 0 0 0 0 ECU_ADDRESS 0x3FA3AC /end MEASUREMENT
/begin COMPU_METHOD MC_EBP_FILT_TIME_CONST "EBP_FILT_TIME_CONST conversion" RAT_FUNC "%10.5" "Unitless" COEFFS 0 1 0 0 0 1 /end COMPU_METHOD
/begin MEASUREMENT EBP_FLT_RECOVERY_CNTR " EBP fault recovery counter" SLONG MC_EBP_FLT_RECOVERY_CNTR 0 0 0 0 ECU_ADDRESS 0x3FA3A4 /end MEASUREMENT
/begin COMPU_METHOD MC_EBP_FLT_RECOVERY_CNTR "EBP_FLT_RECOVERY_CNTR conversion" RAT_FUNC "%10.0" "Unitless" COEFFS 0 1 0 0 0 1 /end COMPU_METHOD
/begin MEASUREMENT EBP_FLT_RECOVERY_FLG "EBP filt recovery flag" UBYTE MC_EBP_FLT_RECOVERY_FLG 0 0 0 0 ECU_ADDRESS 0x3FA3BE /end MEASUREMENT
/begin COMPU_METHOD MC_EBP_FLT_RECOVERY_FLG "EBP_FLT_RECOVERY_FLG conversion" RAT_FUNC "%3.0" "Unitless" COEFFS 0 1 0 0 0 1 /end COMPU_METHOD
/begin CHARACTERISTIC EBP_F_DEC "EBP ORH/ORL failure counter decrement value" VALUE 0x5D5D0 SD_SLONG 0 SC_EBP_F_DEC 0 65535 /end CHARACTERISTIC
/begin COMPU_METHOD SC_EBP_F_DEC "EBP_F_DEC conversion" RAT_FUNC "%10.0" "unitless" COEFFS 0 1 0 0 0 1 /end COMPU_METHOD
/begin CHARACTERISTIC EBP_F_INC "EBP ORH/ORL failure counter increment value" VALUE 0x5D5D4 SD_SLONG 0 SC_EBP_F_INC 0 65535 /end CHARACTERISTIC
/begin COMPU_METHOD SC_EBP_F_INC "EBP_F_INC conversion" RAT_FUNC "%10.0" "unitless" COEFFS 0 1 0 0 0 1 /end COMPU_METHOD
/begin MEASUREMENT EBP_F_ORH "EBP Signal out-of_range high fault" UBYTE MC_EBP_F_ORH 0 0 0 0 ECU_ADDRESS 0x3FA3C4 /end MEASUREMENT
/begin COMPU_METHOD MC_EBP_F_ORH "EBP_F_ORH conversion" RAT_FUNC "%3.0" "Unitless" COEFFS 0 1 0 0 0 1 /end COMPU_METHOD
/begin MEASUREMENT EBP_F_ORL "EBP Signal out of range low fault" UBYTE MC_EBP_F_ORL 0 0 0 0 ECU_ADDRESS 0x3FA3C3 /end MEASUREMENT
/begin COMPU_METHOD MC_EBP_F_ORL "EBP_F_ORL conversion" RAT_FUNC "%3.0" "Unitless" COEFFS 0 1 0 0 0 1 /end COMPU_METHOD
/begin MEASUREMENT EBP_MALF_SET "Indicate  ebp malf high or low failure" UBYTE MC_EBP_MALF_SET 0 0 0 0 ECU_ADDRESS 0x3FA3C0 /end MEASUREMENT
/begin COMPU_METHOD MC_EBP_MALF_SET "EBP_MALF_SET conversion" RAT_FUNC "%3.0" "Unitless" COEFFS 0 1 0 0 0 1 /end COMPU_METHOD
/begin CHARACTERISTIC EBP_NS "No start/crank EBP failure threshold" VALUE 0x5D5C0 SD_FLOAT32_IEEE 0 SC_EBP_NS 0 500 /end CHARACTERISTIC
/begin COMPU_METHOD SC_EBP_NS "EBP_NS conversion" RAT_FUNC "%10.5" "kPa" COEFFS 0 1 0 0 0 1 /end COMPU_METHOD
/begin CHARACTERISTIC EBP_NS_TM "No start/crank fault detection timer value" VALUE 0x5D5B0 SD_FLOAT32_IEEE 0 SC_EBP_NS_TM 0 524288 /end CHARACTERISTIC
/begin COMPU_METHOD SC_EBP_NS_TM "EBP_NS_TM conversion" RAT_FUNC "%10.5" "s" COEFFS 0 1 0 0 0 1 /end COMPU_METHOD
/begin MEASUREMENT EBP_NS_TMR "No Start/Crank, Excessive EBP fault detection timer" FLOAT32_IEEE MC_EBP_NS_TMR 0 0 0 0 ECU_ADDRESS 0x3FA390 /end MEASUREMENT
/begin COMPU_METHOD MC_EBP_NS_TMR "EBP_NS_TMR conversion" RAT_FUNC "%10.5" "Unitless" COEFFS 0 1 0 0 0 1 /end COMPU_METHOD
/begin MEASUREMENT EBP_NS_UPDATE_TMR "No Start/Crank, Excessive EBP FMEM malf update timer" FLOAT32_IEEE MC_EBP_NS_UPDATE_TMR 0 0 0 0 ECU_ADDRESS 0x3FA38C /end MEASUREMENT
/begin COMPU_METHOD MC_EBP_NS_UPDATE_TMR "EBP_NS_UPDATE_TMR conversion" RAT_FUNC "%10.5" "Unitless" COEFFS 0 1 0 0 0 1 /end COMPU_METHOD
/begin MEASUREMENT EBP_ORH_CNTR "Exhaust Back Pressure out of range high counter" SLONG MC_EBP_ORH_CNTR 0 0 0 0 ECU_ADDRESS 0x3FA3A0 /end MEASUREMENT
/begin COMPU_METHOD MC_EBP_ORH_CNTR "EBP_ORH_CNTR conversion" RAT_FUNC "%10.0" "Unitless" COEFFS 0 1 0 0 0 1 /end COMPU_METHOD
/begin MEASUREMENT EBP_ORL_CNTR "Exhaust Back Pressure out of range low counter" SLONG MC_EBP_ORL_CNTR 0 0 0 0 ECU_ADDRESS 0x3FA39C /end MEASUREMENT
/begin COMPU_METHOD MC_EBP_ORL_CNTR "EBP_ORL_CNTR conversion" RAT_FUNC "%10.0" "Unitless" COEFFS 0 1 0 0 0 1 /end COMPU_METHOD
/begin MEASUREMENT EBP_RAW_KPA "Exaust Back Pressure raw value" FLOAT32_IEEE MC_EBP_RAW_KPA 0 0 0 0 ECU_ADDRESS 0x3FA3A8 /end MEASUREMENT
/begin COMPU_METHOD MC_EBP_RAW_KPA "EBP_RAW_KPA conversion" RAT_FUNC "%10.5" "Unitless" COEFFS 0 1 0 0 0 1 /end COMPU_METHOD
/begin CHARACTERISTIC EBP_REC_INC "EBP  Fault recovery counter increment value" VALUE 0x5D5CC SD_SLONG 0 SC_EBP_REC_INC 0 32767 /end CHARACTERISTIC
/begin COMPU_METHOD SC_EBP_REC_INC "EBP_REC_INC conversion" RAT_FUNC "%10.0" "unitless" COEFFS 0 1 0 0 0 1 /end COMPU_METHOD
/begin RECORD_LAYOUT SD_UBYTE FNC_VALUES 1 UBYTE ROW_DIR DIRECT /end RECORD_LAYOUT
/begin RECORD_LAYOUT SD_UWORD FNC_VALUES 1 UWORD ROW_DIR DIRECT /end RECORD_LAYOUT
/begin RECORD_LAYOUT SD_ULONG FNC_VALUES 1 ULONG ROW_DIR DIRECT /end RECORD_LAYOUT
/begin RECORD_LAYOUT SD_SLONG FNC_VALUES 1 SLONG ROW_DIR DIRECT /end RECORD_LAYOUT
/begin RECORD_LAYOUT SD_FLOAT32_IEEE FNC_VALUES 1 FLOAT32_IEEE ROW_DIR DIRECT /end RECORD_LAYOUT
/* asap2_trailer.a2l */ /* This file must be appended to the .a2l file created by the sym2asap2 */ /* tool. The tool does not currently add these keywords to mark the end */ /* of the file. If the sym2asap2 tool is modified in the future to add */ /* these keywords, this file will no longer be necessary. */
/end MODULE
/end PROJECT
