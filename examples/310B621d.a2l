ASAP2_VERSION 1 21
/begin PROJECT Brs_6Zylinder "310B6"
/begin HEADER "" VERSION "_310B621d" PROJECT_NO Brs_6Zylinder /end HEADER
/begin MODULE DIM ""
/begin MOD_COMMON "" BYTE_ORDER MSB_LAST S_REC_LAYOUT DAMOS /end MOD_COMMON
/begin AXIS_PTS SNM12ESUB "SST-Verteilung für die Motordrehzahl nmot" 0x10088 nmot SstAUbSstUb 10200 nmot_ub_q40 12 0 10200 DEPOSIT ABSOLUTE /end AXIS_PTS
/begin AXIS_PTS SRL12ESUB "Sst-Verteilung für die relative Füllung rl" 0x100B7 rl SstAUbSstUb 191.25 rel_ub_q0p75 12 0 191.25 DEPOSIT ABSOLUTE /end AXIS_PTS
/begin AXIS_PTS STM12ESUB "SST-Verteilung für die Motortemperatur tmot" 0x100D1 tmot SstAUbSstUb 191.25 temp_ub_q0p75_o48 12 -48 143.25 DEPOSIT ABSOLUTE /end AXIS_PTS
/begin AXIS_PTS STS12ESUB "SST-Verteilung für Motorstarttemperatur" 0x100DE tmst SstAUbSstUb 191.25 temp_ub_q0p75_o48 12 -48 143.25 DEPOSIT ABSOLUTE /end AXIS_PTS
/begin AXIS_PTS SNM16KRUB "Stützstellenverteilung Drehzahl, 16 Sst." 0x10050 nmot SstAUbSstUb 10200 nmot_ub_q40 16 0 10200 DEPOSIT ABSOLUTE /end AXIS_PTS
/begin AXIS_PTS SRL04KRUB "Stützstellenverteilung relative Füllung, 4 Sst." 0x10066 rl SstAUbSstUb 191.25 rel_ub_q0p75 4 0 191.25 DEPOSIT ABSOLUTE /end AXIS_PTS
/begin AXIS_PTS SRL04DYUB "Stützstellenverteilung relative Füllung, 4 Sst." 0x10061 rl SstAUbSstUb 191.25 rel_ub_q0p75 4 0 191.25 DEPOSIT ABSOLUTE /end AXIS_PTS
/begin AXIS_PTS SRL08GKUB "Stützstellenverteilung Gemischkontrolle 8 rl Stützstellen" 0x104C4 rl SstAUbSstUb 191.25 rel_ub_q0p75 8 0 191.25 DEPOSIT ABSOLUTE /end AXIS_PTS
/begin AXIS_PTS SNM08GKUB "Stützstellenverteilung Gemischkontrolle 8 nmot Stützstellen" 0x104BB nmot SstAUbSstUb 10200 nmot_ub_q40 8 0 10200 DEPOSIT ABSOLUTE /end AXIS_PTS
/begin AXIS_PTS STM08GKUB "8 Motortemperaturstützstellen für KFLAFWL" 0x104CD tmot SstAUbSstUb 191.25 temp_ub_q0p75_o48 8 -48 143.25 DEPOSIT ABSOLUTE /end AXIS_PTS
/begin AXIS_PTS SRL12GKUB "12 Füllungsstützstellen für ?" 0x10B67 rl SstAUbSstUb 191.25 rel_ub_q0p75 12 0 191.25 DEPOSIT ABSOLUTE /end AXIS_PTS
/begin AXIS_PTS SNM16GKUB "Stützstellenverteilung Gemischkontrolle 16 nmot Stützstellen" 0x10B56 nmot SstAUbSstUb 10200 nmot_ub_q40 16 0 10200 DEPOSIT ABSOLUTE /end AXIS_PTS
/begin CHARACTERISTIC CLRDISTLAP "Rücksetzen Lapdistanz manuell" VALUE 0x10035 KwUb 255 dez 0 255 FORMAT "%5.1" /end CHARACTERISTIC
/begin CHARACTERISTIC AIMRU "Anzahl Impulse pro Radumdrehung" VALUE 0x10034 KwUb 253 dez 1 254 FORMAT "%5.1" /end CHARACTERISTIC
/begin CHARACTERISTIC ZFV "Zeitkonstante für Filterung des Geschwindigkeitssignals" VALUE 0x115E4 KwUw 0.999969 fak_uw_b1 1.52588e-005 0.999985 FORMAT "%8.6" /end CHARACTERISTIC
/begin CHARACTERISTIC NDV "Fehlererkennung Tachosignal / Drehzahlschwelle minimal" VALUE 0x10036 KwUb 10200 nmot_ub_q40 0 10200 FORMAT "%5.0" /end CHARACTERISTIC
/begin CHARACTERISTIC RLDV "Erkennung Fehler Geschwindigkeitssignal / Lastschwelle" VALUE 0x10037 KwUb 191.25 rel_ub_q0p75 0 191.25 FORMAT "%5.1" /end CHARACTERISTIC
/begin CHARACTERISTIC TDV "Fehlererkennung Tachosignal / Zeitdauer für Abfrage" VALUE 0x10038 KwUb 25.5 t100msxs_ub_b25p5 0 25.5 FORMAT "%5.2" /end CHARACTERISTIC
/begin CHARACTERISTIC TMDV "Motortemperaturschwelle für Freigabe Fz-Geschwindigkeits-Diagnose" VALUE 0x10039 KwUb 191.25 temp_ub_q0p75_o48 -48 143.25 FORMAT "%5.1" /end CHARACTERISTIC
/begin CHARACTERISTIC VDMN "Geschwindigkeitsschwelle; Fehlererkennung Geschwindigkeitssignal" VALUE 0x1003A KwUb 318.75 vfzg_ub_q1p25 0 318.75 FORMAT "%5.1" /end CHARACTERISTIC
/begin CHARACTERISTIC VFZMN "Erkennen Fahren-Stehen" VALUE 0x1003B KwUb 25.5 vfzg_ub_q0p1 0 25.5 FORMAT "%5.2" /end CHARACTERISTIC
/begin CHARACTERISTIC UMRAD "Radumfang" VALUE 0x115E2 KwUw 65534 umrad_uw_q0p1 1 65535 FORMAT "%8.2" /end CHARACTERISTIC
/begin CHARACTERISTIC FTNR "Fertigteilenummer des Kunden ( <- )" CURVE 0x100ED FklWUb 255 dez 0 255 FORMAT "%5.1" /begin AXIS_DESCR FIX_AXIS dummy1 dez 11 0 10 FIX_AXIS_PAR 0 0 11 /end AXIS_DESCR /end CHARACTERISTIC
/begin CHARACTERISTIC RBSWNR "Bosch-Softwareteilenummer (<-)" CURVE 0x10102 FklWUb 255 dez 0 255 FORMAT "%5.1" /begin AXIS_DESCR FIX_AXIS dummy1 dez 10 0 9 FIX_AXIS_PAR 0 0 10 /end AXIS_DESCR /end CHARACTERISTIC
/begin CHARACTERISTIC DDI "" CURVE 0x100EB FklWUb 255 dez 0 255 FORMAT "%5.1" /begin AXIS_DESCR FIX_AXIS dummy1 dez 2 0 1 FIX_AXIS_PAR 0 0 2 /end AXIS_DESCR /end CHARACTERISTIC
/begin CHARACTERISTIC RBHWNR "Bosch-Hardwareteilenummer (<-)" CURVE 0x100F8 FklWUb 255 dez 0 255 FORMAT "%5.1" /begin AXIS_DESCR FIX_AXIS dummy1 dez 10 0 9 FIX_AXIS_PAR 0 0 10 /end AXIS_DESCR /end CHARACTERISTIC
/begin CHARACTERISTIC CWWDKFKT "Codewort für Umschaltung auf manuelle DK-Justierung" VALUE 0x101ED KwUb 255 dez 0 255 FORMAT "%5.1" /end CHARACTERISTIC
/begin CHARACTERISTIC WDKMAN "Auslösung der manuellen DK-Justierung" VALUE 0x101F1 KwUb 255 dez 0 255 FORMAT "%5.1" /end CHARACTERISTIC
/begin CHARACTERISTIC WDKLMMAX "Maximal zulässiger DK-Winkel für manuelle DK-Justierung" VALUE 0x11F6C KwUw 100 relDK_uw_b100 0 100 FORMAT "%8.4" /end CHARACTERISTIC
/begin CHARACTERISTIC DWDKLA "delta Dk-Winkel im Leerlauf, Begrenzung Aufwärtsadaption" VALUE 0x101D1 KwUb 100 relDK_ub_b100 0 100 FORMAT "%5.1" /end CHARACTERISTIC
/begin CHARACTERISTIC NDSVL "S_VL Fehlererkennung / n - Schwelle minimal" VALUE 0x101EE KwUb 10200 nmot_ub_q40 0 10200 FORMAT "%5.0" /end CHARACTERISTIC
/begin CHARACTERISTIC QDPSLL "maximaler Luftdurchsatz zur Plausibilitätsprüfung von S_LL" VALUE 0x101EF KwUb 1020 m_ub_b1020 0 1020 FORMAT "%5.0" /end CHARACTERISTIC
/begin CHARACTERISTIC RLDSVL "S_VL Fehlererkennung / rl-Schwelle maximal" VALUE 0x101F0 KwUb 191.25 rel_ub_q0p75 0 191.25 FORMAT "%5.1" /end CHARACTERISTIC
/begin CHARACTERISTIC WKLLX "Leerlaufwinkel, maximal zulässiger Wert" VALUE 0x101EC KwUb 100 relDK_ub_b100 0 100 FORMAT "%5.1" /end CHARACTERISTIC
/begin CHARACTERISTIC ZWDK "Zeitkonstante für Leerlaufwinkeladaption" VALUE 0x11F6E KwUw 0.999969 fak_uw_b1 1.52588e-005 0.999985 FORMAT "%8.6" /end CHARACTERISTIC
/begin CHARACTERISTIC WDKNLN "Notlauf-Drosselklappenwinkel" CURVE 0x101F2 KlAUbSstUbWUb 100 relDK_ub_b100 0 100 FORMAT "%5.1" /begin AXIS_DESCR STD_AXIS nmot nmot_ub_q40 6 0 10200 DEPOSIT ABSOLUTE /end AXIS_DESCR /end CHARACTERISTIC
/begin CHARACTERISTIC WDKSLN "Drosselklappenwinkelschwelle für Leerlauferkennung" CURVE 0x101D2 KlAUbSstUbWUb 100 relDK_ub_b100 0 100 FORMAT "%5.1" /begin AXIS_DESCR STD_AXIS nmot nmot_ub_q40 6 0 10200 DEPOSIT ABSOLUTE /end AXIS_DESCR /end CHARACTERISTIC
/begin CHARACTERISTIC WDKVLN "Drosselklappenwinkelschwelle für Vollasterkennung" CURVE 0x101DF KlAUbSstUbWUb 100 relDK_ub_b100 0 100 FORMAT "%5.1" /begin AXIS_DESCR STD_AXIS nmot nmot_ub_q40 6 0 10200 DEPOSIT ABSOLUTE /end AXIS_DESCR /end CHARACTERISTIC
/begin CHARACTERISTIC CWGGLSU "Codewort für GGLSU" VALUE 0x1024F KwUb 255 dez 0 255 FORMAT "%5.1" /end CHARACTERISTIC
/begin CHARACTERISTIC SDLAA "Schwelle delta Lambda für LSU Abgleich" VALUE 0x12084 KwSw 15.9998 fak_sw_b8 -8 7.99976 FORMAT "%8.6" /end CHARACTERISTIC
/begin CHARACTERISTIC SDLAB "Schwelle delta Lambda für Erkennung Betriebsbereitschaft LSU" VALUE 0x12086 KwSw 15.9998 fak_sw_b8 -8 7.99976 FORMAT "%8.6" /end CHARACTERISTIC
/begin CHARACTERISTIC TABGL "Zeit für LSU-Abgleich" VALUE 0x10250 KwUb 2.54 t10msxs_ub_b2p55 0.01 2.55 FORMAT "%5.3" /end CHARACTERISTIC
/begin CHARACTERISTIC TABGS "Zeit nach Start für LSU-Abgleich" VALUE 0x10251 KwUb 25.4 t100msxs_ub_b25p5 0.1 25.5 FORMAT "%5.2" /end CHARACTERISTIC
/begin CHARACTERISTIC TSTBB "Störunterdrückungszeit für Erkennung Betriebsbereitschaft LSU" VALUE 0x10252 KwUb 25.5 t100msxs_ub_b25p5 0 25.5 FORMAT "%5.2" /end CHARACTERISTIC
/begin CHARACTERISTIC TVLENA "Verzögerungszeit für Lambdakorrektur" VALUE 0x10253 KwUb 2.55 t10msxs_ub_b2p55 0 2.55 FORMAT "%5.3" /end CHARACTERISTIC
/begin CHARACTERISTIC ULSUAMN "Minimale Spannung der LSU während Abgleich" VALUE 0x12088 KwUw 319.995 spg_uw_q0p00488 0 319.995 FORMAT "%8.4" /end CHARACTERISTIC
/begin CHARACTERISTIC ULSUAMX "Maximale Spannung der LSU während Abgleich" VALUE 0x1208A KwUw 319.995 spg_uw_q0p00488 0 319.995 FORMAT "%8.4" /end CHARACTERISTIC
/begin CHARACTERISTIC USABGL "LSU-Spannung bei Pumpstrom Null" VALUE 0x1208C KwUw 319.995 spg_uw_q0p00488 0 319.995 FORMAT "%8.4" /end CHARACTERISTIC
/begin CHARACTERISTIC ZFDUSVK "Filterzeitkonstante für LSU-Spannungsabgleich vor Kat" VALUE 0x1208E KwUw 2.54004 zk10msxs_uw_b655 0.0100002 2.55004 FORMAT "%8.6" /end CHARACTERISTIC
/begin CHARACTERISTIC ZFUULSU "Filterzeitkonstante für Lambda" VALUE 0x12090 KwUw 2.54004 zk10msxs_uw_b655 0.0100002 2.55004 FORMAT "%8.6" /end CHARACTERISTIC
/begin CHARACTERISTIC LALIUS "Lambdalinearisierung, LSU-Sonde vor Katalysator" CURVE 0x1202A KlAUwSstUwWUw 15.9998 fak_uw_b16 0 15.9998 FORMAT "%8.5"
 /begin AXIS_DESCR STD_AXIS iusvkk_w spg_uw_q0p00488 22 0 319.995 DEPOSIT ABSOLUTE /end AXIS_DESCR
/end CHARACTERISTIC
/begin CHARACTERISTIC TDNSUB "Batterie - Erholzeit ab Start, für UBATT - Diagnose" VALUE 0x10254 KwUb 255 t100msxs_ub_b255 0 255 FORMAT "%5.1" /end CHARACTERISTIC
/begin CHARACTERISTIC TDUB "Wartezeit für UBATT-Diagnose" VALUE 0x10255 KwUb 25.5 t100msxs_ub_b25p5 0 25.5 FORMAT "%5.2" /end CHARACTERISTIC
/begin CHARACTERISTIC UBDE "Ubatt - Ersatzwert bei defektem AD - Kanal" VALUE 0x10256 KwUb 17.3655 spg_ubatt 0 17.3655 FORMAT "%5.2" /end CHARACTERISTIC
/begin CHARACTERISTIC UBDMN1 "Batteriespannung min. (Netz)" VALUE 0x10257 KwUb 17.3655 spg_ubatt 0 17.3655 FORMAT "%5.2" /end CHARACTERISTIC
/begin CHARACTERISTIC UBDMN2 "Batteriespannung min. (ADC)" VALUE 0x10258 KwUb 17.3655 spg_ubatt 0 17.3655 FORMAT "%5.2" /end CHARACTERISTIC
/begin CHARACTERISTIC UBDMX "Batteriespannung max." VALUE 0x10259 KwUb 17.3655 spg_ubatt 0 17.3655 FORMAT "%5.2" /end CHARACTERISTIC
/begin CHARACTERISTIC DSLGRAD "Gradient für Drucksensor Ladedruck" VALUE 0x12746 KwUw 1023.98 dgrad_uw_q0p015 0 1023.98 FORMAT "%8.3" /end CHARACTERISTIC
/begin CHARACTERISTIC DSLOFS "Offset Drucksensor Ladedruck" VALUE 0x12748 KwSw 2559.96 p_sw_q0p039 -1280 1279.96 FORMAT "%8.3" /end CHARACTERISTIC
/begin CHARACTERISTIC NDSVLU "Drehzahlschwelle für Signalvergleich Ladedruck mit Umgebungsdruck" VALUE 0x103E0 KwUb 10200 nmot_ub_q40 0 10200 FORMAT "%5.0" /end CHARACTERISTIC
/begin CHARACTERISTIC TDDFL "Entprellzeit für Fehlereintrag Drucksensor Ladedruck" VALUE 0x103EB KwUb 25.5 t100msxs_ub_b25p5 0 25.5 FORMAT "%5.2" /end CHARACTERISTIC
/begin CHARACTERISTIC TDDSVLU "Entprellzeit für Fehlereintrag Drucksensorvergleich (DS-L DS-U)" VALUE 0x103ED KwUb 25.5 t100msxs_ub_b25p5 0 25.5 FORMAT "%5.2" /end CHARACTERISTIC
/begin CHARACTERISTIC UADPLMN "min. Spannungswert für Diagnose Drucksensor Ladedruck" VALUE 0x103EE KwUb 5 spg_ub_b5 0 5 FORMAT "%5.3" /end CHARACTERISTIC
/begin CHARACTERISTIC UADPLMX "max. Spannungswert für Diagnose Drucksensor Ladedruck" VALUE 0x103EF KwUb 5 spg_ub_b5 0 5 FORMAT "%5.3" /end CHARACTERISTIC
/begin CHARACTERISTIC PUE "Ersatzwert für Umgebungsdruck" VALUE 0x12740 KwUw 2559.96 p_uw_q0p039 0 2559.96 FORMAT "%8.3" /end CHARACTERISTIC
/begin CHARACTERISTIC PUMX "Umgebungsdruckbegrenzung maximal" VALUE 0x12744 KwUw 2559.96 p_uw_q0p039 0 2559.96 FORMAT "%8.3" /end CHARACTERISTIC
/begin CHARACTERISTIC PUMN "Umgebungsdruckbegrenzung minimal" VALUE 0x12742 KwUw 2559.96 p_uw_q0p039 0 2559.96 FORMAT "%8.3" /end CHARACTERISTIC
/begin CHARACTERISTIC DSUGRAD "Gradient für Drucksensor Umgebung" VALUE 0x1273C KwUw 1023.98 dgrad_uw_q0p015 0 1023.98 FORMAT "%8.3" /end CHARACTERISTIC
/begin CHARACTERISTIC DPDSVLU "Delta Druckwert für Signalvergleich Ladedruck mit Umgebungsdruck" VALUE 0x12718 KwUw 2559.96 p_uw_q0p039 0 2559.96 FORMAT "%8.3" /end CHARACTERISTIC
/begin CHARACTERISTIC DSUOFS "Offset Drucksensor Umgebung" VALUE 0x1273E KwSw 2559.96 p_sw_q0p039 -1280 1279.96 FORMAT "%8.3" /end CHARACTERISTIC
/begin CHARACTERISTIC FHOE "Ersatzwert für Höhe" VALUE 0x103DF KwUb 3.98438 fak_ub_b4 0 3.98438 FORMAT "%5.3" /end CHARACTERISTIC
/begin CHARACTERISTIC UADPUMN "min. Spannungswert für Diagnose Drucksensor" VALUE 0x103F0 KwUb 4.98047 spg_ub_q0p019 0 4.98047 FORMAT "%5.3" /end CHARACTERISTIC
/begin CHARACTERISTIC UADPUMX "max. Spannungswert für Diagnose Drucksensor" VALUE 0x103F1 KwUb 4.98047 spg_ub_q0p019 0 4.98047 FORMAT "%5.3" /end CHARACTERISTIC
/begin CHARACTERISTIC TDDFU "Entprellzeit für Fehlereintrag Druckksensor Umgebung" VALUE 0x103EC KwUb 25.5 t100msxs_ub_b25p5 0 25.5 FORMAT "%5.2" /end CHARACTERISTIC
/begin CHARACTERISTIC ZDSU "Zeitkonstante für Filterung von pu und fho in GGDSU" VALUE 0x103F2 KwUb 25.4996 zk100msxs_ub_b25p5 0.100392 25.6 FORMAT "%5.2" /end CHARACTERISTIC
/begin CHARACTERISTIC PVDKMN "pvdk min. Schwelle für Fehlererkennung Ladedrucksensor" VALUE 0x103E1 KwUb 2550 p_ub_q10 0 2550 FORMAT "%5.0" /end CHARACTERISTIC
/begin CHARACTERISTIC PVDKMX "Ladedruckgrenze für Diagnose max. Fehler" CURVE 0x103E2 KlAUbSstUbWUb 2550 p_ub_q10 0 2550 FORMAT "%5.0" /begin AXIS_DESCR STD_AXIS nmot nmot_ub_q40 4 0 10200 DEPOSIT ABSOLUTE /end AXIS_DESCR /end CHARACTERISTIC
/begin CHARACTERISTIC DPUPVDK "Differenzdruck pu-pvdk" CURVE 0x1271A KlAUwSstUwWUw 2559.96 p_uw_q0p039 0 2559.96 FORMAT "%8.3" /begin AXIS_DESCR STD_AXIS ml_w m_uw_b6553p5 8 0 6553.5 DEPOSIT ABSOLUTE /end AXIS_DESCR /end CHARACTERISTIC
/begin CHARACTERISTIC LDFK "Ladedruck Filterkonstante" CURVE 0x1274A KlAUwSstUwWUw 655.35 zk10msxs_uw_b655 0.0100002 655.36 FORMAT "%8.4" /begin AXIS_DESCR STD_AXIS pspvdkds_w fak_uw_b4 4 0 3.99994 DEPOSIT ABSOLUTE /end AXIS_DESCR /end CHARACTERISTIC
/begin CHARACTERISTIC DSSGRAD "Gradient für Drucksensor Saugrohrdruck" VALUE 0x1275C KwUw 1023.98 dgrad_uw_q0p015 0 1023.98 FORMAT "%8.3" /end CHARACTERISTIC
/begin CHARACTERISTIC DSSOFS "Offset Drucksensor Saugrohrdruck" VALUE 0x1275E KwSw 2559.96 p_sw_q0p039 -1280 1279.96 FORMAT "%8.3" /end CHARACTERISTIC
/begin CHARACTERISTIC CWVWKNWS "Code Wort: Vorlagerungswinkelkorrektur bei NWS" VALUE 0x1043A KwUb 255 dez 0 255 FORMAT "%5.1" /end CHARACTERISTIC
/begin CHARACTERISTIC DWEEMX "maximal zulässige Zunahme Winkel Einspritzende pro Syncro" VALUE 0x10518 KwUb 1530 zw_ub_q6 0 1530 FORMAT "%5.0" /end CHARACTERISTIC
/begin CHARACTERISTIC WEESTN "Winkel Einspritzende im Start" CURVE 0x104FE KlAUbSstUbWUb 1530 zw_ub_q6 0 1530 FORMAT "%5.0" /begin AXIS_DESCR STD_AXIS nmot nmot_ub_q40 4 0 10200 DEPOSIT ABSOLUTE /end AXIS_DESCR /end CHARACTERISTIC
/begin CHARACTERISTIC ZZWEETM "Umschaltschwelle Vorlagerungswinkel" CURVE 0x10507 KlAUbSstUbWUb 255 dez 0 255 FORMAT "%5.1"
 /begin AXIS_DESCR STD_AXIS tmst temp_ub_q0p75_o48 8 -48 143.25 DEPOSIT ABSOLUTE /end AXIS_DESCR
/end CHARACTERISTIC
/begin CHARACTERISTIC WEESTM "Vorlagerunswinkel-Korrektur im Start" CURVE 0x104F6 GklWUb 1530 zw_ub_q6 0 1530 FORMAT "%5.0"
 /begin AXIS_DESCR COM_AXIS tmot temp_ub_q0p75_o48 8 -48 143.25 AXIS_PTS_REF STM08GKUB /end AXIS_DESCR
/end CHARACTERISTIC
/begin CHARACTERISTIC WEAN "Winkel Einspritzabbruch" CURVE 0x104DE GklWUb 1530 zw_ub_q6 0 1530 FORMAT "%5.0" /begin AXIS_DESCR COM_AXIS nmot nmot_ub_q40 8 0 10200 AXIS_PTS_REF SNM08GKUB /end AXIS_DESCR /end CHARACTERISTIC
/begin CHARACTERISTIC WEEHLN "Winkel Einspritzende bei hoher Last" CURVE 0x104E6 GklWUb 1530 zw_ub_q6 0 1530 FORMAT "%5.0" /begin AXIS_DESCR COM_AXIS nmot nmot_ub_q40 8 0 10200 AXIS_PTS_REF SNM08GKUB /end AXIS_DESCR /end CHARACTERISTIC
/begin CHARACTERISTIC WDKEEHL "Schwelle zur Umschaltung des Einspritzendes bei hoher Last" CURVE 0x104D6 GklWUb 100 relDK_ub_b100 0 100 FORMAT "%5.1" /begin AXIS_DESCR COM_AXIS nmot nmot_ub_q40 8 0 10200 AXIS_PTS_REF SNM08GKUB /end AXIS_DESCR /end CHARACTERISTIC
/begin CHARACTERISTIC WEEM "Vorlagerungswinkel - Korrektur" CURVE 0x104EE GklWUb 1530 zw_ub_q6 0 1530 FORMAT "%5.0"
 /begin AXIS_DESCR COM_AXIS tmot temp_ub_q0p75_o48 8 -48 143.25 AXIS_PTS_REF STM08GKUB /end AXIS_DESCR
/end CHARACTERISTIC
/begin CHARACTERISTIC KFWEEK "Kennfeld-Kalt Winkel Einspritzende" MAP 0x1047B GkfWUb 1530 zw_ub_q6 0 1530 FORMAT "%5.0" /begin AXIS_DESCR COM_AXIS rl rel_ub_q0p75 8 0 191.25 AXIS_PTS_REF SRL08GKUB /end AXIS_DESCR /begin AXIS_DESCR COM_AXIS nmot nmot_ub_q40 8 0 10200 AXIS_PTS_REF SNM08GKUB /end AXIS_DESCR /end CHARACTERISTIC
/begin CHARACTERISTIC KFWEE "Kennfeld Winkel Einspritzende" MAP 0x1043B GkfWUb 1530 zw_ub_q6 0 1530 FORMAT "%5.0" /begin AXIS_DESCR COM_AXIS rl rel_ub_q0p75 8 0 191.25 AXIS_PTS_REF SRL08GKUB /end AXIS_DESCR /begin AXIS_DESCR COM_AXIS nmot nmot_ub_q40 8 0 10200 AXIS_PTS_REF SNM08GKUB /end AXIS_DESCR /end CHARACTERISTIC
/begin CHARACTERISTIC FWFN "Faktor Wandfilm Drehzahleinfluss" VALUE 0x107F6 KwUb 1.49414 rel_ub_b1p4941 0 1.49414 FORMAT "%5.3" /end CHARACTERISTIC
/begin CHARACTERISTIC DUKK "Schwelle für Kurzzeitanteil" VALUE 0x128C8 KwSw 12287.8 rel_sw_q0p1875 -6144 6143.81 FORMAT "%8.3" /end CHARACTERISTIC
/begin CHARACTERISTIC TNSUUK "Zeit UK-Unterdrückung im Nachstart" VALUE 0x107F7 KwUb 25.5 t100msxs_ub_b25p5 0 25.5 FORMAT "%5.2" /end CHARACTERISTIC
/begin CHARACTERISTIC ZUKK "Abregelfaktor Kurzzeitanteil" VALUE 0x107F8 KwUb 0.996094 fak_ub_b1 0 0.996094 FORMAT "%5.3" /end CHARACTERISTIC
/begin CHARACTERISTIC FVANST "Gewichtungsfaktor VA im Nachstart" VALUE 0x107F5 KwUb 1.99219 fak_ub_b2 0 1.99219 FORMAT "%5.3" /end CHARACTERISTIC
/begin CHARACTERISTIC DRLPUK "Freigabe Delta Wandfilm durch drlp" VALUE 0x128C6 KwSw 1535.98 rel_sw_q0p0234 -768 767.977 FORMAT "%8.4" /end CHARACTERISTIC
/begin CHARACTERISTIC RKBAUM "rk-Schwelle für BA-Anzeige" CURVE 0x128CA KlAUbSstUbWUw 3071.95 rel_uw_b3072 0 3071.95 FORMAT "%8.3"
 /begin AXIS_DESCR STD_AXIS tmot temp_ub_q0p75_o48 5 -48 143.25 DEPOSIT ABSOLUTE /end AXIS_DESCR
/end CHARACTERISTIC
/begin CHARACTERISTIC RKVAUM "rk-Schwelle für VA-Anzeige" CURVE 0x128DC KlAUbSstUbWUw 3071.95 rel_uw_b3072 0 3071.95 FORMAT "%8.3"
 /begin AXIS_DESCR STD_AXIS tmot temp_ub_q0p75_o48 5 -48 143.25 DEPOSIT ABSOLUTE /end AXIS_DESCR
/end CHARACTERISTIC
/begin CHARACTERISTIC RKUKKLU "Schwelle Summe Kurz-/Langzeitanteil" VALUE 0x128DA KwSw 12287.8 rel_sw_q0p1875 -6144 6143.81 FORMAT "%8.3" /end CHARACTERISTIC
/begin CHARACTERISTIC ZUKNST "Abregelzeitkonstante ÜK-Faktor im Nachstart" VALUE 0x12920 KwUw 6553.5 zk100msxs_uw_b6553 0.100002 6553.6 FORMAT "%8.3" /end CHARACTERISTIC
/begin CHARACTERISTIC KFBAKL "Faktor Beschleunigungsanreicherung (K+L-Anteil)" MAP 0x10735 KfAxUbAyUbSstxUbSstyUbWUb 15.9375 fak_ub_b16 0 15.9375 FORMAT "%5.2"
 /begin AXIS_DESCR STD_AXIS tmot temp_ub_q0p75_o48 9 -48 143.25 DEPOSIT ABSOLUTE /end AXIS_DESCR
 /begin AXIS_DESCR STD_AXIS nmot nmot_ub_q40 7 0 10200 DEPOSIT ABSOLUTE /end AXIS_DESCR
/end CHARACTERISTIC
/begin CHARACTERISTIC KFVAKL "Faktor Verzögerungsabmagerung (K+L-Anteil)" MAP 0x10786 KfAxUbAyUbSstxUbSstyUbWUb 15.9375 fak_ub_b16 0 15.9375 FORMAT "%5.2"
 /begin AXIS_DESCR STD_AXIS tmot temp_ub_q0p75_o48 9 -48 143.25 DEPOSIT ABSOLUTE /end AXIS_DESCR
 /begin AXIS_DESCR STD_AXIS nmot nmot_ub_q40 7 0 10200 DEPOSIT ABSOLUTE /end AXIS_DESCR
/end CHARACTERISTIC
/begin CHARACTERISTIC KFABAK "Aufteilungsfaktor Wandfilm bei BA" MAP 0x10693 KfAxUbAyUbSstxUbSstyUbWUb 0.996094 fak_ub_b1 0 0.996094 FORMAT "%5.3"
 /begin AXIS_DESCR STD_AXIS tmot temp_ub_q0p75_o48 9 -48 143.25 DEPOSIT ABSOLUTE /end AXIS_DESCR
 /begin AXIS_DESCR STD_AXIS nmot nmot_ub_q40 7 0 10200 DEPOSIT ABSOLUTE /end AXIS_DESCR
/end CHARACTERISTIC
/begin CHARACTERISTIC KFAVAK "Aufteilungsfaktor Wandfilm bei VA" MAP 0x106E4 KfAxUbAyUbSstxUbSstyUbWUb 0.996094 fak_ub_b1 0 0.996094 FORMAT "%5.3"
 /begin AXIS_DESCR STD_AXIS tmot temp_ub_q0p75_o48 9 -48 143.25 DEPOSIT ABSOLUTE /end AXIS_DESCR
 /begin AXIS_DESCR STD_AXIS nmot nmot_ub_q40 7 0 10200 DEPOSIT ABSOLUTE /end AXIS_DESCR
/end CHARACTERISTIC
/begin CHARACTERISTIC FUKNSTM "Startwert Faktor ÜK im Nachstart" CURVE 0x10680 KlAUbSstUbWUb 3.98438 fak_ub_b4 0 3.98438 FORMAT "%5.3"
 /begin AXIS_DESCR STD_AXIS tmst temp_ub_q0p75_o48 9 -48 143.25 DEPOSIT ABSOLUTE /end AXIS_DESCR
/end CHARACTERISTIC
/begin CHARACTERISTIC WFRL "Kraftstoffwandfilmkennlinie" CURVE 0x128EC FklWUw 6143.91 rel_uw_b6144 0 6143.91 FORMAT "%8.3"
 /begin AXIS_DESCR FIX_AXIS rlp_w rel_uw_q0p0234 26 0 155.977 FIX_AXIS_PAR 0 8 26 /end AXIS_DESCR
/end CHARACTERISTIC
/begin CHARACTERISTIC ZBALM "Abregelfaktor L-Speicher (tmot) BA" CURVE 0x107D7 KlAUbSstUbWUb 0.124512 fak_ub_b0p125 0 0.124512 FORMAT "%5.3"
 /begin AXIS_DESCR STD_AXIS tmot temp_ub_q0p75_o48 7 -48 143.25 DEPOSIT ABSOLUTE /end AXIS_DESCR
/end CHARACTERISTIC
/begin CHARACTERISTIC ZVALM "Abregelfaktor L-Speicher (tmot) VA" CURVE 0x107E6 KlAUbSstUbWUb 0.124512 fak_ub_b0p125 0 0.124512 FORMAT "%5.3"
 /begin AXIS_DESCR STD_AXIS tmot temp_ub_q0p75_o48 7 -48 143.25 DEPOSIT ABSOLUTE /end AXIS_DESCR
/end CHARACTERISTIC
/begin CHARACTERISTIC FIMWU "Faktor Impuls weich" CURVE 0x10809 FklWUb 1.99219 fak_ub_b2 0 1.99219 FORMAT "%5.3" /begin AXIS_DESCR FIX_AXIS anzwefim dez 16 0 15 FIX_AXIS_PAR 0 0 16 /end AXIS_DESCR /end CHARACTERISTIC
/begin CHARACTERISTIC FIMHU "Faktor Impuls hart" CURVE 0x107F9 FklWUb 1.99219 fak_ub_b2 0 1.99219 FORMAT "%5.3" /begin AXIS_DESCR FIX_AXIS anzwefim dez 16 0 15 FIX_AXIS_PAR 0 0 16 /end AXIS_DESCR /end CHARACTERISTIC
/begin CHARACTERISTIC ZKLANSWL "Zeitkonstante Filterung lamnswl_w" VALUE 0x1293A KwUw 655.35 zk10msxs_uw_b655 0.0100002 655.36 FORMAT "%8.4" /end CHARACTERISTIC
/begin CHARACTERISTIC ATISLATM "Anzti-Schwelle zur Umschaltung von lamns_w auf lamwl_w" CURVE 0x12922 GklWUw 50176 dez 0 50176 FORMAT "%8.2"
 /begin AXIS_DESCR COM_AXIS tmst temp_ub_q0p75_o48 12 -48 143.25 AXIS_PTS_REF STS12ESUB /end AXIS_DESCR
/end CHARACTERISTIC
/begin CHARACTERISTIC LASWLTM "Offset Lambda-Motor-Soll bei inaktiver Lambdaregelung" CURVE 0x10939 GklWSb 1.99219 fak_sb_b1 -1 0.992188 FORMAT "%5.3"
 /begin AXIS_DESCR COM_AXIS tmot temp_ub_q0p75_o48 12 -48 143.25 AXIS_PTS_REF STM12ESUB /end AXIS_DESCR
/end CHARACTERISTIC
/begin CHARACTERISTIC KFLASWLR "Kennfeld Lambda-Motor-Soll im Warmlauf bei aktiver LR" MAP 0x108A9 GkfWUb 1.99219 fak_ub_b2 0 1.99219 FORMAT "%5.3"
 /begin AXIS_DESCR COM_AXIS tmot temp_ub_q0p75_o48 12 -48 143.25 AXIS_PTS_REF STM12ESUB /end AXIS_DESCR
 /begin AXIS_DESCR COM_AXIS tmst temp_ub_q0p75_o48 12 -48 143.25 AXIS_PTS_REF STS12ESUB /end AXIS_DESCR
/end CHARACTERISTIC
/begin CHARACTERISTIC KFFWL "Kennfeld Warmlauffaktor" MAP 0x10819 GkfWUb 1.99219 fak_ub_b2 0 1.99219 FORMAT "%5.3"
 /begin AXIS_DESCR COM_AXIS tmot temp_ub_q0p75_o48 12 -48 143.25 AXIS_PTS_REF STM12ESUB /end AXIS_DESCR
 /begin AXIS_DESCR COM_AXIS tmst temp_ub_q0p75_o48 12 -48 143.25 AXIS_PTS_REF STS12ESUB /end AXIS_DESCR
/end CHARACTERISTIC
/begin CHARACTERISTIC KFFWLW "Kennfeld Wichtung Warmlauffaktor" MAP 0x10945 GkfWUb 0.996094 fak_ub_b1 0 0.996094 FORMAT "%5.3"
 /begin AXIS_DESCR COM_AXIS nmot nmot_ub_q40 12 0 10200 AXIS_PTS_REF SNM12ESUB /end AXIS_DESCR
 /begin AXIS_DESCR COM_AXIS rl rel_ub_q0p75 12 0 191.25 AXIS_PTS_REF SRL12ESUB /end AXIS_DESCR
/end CHARACTERISTIC
/begin CHARACTERISTIC FRKAP "Faktor relative Kraftstoffmasse für Applikation" VALUE 0x109D5 KwUb 1.99219 fak_ub_b2 0 1.99219 FORMAT "%5.3" /end CHARACTERISTIC
/begin CHARACTERISTIC KFBS "Kennfeld für banksel. Gemischfaktor" MAP 0x1293C KfAxUbAyUbSstxUbSstyUbWSb 0.498047 fak_sb_b0p25 -0.25 0.248047 FORMAT "%5.3" /begin AXIS_DESCR STD_AXIS nmot nmot_ub_q40 3 0 10200 DEPOSIT ABSOLUTE /end AXIS_DESCR /begin AXIS_DESCR STD_AXIS rl rel_ub_q0p75 3 0 191.25 DEPOSIT ABSOLUTE /end AXIS_DESCR /end CHARACTERISTIC
/begin CHARACTERISTIC KFLBTS "Lambdasoll für Bauteileschutz" MAP 0x10A96 GkfWUb 1 fak_ub_b2 0 1 FORMAT "%5.3"
 /begin AXIS_DESCR COM_AXIS rl rel_ub_q0p75 12 0 191.25 AXIS_PTS_REF SRL12GKUB /end AXIS_DESCR
 /begin AXIS_DESCR COM_AXIS nmot nmot_ub_q40 16 0 10200 AXIS_PTS_REF SNM16GKUB /end AXIS_DESCR
/end CHARACTERISTIC
/begin CHARACTERISTIC KFFDLBTS "Faktor Delta Lambdasoll für Bauteileschutz" MAP 0x109D6 GkfWUb 1.99219 fak_ub_b2 0 1.99219 FORMAT "%5.3"
 /begin AXIS_DESCR COM_AXIS rl rel_ub_q0p75 12 0 191.25 AXIS_PTS_REF SRL12GKUB /end AXIS_DESCR
 /begin AXIS_DESCR COM_AXIS nmot nmot_ub_q40 16 0 10200 AXIS_PTS_REF SNM16GKUB /end AXIS_DESCR
/end CHARACTERISTIC
/begin CHARACTERISTIC DLBTS "Delta Lambdasoll für Bauteileschutz" CURVE 0x1294E KlAUbSstUbWSb 1 fak_sb_b1 -1 0 FORMAT "%5.3" /begin AXIS_DESCR STD_AXIS detazwbs rel_ub_b127p5 6 0 127.5 DEPOSIT ABSOLUTE /end AXIS_DESCR /end CHARACTERISTIC
/begin CHARACTERISTIC ZDLBTS "Zeitkonstante Delta Lambda Bauteileschutz" VALUE 0x12960 KwUw 6553.5 zk100msxs_uw_b6553 0.100002 6553.6 FORMAT "%8.3" /end CHARACTERISTIC
/begin CHARACTERISTIC TABGBTS "Abgastemperaturschwelle für Bauteileschutz" VALUE 0x1295E KwUw 1279.98 temp_uw_q0p0195_o50 -50 1229.98 FORMAT "%8.3" /end CHARACTERISTIC
/begin CHARACTERISTIC DTBTS "Temperaturhysterese für Bauteileschutz" VALUE 0x1295C KwUw 1279.98 temp_uw_q0p0195 0 1279.98 FORMAT "%8.3" /end CHARACTERISTIC
/begin CHARACTERISTIC KFLAMMP1 "Lambdasollwert Fahrerwunsch, Map Position 1 (default)" MAP 0x10B74 KfAxUbAyUbSstxUbSstyUbWUb 1.99219 fak_ub_b2 0 1.99219 FORMAT "%5.3" /begin AXIS_DESCR STD_AXIS nmot nmot_ub_q40 10 0 10200 DEPOSIT ABSOLUTE /end AXIS_DESCR /begin AXIS_DESCR STD_AXIS wdkba relDK_ub_b100 6 0 100 DEPOSIT ABSOLUTE /end AXIS_DESCR /end CHARACTERISTIC
/begin CHARACTERISTIC KFLAMMP2 "Lambdasollwert Fahrerwunsch, Map Position 2" MAP 0x10BC2 KfAxUbAyUbSstxUbSstyUbWUb 1.99219 fak_ub_b2 0 1.99219 FORMAT "%5.3" /begin AXIS_DESCR STD_AXIS nmot nmot_ub_q40 10 0 10200 DEPOSIT ABSOLUTE /end AXIS_DESCR /begin AXIS_DESCR STD_AXIS wdkba relDK_ub_b100 6 0 100 DEPOSIT ABSOLUTE /end AXIS_DESCR /end CHARACTERISTIC
/begin CHARACTERISTIC KFLAMMP3 "Lambdasollwert Fahrerwunsch, Map Position 3" MAP 0x10C10 KfAxUbAyUbSstxUbSstyUbWUb 1.99219 fak_ub_b2 0 1.99219 FORMAT "%5.3" /begin AXIS_DESCR STD_AXIS nmot nmot_ub_q40 10 0 10200 DEPOSIT ABSOLUTE /end AXIS_DESCR /begin AXIS_DESCR STD_AXIS wdkba relDK_ub_b100 6 0 100 DEPOSIT ABSOLUTE /end AXIS_DESCR /end CHARACTERISTIC
/begin CHARACTERISTIC LAMLGF "Laufgrenze \"fett\"" VALUE 0x10C5E KwUb 1.99219 fak_ub_b2 0 1.99219 FORMAT "%5.3" /end CHARACTERISTIC
/begin CHARACTERISTIC LAMLGMTM "Laufgrenze \"mager\"" CURVE 0x10C5F GklWUb 1.99219 fak_ub_b2 0 1.99219 FORMAT "%5.3"
 /begin AXIS_DESCR COM_AXIS tmot temp_ub_q0p75_o48 12 -48 143.25 AXIS_PTS_REF STM12ESUB /end AXIS_DESCR
/end CHARACTERISTIC
/begin CHARACTERISTIC NOLRA "Codewort für Adaptionsfreigabe" VALUE 0x10C6E KwUb 255 dez 0 255 FORMAT "%5.1" /end CHARACTERISTIC
/begin CHARACTERISTIC FRAMX "obere Begrenzung des Korrekturfaktors fra" VALUE 0x10C6C KwUb 1.99219 fak_ub_b2 0 1.99219 FORMAT "%5.3" /end CHARACTERISTIC
/begin CHARACTERISTIC FRAMN "untere Begrenzung des Korrekturfaktors fra" VALUE 0x10C6B KwUb 1.99219 fak_ub_b2 0 1.99219 FORMAT "%5.3" /end CHARACTERISTIC
/begin CHARACTERISTIC RKATMX "obere Schwelle additive Korrektur pro Zeit" VALUE 0x1296A KwSw 3071.95 rel_sw_b1536 -1536 1535.95 FORMAT "%8.3" /end CHARACTERISTIC
/begin CHARACTERISTIC RKATMN "untere Schwelle additive Korrektur pro Zeit" VALUE 0x12968 KwSw 3071.95 rel_sw_b1536 -1536 1535.95 FORMAT "%8.3" /end CHARACTERISTIC
/begin CHARACTERISTIC RKAZMX "obere Schwelle additive Korrektur pro Zündung" VALUE 0x1296E KwSw 3071.95 rel_sw_b1536 -1536 1535.95 FORMAT "%8.3" /end CHARACTERISTIC
/begin CHARACTERISTIC RKAZMN "untere Schwelle additive Korrektur pro Zündung" VALUE 0x1296C KwSw 3071.95 rel_sw_b1536 -1536 1535.95 FORMAT "%8.3" /end CHARACTERISTIC
/begin CHARACTERISTIC NRKAB "Mindestdrehzahl für Begrenzung Stelleingriff rkat bei niedrigen Drehzahlen" VALUE 0x10C74 KwUb 10200 nmot_ub_q40 0 10200 FORMAT "%5.0" /end CHARACTERISTIC
/begin CHARACTERISTIC NO1 "obere Drehzahlschwelle Bereich 1" VALUE 0x10C6D KwUb 10200 nmot_ub_q40 0 10200 FORMAT "%5.0" /end CHARACTERISTIC
/begin CHARACTERISTIC NU3 "untere Drehzahlschwelle Bereich 3" VALUE 0x10C6F KwUb 10200 nmot_ub_q40 0 10200 FORMAT "%5.0" /end CHARACTERISTIC
/begin CHARACTERISTIC N0 "Umrechnungskonstante für Einrechnung Gemischkorrektur rkat" VALUE 0x10C73 KwUb 10200 nmot_ub_q40 0 10200 FORMAT "%5.0" /end CHARACTERISTIC
/begin CHARACTERISTIC MLO1 "obere Luftmengenschwelle Bereich 1" VALUE 0x12962 KwUw 6553.5 m_uw_b6553p5 0 6553.5 FORMAT "%8.3" /end CHARACTERISTIC
/begin CHARACTERISTIC MLU2 "untere Luftmengenschwelle Bereich 2" VALUE 0x12966 KwUw 6553.5 m_uw_b6553p5 0 6553.5 FORMAT "%8.3" /end CHARACTERISTIC
/begin CHARACTERISTIC MLO3 "obere Luftmengenschwelle Bereich 3" VALUE 0x12964 KwUw 6553.5 m_uw_b6553p5 0 6553.5 FORMAT "%8.3" /end CHARACTERISTIC
/begin CHARACTERISTIC RLU2 "untere rl - Schwelle Bereich 2" VALUE 0x10C71 KwUb 191.25 rel_ub_q0p75 0 191.25 FORMAT "%5.1" /end CHARACTERISTIC
/begin CHARACTERISTIC RLU3 "untere rl - Schwelle Bereich 3" VALUE 0x10C72 KwUb 191.25 rel_ub_q0p75 0 191.25 FORMAT "%5.1" /end CHARACTERISTIC
/begin CHARACTERISTIC RLO3 "obere rl - Schwelle Bereich 3" VALUE 0x10C70 KwUb 191.25 rel_ub_q0p75 0 191.25 FORMAT "%5.1" /end CHARACTERISTIC
/begin CHARACTERISTIC ZKFRA "Zeitkonstante für Fra-Integrator" VALUE 0x12970 KwUw 4.99992 zk200msxs_uw_b5 0 4.99992 FORMAT "%8.6" /end CHARACTERISTIC
/begin CHARACTERISTIC ZKRKAT "Integrationsgeschwindigkeit Integrator rkat" VALUE 0x12972 KwUw 959.985 zk200msxs_uw_b960 0 959.985 FORMAT "%8.4" /end CHARACTERISTIC
/begin CHARACTERISTIC ZKRKAZ "Integrationsgeschwindigkeit Integrator rkaz" VALUE 0x12974 KwUw 959.985 zk200msxs_uw_b960 0 959.985 FORMAT "%8.4" /end CHARACTERISTIC
/begin CHARACTERISTIC TADE "Ersatzgröße Lufttemperatur im Fehlerfall" VALUE 0x10C8D KwUb 191.25 temp_ub_q0p75_o48 -48 143.25 FORMAT "%5.1" /end CHARACTERISTIC
/begin CHARACTERISTIC TADMN "Ansauglufttemperatur min." VALUE 0x10C8E KwUb 191.25 temp_ub_q0p75_o48 -48 143.25 FORMAT "%5.1" /end CHARACTERISTIC
/begin CHARACTERISTIC TADMX "Ansauglufttemperatur max." VALUE 0x10C8F KwUb 191.25 temp_ub_q0p75_o48 -48 143.25 FORMAT "%5.1" /end CHARACTERISTIC
/begin CHARACTERISTIC TANSELI "Temperatur Ansaugluft-Erfassung u. Linearisierung, Inverskennlinie" CURVE 0x10C90 KlAUbSstUbWUb 191.25 temp_ub_q0p75_o48 -48 143.25 FORMAT "%5.1" /begin AXIS_DESCR STD_AXIS wtans spg_ub_q0p019 20 0 4.98047 DEPOSIT ABSOLUTE /end AXIS_DESCR /end CHARACTERISTIC
/begin CHARACTERISTIC TDNSTA "Auspufferwärmzeit ab Start, für TANS - Diagnose" VALUE 0x10CB9 KwUb 255 t1sxs_ub_b255 0 255 FORMAT "%5.1" /end CHARACTERISTIC
/begin CHARACTERISTIC TDTA "Entprellzeit Fehlererkennung TANS" VALUE 0x10CBA KwUb 25.5 t100msxs_ub_b25p5 0 25.5 FORMAT "%5.2" /end CHARACTERISTIC
/begin CHARACTERISTIC TDTAL "TANS Fehlererkennung / Zeitsperre ab B_LL = 1" VALUE 0x10CBB KwUb 255 t1sxs_ub_b255 0 255 FORMAT "%5.1" /end CHARACTERISTIC
/begin CHARACTERISTIC DTMTE "Motortemperaturgradient für Ersatztemperatur" VALUE 0x10CBD KwSb 0.186768 temp_sb_b0p093 -0.09375 0.0930176 FORMAT "%6.4" /end CHARACTERISTIC
/begin CHARACTERISTIC DTMTR "Motortemperaturgradient für Referenztemperatur" VALUE 0x10CBE KwSb 0.186768 temp_sb_b0p093 -0.09375 0.0930176 FORMAT "%6.4" /end CHARACTERISTIC
/begin CHARACTERISTIC TMOTELI "Temperatur Motor Erfassung u. Linearisierung, Inverskennlinie" CURVE 0x10CC5 KlAUbSstUbWUb 191.25 temp_ub_q0p75_o48 -48 143.25 FORMAT "%5.1" /begin AXIS_DESCR STD_AXIS wtmot spg_ub_q0p019 20 0 4.98047 DEPOSIT ABSOLUTE /end AXIS_DESCR /end CHARACTERISTIC
/begin CHARACTERISTIC TMDMX "Motortemperatur max." VALUE 0x10CC4 KwUb 191.25 temp_ub_q0p75_o48 -48 143.25 FORMAT "%5.1" /end CHARACTERISTIC
/begin CHARACTERISTIC TMDMN "Motortemperatur min." VALUE 0x10CC3 KwUb 191.25 temp_ub_q0p75_o48 -48 143.25 FORMAT "%5.1" /end CHARACTERISTIC
/begin CHARACTERISTIC DTMDMA "Abstand Motortemperaturmodell zur Starttemperatur" VALUE 0x10CBC KwUb 191.25 temp_ub_b191p25 0 191.25 FORMAT "%5.1" /end CHARACTERISTIC
/begin CHARACTERISTIC TDTM "Entprellzeit Fehlererkennung TMOT" VALUE 0x12BA2 KwUw 6553.5 t100msxs_uw_b6553p5 0 6553.5 FORMAT "%8.3" /end CHARACTERISTIC
/begin CHARACTERISTIC TMDMMER "Endtemperatur für Referenzwert Motortemperatur" VALUE 0x10CC2 KwUb 191.25 temp_ub_q0p75_o48 -48 143.25 FORMAT "%5.1" /end CHARACTERISTIC
/begin CHARACTERISTIC TMDMMEE "Endtemperatur für Ersatzwert Motortemperatur" VALUE 0x10CC1 KwUb 143 temp_ub_q0p75_o48 -48 95 FORMAT "%5.2" /end CHARACTERISTIC
/begin CHARACTERISTIC TMDMMA "Anfangstemperatur für Motortemperaturmodell" VALUE 0x10CBF KwUb 191.25 temp_ub_q0p75_o48 -48 143.25 FORMAT "%5.1" /end CHARACTERISTIC
/begin CHARACTERISTIC TMDMMAU "Unterster Anfangswert aus tans für Motortemperaturmodell" VALUE 0x10CC0 KwUb 191.25 temp_ub_q0p75_o48 -48 143.25 FORMAT "%5.1" /end CHARACTERISTIC
/begin CHARACTERISTIC TADMM "1. Stufenbreite (Zeit) für Motortemperaturmodell" VALUE 0x12BA0 KwUw 6553.5 t100msxs_uw_b6553p5 0 6553.5 FORMAT "%8.3" /end CHARACTERISTIC
/begin CHARACTERISTIC SENZZYL0 "Klopfsensor für SW-Zylinderzähler 0" VALUE 0x10D4E KwUb 3 dezsub1 1 4 FORMAT "%5.3" /end CHARACTERISTIC
/begin CHARACTERISTIC SENZZYL1 "Klopfsensor für SW-Zylinderzähler 1" VALUE 0x10D4F KwUb 3 dezsub1 1 4 FORMAT "%5.3" /end CHARACTERISTIC
/begin CHARACTERISTIC SENZZYL2 "Klopfsensor für SW-Zylinderzähler 2" VALUE 0x10D50 KwUb 3 dezsub1 1 4 FORMAT "%5.3" /end CHARACTERISTIC
/begin CHARACTERISTIC SENZZYL3 "Klopfsensor für SW-Zylinderzähler 3" VALUE 0x10D51 KwUb 3 dezsub1 1 4 FORMAT "%5.3" /end CHARACTERISTIC
/begin CHARACTERISTIC SENZZYL4 "Klopfsensor für SW-Zylinderzähler 4" VALUE 0x10D52 KwUb 3 dezsub1 1 4 FORMAT "%5.3" /end CHARACTERISTIC
/begin CHARACTERISTIC SENZZYL5 "Klopfsensor für SW-Zylinderzähler 5" VALUE 0x10D53 KwUb 3 dezsub1 1 4 FORMAT "%5.3" /end CHARACTERISTIC
/begin CHARACTERISTIC SENZZYL6 "Klopfsensor für SW-Zylinderzähler 6" VALUE 0x10D54 KwUb 3 dezsub1 1 4 FORMAT "%5.3" /end CHARACTERISTIC
/begin CHARACTERISTIC SENZZYL7 "Klopfsensor für SW-Zylinderzähler 7" VALUE 0x10D55 KwUb 3 dezsub1 1 4 FORMAT "%5.3" /end CHARACTERISTIC
/begin CHARACTERISTIC DKROKMX "Maximaler Offsetkompensationswert" VALUE 0x10D56 KwUb 5 spg_ub_b5 0 5 FORMAT "%5.3" /end CHARACTERISTIC
/begin CHARACTERISTIC DKROKO "Obere Drehzahlschwelle für Ermittlung Offsetkompensationswert" VALUE 0x10CFC KwUb 10200 nmot_ub_q40 0 10200 FORMAT "%5.0" /end CHARACTERISTIC
/begin CHARACTERISTIC FMFKR "Mittenfrequenz für Bandpaßfilter Klopfregelung" VALUE 0x10CFD KwUb 16 fmfkr_dez 0 16 FORMAT "%5.2" /end CHARACTERISTIC
/begin CHARACTERISTIC KEMLN "Messfensterlänge für Klopfregelung" CURVE 0x10CFE GklWUb 191.25 zw_ub_q0p75 0 191.25 FORMAT "%5.1"
 /begin AXIS_DESCR COM_AXIS nmot nmot_ub_q40 16 0 10200 AXIS_PTS_REF SNM16KRUB /end AXIS_DESCR
/end CHARACTERISTIC
/begin CHARACTERISTIC KFMAKR "Kennfeld Meßfensteranfang Klopfregelung" MAP 0x10D0E GkfWUb 191.25 zw_ub_q0p75 0 191.25 FORMAT "%5.1"
 /begin AXIS_DESCR COM_AXIS nmot nmot_ub_q40 16 0 10200 AXIS_PTS_REF SNM16KRUB /end AXIS_DESCR
 /begin AXIS_DESCR COM_AXIS rl rel_ub_q0p75 4 0 191.25 AXIS_PTS_REF SRL04KRUB /end AXIS_DESCR
/end CHARACTERISTIC
/begin CHARACTERISTIC KFDYES "Lastdynamikerkennungsschwelle" MAP 0x12CE2 GkfWUw 767.977 rel_uw_q0p0234 0 767.977 FORMAT "%8.4"
 /begin AXIS_DESCR COM_AXIS nmot nmot_ub_q40 16 0 10200 AXIS_PTS_REF SNM16KRUB /end AXIS_DESCR
 /begin AXIS_DESCR COM_AXIS rl rel_ub_q0p75 4 0 191.25 AXIS_PTS_REF SRL04DYUB /end AXIS_DESCR
/end CHARACTERISTIC
/begin CHARACTERISTIC KFDYESOF "Dynamikvorhalt Offsetschwelle" MAP 0x12D62 GkfWUw 767.977 rel_uw_q0p0234 0 767.977 FORMAT "%8.4"
 /begin AXIS_DESCR COM_AXIS nmot nmot_ub_q40 16 0 10200 AXIS_PTS_REF SNM16KRUB /end AXIS_DESCR
 /begin AXIS_DESCR COM_AXIS rl rel_ub_q0p75 4 0 191.25 AXIS_PTS_REF SRL04DYUB /end AXIS_DESCR
/end CHARACTERISTIC
/begin CHARACTERISTIC AZKRLDYN "Anzahl Zündungen pro Zyl. bei KR-Lastdynamik" CURVE 0x10D57 GklWUb 254 dez 1 255 FORMAT "%5.1"
 /begin AXIS_DESCR COM_AXIS nmot nmot_ub_q40 16 0 10200 AXIS_PTS_REF SNM16KRUB /end AXIS_DESCR
/end CHARACTERISTIC
/begin CHARACTERISTIC AZKRNDYN "Anzahl Zündungen für KR-Drehzahldynamik" CURVE 0x10D67 GklWUb 254 dez 1 255 FORMAT "%5.1"
 /begin AXIS_DESCR COM_AXIS nmot nmot_ub_q40 16 0 10200 AXIS_PTS_REF SNM16KRUB /end AXIS_DESCR
/end CHARACTERISTIC
/begin CHARACTERISTIC NGKRWN "Schwellwert Drehzahlgradient für Dynamikerkennung" CURVE 0x12DE2 GklWSw 12799.8 nmotg_sw_q0p39 0 12799.8 FORMAT "%8.2"
 /begin AXIS_DESCR COM_AXIS nmot nmot_ub_q40 16 0 10200 AXIS_PTS_REF SNM16KRUB /end AXIS_DESCR
/end CHARACTERISTIC
/begin CHARACTERISTIC DYADMX "Max. Wert des add. Dynamikvorhalts" VALUE 0x10D79 KwUb 24 zw_ub_qn0p75 -24 0 FORMAT "%5.2" /end CHARACTERISTIC
/begin CHARACTERISTIC DYADS "Add. Spätverstellung pro Zyk. durch lern. Dyn." VALUE 0x10D7A KwUb 24 zw_ub_qn0p75 -24 0 FORMAT "%5.2" /end CHARACTERISTIC
/begin CHARACTERISTIC DYAMNV "Min. Wert des add. Dynamikvorhalts" VALUE 0x10D7B KwUb 24 zw_ub_qn0p75 -24 0 FORMAT "%5.2" /end CHARACTERISTIC
/begin CHARACTERISTIC DYAVF "Abregelkonstante für Dynamikvorhalt" VALUE 0x10D7C KwUb 254 dez 1 255 FORMAT "%5.1" /end CHARACTERISTIC
/begin CHARACTERISTIC FKELDYA "Korrekturfaktor für Klopferkennungsschwelle bei Lastdynamikadaption" VALUE 0x10D7D KwUb 0.625 fak_ub_b16 0.625 1.25 FORMAT "%5.3" /end CHARACTERISTIC
/begin CHARACTERISTIC PZWKRA "Prozentuale Häufigkeit der ZW-Ausgabe durch die KR während Dynamikadaption" VALUE 0x10D7E KwUb 99.6094 rel_ub_b99p6 0 99.6094 FORMAT "%5.2" /end CHARACTERISTIC
/begin CHARACTERISTIC TMDYNA "TMOT - Schwelle für Lastdynamikadaption aktiv" VALUE 0x10D7F KwUb 191.25 temp_ub_q0p75_o48 -48 143.25 FORMAT "%5.1" /end CHARACTERISTIC
/begin CHARACTERISTIC CWKR "Codewort Klopfregelung" VALUE 0x10D77 KwUb 3 dez 0 3 FORMAT "%5.3" /end CHARACTERISTIC
/begin CHARACTERISTIC NKRUM "Drehzahlschwelle Umschalten Delta-Lastsignal für Lastdynamik" VALUE 0x10D78 KwUb 10200 nmot_ub_q40 0 10200 FORMAT "%5.0" /end CHARACTERISTIC
/begin CHARACTERISTIC ZYRKR "Zylinderzuordnung für maximale Referenzpegelbegrenzung Klopfregelung" VALUE 0x10E20 KwUb 255 dez 0 255 FORMAT "%5.1" /end CHARACTERISTIC
/begin CHARACTERISTIC KRKFKS "Zuordnung der Kloperkennungskennlinie bei fehlender Zyl.-1-Erkennung" VALUE 0x10E28 KwUb 255 dez 0 255 FORMAT "%5.1" /end CHARACTERISTIC
/begin CHARACTERISTIC KSZA "Anzahl Klopfsensoren" VALUE 0x10E2A KwUb 3 dez 1 4 FORMAT "%5.3" /end CHARACTERISTIC
/begin CHARACTERISTIC FKELDY "Korrekturfaktor für Klopferkennungsschwelle bei Lastdynamik" VALUE 0x10E23 KwUb 2 fak_ub_b16 0 2 FORMAT "%5.3" /end CHARACTERISTIC
/begin CHARACTERISTIC FKENDY "Korrekturfaktor für Klopferkennungsschwelle bei Drehzahldynamik" VALUE 0x10E24 KwUb 2 fak_ub_b16 0 2 FORMAT "%5.3" /end CHARACTERISTIC
/begin CHARACTERISTIC KRFTP1 "Tiefpassverhalten normal" VALUE 0x10E25 KwUb 24 dez 8 32 FORMAT "%5.2" /end CHARACTERISTIC
/begin CHARACTERISTIC KRFTP2 "Tiefpassverhalten bei Drehzahldynamik" VALUE 0x10E26 KwUb 14 dez 2 16 FORMAT "%5.2" /end CHARACTERISTIC
/begin CHARACTERISTIC KRFTP3 "Tiefpassverhalten bei Lastdynamik" VALUE 0x10E27 KwUb 14 dez 2 16 FORMAT "%5.2" /end CHARACTERISTIC
/begin CHARACTERISTIC KRVST "Verstärkung nach Start" VALUE 0x10E29 KwUb 6 dez 0 6 FORMAT "%5.3" /end CHARACTERISTIC
/begin CHARACTERISTIC REFINI "Startwert Referenzpegel bei Klopfregelung aktiv" VALUE 0x10E2B KwUb 0.72549 spg_ub_b5 0.294118 1.01961 FORMAT "%5.3" /end CHARACTERISTIC
/begin CHARACTERISTIC DKEMAP2 "Delta Klopferkennungsschwelle bei Mapposition 2" VALUE 0x10E21 KwSb 15.9375 fak_ub_b16 -8 7.9375 FORMAT "%5.3" /end CHARACTERISTIC
/begin CHARACTERISTIC DKEMAP3 "Delta Klopferkennungsschwelle bei Mapposition 3" VALUE 0x10E22 KwSb 15.9375 fak_ub_b16 -8 7.9375 FORMAT "%5.3" /end CHARACTERISTIC
/begin CHARACTERISTIC RKRMX1N "Maximaler Referenzpegel für Klopferkennungsschwelle Zyl.-gruppe 1" CURVE 0x10E00 GklWUb 317.5 spg_ub_b320 1.25 318.75 FORMAT "%5.1"
 /begin AXIS_DESCR COM_AXIS nmot nmot_ub_q40 16 0 10200 AXIS_PTS_REF SNM16KRUB /end AXIS_DESCR
/end CHARACTERISTIC
/begin CHARACTERISTIC RKRMX2N "Maximaler Referenzpegel für Klopferkennungsschwelle Zyl.-gruppe 2" CURVE 0x10E10 GklWUb 317.5 spg_ub_b320 1.25 318.75 FORMAT "%5.1"
 /begin AXIS_DESCR COM_AXIS nmot nmot_ub_q40 16 0 10200 AXIS_PTS_REF SNM16KRUB /end AXIS_DESCR
/end CHARACTERISTIC
/begin CHARACTERISTIC KE1N "Klopferkennungsschwelle bei Zylinderzähler 1" CURVE 0x10D80 GklWUb 15.9375 fak_ub_b16 0 15.9375 FORMAT "%5.2"
 /begin AXIS_DESCR COM_AXIS nmot nmot_ub_q40 16 0 10200 AXIS_PTS_REF SNM16KRUB /end AXIS_DESCR
/end CHARACTERISTIC
/begin CHARACTERISTIC KE2N "Klopferkennungsschwelle bei Zylinderzähler 2" CURVE 0x10D90 GklWUb 15.9375 fak_ub_b16 0 15.9375 FORMAT "%5.2"
 /begin AXIS_DESCR COM_AXIS nmot nmot_ub_q40 16 0 10200 AXIS_PTS_REF SNM16KRUB /end AXIS_DESCR
/end CHARACTERISTIC
/begin CHARACTERISTIC KE3N "Klopferkennungsschwelle bei Zylinderzähler 3" CURVE 0x10DA0 GklWUb 15.9375 fak_ub_b16 0 15.9375 FORMAT "%5.2"
 /begin AXIS_DESCR COM_AXIS nmot nmot_ub_q40 16 0 10200 AXIS_PTS_REF SNM16KRUB /end AXIS_DESCR
/end CHARACTERISTIC
/begin CHARACTERISTIC KE4N "Klopferkennungsschwelle bei Zylinderzähler 4" CURVE 0x10DB0 GklWUb 15.9375 fak_ub_b16 0 15.9375 FORMAT "%5.2"
 /begin AXIS_DESCR COM_AXIS nmot nmot_ub_q40 16 0 10200 AXIS_PTS_REF SNM16KRUB /end AXIS_DESCR
/end CHARACTERISTIC
/begin CHARACTERISTIC KE5N "Klopferkennungsschwelle bei Zylinderzähler 5" CURVE 0x10DC0 GklWUb 15.9375 fak_ub_b16 0 15.9375 FORMAT "%5.2"
 /begin AXIS_DESCR COM_AXIS nmot nmot_ub_q40 16 0 10200 AXIS_PTS_REF SNM16KRUB /end AXIS_DESCR
/end CHARACTERISTIC
/begin CHARACTERISTIC KE6N "Klopferkennungsschwelle bei Zylinderzähler 6" CURVE 0x10DD0 GklWUb 15.9375 fak_ub_b16 0 15.9375 FORMAT "%5.2"
 /begin AXIS_DESCR COM_AXIS nmot nmot_ub_q40 16 0 10200 AXIS_PTS_REF SNM16KRUB /end AXIS_DESCR
/end CHARACTERISTIC
/begin CHARACTERISTIC KE7N "Klopferkennungsschwelle bei Zylinderzähler 7" CURVE 0x10DE0 GklWUb 15.9375 fak_ub_b16 0 15.9375 FORMAT "%5.2"
 /begin AXIS_DESCR COM_AXIS nmot nmot_ub_q40 16 0 10200 AXIS_PTS_REF SNM16KRUB /end AXIS_DESCR
/end CHARACTERISTIC
/begin CHARACTERISTIC KE8N "Klopferkennungsschwelle bei Zylinderzähler 8" CURVE 0x10DF0 GklWUb 15.9375 fak_ub_b16 0 15.9375 FORMAT "%5.2"
 /begin AXIS_DESCR COM_AXIS nmot nmot_ub_q40 16 0 10200 AXIS_PTS_REF SNM16KRUB /end AXIS_DESCR
/end CHARACTERISTIC
/begin CHARACTERISTIC TMKR "Motortemperaturschwelle für Klopfregelung aktiv" VALUE 0x10ECC KwUb 191.25 temp_ub_q0p75_o48 -48 143.25 FORMAT "%5.1" /end CHARACTERISTIC
/begin CHARACTERISTIC TMKRA "Motortemperaturschwelle für adaptive Klopfregelung" VALUE 0x10ECD KwUb 191.25 temp_ub_q0p75_o48 -48 143.25 FORMAT "%5.1" /end CHARACTERISTIC
/begin CHARACTERISTIC KRNMDY "Lesen bei Drehzahlbereichswechsel: immer oder nur bei Dynamik" VALUE 0x10ED0 KwUb 1 dez 0 1 FORMAT "%5.3" /end CHARACTERISTIC
/begin CHARACTERISTIC KRLMDY "Lesen bei Lastbereichswechsel: immer oder nur bei Dynamik" VALUE 0x10ECF KwUb 1 dez 0 1 FORMAT "%5.3" /end CHARACTERISTIC
/begin CHARACTERISTIC KRWKRUM "Speichern bei Klopfen: Wert vor oder nach Klopfen" VALUE 0x10ED1 KwUb 1 dez 0 1 FORMAT "%5.3" /end CHARACTERISTIC
/begin CHARACTERISTIC KRDWA "Klopfregelung Differenz aktueller ZW zu Adaptionskennfeld" VALUE 0x10ECE KwUb 191.25 zw_ub_q0p75 0 191.25 FORMAT "%5.1" /end CHARACTERISTIC
/begin CHARACTERISTIC KRALH "Klopfregeladaption Lasthysterese" VALUE 0x10E63 KwUb 191.25 rel_ub_q0p75 0 191.25 FORMAT "%5.1" /end CHARACTERISTIC
/begin CHARACTERISTIC KRANH "Klopfregeladaption Drehzahlhysterese" VALUE 0x10E6B KwUb 10200 nmot_ub_q40 0 10200 FORMAT "%5.0" /end CHARACTERISTIC
/begin CHARACTERISTIC KRAN1 "Klopfregeladaption Drehzahlbereich, Stützstelle 1" VALUE 0x10E64 KwUb 10200 nmot_ub_q40 0 10200 FORMAT "%5.0" /end CHARACTERISTIC
/begin CHARACTERISTIC KRAN2 "Klopfregeladaption Drehzahlbereich, Stützstelle 2" VALUE 0x10E65 KwUb 10200 nmot_ub_q40 0 10200 FORMAT "%5.0" /end CHARACTERISTIC
/begin CHARACTERISTIC KRAN3 "Klopfregeladaption Drehzahlbereich, Stützstelle 3" VALUE 0x10E66 KwUb 10200 nmot_ub_q40 0 10200 FORMAT "%5.0" /end CHARACTERISTIC
/begin CHARACTERISTIC KRAN4 "Klopfregeladaption Drehzahlbereich, Stützstelle 4" VALUE 0x10E67 KwUb 10200 nmot_ub_q40 0 10200 FORMAT "%5.0" /end CHARACTERISTIC
/begin CHARACTERISTIC KRAN5 "Klopfregeladaption Drehzahlbereich, Stützstelle 5" VALUE 0x10E68 KwUb 10200 nmot_ub_q40 0 10200 FORMAT "%5.0" /end CHARACTERISTIC
/begin CHARACTERISTIC KRAN6 "Klopfregeladaption Drehzahlbereich, Stützstelle 6" VALUE 0x10E69 KwUb 10200 nmot_ub_q40 0 10200 FORMAT "%5.0" /end CHARACTERISTIC
/begin CHARACTERISTIC KRAN7 "Klopfregeladaption Drehzahlbereich, Stützstelle 7" VALUE 0x10E6A KwUb 10200 nmot_ub_q40 0 10200 FORMAT "%5.0" /end CHARACTERISTIC
/begin CHARACTERISTIC LKRN "Lastschwelle Klopfregelung" CURVE 0x10EBC GklWUb 191.25 rel_ub_q0p75 0 191.25 FORMAT "%5.1"
 /begin AXIS_DESCR COM_AXIS nmot nmot_ub_q40 16 0 10200 AXIS_PTS_REF SNM16KRUB /end AXIS_DESCR
/end CHARACTERISTIC
/begin CHARACTERISTIC KRMXN "maximale Spätverstellung" CURVE 0x10E8C GklWUb 190.5 zw_ub_qn0p75 -191.25 -0.75 FORMAT "%5.1"
 /begin AXIS_DESCR COM_AXIS nmot nmot_ub_q40 16 0 10200 AXIS_PTS_REF SNM16KRUB /end AXIS_DESCR
/end CHARACTERISTIC
/begin CHARACTERISTIC KRVFSN "Anzahl Zündungen/Zyl., oder Zeitangabe für schnelle Frühverstellung der KR" CURVE 0x10EAC GklWUb 254 dez 1 255 FORMAT "%5.1"
 /begin AXIS_DESCR COM_AXIS nmot nmot_ub_q40 16 0 10200 AXIS_PTS_REF SNM16KRUB /end AXIS_DESCR
/end CHARACTERISTIC
/begin CHARACTERISTIC KRVFN "Anz. Zünd./Zyl., bzw. Zeitangabe von Frühverst. zu Frühverst. (Stufenbreite-KR)" CURVE 0x10E9C GklWUb 254 dez 1 255 FORMAT "%5.1"
 /begin AXIS_DESCR COM_AXIS nmot nmot_ub_q40 16 0 10200 AXIS_PTS_REF SNM16KRUB /end AXIS_DESCR
/end CHARACTERISTIC
/begin CHARACTERISTIC KRFKN "Spätverstellung pro Klopfereignis" CURVE 0x10E7C GklWUb 191.25 zw_ub_qn0p75 -191.25 0 FORMAT "%5.1"
 /begin AXIS_DESCR COM_AXIS nmot nmot_ub_q40 16 0 10200 AXIS_PTS_REF SNM16KRUB /end AXIS_DESCR
/end CHARACTERISTIC
/begin CHARACTERISTIC KRAL1N "Klopfregeladaption Lastbereich 1" CURVE 0x10E43 GklWUb 191.25 rel_ub_q0p75 0 191.25 FORMAT "%5.1"
 /begin AXIS_DESCR COM_AXIS nmot nmot_ub_q40 16 0 10200 AXIS_PTS_REF SNM16KRUB /end AXIS_DESCR
/end CHARACTERISTIC
/begin CHARACTERISTIC KRAL2N "Klopfregeladaption Lastbereich 2" CURVE 0x10E53 GklWUb 191.25 rel_ub_q0p75 0 191.25 FORMAT "%5.1"
 /begin AXIS_DESCR COM_AXIS nmot nmot_ub_q40 16 0 10200 AXIS_PTS_REF SNM16KRUB /end AXIS_DESCR
/end CHARACTERISTIC
/begin CHARACTERISTIC DWKRMSN "delta Winkel KR Abstand zur gemittelten Spätverstellung" CURVE 0x10E33 GklWUb 191.25 zw_ub_qn0p75 -191.25 0 FORMAT "%5.1"
 /begin AXIS_DESCR COM_AXIS nmot nmot_ub_q40 16 0 10200 AXIS_PTS_REF SNM16KRUB /end AXIS_DESCR
/end CHARACTERISTIC
/begin CHARACTERISTIC KRDWSN "Klopfregelung delta - Winkel Sicherheit" CURVE 0x10E6C GklWUb 191.25 zw_ub_qn0p75 -191.25 0 FORMAT "%5.1"
 /begin AXIS_DESCR COM_AXIS nmot nmot_ub_q40 16 0 10200 AXIS_PTS_REF SNM16KRUB /end AXIS_DESCR
/end CHARACTERISTIC
/begin CHARACTERISTIC TLAPTRGBLK "Sperrzeit nach erkanntem Laptrigger (Retriggerschutz)" VALUE 0x11091 KwUb 51 t200msxs_ub_b51 0 51 FORMAT "%5.2" /end CHARACTERISTIC
/begin CHARACTERISTIC TLAPTRGE "Verzögerungszeit bis Laptrigger erkannt" VALUE 0x11092 KwUb 2.55 t10msxs_ub_b2p55 0 2.55 FORMAT "%5.3" /end CHARACTERISTIC
/begin CHARACTERISTIC DATAVERS "Textstring für Datenstand" ASCII 0x11097 KwbUb 255 KennText 0 255 FORMAT "%5.1" NUMBER 30 /end CHARACTERISTIC
/begin CHARACTERISTIC TDLAP "Entprellzeit Diagnose Laptriggersignal" VALUE 0x11090 KwUb 51 t200msxs_ub_b51 0 51 FORMAT "%5.2" /end CHARACTERISTIC
/begin CHARACTERISTIC CWLAPTRG "Codewort Auswahl Laptrigger" VALUE 0x11096 KwUb 255 dez 0 255 FORMAT "%5.1" /end CHARACTERISTIC
/begin CHARACTERISTIC CLRLAPCTR "Rücksetzen Rundenzähler manuell" VALUE 0x11094 KwUb 255 dez 0 255 FORMAT "%5.1" /end CHARACTERISTIC
/begin CHARACTERISTIC CWCLRLAP "Codewort Rücksetzen Lapfunktionen" VALUE 0x11095 KwUb 255 dez 0 255 FORMAT "%5.1" /end CHARACTERISTIC
/begin CHARACTERISTIC VFZLAPMN "Mindestgeschwindigkeit für Laptrigger" VALUE 0x11093 KwUb 318.75 vfzg_ub_q1p25 0 318.75 FORMAT "%5.1" /end CHARACTERISTIC
/begin CHARACTERISTIC LLAP "Rundenlänge" VALUE 0x1341E KwUw 131070 distm_uw_q2p0 0 131070 FORMAT "%8.1" /end CHARACTERISTIC
/begin CHARACTERISTIC FLLAPMAX "Faktor maximale Rundenlänge für Laptriggerfenster" VALUE 0x1341A KwUw 3.99994 rel_uw_b256p0 0 3.99994 FORMAT "%8.6" /end CHARACTERISTIC
/begin CHARACTERISTIC FLLAPMIN "Faktor minimale Rundenlänge für Laptriggerfenster" VALUE 0x1341C KwUw 3.99994 rel_uw_b256p0 0 3.99994 FORMAT "%8.6" /end CHARACTERISTIC
/begin CHARACTERISTIC CLRKVA "Rücksetzen Kraftstoffverbrauch" VALUE 0x110B5 KwUb 255 dez 0 255 FORMAT "%5.1" /end CHARACTERISTIC
/begin CHARACTERISTIC KVACAL "Kalibrierungsfaktor KVA" VALUE 0x13420 KwUw 0.0312424 fak_uw_b0p5 7.62939e-006 0.03125 FORMAT "%9.7" /end CHARACTERISTIC
/begin CHARACTERISTIC UGSSW "Auslöseschwelle für Getriebeschaltfunktion" VALUE 0x13426 KwUw 319.995 spg_uw_q0p00488 0 319.995 FORMAT "%8.4" /end CHARACTERISTIC
/begin CHARACTERISTIC TDGSH "Entprellzeit Diagnose der Anforderung Getriebeschaltfunktion" VALUE 0x110B7 KwUb 25.5 t100msxs_ub_b25p5 0 25.5 FORMAT "%5.2" /end CHARACTERISTIC
/begin CHARACTERISTIC CWGSPOL "Codewort für Polaritätsumschaltung Gangwechselschalter" VALUE 0x110B8 KwUb 255 dez 0 255 FORMAT "%5.1" /end CHARACTERISTIC
/begin CHARACTERISTIC NMOTMNGS "Minimaldrehzahl für Auslösung der Gangwechselfunktion" VALUE 0x1111D KwUb 10200 nmot_ub_q40 0 10200 FORMAT "%5.0" /end CHARACTERISTIC
/begin CHARACTERISTIC RLMNGS "Minimale Last für Auslösung der Gangwechselfunktion" VALUE 0x1111E KwUb 191.25 rel_ub_q0p75 0 191.25 FORMAT "%5.1" /end CHARACTERISTIC
/begin CHARACTERISTIC MIREDGSZ "Angefordertes Moment der Getriebeschaltfunktion" CURVE 0x110B9 FklWUb 99.6094 rel_ub_b100 0 99.6094 FORMAT "%5.2" /begin AXIS_DESCR FIX_AXIS zzgs dez 100 0 99 FIX_AXIS_PAR 0 0 100 /end AXIS_DESCR /end CHARACTERISTIC
/begin CHARACTERISTIC POELDE "Ersatzwert Oeldruck Motor" VALUE 0x11129 KwUb 16 msd_poil_ub_0 0 16 FORMAT "%5.2" /end CHARACTERISTIC
/begin CHARACTERISTIC UPOELDMN "untere Fehlerschwelle Drucksensor Motoroel" VALUE 0x1112C KwUb 4.98047 spg_ub_q0p019 0 4.98047 FORMAT "%5.3" /end CHARACTERISTIC
/begin CHARACTERISTIC UPOELDMX "obere Fehlerschwelle Drucksensor Motoroel" VALUE 0x1112D KwUb 4.98047 spg_ub_q0p019 0 4.98047 FORMAT "%5.3" /end CHARACTERISTIC
/begin CHARACTERISTIC POELGRAD "Gradient Drucksensor Motoroel" VALUE 0x1346C KwUw 12.7998 dgrad_uw_q0p125 0 12.7998 FORMAT "%8.5" /end CHARACTERISTIC
/begin CHARACTERISTIC POELOFS "Offset Drucksensor Motoroel" VALUE 0x1112A KwSb 4.98047 spg_ub_q0p019 -2.5 2.48047 FORMAT "%5.3" /end CHARACTERISTIC
/begin CHARACTERISTIC TDPOEL "Entprellzeit Fehlererkennung poel" VALUE 0x1112B KwUb 51 t200msxs_ub_b51 0 51 FORMAT "%5.2" /end CHARACTERISTIC
/begin CHARACTERISTIC ZPOEL "Zeitkonstante für Filter Motoroeldruck" VALUE 0x1346E KwUw 6553.5 zk100msxs_uw_b6553 0.100002 6553.6 FORMAT "%8.3" /end CHARACTERISTIC
/begin CHARACTERISTIC PFUELDE "Ersatzwert Kraftstoffdruck" VALUE 0x1112E KwUb 16 msd_poil_ub_0 0 16 FORMAT "%5.2" /end CHARACTERISTIC
/begin CHARACTERISTIC UPFUELDMN "untere Fehlerschwelle Drucksensor Kraftstoff" VALUE 0x11131 KwUb 4.98047 spg_ub_q0p019 0 4.98047 FORMAT "%5.3" /end CHARACTERISTIC
/begin CHARACTERISTIC UPFUELDMX "obere Fehlerschwelle Drucksensor Kraftstoff" VALUE 0x11132 KwUb 4.98047 spg_ub_q0p019 0 4.98047 FORMAT "%5.3" /end CHARACTERISTIC
/begin CHARACTERISTIC PFUELGRAD "Gradient Drucksensor Kraftstoff" VALUE 0x13470 KwUw 12.7998 dgrad_uw_q0p125 0 12.7998 FORMAT "%8.5" /end CHARACTERISTIC
/begin CHARACTERISTIC PFUELOFS "Offset Drucksensor Kraftstoff" VALUE 0x1112F KwSb 4.98047 spg_ub_q0p019 -2.5 2.48047 FORMAT "%5.3" /end CHARACTERISTIC
/begin CHARACTERISTIC TDPFUEL "Entprellzeit Fehlererkennung pfuel" VALUE 0x11130 KwUb 51 t200msxs_ub_b51 0 51 FORMAT "%5.2" /end CHARACTERISTIC
/begin CHARACTERISTIC ZPFUEL "Zeitkonstante für Filter Kraftstoffdruck" VALUE 0x13472 KwUw 6553.5 zk100msxs_uw_b6553 0.100002 6553.6 FORMAT "%8.3" /end CHARACTERISTIC
/begin CHARACTERISTIC TOLDE "Ersatzgröße Öltemperatur im Fehlerfall" VALUE 0x11135 KwUb 255 temp_ub_q1_o40 -40 215 FORMAT "%5.1" /end CHARACTERISTIC
/begin CHARACTERISTIC TOLDMN "Öltemperatur min." VALUE 0x11136 KwUb 255 temp_ub_q1_o40 -40 215 FORMAT "%5.1" /end CHARACTERISTIC
/begin CHARACTERISTIC TOLDMX "Öltemperatur max." VALUE 0x11137 KwUb 255 temp_ub_q1_o40 -40 215 FORMAT "%5.1" /end CHARACTERISTIC
/begin CHARACTERISTIC TOLELI "(Motor-)Oeltemperatur Erfassung u. Linearisierung, Inverskennlinie" CURVE 0x11138 KlAUbSstUbWUb 255 temp_ub_q1_o40 -40 215 FORMAT "%5.1" /begin AXIS_DESCR STD_AXIS utol spg_ub_b5 20 0 5 DEPOSIT ABSOLUTE /end AXIS_DESCR /end CHARACTERISTIC
/begin CHARACTERISTIC TDNSTOL "Wartezeit für Anfangserwärmung des (Motor-)Oel-Sensors TOL ab Startende" VALUE 0x11133 KwUb 255 t1sxs_ub_b255 0 255 FORMAT "%5.1" /end CHARACTERISTIC
/begin CHARACTERISTIC TDTOL "Entprellzeit Fehlererkennung TOL (Motor-)Oeltemperatur" VALUE 0x11134 KwUb 51 t200msxs_ub_b51 0 51 FORMAT "%5.2" /end CHARACTERISTIC
/begin CHARACTERISTIC TFUELDE "Ersatzgröße Kraftstofftemperatur im Fehlerfall" VALUE 0x11163 KwUb 255 temp_ub_q1_o40 -40 215 FORMAT "%5.1" /end CHARACTERISTIC
/begin CHARACTERISTIC TFUELDMN "Diagnoseschwelle min. Kraftstofftemperatur" VALUE 0x11164 KwUb 255 temp_ub_q1_o40 -40 215 FORMAT "%5.1" /end CHARACTERISTIC
/begin CHARACTERISTIC TFUELDMX "Diagnoseschwelle max. Kraftstofftemperatur" VALUE 0x11165 KwUb 255 temp_ub_q1_o40 -40 215 FORMAT "%5.1" /end CHARACTERISTIC
/begin CHARACTERISTIC TFUELELI "Temperatur Kraftstoff, Erfassung u. Linearisierung, Inverskennlinie" CURVE 0x11166 KlAUbSstUbWUb 255 temp_ub_q1_o40 -40 215 FORMAT "%5.1" /begin AXIS_DESCR STD_AXIS utfuel spg_ub_b5 20 0 5 DEPOSIT ABSOLUTE /end AXIS_DESCR /end CHARACTERISTIC
/begin CHARACTERISTIC TDNSTFUEL "Wartezeit für Anfangserwärmung der Kraftstofftemperatur ab Startende" VALUE 0x11161 KwUb 255 t1sxs_ub_b255 0 255 FORMAT "%5.1" /end CHARACTERISTIC
/begin CHARACTERISTIC TDTFUEL "Entprellzeit Diagnose Kraftstofftemperatur tfuel" VALUE 0x11162 KwUb 51 t200msxs_ub_b51 0 51 FORMAT "%5.2" /end CHARACTERISTIC
/begin CHARACTERISTIC CWATS "Codewort für Abgastemperatursensor" VALUE 0x11190 KwUb 255 dez 0 255 FORMAT "%5.1" /end CHARACTERISTIC
/begin CHARACTERISTIC UATSDMN "untere Fehlerschwelle Abgastemperatursensor" VALUE 0x134AA KwUw 319.995 spg_uw_q0p00488 0 319.995 FORMAT "%8.4" /end CHARACTERISTIC
/begin CHARACTERISTIC UATSDMX "obere Fehlerschwelle Abgastemperatursensor" VALUE 0x134AC KwUw 319.995 spg_uw_q0p00488 0 319.995 FORMAT "%8.4" /end CHARACTERISTIC
/begin CHARACTERISTIC TATSLI "Abgastemperatursensor Linearisierungskennline" CURVE 0x13474 KlAUwSstUwWUw 1279.98 temp_uw_q0p0195_o50 -50 1229.98 FORMAT "%8.3"
 /begin AXIS_DESCR STD_AXIS uats_kge spg_uw_q0p00488 13 0 319.995 DEPOSIT ABSOLUTE /end AXIS_DESCR
/end CHARACTERISTIC
/begin CHARACTERISTIC TDATS "Entprellzeit Fehlererkennung Abgastemperatursensor" VALUE 0x1118F KwUb 51 t200msxs_ub_b51 0 51 FORMAT "%5.2" /end CHARACTERISTIC
/begin CHARACTERISTIC KEDPOS "Wert für die Vergrößerung der Einschaltdauer LSU-Heizung nach Start" VALUE 0x1119C KwUb 99.2188 tgrad_ub_b99p6 0.390625 99.6094 FORMAT "%5.2" /end CHARACTERISTIC
/begin CHARACTERISTIC KEDNEG "Wert für die Reduzierung der Einschaltdauer LSU-Heizung nach Start" VALUE 0x1119B KwUb 99.2188 tgrad_ub_b99p6 0.390625 99.6094 FORMAT "%5.2" /end CHARACTERISTIC
/begin CHARACTERISTIC TABGMHS "Abgastemperaturschwelle für die Sondenheizung LSU" VALUE 0x111FF KwUb 1275 temp_ub_q5_o50 -50 1225 FORMAT "%5.0" /end CHARACTERISTIC
/begin CHARACTERISTIC TEDTP "Einschaltdauer der LSU-Heizung während Kondenswasserphase" VALUE 0x11200 KwUb 2.55 t10msxs_ub_b2p55 0 2.55 FORMAT "%5.3" /end CHARACTERISTIC
/begin CHARACTERISTIC TLSUVH "Zeit für LSU vorheizen" VALUE 0x11201 KwUb 25.5 t100msxs_ub_b25p5 0 25.5 FORMAT "%5.2" /end CHARACTERISTIC
/begin CHARACTERISTIC TMOTSH "Motortemperaturschwelle für die Sondenheizung LSU" VALUE 0x11202 KwUb 191.25 temp_ub_q0p75_o48 -48 143.25 FORMAT "%5.1" /end CHARACTERISTIC
/begin CHARACTERISTIC TVLSUWU "maximale Zeit für \"warm up\" stetige Lambdasonde LSU" VALUE 0x11203 KwUb 25.5 t100msxs_ub_b25p5 0 25.5 FORMAT "%5.2" /end CHARACTERISTIC
/begin CHARACTERISTIC TLSUTA "Kennlinie für die Einschaltdauer der LSU-Heizung nach Start" CURVE 0x11192 KlAUbSstUbWUb 2.55 t10msxs_ub_b2p55 0 2.55 FORMAT "%5.3"
 /begin AXIS_DESCR STD_AXIS tans temp_ub_q0p75_o48 4 -48 143.25 DEPOSIT ABSOLUTE /end AXIS_DESCR
/end CHARACTERISTIC
/begin CHARACTERISTIC KFLSUED "Kennfeld für die Einschaltdauer der LSU-Heizung abh. von Abgastemperatur und ml" MAP 0x1119D KfAxUbAyUbSstxUbSstyUbWUb 2.55 t10msxs_ub_b2p55 0 2.55 FORMAT "%5.3" /begin AXIS_DESCR STD_AXIS tabgm temp_ub_q5_o50 7 -50 1225 DEPOSIT ABSOLUTE /end AXIS_DESCR /begin AXIS_DESCR STD_AXIS ml m_ub_b1020 5 0 1020 DEPOSIT ABSOLUTE /end AXIS_DESCR /end CHARACTERISTIC
/begin CHARACTERISTIC KFLSUED2 "Kennfeld für die Einschaltdauer der LSU-Heizung abh. von Abgastemperatur2 und ml" MAP 0x111CE KfAxUbAyUbSstxUbSstyUbWUb 2.55 t10msxs_ub_b2p55 0 2.55 FORMAT "%5.3" /begin AXIS_DESCR STD_AXIS tabgm2 temp_ub_q5_o50 7 -50 1225 DEPOSIT ABSOLUTE /end AXIS_DESCR /begin AXIS_DESCR STD_AXIS ml m_ub_b1020 5 0 1020 DEPOSIT ABSOLUTE /end AXIS_DESCR /end CHARACTERISTIC
/begin MEASUREMENT abak "Aufteilungsfaktor Wandfilm bei BA" UBYTE fak_ub_b1 1 100 0 0.996094 FORMAT "%5.3" /begin IF_DATA ASAP1B_KWP2000 KP_BLOB 0x380394 EXTERN 0x1 /end IF_DATA /begin IF_DATA ETK KP_BLOB 0x380394 EXTERN 0x1 /end IF_DATA /end MEASUREMENT
/begin MEASUREMENT aimvpm "Anzahl Geschwindigkeitsimpulse pro Meter" UWORD fak_uw_q0p001 1 100 0 65.535 FORMAT "%8.5" /begin IF_DATA ASAP1B_KWP2000 KP_BLOB 0x382950 EXTERN 0x2 /end IF_DATA /begin IF_DATA ETK KP_BLOB 0x382950 EXTERN 0x2 /end IF_DATA /end MEASUREMENT
/begin MEASUREMENT anztis "Anzahl vom CIFI initialisierter ti's (Synchro-Abtastung)" UBYTE dez 1 100 0 255 FORMAT "%5.1" /begin IF_DATA ASAP1B_KWP2000 KP_BLOB 0x38039A EXTERN 0x1 /end IF_DATA /begin IF_DATA ETK KP_BLOB 0x38039A EXTERN 0x1 /end IF_DATA /end MEASUREMENT
/begin MEASUREMENT anzudsl_w "Anzahl Abtastungen Drucksensor Ladedruck über einem Segment(word)" UWORD dez 1 100 0 65535 FORMAT "%8.2" /begin IF_DATA ASAP1B_KWP2000 KP_BLOB 0xF86A INTERN 0x2 /end IF_DATA /begin IF_DATA ETK KP_BLOB 0xF86A INTERN 0x2 /end IF_DATA /end MEASUREMENT
/begin MEASUREMENT anzwefim "Anzahl der abgearbeiteten Wiedereinsetzfaktoren" UBYTE dez 1 100 0 255 FORMAT "%5.1" /begin IF_DATA ASAP1B_KWP2000 KP_BLOB 0x38039B EXTERN 0x1 /end IF_DATA /begin IF_DATA ETK KP_BLOB 0x38039B EXTERN 0x1 /end IF_DATA /end MEASUREMENT
/begin MEASUREMENT avak "Aufteilungsfaktor Wandfilm bei VA" UBYTE fak_ub_b1 1 100 0 0.996094 FORMAT "%5.3" /begin IF_DATA ASAP1B_KWP2000 KP_BLOB 0x380395 EXTERN 0x1 /end IF_DATA /begin IF_DATA ETK KP_BLOB 0x380395 EXTERN 0x1 /end IF_DATA /end MEASUREMENT
/begin MEASUREMENT azylwe "Anzahl wiedereingesetzter Zylinder" UBYTE dez 1 100 0 255 FORMAT "%5.1" /begin IF_DATA ASAP1B_KWP2000 KP_BLOB 0x38039C EXTERN 0x1 /end IF_DATA /begin IF_DATA ETK KP_BLOB 0x38039C EXTERN 0x1 /end IF_DATA /end MEASUREMENT
/begin MEASUREMENT bbsu "Byte fuer Bedingung Status Saugrohrklappe + device control" UBYTE dez 1 100 0 255 FORMAT "%5.1" /begin IF_DATA ASAP1B_KWP2000 KP_BLOB 0x380327 EXTERN 0x1 /end IF_DATA /begin IF_DATA ETK KP_BLOB 0x380327 EXTERN 0x1 /end IF_DATA /end MEASUREMENT
/begin MEASUREMENT bbsu2 "Byte fuer Bedingung Status Saugrohrklappe 2 + device control" UBYTE dez 1 100 0 255 FORMAT "%5.1" /begin IF_DATA ASAP1B_KWP2000 KP_BLOB 0x380328 EXTERN 0x1 /end IF_DATA /begin IF_DATA ETK KP_BLOB 0x380328 EXTERN 0x1 /end IF_DATA /end MEASUREMENT
/begin MEASUREMENT bfzgl_b "Fahrzeuglängsbeschleunigung" SBYTE bfzg_sb_q0p217 1 100 -27.776 27.559 FORMAT "%5.2" /begin IF_DATA ASAP1B_KWP2000 KP_BLOB 0x380301 EXTERN 0x1 /end IF_DATA /begin IF_DATA ETK KP_BLOB 0x380301 EXTERN 0x1 /end IF_DATA /end MEASUREMENT
/begin MEASUREMENT B_abll "Bedingung Abgleich im Leerlauf" UWORD B_TRUE 1 100 0 1 BIT_MASK 0x40 FORMAT "%5.3" /begin IF_DATA ASAP1B_KWP2000 KP_BLOB 0xFD1E INTERN 0x2 /end IF_DATA /begin IF_DATA ETK KP_BLOB 0xFD1E INTERN 0x2 /end IF_DATA /end MEASUREMENT
/begin MEASUREMENT B_abll2 "Bedingung Abgleich im Leerlauf, Bank2" UWORD B_TRUE 1 100 0 1 BIT_MASK 0x80 FORMAT "%5.3" /begin IF_DATA ASAP1B_KWP2000 KP_BLOB 0xFD1E INTERN 0x2 /end IF_DATA /begin IF_DATA ETK KP_BLOB 0xFD1E INTERN 0x2 /end IF_DATA /end MEASUREMENT
/begin MEASUREMENT B_afwe "Bedingung Anzahl der Wiedereinsetzfaktoren" UWORD B_TRUE 1 100 0 1 BIT_MASK 0x1 FORMAT "%5.3" /begin IF_DATA ASAP1B_KWP2000 KP_BLOB 0xFD28 INTERN 0x2 /end IF_DATA /begin IF_DATA ETK KP_BLOB 0xFD28 INTERN 0x2 /end IF_DATA /end MEASUREMENT
/begin MEASUREMENT B_ba "Bedingung Beschleunigungsanreicherung (Anzeige)" UWORD B_TRUE 1 100 0 1 BIT_MASK 0x10 FORMAT "%5.3" /begin IF_DATA ASAP1B_KWP2000 KP_BLOB 0xFD26 INTERN 0x2 /end IF_DATA /begin IF_DATA ETK KP_BLOB 0xFD26 INTERN 0x2 /end IF_DATA /end MEASUREMENT
/begin MEASUREMENT B_bag "Bedingung starke Beschleunigungsanreicherung" UWORD B_TRUE 1 100 0 1 BIT_MASK 0x20 FORMAT "%5.3" /begin IF_DATA ASAP1B_KWP2000 KP_BLOB 0xFD26 INTERN 0x2 /end IF_DATA /begin IF_DATA ETK KP_BLOB 0xFD26 INTERN 0x2 /end IF_DATA /end MEASUREMENT
/begin MEASUREMENT B_c95bf0 "Ansteuersignal zum Einstellen der Filtermittenfrequenz des CC195 (Pin BF0)" UWORD B_TRUE 1 100 0 1 BIT_MASK 0x80 FORMAT "%5.3" /begin IF_DATA ASAP1B_KWP2000 KP_BLOB 0xFD2A INTERN 0x2 /end IF_DATA /begin IF_DATA ETK KP_BLOB 0xFD2A INTERN 0x2 /end IF_DATA /end MEASUREMENT
/begin MEASUREMENT B_c95bf1 "Ansteuersignal zum Einstellen der Filtermittenfrequenz des CC195 (Pin BF1)" UWORD B_TRUE 1 100 0 1 BIT_MASK 0x100 FORMAT "%5.3" /begin IF_DATA ASAP1B_KWP2000 KP_BLOB 0xFD2A INTERN 0x2 /end IF_DATA /begin IF_DATA ETK KP_BLOB 0xFD2A INTERN 0x2 /end IF_DATA /end MEASUREMENT
/begin MEASUREMENT B_c95bf2 "Ansteuersignal zum Einstellen der Filtermittenfrequenz des CC195 (Pin BF2)" UWORD B_TRUE 1 100 0 1 BIT_MASK 0x200 FORMAT "%5.3" /begin IF_DATA ASAP1B_KWP2000 KP_BLOB 0xFD2A INTERN 0x2 /end IF_DATA /begin IF_DATA ETK KP_BLOB 0xFD2A INTERN 0x2 /end IF_DATA /end MEASUREMENT
/begin MEASUREMENT B_c95bf3 "Ansteuersignal zum Eintstellen der Filtermittenfrequenz des CC195 (Pin BF3)" UWORD B_TRUE 1 100 0 1 BIT_MASK 0x400 FORMAT "%5.3" /begin IF_DATA ASAP1B_KWP2000 KP_BLOB 0xFD2A INTERN 0x2 /end IF_DATA /begin IF_DATA ETK KP_BLOB 0xFD2A INTERN 0x2 /end IF_DATA /end MEASUREMENT
/begin MEASUREMENT B_c95ks3 "Ansteuersignal für den Nulltest des CC195" UWORD B_TRUE 1 100 0 1 BIT_MASK 0x800 FORMAT "%5.3" /begin IF_DATA ASAP1B_KWP2000 KP_BLOB 0xFD2A INTERN 0x2 /end IF_DATA /begin IF_DATA ETK KP_BLOB 0xFD2A INTERN 0x2 /end IF_DATA /end MEASUREMENT
/begin MEASUREMENT B_c95_g0 "Ansteuerung der Verstärkerstufe des CC195 (PIN G0)" UWORD B_TRUE 1 100 0 1 BIT_MASK 0x1000 FORMAT "%5.3" /begin IF_DATA ASAP1B_KWP2000 KP_BLOB 0xFD2C INTERN 0x2 /end IF_DATA /begin IF_DATA ETK KP_BLOB 0xFD2C INTERN 0x2 /end IF_DATA /end MEASUREMENT
/begin MEASUREMENT B_c95_g1 "Ansteuerung der Verstärkerstufe des CC195 (Pin G1)" UWORD B_TRUE 1 100 0 1 BIT_MASK 0x2000 FORMAT "%5.3" /begin IF_DATA ASAP1B_KWP2000 KP_BLOB 0xFD2C INTERN 0x2 /end IF_DATA /begin IF_DATA ETK KP_BLOB 0xFD2C INTERN 0x2 /end IF_DATA /end MEASUREMENT
/begin MEASUREMENT B_c95_g2 "Ansteuerung der Verstärkerstufe des CC195 (Pin G2)" UWORD B_TRUE 1 100 0 1 BIT_MASK 0x4000 FORMAT "%5.3" /begin IF_DATA ASAP1B_KWP2000 KP_BLOB 0xFD2C INTERN 0x2 /end IF_DATA /begin IF_DATA ETK KP_BLOB 0xFD2C INTERN 0x2 /end IF_DATA /end MEASUREMENT
/begin MEASUREMENT B_csu "" UBYTE B_TRUE 1 100 0 1 BIT_MASK 0x2 FORMAT "%5.3" /begin IF_DATA ASAP1B_KWP2000 KP_BLOB 0x380327 EXTERN 0x1 /end IF_DATA /begin IF_DATA ETK KP_BLOB 0x380327 EXTERN 0x1 /end IF_DATA /end MEASUREMENT
/begin MEASUREMENT B_csu2 "" UBYTE B_TRUE 1 100 0 1 BIT_MASK 0x2 FORMAT "%5.3" /begin IF_DATA ASAP1B_KWP2000 KP_BLOB 0x380328 EXTERN 0x1 /end IF_DATA /begin IF_DATA ETK KP_BLOB 0x380328 EXTERN 0x1 /end IF_DATA /end MEASUREMENT
/begin MEASUREMENT B_dkgini "Bedingung manuelle DK-Justierung ausgelöst" UWORD B_TRUE 1 100 0 1 BIT_MASK 0x2000 FORMAT "%5.3" /begin IF_DATA ASAP1B_KWP2000 KP_BLOB 0xFD18 INTERN 0x2 /end IF_DATA /begin IF_DATA ETK KP_BLOB 0xFD18 INTERN 0x2 /end IF_DATA /end MEASUREMENT
/begin MEASUREMENT B_dnt "Aktive Diagnose: Klopfregelung Nulltest" UWORD B_TRUE 1 100 0 1 BIT_MASK 0x1000 FORMAT "%5.3" /begin IF_DATA ASAP1B_KWP2000 KP_BLOB 0xFD2A INTERN 0x2 /end IF_DATA /begin IF_DATA ETK KP_BLOB 0xFD2A INTERN 0x2 /end IF_DATA /end MEASUREMENT
/begin MEASUREMENT B_dntb "Bedingung Diagnose: Bereitschaft zum Nulltest (Nulltest im nächsten MF)" UWORD B_TRUE 1 100 0 1 BIT_MASK 0x2000 FORMAT "%5.3" /begin IF_DATA ASAP1B_KWP2000 KP_BLOB 0xFD2A INTERN 0x2 /end IF_DATA /begin IF_DATA ETK KP_BLOB 0xFD2A INTERN 0x2 /end IF_DATA /end MEASUREMENT
/begin MEASUREMENT B_drlkrdy "Flag für n > NKRUM" UWORD B_TRUE 1 100 0 1 BIT_MASK 0x8 FORMAT "%5.3" /begin IF_DATA ASAP1B_KWP2000 KP_BLOB 0xFD2C INTERN 0x2 /end IF_DATA /begin IF_DATA ETK KP_BLOB 0xFD2C INTERN 0x2 /end IF_DATA /end MEASUREMENT
/begin MEASUREMENT B_drlpuk "Bedingung Freigabe Delta Wandfilm durch drlp" UWORD B_TRUE 1 100 0 1 BIT_MASK 0x40 FORMAT "%5.3" /begin IF_DATA ASAP1B_KWP2000 KP_BLOB 0xFD26 INTERN 0x2 /end IF_DATA /begin IF_DATA ETK KP_BLOB 0xFD26 INTERN 0x2 /end IF_DATA /end MEASUREMENT
/begin MEASUREMENT B_dtp "Aktive Diagnose: Klopfregelung Testimpuls" UWORD B_TRUE 1 100 0 1 BIT_MASK 0x4000 FORMAT "%5.3" /begin IF_DATA ASAP1B_KWP2000 KP_BLOB 0xFD2A INTERN 0x2 /end IF_DATA /begin IF_DATA ETK KP_BLOB 0xFD2A INTERN 0x2 /end IF_DATA /end MEASUREMENT
/begin MEASUREMENT B_dtpb "Bedingung Diagnose: Bereitschaft zum Testpuls (Testpuls im nächsten MF)" UWORD B_TRUE 1 100 0 1 BIT_MASK 0x8000 FORMAT "%5.3" /begin IF_DATA ASAP1B_KWP2000 KP_BLOB 0xFD2A INTERN 0x2 /end IF_DATA /begin IF_DATA ETK KP_BLOB 0xFD2A INTERN 0x2 /end IF_DATA /end MEASUREMENT
/begin MEASUREMENT B_eehl "Umschaltung Einspritzende bei hoher Last aktiv" UWORD B_TRUE 1 100 0 1 BIT_MASK 0x2 FORMAT "%5.3" /begin IF_DATA ASAP1B_KWP2000 KP_BLOB 0xFD26 INTERN 0x2 /end IF_DATA /begin IF_DATA ETK KP_BLOB 0xFD26 INTERN 0x2 /end IF_DATA /end MEASUREMENT
/begin MEASUREMENT B_fra "Einschaltbedingung für Adaption von fra (multipl. Fehler)" UWORD B_TRUE 1 100 0 1 BIT_MASK 0x20 FORMAT "%5.3" /begin IF_DATA ASAP1B_KWP2000 KP_BLOB 0xFD28 INTERN 0x2 /end IF_DATA /begin IF_DATA ETK KP_BLOB 0xFD28 INTERN 0x2 /end IF_DATA /end MEASUREMENT
/begin MEASUREMENT B_fwe "Bedingung Faktor Wiedereinsetzen" UWORD B_TRUE 1 100 0 1 BIT_MASK 0x2 FORMAT "%5.3" /begin IF_DATA ASAP1B_KWP2000 KP_BLOB 0xFD28 INTERN 0x2 /end IF_DATA /begin IF_DATA ETK KP_BLOB 0xFD28 INTERN 0x2 /end IF_DATA /end MEASUREMENT
/begin MEASUREMENT B_gs "GS aktiv (intern)" UWORD B_TRUE 1 100 0 1 BIT_MASK 0x8 FORMAT "%5.3" /begin IF_DATA ASAP1B_KWP2000 KP_BLOB 0xFD3A INTERN 0x2 /end IF_DATA /begin IF_DATA ETK KP_BLOB 0xFD3A INTERN 0x2 /end IF_DATA /end MEASUREMENT
/begin MEASUREMENT B_gssw "Bedingung Schaltschwelle Getriebeschaltfunktion überschritten" UWORD B_TRUE 1 100 0 1 BIT_MASK 0x10 FORMAT "%5.3" /begin IF_DATA ASAP1B_KWP2000 KP_BLOB 0xFD3A INTERN 0x2 /end IF_DATA /begin IF_DATA ETK KP_BLOB 0xFD3A INTERN 0x2 /end IF_DATA /end MEASUREMENT
/begin MEASUREMENT B_hag "Bedingung Höhenadaption gültig" UWORD B_TRUE 1 100 0 1 BIT_MASK 0x200 FORMAT "%5.3" /begin IF_DATA ASAP1B_KWP2000 KP_BLOB 0xFD24 INTERN 0x2 /end IF_DATA /begin IF_DATA ETK KP_BLOB 0xFD24 INTERN 0x2 /end IF_DATA /end MEASUREMENT
/begin MEASUREMENT B_hmx "Bedingung LSU maximal beheizt" UWORD B_TRUE 1 100 0 1 BIT_MASK 0x10 FORMAT "%5.3" /begin IF_DATA ASAP1B_KWP2000 KP_BLOB 0xFD40 INTERN 0x2 /end IF_DATA /begin IF_DATA ETK KP_BLOB 0xFD40 INTERN 0x2 /end IF_DATA /end MEASUREMENT
/begin MEASUREMENT B_hmx2 "Bedingung LSU2 maximal beheizt" UWORD B_TRUE 1 100 0 1 BIT_MASK 0x20 FORMAT "%5.3" /begin IF_DATA ASAP1B_KWP2000 KP_BLOB 0xFD40 INTERN 0x2 /end IF_DATA /begin IF_DATA ETK KP_BLOB 0xFD40 INTERN 0x2 /end IF_DATA /end MEASUREMENT
/begin MEASUREMENT B_hsv "Bedingung Heizung Sonde vor Kat einschaltbereit" UWORD B_TRUE 1 100 0 1 BIT_MASK 0x40 FORMAT "%5.3" /begin IF_DATA ASAP1B_KWP2000 KP_BLOB 0xFD40 INTERN 0x2 /end IF_DATA /begin IF_DATA ETK KP_BLOB 0xFD40 INTERN 0x2 /end IF_DATA /end MEASUREMENT
/begin MEASUREMENT B_hsv2 "Bedingung Heizung Sonde2 vor Kat einschaltbereit" UWORD B_TRUE 1 100 0 1 BIT_MASK 0x80 FORMAT "%5.3" /begin IF_DATA ASAP1B_KWP2000 KP_BLOB 0xFD40 INTERN 0x2 /end IF_DATA /begin IF_DATA ETK KP_BLOB 0xFD40 INTERN 0x2 /end IF_DATA /end MEASUREMENT
/begin MEASUREMENT B_hsve "Bedingung Endstufe Sondenheizung vor Kat angesteuert" UWORD B_TRUE 1 100 0 1 BIT_MASK 0x100 FORMAT "%5.3" /begin IF_DATA ASAP1B_KWP2000 KP_BLOB 0xFD40 INTERN 0x2 /end IF_DATA /begin IF_DATA ETK KP_BLOB 0xFD40 INTERN 0x2 /end IF_DATA /end MEASUREMENT
/begin MEASUREMENT B_hsve2 "Bedingung Endstufe Sondenheizung2 vor Kat angesteuert" UWORD B_TRUE 1 100 0 1 BIT_MASK 0x200 FORMAT "%5.3" /begin IF_DATA ASAP1B_KWP2000 KP_BLOB 0xFD40 INTERN 0x2 /end IF_DATA /begin IF_DATA ETK KP_BLOB 0xFD40 INTERN 0x2 /end IF_DATA /end MEASUREMENT
/begin MEASUREMENT B_kfwee "Bedingung Kennfeld KFWEE aktiv" UWORD B_TRUE 1 100 0 1 BIT_MASK 0x4 FORMAT "%5.3" /begin IF_DATA ASAP1B_KWP2000 KP_BLOB 0xFD26 INTERN 0x2 /end IF_DATA /begin IF_DATA ETK KP_BLOB 0xFD26 INTERN 0x2 /end IF_DATA /end MEASUREMENT
/begin MEASUREMENT B_kl "Bedingung für erkannte Klopfer" UWORD B_TRUE 1 100 0 1 BIT_MASK 0x8000 FORMAT "%5.3" /begin IF_DATA ASAP1B_KWP2000 KP_BLOB 0xFD2C INTERN 0x2 /end IF_DATA /begin IF_DATA ETK KP_BLOB 0xFD2C INTERN 0x2 /end IF_DATA /end MEASUREMENT
/begin MEASUREMENT B_kldynrm "Bedingung normales Klopfen bei adapt. Lastdynamik" UWORD B_TRUE 1 100 0 1 BIT_MASK 0x10 FORMAT "%5.3" /begin IF_DATA ASAP1B_KWP2000 KP_BLOB 0xFD2C INTERN 0x2 /end IF_DATA /begin IF_DATA ETK KP_BLOB 0xFD2C INTERN 0x2 /end IF_DATA /end MEASUREMENT
/begin MEASUREMENT B_kldystk "Bedingung starkes Klopfen bei adapt. Lastdynamik" UWORD B_TRUE 1 100 0 1 BIT_MASK 0x20 FORMAT "%5.3" /begin IF_DATA ASAP1B_KWP2000 KP_BLOB 0xFD2C INTERN 0x2 /end IF_DATA /begin IF_DATA ETK KP_BLOB 0xFD2C INTERN 0x2 /end IF_DATA /end MEASUREMENT
/begin MEASUREMENT B_kr "Bedingung Klopregelung aktiv" UWORD B_TRUE 1 100 0 1 BIT_MASK 0x1 FORMAT "%5.3" /begin IF_DATA ASAP1B_KWP2000 KP_BLOB 0xFD2E INTERN 0x2 /end IF_DATA /begin IF_DATA ETK KP_BLOB 0xFD2E INTERN 0x2 /end IF_DATA /end MEASUREMENT
/begin MEASUREMENT B_kra "Bedingung KR-Adaption aktiv" UWORD B_TRUE 1 100 0 1 BIT_MASK 0x2 FORMAT "%5.3" /begin IF_DATA ASAP1B_KWP2000 KP_BLOB 0xFD2E INTERN 0x2 /end IF_DATA /begin IF_DATA ETK KP_BLOB 0xFD2E INTERN 0x2 /end IF_DATA /end MEASUREMENT
/begin MEASUREMENT B_krldy "Bedingung Lastdynamik für Klopferkennung aktiv" UWORD B_TRUE 1 100 0 1 BIT_MASK 0x40 FORMAT "%5.3" /begin IF_DATA ASAP1B_KWP2000 KP_BLOB 0xFD2C INTERN 0x2 /end IF_DATA /begin IF_DATA ETK KP_BLOB 0xFD2C INTERN 0x2 /end IF_DATA /end MEASUREMENT
/begin MEASUREMENT B_krldya "Bedingung Lastdynamikvorhalt und -adaption aktiv" UWORD B_TRUE 1 100 0 1 BIT_MASK 0x80 FORMAT "%5.3" /begin IF_DATA ASAP1B_KWP2000 KP_BLOB 0xFD2C INTERN 0x2 /end IF_DATA /begin IF_DATA ETK KP_BLOB 0xFD2C INTERN 0x2 /end IF_DATA /end MEASUREMENT
/begin MEASUREMENT B_krldyf "Bedingung Adaption Lastdynamikvorhalt nach früh freigegeben" UWORD B_TRUE 1 100 0 1 BIT_MASK 0x100 FORMAT "%5.3" /begin IF_DATA ASAP1B_KWP2000 KP_BLOB 0xFD2C INTERN 0x2 /end IF_DATA /begin IF_DATA ETK KP_BLOB 0xFD2C INTERN 0x2 /end IF_DATA /end MEASUREMENT
/begin MEASUREMENT B_krndy "Bedingung Drehzahldynamik für Klopferkennung aktiv" UWORD B_TRUE 1 100 0 1 BIT_MASK 0x200 FORMAT "%5.3" /begin IF_DATA ASAP1B_KWP2000 KP_BLOB 0xFD2C INTERN 0x2 /end IF_DATA /begin IF_DATA ETK KP_BLOB 0xFD2C INTERN 0x2 /end IF_DATA /end MEASUREMENT
/begin MEASUREMENT B_lalgf "Bedingung Laufgrenze \"Lambda fett\" aktiv" UWORD B_TRUE 1 100 0 1 BIT_MASK 0x8 FORMAT "%5.3" /begin IF_DATA ASAP1B_KWP2000 KP_BLOB 0xFD28 INTERN 0x2 /end IF_DATA /begin IF_DATA ETK KP_BLOB 0xFD28 INTERN 0x2 /end IF_DATA /end MEASUREMENT
/begin MEASUREMENT B_lamnswl "Lambda-Motor-Soll für Nachstart und Warmlauf aktiv" UWORD B_TRUE 1 100 0 1 BIT_MASK 0x10 FORMAT "%5.3" /begin IF_DATA ASAP1B_KWP2000 KP_BLOB 0xFD28 INTERN 0x2 /end IF_DATA /begin IF_DATA ETK KP_BLOB 0xFD28 INTERN 0x2 /end IF_DATA /end MEASUREMENT
/begin MEASUREMENT B_lapcan "Bedingung Laptrigger aus CAN-Signal" UWORD B_TRUE 1 100 0 1 BIT_MASK 0x40 FORMAT "%5.3" /begin IF_DATA ASAP1B_KWP2000 KP_BLOB 0xFD36 INTERN 0x2 /end IF_DATA /begin IF_DATA ETK KP_BLOB 0xFD36 INTERN 0x2 /end IF_DATA /end MEASUREMENT
/begin MEASUREMENT B_lapin "Bedingung Eingangssignal Laptrigger liegt an" UWORD B_TRUE 1 100 0 1 BIT_MASK 0x80 FORMAT "%5.3" /begin IF_DATA ASAP1B_KWP2000 KP_BLOB 0xFD36 INTERN 0x2 /end IF_DATA /begin IF_DATA ETK KP_BLOB 0xFD36 INTERN 0x2 /end IF_DATA /end MEASUREMENT
/begin MEASUREMENT B_lappin "Bedingung Laptrigger aus SG-Pin" UWORD B_TRUE 1 100 0 1 BIT_MASK 0x100 FORMAT "%5.3" /begin IF_DATA ASAP1B_KWP2000 KP_BLOB 0xFD36 INTERN 0x2 /end IF_DATA /begin IF_DATA ETK KP_BLOB 0xFD36 INTERN 0x2 /end IF_DATA /end MEASUREMENT
/begin MEASUREMENT B_lapset "Bedingung Laptrigger wird zwangsgesetzt" UWORD B_TRUE 1 100 0 1 BIT_MASK 0x200 FORMAT "%5.3" /begin IF_DATA ASAP1B_KWP2000 KP_BLOB 0xFD36 INTERN 0x2 /end IF_DATA /begin IF_DATA ETK KP_BLOB 0xFD36 INTERN 0x2 /end IF_DATA /end MEASUREMENT
/begin MEASUREMENT B_laptrg "Bedingung Laptrigger" UWORD B_TRUE 1 100 0 1 BIT_MASK 0x400 FORMAT "%5.3" /begin IF_DATA ASAP1B_KWP2000 KP_BLOB 0xFD36 INTERN 0x2 /end IF_DATA /begin IF_DATA ETK KP_BLOB 0xFD36 INTERN 0x2 /end IF_DATA /end MEASUREMENT
/begin MEASUREMENT B_laptrgb "Bedingung Sperrung Laptrigger als Retriggerschutz" UWORD B_TRUE 1 100 0 1 BIT_MASK 0x800 FORMAT "%5.3" /begin IF_DATA ASAP1B_KWP2000 KP_BLOB 0xFD36 INTERN 0x2 /end IF_DATA /begin IF_DATA ETK KP_BLOB 0xFD36 INTERN 0x2 /end IF_DATA /end MEASUREMENT
/begin MEASUREMENT B_ll "Bedingung Leerlauf" UWORD B_TRUE 1 100 0 1 BIT_MASK 0x4000 FORMAT "%5.3" /begin IF_DATA ASAP1B_KWP2000 KP_BLOB 0xFD18 INTERN 0x2 /end IF_DATA /begin IF_DATA ETK KP_BLOB 0xFD18 INTERN 0x2 /end IF_DATA /end MEASUREMENT
/begin MEASUREMENT B_llapmn "Bedingung minimale gefahrene Streckenlänge für Laptrigger erreicht" UWORD B_TRUE 1 100 0 1 BIT_MASK 0x1000 FORMAT "%5.3" /begin IF_DATA ASAP1B_KWP2000 KP_BLOB 0xFD36 INTERN 0x2 /end IF_DATA /begin IF_DATA ETK KP_BLOB 0xFD36 INTERN 0x2 /end IF_DATA /end MEASUREMENT
/begin MEASUREMENT B_lrare "Bedingung Reset LRA" UWORD B_TRUE 1 100 0 1 BIT_MASK 0x40 FORMAT "%5.3" /begin IF_DATA ASAP1B_KWP2000 KP_BLOB 0xFD28 INTERN 0x2 /end IF_DATA /begin IF_DATA ETK KP_BLOB 0xFD28 INTERN 0x2 /end IF_DATA /end MEASUREMENT
/begin MEASUREMENT B_lrare2 "Bedingung Reset LRA Bank 2" UWORD B_TRUE 1 100 0 1 BIT_MASK 0x80 FORMAT "%5.3" /begin IF_DATA ASAP1B_KWP2000 KP_BLOB 0xFD28 INTERN 0x2 /end IF_DATA /begin IF_DATA ETK KP_BLOB 0xFD28 INTERN 0x2 /end IF_DATA /end MEASUREMENT
/begin MEASUREMENT B_lsuab "Bedingung Abgleich stetige Lambda-Sonde LSU" UWORD B_TRUE 1 100 0 1 BIT_MASK 0x100 FORMAT "%5.3" /begin IF_DATA ASAP1B_KWP2000 KP_BLOB 0xFD1E INTERN 0x2 /end IF_DATA /begin IF_DATA ETK KP_BLOB 0xFD1E INTERN 0x2 /end IF_DATA /end MEASUREMENT
/begin MEASUREMENT B_lsuab2 "Bedingung Abgleich stetige Lambda-Sonde LSU2" UWORD B_TRUE 1 100 0 1 BIT_MASK 0x200 FORMAT "%5.3" /begin IF_DATA ASAP1B_KWP2000 KP_BLOB 0xFD1E INTERN 0x2 /end IF_DATA /begin IF_DATA ETK KP_BLOB 0xFD1E INTERN 0x2 /end IF_DATA /end MEASUREMENT
/begin MEASUREMENT B_nofra "Bedingung Sperren der multiplikativen Gemischkorrektur" UWORD B_TRUE 1 100 0 1 BIT_MASK 0x100 FORMAT "%5.3" /begin IF_DATA ASAP1B_KWP2000 KP_BLOB 0xFD28 INTERN 0x2 /end IF_DATA /begin IF_DATA ETK KP_BLOB 0xFD28 INTERN 0x2 /end IF_DATA /end MEASUREMENT
/begin MEASUREMENT B_norkat "Bedingung additive Korrektur der Gemischadaption pro Zeit abgeschaltet" UWORD B_TRUE 1 100 0 1 BIT_MASK 0x200 FORMAT "%5.3" /begin IF_DATA ASAP1B_KWP2000 KP_BLOB 0xFD28 INTERN 0x2 /end IF_DATA /begin IF_DATA ETK KP_BLOB 0xFD28 INTERN 0x2 /end IF_DATA /end MEASUREMENT
/begin MEASUREMENT B_norkaz "Bedingung additive Korrektur der Gemischadaption pro Zündung abgeschaltet" UWORD B_TRUE 1 100 0 1 BIT_MASK 0x400 FORMAT "%5.3" /begin IF_DATA ASAP1B_KWP2000 KP_BLOB 0xFD28 INTERN 0x2 /end IF_DATA /begin IF_DATA ETK KP_BLOB 0xFD28 INTERN 0x2 /end IF_DATA /end MEASUREMENT
/begin MEASUREMENT B_ntini "KR: Bedingung für Initialisierungs-Nulltest" UWORD B_TRUE 1 100 0 1 BIT_MASK 0x1 FORMAT "%5.3" /begin IF_DATA ASAP1B_KWP2000 KP_BLOB 0xFD2C INTERN 0x2 /end IF_DATA /begin IF_DATA ETK KP_BLOB 0xFD2C INTERN 0x2 /end IF_DATA /end MEASUREMENT
/begin MEASUREMENT B_redkl "Freigabe Reduzierung ÜK-K- und -L-Anteil" UWORD B_TRUE 1 100 0 1 BIT_MASK 0x80 FORMAT "%5.3" /begin IF_DATA ASAP1B_KWP2000 KP_BLOB 0xFD26 INTERN 0x2 /end IF_DATA /begin IF_DATA ETK KP_BLOB 0xFD26 INTERN 0x2 /end IF_DATA /end MEASUREMENT
/begin MEASUREMENT B_rkat "Bedingung Lernbereich additive Korrektur pro Zeit aktiv" UWORD B_TRUE 1 100 0 1 BIT_MASK 0x800 FORMAT "%5.3" /begin IF_DATA ASAP1B_KWP2000 KP_BLOB 0xFD28 INTERN 0x2 /end IF_DATA /begin IF_DATA ETK KP_BLOB 0xFD28 INTERN 0x2 /end IF_DATA /end MEASUREMENT
/begin MEASUREMENT B_rkaz "Bedingung Lernbereich additive Korrektur pro Zündung aktiv" UWORD B_TRUE 1 100 0 1 BIT_MASK 0x1000 FORMAT "%5.3" /begin IF_DATA ASAP1B_KWP2000 KP_BLOB 0xFD28 INTERN 0x2 /end IF_DATA /begin IF_DATA ETK KP_BLOB 0xFD28 INTERN 0x2 /end IF_DATA /end MEASUREMENT
/begin MEASUREMENT B_sbbvk "Bedingung Sonde betriebsbereit vor Kat" UWORD B_TRUE 1 100 0 1 BIT_MASK 0x400 FORMAT "%5.3" /begin IF_DATA ASAP1B_KWP2000 KP_BLOB 0xFD1E INTERN 0x2 /end IF_DATA /begin IF_DATA ETK KP_BLOB 0xFD1E INTERN 0x2 /end IF_DATA /end MEASUREMENT
/begin MEASUREMENT B_sbbvk2 "Bedingung Sonde betriebsbereit vor Kat, Bank 2" UWORD B_TRUE 1 100 0 1 BIT_MASK 0x800 FORMAT "%5.3" /begin IF_DATA ASAP1B_KWP2000 KP_BLOB 0xFD1E INTERN 0x2 /end IF_DATA /begin IF_DATA ETK KP_BLOB 0xFD1E INTERN 0x2 /end IF_DATA /end MEASUREMENT
/begin MEASUREMENT B_stoe "Bedingung B_st oder B_stend" UWORD B_TRUE 1 100 0 1 BIT_MASK 0x400 FORMAT "%5.3" /begin IF_DATA ASAP1B_KWP2000 KP_BLOB 0xFD40 INTERN 0x2 /end IF_DATA /begin IF_DATA ETK KP_BLOB 0xFD40 INTERN 0x2 /end IF_DATA /end MEASUREMENT
/begin MEASUREMENT B_tabgbts "Bedingung Abgastemperatur für Bauteileschutz überschritten" UWORD B_TRUE 1 100 0 1 BIT_MASK 0x4 FORMAT "%5.3" /begin IF_DATA ASAP1B_KWP2000 KP_BLOB 0xFD28 INTERN 0x2 /end IF_DATA /begin IF_DATA ETK KP_BLOB 0xFD28 INTERN 0x2 /end IF_DATA /end MEASUREMENT
/begin MEASUREMENT B_tmkr "Bedingung Temperatur (tmot) fuer KR aktiv erreicht" UWORD B_TRUE 1 100 0 1 BIT_MASK 0x4 FORMAT "%5.3" /begin IF_DATA ASAP1B_KWP2000 KP_BLOB 0xFD2E INTERN 0x2 /end IF_DATA /begin IF_DATA ETK KP_BLOB 0xFD2E INTERN 0x2 /end IF_DATA /end MEASUREMENT
/begin MEASUREMENT B_tpnt_aw "KR: Auswahl Nulltest oder Testimpuls" UWORD B_TRUE 1 100 0 1 BIT_MASK 0x2 FORMAT "%5.3" /begin IF_DATA ASAP1B_KWP2000 KP_BLOB 0xFD2C INTERN 0x2 /end IF_DATA /begin IF_DATA ETK KP_BLOB 0xFD2C INTERN 0x2 /end IF_DATA /end MEASUREMENT
/begin MEASUREMENT B_tpnt_e "KR: Nulltest/Testimpuls freigegeben" UWORD B_TRUE 1 100 0 1 BIT_MASK 0x4 FORMAT "%5.3" /begin IF_DATA ASAP1B_KWP2000 KP_BLOB 0xFD2C INTERN 0x2 /end IF_DATA /begin IF_DATA ETK KP_BLOB 0xFD2C INTERN 0x2 /end IF_DATA /end MEASUREMENT
/begin MEASUREMENT B_turbo "Bedingung Turbolader-Motor" UBYTE B_TRUE 1 100 0 1 BIT_MASK 0x1 FORMAT "%5.3" /begin IF_DATA ASAP1B_KWP2000 KP_BLOB 0x380373 EXTERN 0x1 /end IF_DATA /begin IF_DATA ETK KP_BLOB 0x380373 EXTERN 0x1 /end IF_DATA /end MEASUREMENT
/begin MEASUREMENT B_uk1 "Einschaltbedingung Übergangskompensation" UWORD B_TRUE 1 100 0 1 BIT_MASK 0x100 FORMAT "%5.3" /begin IF_DATA ASAP1B_KWP2000 KP_BLOB 0xFD26 INTERN 0x2 /end IF_DATA /begin IF_DATA ETK KP_BLOB 0xFD26 INTERN 0x2 /end IF_DATA /end MEASUREMENT
/begin MEASUREMENT B_ukg "Bedingung Ük wirkt stark" UWORD B_TRUE 1 100 0 1 BIT_MASK 0x200 FORMAT "%5.3" /begin IF_DATA ASAP1B_KWP2000 KP_BLOB 0xFD26 INTERN 0x2 /end IF_DATA /begin IF_DATA ETK KP_BLOB 0xFD26 INTERN 0x2 /end IF_DATA /end MEASUREMENT
/begin MEASUREMENT B_ukk "Einschaltbedingung ÜK Kurzzeit-Anteil" UWORD B_TRUE 1 100 0 1 BIT_MASK 0x400 FORMAT "%5.3" /begin IF_DATA ASAP1B_KWP2000 KP_BLOB 0xFD26 INTERN 0x2 /end IF_DATA /begin IF_DATA ETK KP_BLOB 0xFD26 INTERN 0x2 /end IF_DATA /end MEASUREMENT
/begin MEASUREMENT B_va "Bedingung Verzögerungsabmagerung (Anzeige)" UWORD B_TRUE 1 100 0 1 BIT_MASK 0x800 FORMAT "%5.3" /begin IF_DATA ASAP1B_KWP2000 KP_BLOB 0xFD26 INTERN 0x2 /end IF_DATA /begin IF_DATA ETK KP_BLOB 0xFD26 INTERN 0x2 /end IF_DATA /end MEASUREMENT
/begin MEASUREMENT B_vaau "Bedingung Verzögerungsabmagerung Aufteilung" UWORD B_TRUE 1 100 0 1 BIT_MASK 0x1000 FORMAT "%5.3" /begin IF_DATA ASAP1B_KWP2000 KP_BLOB 0xFD26 INTERN 0x2 /end IF_DATA /begin IF_DATA ETK KP_BLOB 0xFD26 INTERN 0x2 /end IF_DATA /end MEASUREMENT
/begin MEASUREMENT B_vag "Bedingung starke Verzögerungsabmagerung" UWORD B_TRUE 1 100 0 1 BIT_MASK 0x2000 FORMAT "%5.3" /begin IF_DATA ASAP1B_KWP2000 KP_BLOB 0xFD26 INTERN 0x2 /end IF_DATA /begin IF_DATA ETK KP_BLOB 0xFD26 INTERN 0x2 /end IF_DATA /end MEASUREMENT
/begin MEASUREMENT B_vakl "Bedingung Verzögerungsabmagerung L- und K-Anteil" UWORD B_TRUE 1 100 0 1 BIT_MASK 0x4000 FORMAT "%5.3" /begin IF_DATA ASAP1B_KWP2000 KP_BLOB 0xFD26 INTERN 0x2 /end IF_DATA /begin IF_DATA ETK KP_BLOB 0xFD26 INTERN 0x2 /end IF_DATA /end MEASUREMENT
/begin MEASUREMENT B_val "Bedingung Verzögerungsabmagerung L-Anteil" UWORD B_TRUE 1 100 0 1 BIT_MASK 0x8000 FORMAT "%5.3" /begin IF_DATA ASAP1B_KWP2000 KP_BLOB 0xFD26 INTERN 0x2 /end IF_DATA /begin IF_DATA ETK KP_BLOB 0xFD26 INTERN 0x2 /end IF_DATA /end MEASUREMENT
/begin MEASUREMENT B_vfzlapmn "Bedingung Mindestgeschwindigkeit für Laptrigger" UWORD B_TRUE 1 100 0 1 BIT_MASK 0x2000 FORMAT "%5.3" /begin IF_DATA ASAP1B_KWP2000 KP_BLOB 0xFD36 INTERN 0x2 /end IF_DATA /begin IF_DATA ETK KP_BLOB 0xFD36 INTERN 0x2 /end IF_DATA /end MEASUREMENT
/begin MEASUREMENT B_vl "Bedingung Vollast" UWORD B_TRUE 1 100 0 1 BIT_MASK 0x8000 FORMAT "%5.3" /begin IF_DATA ASAP1B_KWP2000 KP_BLOB 0xFD18 INTERN 0x2 /end IF_DATA /begin IF_DATA ETK KP_BLOB 0xFD18 INTERN 0x2 /end IF_DATA /end MEASUREMENT
/begin MEASUREMENT B_vnull "Bedingung Fahrzeug steht" UWORD B_TRUE 1 100 0 1 BIT_MASK 0x4 FORMAT "%5.3" /begin IF_DATA ASAP1B_KWP2000 KP_BLOB 0xFD16 INTERN 0x2 /end IF_DATA /begin IF_DATA ETK KP_BLOB 0xFD16 INTERN 0x2 /end IF_DATA /end MEASUREMENT
/begin MEASUREMENT B_wkral "Bedingung wkr aus KR-Adaptionskennfeld einlesen" UWORD B_TRUE 1 100 0 1 BIT_MASK 0x8 FORMAT "%5.3" /begin IF_DATA ASAP1B_KWP2000 KP_BLOB 0xFD2E INTERN 0x2 /end IF_DATA /begin IF_DATA ETK KP_BLOB 0xFD2E INTERN 0x2 /end IF_DATA /end MEASUREMENT
/begin MEASUREMENT B_wkrdyw "Bedingung Dynamikvorhalt überschreiben" UWORD B_TRUE 1 100 0 1 BIT_MASK 0x400 FORMAT "%5.3" /begin IF_DATA ASAP1B_KWP2000 KP_BLOB 0xFD2C INTERN 0x2 /end IF_DATA /begin IF_DATA ETK KP_BLOB 0xFD2C INTERN 0x2 /end IF_DATA /end MEASUREMENT
/begin MEASUREMENT B_wu "Flagge Verzögerungszeit TVLSUWU abgelaufen" UWORD B_TRUE 1 100 0 1 BIT_MASK 0x800 FORMAT "%5.3" /begin IF_DATA ASAP1B_KWP2000 KP_BLOB 0xFD40 INTERN 0x2 /end IF_DATA /begin IF_DATA ETK KP_BLOB 0xFD40 INTERN 0x2 /end IF_DATA /end MEASUREMENT
/begin MEASUREMENT B_wu2 "Flagge Verzögerungszeit TVLSUWU abgelaufen, LSU2" UWORD B_TRUE 1 100 0 1 BIT_MASK 0x1000 FORMAT "%5.3" /begin IF_DATA ASAP1B_KWP2000 KP_BLOB 0xFD40 INTERN 0x2 /end IF_DATA /begin IF_DATA ETK KP_BLOB 0xFD40 INTERN 0x2 /end IF_DATA /end MEASUREMENT
/begin MEASUREMENT B_zwkraa "Bedingung Zündwinkel der KR wird ausgegeben" UWORD B_TRUE 1 100 0 1 BIT_MASK 0x10 FORMAT "%5.3" /begin IF_DATA ASAP1B_KWP2000 KP_BLOB 0xFD2E INTERN 0x2 /end IF_DATA /begin IF_DATA ETK KP_BLOB 0xFD2E INTERN 0x2 /end IF_DATA /end MEASUREMENT
/begin MEASUREMENT B_zwkrum "Flag: schnelle Frühverstellung" UWORD B_TRUE 1 100 0 1 BIT_MASK 0x20 FORMAT "%5.3" /begin IF_DATA ASAP1B_KWP2000 KP_BLOB 0xFD2E INTERN 0x2 /end IF_DATA /begin IF_DATA ETK KP_BLOB 0xFD2E INTERN 0x2 /end IF_DATA /end MEASUREMENT
/begin MEASUREMENT detazwbs "Delta ZW-Wirkungsgrad für Bauteileschutz" UBYTE rel_ub_b127p5 1 100 0 127.5 FORMAT "%5.1" /begin IF_DATA ASAP1B_KWP2000 KP_BLOB 0x38039F EXTERN 0x1 /end IF_DATA /begin IF_DATA ETK KP_BLOB 0x38039F EXTERN 0x1 /end IF_DATA /end MEASUREMENT
/begin MEASUREMENT dfrm2_w "Abweichung schneller Mittelwert des Lambdareglers von 1.0 (Word)" SWORD fak_sw_b1 1 100 -1 0.999969 FORMAT "%8.6" /begin IF_DATA ASAP1B_KWP2000 KP_BLOB 0x380C64 EXTERN 0x2 /end IF_DATA /begin IF_DATA ETK KP_BLOB 0x380C64 EXTERN 0x2 /end IF_DATA /end MEASUREMENT
/begin MEASUREMENT dfrm_w "Abweichung schneller Mittelwert des Lambdareglers von 1.0 (Word)" SWORD fak_sw_b1 1 100 -1 0.999969 FORMAT "%8.6" /begin IF_DATA ASAP1B_KWP2000 KP_BLOB 0x380C66 EXTERN 0x2 /end IF_DATA /begin IF_DATA ETK KP_BLOB 0x380C66 EXTERN 0x2 /end IF_DATA /end MEASUREMENT
/begin MEASUREMENT distkm_w "Zurückgelegte Strecke, Kilometerzähler" UWORD dist_uw_q0p1 1 100 0 65535 FORMAT "%8.2" /begin IF_DATA ASAP1B_KWP2000 KP_BLOB 0x3804B0 EXTERN 0x2 /end IF_DATA /begin IF_DATA ETK KP_BLOB 0x3804B0 EXTERN 0x2 /end IF_DATA /end MEASUREMENT
/begin MEASUREMENT distlap_w "Zurückgelegte Rundendistanz" UWORD distm_uw_q0p0 1 100 0 65535 FORMAT "%8.2" /begin IF_DATA ASAP1B_KWP2000 KP_BLOB 0x382952 EXTERN 0x2 /end IF_DATA /begin IF_DATA ETK KP_BLOB 0x382952 EXTERN 0x2 /end IF_DATA /end MEASUREMENT
/begin MEASUREMENT distm_w "Zurückgelegte Strecke, Meterzähler" UWORD distm_uw_q0p1 1 100 0 6553.5 FORMAT "%8.3" /begin IF_DATA ASAP1B_KWP2000 KP_BLOB 0x3804B2 EXTERN 0x2 /end IF_DATA /begin IF_DATA ETK KP_BLOB 0x3804B2 EXTERN 0x2 /end IF_DATA /end MEASUREMENT
/begin MEASUREMENT dlam2_w "delta Lambda Bank2, Abweichung von Lambda 1" SWORD fak_sw_b8 1 100 -8 7.99976 FORMAT "%8.6" /begin IF_DATA ASAP1B_KWP2000 KP_BLOB 0x380A8C EXTERN 0x2 /end IF_DATA /begin IF_DATA ETK KP_BLOB 0x380A8C EXTERN 0x2 /end IF_DATA /end MEASUREMENT
/begin MEASUREMENT dlambts_w "Delta Lambda für Bauteileschutz" SWORD fak_sw_b8 1 100 -8 7.99976 FORMAT "%8.6" /begin IF_DATA ASAP1B_KWP2000 KP_BLOB 0x380C48 EXTERN 0x2 /end IF_DATA /begin IF_DATA ETK KP_BLOB 0x380C48 EXTERN 0x2 /end IF_DATA /end MEASUREMENT
/begin MEASUREMENT dlam_w "delta Lambda, Abweichung von Lambda 1" SWORD fak_sw_b8 1 100 -8 7.99976 FORMAT "%8.6" /begin IF_DATA ASAP1B_KWP2000 KP_BLOB 0x380A8E EXTERN 0x2 /end IF_DATA /begin IF_DATA ETK KP_BLOB 0x380A8E EXTERN 0x2 /end IF_DATA /end MEASUREMENT
/begin MEASUREMENT dpvdkspu_w "delta zwischen Druck vor Drosselklappe und Umgebungsdruck" UWORD p_uw_q0p039 1 100 0 2559.96 FORMAT "%8.3" /begin IF_DATA ASAP1B_KWP2000 KP_BLOB 0x380B86 EXTERN 0x2 /end IF_DATA /begin IF_DATA ETK KP_BLOB 0x380B86 EXTERN 0x2 /end IF_DATA /end MEASUREMENT
/begin MEASUREMENT drlkrdy "Lastgradient für Auslösung KR-Lastdynamik" SWORD rel_sw_q0p0234 1 100 -768 767.977 FORMAT "%8.4" /begin IF_DATA ASAP1B_KWP2000 KP_BLOB 0x380CD0 EXTERN 0x2 /end IF_DATA /begin IF_DATA ETK KP_BLOB 0x380CD0 EXTERN 0x2 /end IF_DATA /end MEASUREMENT
/begin MEASUREMENT dtc1_high "" UBYTE dez 1 100 0 255 FORMAT "%5.1" /begin IF_DATA ASAP1B_KWP2000 KP_BLOB 0x38032A EXTERN 0x1 /end IF_DATA /begin IF_DATA ETK KP_BLOB 0x38032A EXTERN 0x1 /end IF_DATA /end MEASUREMENT
/begin MEASUREMENT dtc1_low "" UBYTE dez 1 100 0 255 FORMAT "%5.1" /begin IF_DATA ASAP1B_KWP2000 KP_BLOB 0x38032B EXTERN 0x1 /end IF_DATA /begin IF_DATA ETK KP_BLOB 0x38032B EXTERN 0x1 /end IF_DATA /end MEASUREMENT
/begin MEASUREMENT dtc1_stat "" UBYTE dez 1 100 0 255 FORMAT "%5.1" /begin IF_DATA ASAP1B_KWP2000 KP_BLOB 0x38032C EXTERN 0x1 /end IF_DATA /begin IF_DATA ETK KP_BLOB 0x38032C EXTERN 0x1 /end IF_DATA /end MEASUREMENT
/begin MEASUREMENT dtc2_high "" UBYTE dez 1 100 0 255 FORMAT "%5.1" /begin IF_DATA ASAP1B_KWP2000 KP_BLOB 0x38032D EXTERN 0x1 /end IF_DATA /begin IF_DATA ETK KP_BLOB 0x38032D EXTERN 0x1 /end IF_DATA /end MEASUREMENT
/begin MEASUREMENT dtc2_low "" UBYTE dez 1 100 0 255 FORMAT "%5.1" /begin IF_DATA ASAP1B_KWP2000 KP_BLOB 0x38032E EXTERN 0x1 /end IF_DATA /begin IF_DATA ETK KP_BLOB 0x38032E EXTERN 0x1 /end IF_DATA /end MEASUREMENT
/begin MEASUREMENT dtc2_stat "" UBYTE dez 1 100 0 255 FORMAT "%5.1" /begin IF_DATA ASAP1B_KWP2000 KP_BLOB 0x38032F EXTERN 0x1 /end IF_DATA /begin IF_DATA ETK KP_BLOB 0x38032F EXTERN 0x1 /end IF_DATA /end MEASUREMENT
/begin MEASUREMENT dummy1 "" UBYTE dez 1 100 0 255 FORMAT "%5.1" /begin IF_DATA ASAP1B_KWP2000 KP_BLOB 0x380329 EXTERN 0x1 /end IF_DATA /begin IF_DATA ETK KP_BLOB 0x380329 EXTERN 0x1 /end IF_DATA /end MEASUREMENT
/begin MEASUREMENT dwdkba_w "Gradient DK-Winkel" SWORD relDK_q0p02441 1 100 -800 799.976 FORMAT "%8.4" /begin IF_DATA ASAP1B_KWP2000 KP_BLOB 0x3809C6 EXTERN 0x2 /end IF_DATA /begin IF_DATA ETK KP_BLOB 0x3809C6 EXTERN 0x2 /end IF_DATA /end MEASUREMENT
/begin MEASUREMENT dwdkkr "" SWORD rel_sw_q0p0234 1 100 -768 767.977 FORMAT "%8.4" /begin IF_DATA ASAP1B_KWP2000 KP_BLOB 0x380CD2 EXTERN 0x2 /end IF_DATA /begin IF_DATA ETK KP_BLOB 0x380CD2 EXTERN 0x2 /end IF_DATA /end MEASUREMENT
/begin MEASUREMENT dwfk_w "Wandfilmmengendifferenz Kurzzeitanteil" SWORD rel_sw_q0p1875 1 100 -6144 6143.81 FORMAT "%8.3" /begin IF_DATA ASAP1B_KWP2000 KP_BLOB 0x380C14 EXTERN 0x2 /end IF_DATA /begin IF_DATA ETK KP_BLOB 0x380C14 EXTERN 0x2 /end IF_DATA /end MEASUREMENT
/begin MEASUREMENT dwfl_w "Wandfilmmengendifferenz Langzeitanteil" SWORD rel_sw_q0p1875 1 100 -6144 6143.81 FORMAT "%8.3" /begin IF_DATA ASAP1B_KWP2000 KP_BLOB 0x380C16 EXTERN 0x2 /end IF_DATA /begin IF_DATA ETK KP_BLOB 0x380C16 EXTERN 0x2 /end IF_DATA /end MEASUREMENT
/begin MEASUREMENT dwf_w "Wandfilmmengendifferenz" SWORD rel_sw_q0p1875 1 100 -6144 6143.81 FORMAT "%8.3" /begin IF_DATA ASAP1B_KWP2000 KP_BLOB 0x380C18 EXTERN 0x2 /end IF_DATA /begin IF_DATA ETK KP_BLOB 0x380C18 EXTERN 0x2 /end IF_DATA /end MEASUREMENT
/begin MEASUREMENT dwkr "zylinderindividuelle Zündwinkelspätverstellung KR" SBYTE zw_sb_q0p75 1 100 -96 95.25 FORMAT "%5.2" /begin IF_DATA ASAP1B_KWP2000 KP_BLOB 0x380400 EXTERN 0x1 /end IF_DATA /begin IF_DATA ETK KP_BLOB 0x380400 EXTERN 0x1 /end IF_DATA /end MEASUREMENT
/begin MEASUREMENT dwkrmsw "aktueller Wert für Mittelwertbegrenzung der Spätverstellung" UBYTE zw_ub_qn0p75 1 100 -191.25 0 FORMAT "%5.1" /begin IF_DATA ASAP1B_KWP2000 KP_BLOB 0x380401 EXTERN 0x1 /end IF_DATA /begin IF_DATA ETK KP_BLOB 0x380401 EXTERN 0x1 /end IF_DATA /end MEASUREMENT
/begin MEASUREMENT dwkrz "zyl.ind. ZW-Spätverstellung inkl. Dyn.vorhalt" SBYTE zw_sb_q0p75 1 100 -96 95.25 FORMAT "%5.2" ARRAY_SIZE 8 /begin IF_DATA ASAP1B_KWP2000 KP_BLOB 0x380402 EXTERN 0x1 /end IF_DATA /begin IF_DATA ETK KP_BLOB 0x380402 EXTERN 0x1 /end IF_DATA /end MEASUREMENT
/begin MEASUREMENT dyesofv "aktueller Wert Offset für Lastdynamikerkennungsschwelle" SWORD rel_sw_q0p0234 1 100 -768 767.977 FORMAT "%8.4" /begin IF_DATA ASAP1B_KWP2000 KP_BLOB 0x380CD4 EXTERN 0x2 /end IF_DATA /begin IF_DATA ETK KP_BLOB 0x380CD4 EXTERN 0x2 /end IF_DATA /end MEASUREMENT
/begin MEASUREMENT dyesv "aktueller Wert Lastdynamikerkennungsschwelle" SWORD rel_sw_q0p0234 1 100 -768 767.977 FORMAT "%8.4" /begin IF_DATA ASAP1B_KWP2000 KP_BLOB 0x380CD6 EXTERN 0x2 /end IF_DATA /begin IF_DATA ETK KP_BLOB 0x380CD6 EXTERN 0x2 /end IF_DATA /end MEASUREMENT
/begin MEASUREMENT dzwg "Delta Zündwinkel Grund-ZW zu Optimal-ZW" SBYTE zw_sb_q0p75 1 100 -96 95.25 FORMAT "%5.2" /begin IF_DATA ASAP1B_KWP2000 KP_BLOB 0x3803A0 EXTERN 0x1 /end IF_DATA /begin IF_DATA ETK KP_BLOB 0x3803A0 EXTERN 0x1 /end IF_DATA /end MEASUREMENT
/begin MEASUREMENT esst_snm08gkub "" UWORD dez 1 100 0 65535 FORMAT "%8.2" /begin IF_DATA ASAP1B_KWP2000 KP_BLOB 0x380BEA EXTERN 0x2 /end IF_DATA /begin IF_DATA ETK KP_BLOB 0x380BEA EXTERN 0x2 /end IF_DATA /end MEASUREMENT
/begin MEASUREMENT esst_snm16gkub "" UWORD dez 1 100 0 65535 FORMAT "%8.2" /begin IF_DATA ASAP1B_KWP2000 KP_BLOB 0x380C4A EXTERN 0x2 /end IF_DATA /begin IF_DATA ETK KP_BLOB 0x380C4A EXTERN 0x2 /end IF_DATA /end MEASUREMENT
/begin MEASUREMENT esst_srl08gkub "" UWORD dez 1 100 0 65535 FORMAT "%8.2" /begin IF_DATA ASAP1B_KWP2000 KP_BLOB 0x380BEC EXTERN 0x2 /end IF_DATA /begin IF_DATA ETK KP_BLOB 0x380BEC EXTERN 0x2 /end IF_DATA /end MEASUREMENT
/begin MEASUREMENT esst_srl12gkub "" UWORD dez 1 100 0 65535 FORMAT "%8.2" /begin IF_DATA ASAP1B_KWP2000 KP_BLOB 0x380C4C EXTERN 0x2 /end IF_DATA /begin IF_DATA ETK KP_BLOB 0x380C4C EXTERN 0x2 /end IF_DATA /end MEASUREMENT
/begin MEASUREMENT esst_stm08gkub "" UWORD dez 1 100 0 65535 FORMAT "%8.2" /begin IF_DATA ASAP1B_KWP2000 KP_BLOB 0x380BEE EXTERN 0x2 /end IF_DATA /begin IF_DATA ETK KP_BLOB 0x380BEE EXTERN 0x2 /end IF_DATA /end MEASUREMENT
/begin MEASUREMENT etazwg "Wirkungsgrad beim Grundzündwinkel" UBYTE rel_ub_b127p5 1 100 0 127.5 FORMAT "%5.1" /begin IF_DATA ASAP1B_KWP2000 KP_BLOB 0x3803A1 EXTERN 0x1 /end IF_DATA /begin IF_DATA ETK KP_BLOB 0x3803A1 EXTERN 0x1 /end IF_DATA /end MEASUREMENT
/begin MEASUREMENT etazwim "Gemittelter Wirkungsgrad beim Ist-Zündwinkel" UBYTE rel_ub_b127p5 1 100 0 127.5 FORMAT "%5.1" /begin IF_DATA ASAP1B_KWP2000 KP_BLOB 0x3803A2 EXTERN 0x1 /end IF_DATA /begin IF_DATA ETK KP_BLOB 0x3803A2 EXTERN 0x1 /end IF_DATA /end MEASUREMENT
/begin MEASUREMENT fbakl_w "Faktor K- und L-Anteil der ÜK bei BA" SWORD fak_sw_b256 1 100 -256 255.992 FORMAT "%8.4" /begin IF_DATA ASAP1B_KWP2000 KP_BLOB 0x380C0E EXTERN 0x2 /end IF_DATA /begin IF_DATA ETK KP_BLOB 0x380C0E EXTERN 0x2 /end IF_DATA /end MEASUREMENT
/begin MEASUREMENT fbans "Nachstartfaktor der ÜK bei BA" UBYTE fak_ub_b8 1 100 0 7.96875 FORMAT "%5.3" /begin IF_DATA ASAP1B_KWP2000 KP_BLOB 0x380396 EXTERN 0x1 /end IF_DATA /begin IF_DATA ETK KP_BLOB 0x380396 EXTERN 0x1 /end IF_DATA /end MEASUREMENT
/begin MEASUREMENT fbans_w "Nachstartfaktor der ÜK bei BA" UWORD fak_uw_b8 1 100 0 7.99988 FORMAT "%8.6" /begin IF_DATA ASAP1B_KWP2000 KP_BLOB 0x380C10 EXTERN 0x2 /end IF_DATA /begin IF_DATA ETK KP_BLOB 0x380C10 EXTERN 0x2 /end IF_DATA /end MEASUREMENT
/begin MEASUREMENT fho "Korrekturfaktor Höhe" UBYTE fak_ub_b4 1 100 0 3.98438 FORMAT "%5.3" /begin IF_DATA ASAP1B_KWP2000 KP_BLOB 0x380372 EXTERN 0x1 /end IF_DATA /begin IF_DATA ETK KP_BLOB 0x380372 EXTERN 0x1 /end IF_DATA /end MEASUREMENT
/begin MEASUREMENT fho_w "Korrekturfaktor Höhe (word)" UWORD fak_uw_b4 1 100 0 3.99994 FORMAT "%8.6" /begin IF_DATA ASAP1B_KWP2000 KP_BLOB 0x380B88 EXTERN 0x2 /end IF_DATA /begin IF_DATA ETK KP_BLOB 0x380B88 EXTERN 0x2 /end IF_DATA /end MEASUREMENT
/begin MEASUREMENT fpvdkds "Faktor Druck vor Drosselklappe von Drucksensor" UBYTE fak_ub_b4 1 100 0 3.98438 FORMAT "%5.3" /begin IF_DATA ASAP1B_KWP2000 KP_BLOB 0x380375 EXTERN 0x1 /end IF_DATA /begin IF_DATA ETK KP_BLOB 0x380375 EXTERN 0x1 /end IF_DATA /end MEASUREMENT
/begin MEASUREMENT fpvdkdsl_w "Faktor Druck vor Drosselklappe von Ladedrucksensor (word)" UWORD fak_uw_b4 1 100 0 3.99994 FORMAT "%8.6" /begin IF_DATA ASAP1B_KWP2000 KP_BLOB 0x380B94 EXTERN 0x2 /end IF_DATA /begin IF_DATA ETK KP_BLOB 0x380B94 EXTERN 0x2 /end IF_DATA /end MEASUREMENT
/begin MEASUREMENT fpvdkdsu_w "Faktor Druck vor Drosselklappe von Umgebungsdrucksensor (word)" UWORD fak_uw_b4 1 100 0 3.99994 FORMAT "%8.6" /begin IF_DATA ASAP1B_KWP2000 KP_BLOB 0x380B8A EXTERN 0x2 /end IF_DATA /begin IF_DATA ETK KP_BLOB 0x380B8A EXTERN 0x2 /end IF_DATA /end MEASUREMENT
/begin MEASUREMENT fpvdkds_w "Faktor Druck vor Drosselklappe von Drucksensor (word)" UWORD fak_uw_b4 1 100 0 3.99994 FORMAT "%8.6" /begin IF_DATA ASAP1B_KWP2000 KP_BLOB 0x380B96 EXTERN 0x2 /end IF_DATA /begin IF_DATA ETK KP_BLOB 0x380B96 EXTERN 0x2 /end IF_DATA /end MEASUREMENT
/begin MEASUREMENT fra2_w "multiplikative Gemischkorrektur der Gemischadaption (Word)" UWORD fak_uw_b2 1 100 0 1.99997 FORMAT "%8.6" /begin IF_DATA ASAP1B_KWP2000 KP_BLOB 0x382AFE EXTERN 0x2 /end IF_DATA /begin IF_DATA ETK KP_BLOB 0x382AFE EXTERN 0x2 /end IF_DATA /end MEASUREMENT
/begin MEASUREMENT fra_w "multiplikative Gemischkorrektur der Gemischadaption (Word)" UWORD fak_uw_b2 1 100 0 1.99997 FORMAT "%8.6" /begin IF_DATA ASAP1B_KWP2000 KP_BLOB 0x382B00 EXTERN 0x2 /end IF_DATA /begin IF_DATA ETK KP_BLOB 0x382B00 EXTERN 0x2 /end IF_DATA /end MEASUREMENT
/begin MEASUREMENT frhol_w "Faktor Luftdichte f(Ansauglufttemp., Höhe) 16-Bit" UWORD fak_uw_b2 1 100 0 1.99997 FORMAT "%8.6" /begin IF_DATA ASAP1B_KWP2000 KP_BLOB 0x380B8C EXTERN 0x2 /end IF_DATA /begin IF_DATA ETK KP_BLOB 0x380B8C EXTERN 0x2 /end IF_DATA /end MEASUREMENT
/begin MEASUREMENT fvakl_w "Faktor K- und L-Anteil der ÜK bei VA" SWORD fak_sw_b256 1 100 -256 255.992 FORMAT "%8.4" /begin IF_DATA ASAP1B_KWP2000 KP_BLOB 0x380C12 EXTERN 0x2 /end IF_DATA /begin IF_DATA ETK KP_BLOB 0x380C12 EXTERN 0x2 /end IF_DATA /end MEASUREMENT
/begin MEASUREMENT fvans "Nachstartfaktor der ÜK bei VA" UBYTE fak_ub_b8 1 100 0 7.96875 FORMAT "%5.3" /begin IF_DATA ASAP1B_KWP2000 KP_BLOB 0x380397 EXTERN 0x1 /end IF_DATA /begin IF_DATA ETK KP_BLOB 0x380397 EXTERN 0x1 /end IF_DATA /end MEASUREMENT
/begin MEASUREMENT fvst_w "Faktor Vorsteuerung" UWORD fak_uw_b64 1 100 0 63.999 FORMAT "%8.5" /begin IF_DATA ASAP1B_KWP2000 KP_BLOB 0x380C3C EXTERN 0x2 /end IF_DATA /begin IF_DATA ETK KP_BLOB 0x380C3C EXTERN 0x2 /end IF_DATA /end MEASUREMENT
/begin MEASUREMENT fwe "Faktor Wiedereinsetzen" UBYTE fak_ub_b2 1 100 0 1.99219 FORMAT "%5.3" /begin IF_DATA ASAP1B_KWP2000 KP_BLOB 0x38039D EXTERN 0x1 /end IF_DATA /begin IF_DATA ETK KP_BLOB 0x38039D EXTERN 0x1 /end IF_DATA /end MEASUREMENT
/begin MEASUREMENT fwl "Faktor Warmlauf" UBYTE fak_ub_b2 1 100 0 1.99219 FORMAT "%5.3" /begin IF_DATA ASAP1B_KWP2000 KP_BLOB 0x38039E EXTERN 0x1 /end IF_DATA /begin IF_DATA ETK KP_BLOB 0x38039E EXTERN 0x1 /end IF_DATA /end MEASUREMENT
/begin MEASUREMENT GGDSASlokbits "" UBYTE dez 1 100 0 255 FORMAT "%5.1" /begin IF_DATA ASAP1B_KWP2000 KP_BLOB 0x380373 EXTERN 0x1 /end IF_DATA /begin IF_DATA ETK KP_BLOB 0x380373 EXTERN 0x1 /end IF_DATA /end MEASUREMENT
/begin MEASUREMENT igokr_w "Integratorgradient für Offsetkorrektur Klopfregelung (Word)" SWORD spgg_sw_b3052 1 100 -3051.76 3051.67 FORMAT "%8.3" /begin IF_DATA ASAP1B_KWP2000 KP_BLOB 0x380CC0 EXTERN 0x2 /end IF_DATA /begin IF_DATA ETK KP_BLOB 0x380CC0 EXTERN 0x2 /end IF_DATA /end MEASUREMENT
/begin MEASUREMENT ikr "Integratorwert Klopfregelung offsetkorrigiert" UBYTE spg_ub_b5 1 100 0 5 FORMAT "%5.3" ARRAY_SIZE 8 /begin IF_DATA ASAP1B_KWP2000 KP_BLOB 0xE008 INTERN 0x1 /end IF_DATA /begin IF_DATA ETK KP_BLOB 0xE008 INTERN 0x1 /end IF_DATA /end MEASUREMENT
/begin MEASUREMENT ikrma "Integratorwert Klopfregelung Meßfensteranfang" UBYTE spg_ub_b5 1 100 0 5 FORMAT "%5.3" /begin IF_DATA ASAP1B_KWP2000 KP_BLOB 0x3803BC EXTERN 0x1 /end IF_DATA /begin IF_DATA ETK KP_BLOB 0x3803BC EXTERN 0x1 /end IF_DATA /end MEASUREMENT
/begin MEASUREMENT ikrme "Integratorwert Klopfregelung Meßfensterende" UBYTE spg_ub_b5 1 100 0 5 FORMAT "%5.3" ARRAY_SIZE 8 /begin IF_DATA ASAP1B_KWP2000 KP_BLOB 0xE010 INTERN 0x1 /end IF_DATA /begin IF_DATA ETK KP_BLOB 0xE010 INTERN 0x1 /end IF_DATA /end MEASUREMENT
/begin MEASUREMENT ikrmen "Integratorwert Klopfregelung Meßfensterende Nulltest" UBYTE spg_ub_b5 1 100 0 5 FORMAT "%5.3" /begin IF_DATA ASAP1B_KWP2000 KP_BLOB 0x3803BD EXTERN 0x1 /end IF_DATA /begin IF_DATA ETK KP_BLOB 0x3803BD EXTERN 0x1 /end IF_DATA /end MEASUREMENT
/begin MEASUREMENT ikrmet "Integratorwert Klopfregelung Meßfensterende Testimpuls" UBYTE spg_ub_b5 1 100 0 5 FORMAT "%5.3" /begin IF_DATA ASAP1B_KWP2000 KP_BLOB 0x3803BE EXTERN 0x1 /end IF_DATA /begin IF_DATA ETK KP_BLOB 0x3803BE EXTERN 0x1 /end IF_DATA /end MEASUREMENT
/begin MEASUREMENT ikr_tst "Integratorwert Klopfregelung offsetkorregiert rollierend mit Zyl.zähler" UBYTE spg_ub_b5 1 100 0 5 FORMAT "%5.3" /begin IF_DATA ASAP1B_KWP2000 KP_BLOB 0x3803BF EXTERN 0x1 /end IF_DATA /begin IF_DATA ETK KP_BLOB 0x3803BF EXTERN 0x1 /end IF_DATA /end MEASUREMENT
/begin MEASUREMENT iokkr "Integratoroffsetkorrektur Klopfregelung" UBYTE spg_ub_b5 1 100 0 5 FORMAT "%5.3" /begin IF_DATA ASAP1B_KWP2000 KP_BLOB 0x3803C0 EXTERN 0x1 /end IF_DATA /begin IF_DATA ETK KP_BLOB 0x3803C0 EXTERN 0x1 /end IF_DATA /end MEASUREMENT
/begin MEASUREMENT iusvkk_w "" UWORD spg_uw_q0p00488 1 100 0 319.995 FORMAT "%8.4" /begin IF_DATA ASAP1B_KWP2000 KP_BLOB 0x380A90 EXTERN 0x2 /end IF_DATA /begin IF_DATA ETK KP_BLOB 0x380A90 EXTERN 0x2 /end IF_DATA /end MEASUREMENT
/begin MEASUREMENT ke "Klopferkennungsschwelle aus Kennfeld" UBYTE fak_ub_b16 1 100 0 15.9375 FORMAT "%5.2" ARRAY_SIZE 8 /begin IF_DATA ASAP1B_KWP2000 KP_BLOB 0x3803CE EXTERN 0x1 /end IF_DATA /begin IF_DATA ETK KP_BLOB 0x3803CE EXTERN 0x1 /end IF_DATA /end MEASUREMENT
/begin MEASUREMENT kek "Klopferkennungsschwelle korrigiert" UBYTE fak_ub_b16 1 100 0 15.9375 FORMAT "%5.2" ARRAY_SIZE 8 /begin IF_DATA ASAP1B_KWP2000 KP_BLOB 0x3803D8 EXTERN 0x1 /end IF_DATA /begin IF_DATA ETK KP_BLOB 0x3803D8 EXTERN 0x1 /end IF_DATA /end MEASUREMENT
/begin MEASUREMENT kek_tst "Klopferkennungsschwelle korrigiert rollierend mit Zyl.zähler" UBYTE fak_ub_b16 1 100 0 15.9375 FORMAT "%5.2" /begin IF_DATA ASAP1B_KWP2000 KP_BLOB 0x3803E0 EXTERN 0x1 /end IF_DATA /begin IF_DATA ETK KP_BLOB 0x3803E0 EXTERN 0x1 /end IF_DATA /end MEASUREMENT
/begin MEASUREMENT kfbs2_w "Aufteilungsfaktor bankselektiv (Bank2)" UWORD msd_gk1 1 100 0 1.99997 FORMAT "%8.6" /begin IF_DATA ASAP1B_KWP2000 KP_BLOB 0x380C3E EXTERN 0x2 /end IF_DATA /begin IF_DATA ETK KP_BLOB 0x380C3E EXTERN 0x2 /end IF_DATA /end MEASUREMENT
/begin MEASUREMENT kfbs_w "Aufteilungsfaktor bankselektiv (Bank1)" UWORD msd_gk1 1 100 0 1.99997 FORMAT "%8.6" /begin IF_DATA ASAP1B_KWP2000 KP_BLOB 0x380C40 EXTERN 0x2 /end IF_DATA /begin IF_DATA ETK KP_BLOB 0x380C40 EXTERN 0x2 /end IF_DATA /end MEASUREMENT
/begin MEASUREMENT kral1w "aktueller Wert Last-Adaptionsbereich 1" UBYTE rel_ub_q0p75 1 100 0 191.25 FORMAT "%5.1" /begin IF_DATA ASAP1B_KWP2000 KP_BLOB 0x3803FD EXTERN 0x1 /end IF_DATA /begin IF_DATA ETK KP_BLOB 0x3803FD EXTERN 0x1 /end IF_DATA /end MEASUREMENT
/begin MEASUREMENT kral2w "aktueller Wert Last-Adaptionsbereich 2" UBYTE rel_ub_q0p75 1 100 0 191.25 FORMAT "%5.1" /begin IF_DATA ASAP1B_KWP2000 KP_BLOB 0x3803FE EXTERN 0x1 /end IF_DATA /begin IF_DATA ETK KP_BLOB 0x3803FE EXTERN 0x1 /end IF_DATA /end MEASUREMENT
/begin MEASUREMENT krdwsw "aktueller KL-Wert der Sicherheitsspätverstellung" UBYTE zw_ub_qn0p75 1 100 -191.25 0 FORMAT "%5.1" /begin IF_DATA ASAP1B_KWP2000 KP_BLOB 0x38040A EXTERN 0x1 /end IF_DATA /begin IF_DATA ETK KP_BLOB 0x38040A EXTERN 0x1 /end IF_DATA /end MEASUREMENT
/begin MEASUREMENT krfkw "Aktueller Wert aus KRFKN" UBYTE zw_ub_qn0p75 1 100 -191.25 0 FORMAT "%5.1" /begin IF_DATA ASAP1B_KWP2000 KP_BLOB 0x38040B EXTERN 0x1 /end IF_DATA /begin IF_DATA ETK KP_BLOB 0x38040B EXTERN 0x1 /end IF_DATA /end MEASUREMENT
/begin MEASUREMENT krmxw "aktueller Wert für Spätbegrenzung der Spätverstellung" UBYTE zw_ub_qn0p75 1 100 -191.25 0 FORMAT "%5.1" /begin IF_DATA ASAP1B_KWP2000 KP_BLOB 0x38040C EXTERN 0x1 /end IF_DATA /begin IF_DATA ETK KP_BLOB 0x38040C EXTERN 0x1 /end IF_DATA /end MEASUREMENT
/begin MEASUREMENT krvfakt "" UBYTE dez 1 100 0 255 FORMAT "%5.1" /begin IF_DATA ASAP1B_KWP2000 KP_BLOB 0x38040D EXTERN 0x1 /end IF_DATA /begin IF_DATA ETK KP_BLOB 0x38040D EXTERN 0x1 /end IF_DATA /end MEASUREMENT
/begin MEASUREMENT krvfsw "Initwert für schnelle Frühverstellung" UBYTE dez 1 100 0 255 FORMAT "%5.1" /begin IF_DATA ASAP1B_KWP2000 KP_BLOB 0x38040E EXTERN 0x1 /end IF_DATA /begin IF_DATA ETK KP_BLOB 0x38040E EXTERN 0x1 /end IF_DATA /end MEASUREMENT
/begin MEASUREMENT krvfw "Initwert für normale Frühverstellung" UBYTE dez 1 100 0 255 FORMAT "%5.1" /begin IF_DATA ASAP1B_KWP2000 KP_BLOB 0x38040F EXTERN 0x1 /end IF_DATA /begin IF_DATA ETK KP_BLOB 0x38040F EXTERN 0x1 /end IF_DATA /end MEASUREMENT
/begin MEASUREMENT ks_sym "Eingang des Klopfauswerte-IC" UBYTE dez 1 100 0 255 FORMAT "%5.1" ARRAY_SIZE 4 /begin IF_DATA ASAP1B_KWP2000 KP_BLOB 0xE018 INTERN 0x1 /end IF_DATA /begin IF_DATA ETK KP_BLOB 0xE018 INTERN 0x1 /end IF_DATA /end MEASUREMENT
/begin MEASUREMENT kusvk2_w "Korrekturwert der LSU-Spannung vor Kat Bank2" SWORD spg_sw_q0p00488 1 100 -160 159.995 FORMAT "%8.4" /begin IF_DATA ASAP1B_KWP2000 KP_BLOB 0x382AF0 EXTERN 0x2 /end IF_DATA /begin IF_DATA ETK KP_BLOB 0x382AF0 EXTERN 0x2 /end IF_DATA /end MEASUREMENT
/begin MEASUREMENT kusvk_w "Korrekturwert der LSU-Spannung vor Kat" SWORD spg_sw_q0p00488 1 100 -160 159.995 FORMAT "%8.4" /begin IF_DATA ASAP1B_KWP2000 KP_BLOB 0x382AF2 EXTERN 0x2 /end IF_DATA /begin IF_DATA ETK KP_BLOB 0x382AF2 EXTERN 0x2 /end IF_DATA /end MEASUREMENT
/begin MEASUREMENT kvges_w "Gesamtkraftstoffverbrauch" UWORD msd_cons_uw_1 1 100 0 858.993 FORMAT "%8.4" /begin IF_DATA ASAP1B_KWP2000 KP_BLOB 0x382B4A EXTERN 0x2 /end IF_DATA /begin IF_DATA ETK KP_BLOB 0x382B4A EXTERN 0x2 /end IF_DATA /end MEASUREMENT
/begin MEASUREMENT kvlapold_w "Rundenkraftstoffverbrauch vorherige Runde" UWORD msd_cons_uw_0 1 100 0 26.8435 FORMAT "%8.5" /begin IF_DATA ASAP1B_KWP2000 KP_BLOB 0x38133A EXTERN 0x2 /end IF_DATA /begin IF_DATA ETK KP_BLOB 0x38133A EXTERN 0x2 /end IF_DATA /end MEASUREMENT
/begin MEASUREMENT kvlap_w "Rundenkraftstoffverbrauch" UWORD msd_cons_uw_0 1 100 0 26.8435 FORMAT "%8.5" /begin IF_DATA ASAP1B_KWP2000 KP_BLOB 0x38133C EXTERN 0x2 /end IF_DATA /begin IF_DATA ETK KP_BLOB 0x38133C EXTERN 0x2 /end IF_DATA /end MEASUREMENT
/begin MEASUREMENT lambas "Basis-Lambda" UBYTE fak_ub_b2 1 100 0 1.99219 FORMAT "%5.3" /begin IF_DATA ASAP1B_KWP2000 KP_BLOB 0x3803A3 EXTERN 0x1 /end IF_DATA /begin IF_DATA ETK KP_BLOB 0x3803A3 EXTERN 0x1 /end IF_DATA /end MEASUREMENT
/begin MEASUREMENT lambts_w "Lambda für Bauteileschutz" UWORD fak_uw_b16 1 100 0 15.9998 FORMAT "%8.5" /begin IF_DATA ASAP1B_KWP2000 KP_BLOB 0x380C4E EXTERN 0x2 /end IF_DATA /begin IF_DATA ETK KP_BLOB 0x380C4E EXTERN 0x2 /end IF_DATA /end MEASUREMENT
/begin MEASUREMENT lamfa_w "Lambdasoll Fahrerwunsch (word)" UWORD fak_uw_b16 1 100 0 15.9998 FORMAT "%8.5" /begin IF_DATA ASAP1B_KWP2000 KP_BLOB 0x380C58 EXTERN 0x2 /end IF_DATA /begin IF_DATA ETK KP_BLOB 0x380C58 EXTERN 0x2 /end IF_DATA /end MEASUREMENT
/begin MEASUREMENT lamlgm "Laufgrenze \"Lambda mager\"" UBYTE fak_ub_b2 1 100 0 1.99219 FORMAT "%5.3" /begin IF_DATA ASAP1B_KWP2000 KP_BLOB 0x3803A4 EXTERN 0x1 /end IF_DATA /begin IF_DATA ETK KP_BLOB 0x3803A4 EXTERN 0x1 /end IF_DATA /end MEASUREMENT
/begin MEASUREMENT lamnswl_w "Lambda-Motor-Soll für Nachstart und Warmlauf" UWORD fak_uw_b16 1 100 0 15.9998 FORMAT "%8.5" /begin IF_DATA ASAP1B_KWP2000 KP_BLOB 0x380C32 EXTERN 0x2 /end IF_DATA /begin IF_DATA ETK KP_BLOB 0x380C32 EXTERN 0x2 /end IF_DATA /end MEASUREMENT
/begin MEASUREMENT lamsoni "Lambda-Istwert" UBYTE fak_ub_b4 1 100 0 3.98438 FORMAT "%5.3" /begin IF_DATA ASAP1B_KWP2000 KP_BLOB 0x380359 EXTERN 0x1 /end IF_DATA /begin IF_DATA ETK KP_BLOB 0x380359 EXTERN 0x1 /end IF_DATA /end MEASUREMENT
/begin MEASUREMENT lamsoni2 "Lambda-Istwert Bank2" UBYTE fak_ub_b4 1 100 0 3.98438 FORMAT "%5.3" /begin IF_DATA ASAP1B_KWP2000 KP_BLOB 0x38035A EXTERN 0x1 /end IF_DATA /begin IF_DATA ETK KP_BLOB 0x38035A EXTERN 0x1 /end IF_DATA /end MEASUREMENT
/begin MEASUREMENT lamsoni2_w "Lambda-Istwert Bank2" UWORD fak_uw_b16 1 100 0 15.9998 FORMAT "%8.5" /begin IF_DATA ASAP1B_KWP2000 KP_BLOB 0x380A92 EXTERN 0x2 /end IF_DATA /begin IF_DATA ETK KP_BLOB 0x380A92 EXTERN 0x2 /end IF_DATA /end MEASUREMENT
/begin MEASUREMENT lamsoni_w "Lambda-Istwert" UWORD fak_uw_b16 1 100 0 15.9998 FORMAT "%8.5" /begin IF_DATA ASAP1B_KWP2000 KP_BLOB 0x380A94 EXTERN 0x2 /end IF_DATA /begin IF_DATA ETK KP_BLOB 0x380A94 EXTERN 0x2 /end IF_DATA /end MEASUREMENT
/begin MEASUREMENT lamsons2_w "Lambda-Sollwert bezogen auf Einbauort Lambda-Sensor Bank2" UWORD fak_uw_b16 1 100 0 15.9998 FORMAT "%8.5" /begin IF_DATA ASAP1B_KWP2000 KP_BLOB 0x380C5A EXTERN 0x2 /end IF_DATA /begin IF_DATA ETK KP_BLOB 0x380C5A EXTERN 0x2 /end IF_DATA /end MEASUREMENT
/begin MEASUREMENT lamsons_w "Lambda-Sollwert bezogen auf Einbauort Lambda-Sensor" UWORD fak_uw_b16 1 100 0 15.9998 FORMAT "%8.5" /begin IF_DATA ASAP1B_KWP2000 KP_BLOB 0x380C5C EXTERN 0x2 /end IF_DATA /begin IF_DATA ETK KP_BLOB 0x380C5C EXTERN 0x2 /end IF_DATA /end MEASUREMENT
/begin MEASUREMENT lamsubg_w "Lambdasoll unbegrenzt (word)" UWORD fak_uw_b16 1 100 0 15.9998 FORMAT "%8.5" /begin IF_DATA ASAP1B_KWP2000 KP_BLOB 0x380C5E EXTERN 0x2 /end IF_DATA /begin IF_DATA ETK KP_BLOB 0x380C5E EXTERN 0x2 /end IF_DATA /end MEASUREMENT
/begin MEASUREMENT lams_w "Lambdasoll (word)" UWORD fak_uw_b16 1 100 0 15.9998 FORMAT "%8.5" /begin IF_DATA ASAP1B_KWP2000 KP_BLOB 0x380C60 EXTERN 0x2 /end IF_DATA /begin IF_DATA ETK KP_BLOB 0x380C60 EXTERN 0x2 /end IF_DATA /end MEASUREMENT
/begin MEASUREMENT lamwl_w "Lambda-Motor-Soll für Warmlauf" UWORD fak_uw_b16 1 100 0 15.9998 FORMAT "%8.5" /begin IF_DATA ASAP1B_KWP2000 KP_BLOB 0x380C34 EXTERN 0x2 /end IF_DATA /begin IF_DATA ETK KP_BLOB 0x380C34 EXTERN 0x2 /end IF_DATA /end MEASUREMENT
/begin MEASUREMENT lapctr "Rundenzähler" UBYTE msd_lapnumber_ub_0 1 100 0 255 FORMAT "%5.1" /begin IF_DATA ASAP1B_KWP2000 KP_BLOB 0x382945 EXTERN 0x1 /end IF_DATA /begin IF_DATA ETK KP_BLOB 0x382945 EXTERN 0x1 /end IF_DATA /end MEASUREMENT
/begin MEASUREMENT laptiap_w "Laufende Rundenzeit, Anzeige im Applikationstool" UWORD msd_laptime_uw_0 1 100 0 1310.7 FORMAT "%8.3" /begin IF_DATA ASAP1B_KWP2000 KP_BLOB 0x382B38 EXTERN 0x2 /end IF_DATA /begin IF_DATA ETK KP_BLOB 0x382B38 EXTERN 0x2 /end IF_DATA /end MEASUREMENT
/begin MEASUREMENT laptime "Laufende Rundenzeit" ULONG msd_laptime_ul_0 1 100 0 2.14748e+007 FORMAT "%13.4" /begin IF_DATA ASAP1B_KWP2000 KP_BLOB 0xF906 EXTERN 0x4 /end IF_DATA /begin IF_DATA ETK KP_BLOB 0xF906 EXTERN 0x4 /end IF_DATA /end MEASUREMENT
/begin MEASUREMENT laptimeold "Vorhergehende Rundenzeit" ULONG msd_laptime_ul_0 1 100 0 2.14748e+007 FORMAT "%13.4" /begin IF_DATA ASAP1B_KWP2000 KP_BLOB 0xF90A EXTERN 0x4 /end IF_DATA /begin IF_DATA ETK KP_BLOB 0xF90A EXTERN 0x4 /end IF_DATA /end MEASUREMENT
/begin MEASUREMENT laptimeo_h "Vorhergehende Rundenzeit, Highword" UWORD msd_laptime_ul_1 1 100 0 4.2949e+007 FORMAT "%8.0" /begin IF_DATA ASAP1B_KWP2000 KP_BLOB 0x382B3A EXTERN 0x2 /end IF_DATA /begin IF_DATA ETK KP_BLOB 0x382B3A EXTERN 0x2 /end IF_DATA /end MEASUREMENT
/begin MEASUREMENT laptimeo_l "Vorhergehende Rundenzeit, Lowword" UWORD msd_laptime_uw_1 1 100 0 655.35 FORMAT "%8.4" /begin IF_DATA ASAP1B_KWP2000 KP_BLOB 0x382B3C EXTERN 0x2 /end IF_DATA /begin IF_DATA ETK KP_BLOB 0x382B3C EXTERN 0x2 /end IF_DATA /end MEASUREMENT
/begin MEASUREMENT laptime_h "Laufende Rundenzeit, Highword" UWORD msd_laptime_ul_1 1 100 0 4.2949e+007 FORMAT "%8.0" /begin IF_DATA ASAP1B_KWP2000 KP_BLOB 0x382B3E EXTERN 0x2 /end IF_DATA /begin IF_DATA ETK KP_BLOB 0x382B3E EXTERN 0x2 /end IF_DATA /end MEASUREMENT
/begin MEASUREMENT laptime_l "Laufende Rundenzeit, Lowword" UWORD msd_laptime_uw_1 1 100 0 655.35 FORMAT "%8.4" /begin IF_DATA ASAP1B_KWP2000 KP_BLOB 0x382B40 EXTERN 0x2 /end IF_DATA /begin IF_DATA ETK KP_BLOB 0x382B40 EXTERN 0x2 /end IF_DATA /end MEASUREMENT
/begin MEASUREMENT laptioap_w "Vorhergehende Rundenzeit, Anzeige im Applikationstool" UWORD msd_laptime_uw_0 1 100 0 1310.7 FORMAT "%8.3" /begin IF_DATA ASAP1B_KWP2000 KP_BLOB 0x382B42 EXTERN 0x2 /end IF_DATA /begin IF_DATA ETK KP_BLOB 0x382B42 EXTERN 0x2 /end IF_DATA /end MEASUREMENT
/begin MEASUREMENT ldfki_w "Ladedruck Filterzeitkonstante aus Kennfeld" UWORD zk10msxs_uw_b655 1 100 0.0100002 655.36 FORMAT "%8.4" /begin IF_DATA ASAP1B_KWP2000 KP_BLOB 0x380B98 EXTERN 0x2 /end IF_DATA /begin IF_DATA ETK KP_BLOB 0x380B98 EXTERN 0x2 /end IF_DATA /end MEASUREMENT
/begin MEASUREMENT lkrnew "Lastwert Zeitpunkt t" SWORD rel_sw_q0p0234 1 100 -768 767.977 FORMAT "%8.4" /begin IF_DATA ASAP1B_KWP2000 KP_BLOB 0x380CD8 EXTERN 0x2 /end IF_DATA /begin IF_DATA ETK KP_BLOB 0x380CD8 EXTERN 0x2 /end IF_DATA /end MEASUREMENT
/begin MEASUREMENT lkrold "Lastwert Zeitpunkt t-dt" SWORD rel_sw_q0p0234 1 100 -768 767.977 FORMAT "%8.4" /begin IF_DATA ASAP1B_KWP2000 KP_BLOB 0x380CDA EXTERN 0x2 /end IF_DATA /begin IF_DATA ETK KP_BLOB 0x380CDA EXTERN 0x2 /end IF_DATA /end MEASUREMENT
/begin MEASUREMENT lkrw "aktueller Wert der Lastschwelle Klopfregelung" UBYTE rel_ub_q0p75 1 100 0 191.25 FORMAT "%5.1" /begin IF_DATA ASAP1B_KWP2000 KP_BLOB 0x3803FF EXTERN 0x1 /end IF_DATA /begin IF_DATA ETK KP_BLOB 0x3803FF EXTERN 0x1 /end IF_DATA /end MEASUREMENT
/begin MEASUREMENT ltdistcr_w "Zurückgelegte Strecke über Lebensdauer, Impulszähler" UWORD dez 1 100 0 65535 FORMAT "%8.2" /begin IF_DATA ASAP1B_KWP2000 KP_BLOB 0xF792 INTERN 0x2 /end IF_DATA /begin IF_DATA ETK KP_BLOB 0xF792 INTERN 0x2 /end IF_DATA /end MEASUREMENT
/begin MEASUREMENT migs_w "Indiziertes Soll-Motormoment GS für schnellen Eingriff" UWORD rel_uw_b100 1 100 0 99.9985 FORMAT "%8.5" /begin IF_DATA ASAP1B_KWP2000 KP_BLOB 0x381380 EXTERN 0x2 /end IF_DATA /begin IF_DATA ETK KP_BLOB 0x381380 EXTERN 0x2 /end IF_DATA /end MEASUREMENT
/begin MEASUREMENT ngkrv_w "aktueller Wert Drehzahldynamikschwelle" SWORD nmotg_sw_q0p39 1 100 -12800.2 12799.8 FORMAT "%8.2" /begin IF_DATA ASAP1B_KWP2000 KP_BLOB 0x380CDC EXTERN 0x2 /end IF_DATA /begin IF_DATA ETK KP_BLOB 0x380CDC EXTERN 0x2 /end IF_DATA /end MEASUREMENT
/begin MEASUREMENT pfuel "Kraftstoffdruck" UBYTE msd_poil_ub_0 1 100 0 16 FORMAT "%5.2" /begin IF_DATA ASAP1B_KWP2000 KP_BLOB 0x380444 EXTERN 0x1 /end IF_DATA /begin IF_DATA ETK KP_BLOB 0x380444 EXTERN 0x1 /end IF_DATA /end MEASUREMENT
/begin MEASUREMENT pfuels "Kraftstoffdruck, Sensorwert" UBYTE msd_poil_ub_0 1 100 0 16 FORMAT "%5.2" /begin IF_DATA ASAP1B_KWP2000 KP_BLOB 0x380445 EXTERN 0x1 /end IF_DATA /begin IF_DATA ETK KP_BLOB 0x380445 EXTERN 0x1 /end IF_DATA /end MEASUREMENT
/begin MEASUREMENT poel "Öldruck" UBYTE msd_poil_ub_0 1 100 0 16 FORMAT "%5.2" /begin IF_DATA ASAP1B_KWP2000 KP_BLOB 0x380442 EXTERN 0x1 /end IF_DATA /begin IF_DATA ETK KP_BLOB 0x380442 EXTERN 0x1 /end IF_DATA /end MEASUREMENT
/begin MEASUREMENT poels "Oeldruck Motor, Sensorwert" UBYTE msd_poil_ub_0 1 100 0 16 FORMAT "%5.2" /begin IF_DATA ASAP1B_KWP2000 KP_BLOB 0x380443 EXTERN 0x1 /end IF_DATA /begin IF_DATA ETK KP_BLOB 0x380443 EXTERN 0x1 /end IF_DATA /end MEASUREMENT
/begin MEASUREMENT psdss "Saugrohrdruck gemessen mit Drucksensor am Saugrohr (DS-S)" UBYTE p_ub_q10 1 100 0 2550 FORMAT "%5.0" /begin IF_DATA ASAP1B_KWP2000 KP_BLOB 0x380377 EXTERN 0x1 /end IF_DATA /begin IF_DATA ETK KP_BLOB 0x380377 EXTERN 0x1 /end IF_DATA /end MEASUREMENT
/begin MEASUREMENT psdss_w "Saugrohrdruck gemessen mit Drucksensor am Saugrohr (DS-S)" UWORD p_uw_q0p039 1 100 0 2559.96 FORMAT "%8.3" /begin IF_DATA ASAP1B_KWP2000 KP_BLOB 0x380BB6 EXTERN 0x2 /end IF_DATA /begin IF_DATA ETK KP_BLOB 0x380BB6 EXTERN 0x2 /end IF_DATA /end MEASUREMENT
/begin MEASUREMENT pspvdkds_w "Verhältnis Saugrohrdruck/Druck vor Drosselklappe von Drucksensor (word)" UWORD fak_uw_b4 1 100 0 3.99994 FORMAT "%8.6" /begin IF_DATA ASAP1B_KWP2000 KP_BLOB 0x380B9A EXTERN 0x2 /end IF_DATA /begin IF_DATA ETK KP_BLOB 0x380B9A EXTERN 0x2 /end IF_DATA /end MEASUREMENT
/begin MEASUREMENT pu "Umgebungsdruck" UBYTE p_ub_q5 1 100 0 1275 FORMAT "%5.0" /begin IF_DATA ASAP1B_KWP2000 KP_BLOB 0x380374 EXTERN 0x1 /end IF_DATA /begin IF_DATA ETK KP_BLOB 0x380374 EXTERN 0x1 /end IF_DATA /end MEASUREMENT
/begin MEASUREMENT pus_w "Umgebungsdruck ohne Umschaltung auf Ersatzwert bei Sensorfehler" UWORD p_uw_q0p039 1 100 0 2559.96 FORMAT "%8.3" /begin IF_DATA ASAP1B_KWP2000 KP_BLOB 0x380B8E EXTERN 0x2 /end IF_DATA /begin IF_DATA ETK KP_BLOB 0x380B8E EXTERN 0x2 /end IF_DATA /end MEASUREMENT
/begin MEASUREMENT pu_w "Umgebungsdruck" UWORD p_uw_q0p039 1 100 0 2559.96 FORMAT "%8.3" /begin IF_DATA ASAP1B_KWP2000 KP_BLOB 0x380B90 EXTERN 0x2 /end IF_DATA /begin IF_DATA ETK KP_BLOB 0x380B90 EXTERN 0x2 /end IF_DATA /end MEASUREMENT
/begin MEASUREMENT pvdkds "Druck vor Drosselklappe von Drucksensor" UBYTE p_ub_q10 1 100 0 2550 FORMAT "%5.0" /begin IF_DATA ASAP1B_KWP2000 KP_BLOB 0x380376 EXTERN 0x1 /end IF_DATA /begin IF_DATA ETK KP_BLOB 0x380376 EXTERN 0x1 /end IF_DATA /end MEASUREMENT
/begin MEASUREMENT pvdkdsl_w "Druck vor Drosselklappe von Ladedrucksensor (word)" UWORD p_uw_q0p039 1 100 0 2559.96 FORMAT "%8.3" /begin IF_DATA ASAP1B_KWP2000 KP_BLOB 0x380B9C EXTERN 0x2 /end IF_DATA /begin IF_DATA ETK KP_BLOB 0x380B9C EXTERN 0x2 /end IF_DATA /end MEASUREMENT
/begin MEASUREMENT pvdkdsu_w "Druck vor Drosselklappe von Umgebungsdrucksensor (word)" UWORD p_uw_q0p039 1 100 0 2559.96 FORMAT "%8.3" /begin IF_DATA ASAP1B_KWP2000 KP_BLOB 0x380B92 EXTERN 0x2 /end IF_DATA /begin IF_DATA ETK KP_BLOB 0x380B92 EXTERN 0x2 /end IF_DATA /end MEASUREMENT
/begin MEASUREMENT pvdkds_w "Druck vor Drosselklappe von Drucksensor (word)" UWORD p_uw_q0p039 1 100 0 2559.96 FORMAT "%8.3" /begin IF_DATA ASAP1B_KWP2000 KP_BLOB 0x380B9E EXTERN 0x2 /end IF_DATA /begin IF_DATA ETK KP_BLOB 0x380B9E EXTERN 0x2 /end IF_DATA /end MEASUREMENT
/begin MEASUREMENT pvdks_w "Druck vor Drosselklappe ohne Umschaltung auf Ersatzwert bei Sensorfehler" UWORD p_uw_q0p039 1 100 0 2559.96 FORMAT "%8.3" /begin IF_DATA ASAP1B_KWP2000 KP_BLOB 0x380BA0 EXTERN 0x2 /end IF_DATA /begin IF_DATA ETK KP_BLOB 0x380BA0 EXTERN 0x2 /end IF_DATA /end MEASUREMENT
/begin MEASUREMENT rk2_w "relative Kraftstoffmasse Bank2" UWORD rel_uw_b3072 1 100 0 3071.95 FORMAT "%8.3" /begin IF_DATA ASAP1B_KWP2000 KP_BLOB 0x380C42 EXTERN 0x2 /end IF_DATA /begin IF_DATA ETK KP_BLOB 0x380C42 EXTERN 0x2 /end IF_DATA /end MEASUREMENT
/begin MEASUREMENT rka2_w "Additive adaptive Korrektur der relativen Kraftstoffmasse" SWORD rel_sw_b1536 1 100 -1536 1535.95 FORMAT "%8.3" /begin IF_DATA ASAP1B_KWP2000 KP_BLOB 0x380C68 EXTERN 0x2 /end IF_DATA /begin IF_DATA ETK KP_BLOB 0x380C68 EXTERN 0x2 /end IF_DATA /end MEASUREMENT
/begin MEASUREMENT rkat2_w "additive Gemischkorrektur (pro Zeit) der Gemischadaption Bank 2 (Word)" SWORD rel_sw_b1536 1 100 -1536 1535.95 FORMAT "%8.3" /begin IF_DATA ASAP1B_KWP2000 KP_BLOB 0x382B02 EXTERN 0x2 /end IF_DATA /begin IF_DATA ETK KP_BLOB 0x382B02 EXTERN 0x2 /end IF_DATA /end MEASUREMENT
/begin MEASUREMENT rkat_w "additive Gemischkorrektur (pro Zeit) der Gemischdaption (Word)" SWORD rel_sw_b1536 1 100 -1536 1535.95 FORMAT "%8.3" /begin IF_DATA ASAP1B_KWP2000 KP_BLOB 0x382B04 EXTERN 0x2 /end IF_DATA /begin IF_DATA ETK KP_BLOB 0x382B04 EXTERN 0x2 /end IF_DATA /end MEASUREMENT
/begin MEASUREMENT rkaz2_w "additive Gemischkorrektur (pro Zündung) der Gemischadaption Bank2 (Word)" SWORD rel_sw_b1536 1 100 -1536 1535.95 FORMAT "%8.3" /begin IF_DATA ASAP1B_KWP2000 KP_BLOB 0x382B06 EXTERN 0x2 /end IF_DATA /begin IF_DATA ETK KP_BLOB 0x382B06 EXTERN 0x2 /end IF_DATA /end MEASUREMENT
/begin MEASUREMENT rkaz_w "additive Gemischkorrektur (pro Zündung) der Gemischadaption" SWORD rel_sw_b1536 1 100 -1536 1535.95 FORMAT "%8.3" /begin IF_DATA ASAP1B_KWP2000 KP_BLOB 0x382B08 EXTERN 0x2 /end IF_DATA /begin IF_DATA ETK KP_BLOB 0x382B08 EXTERN 0x2 /end IF_DATA /end MEASUREMENT
/begin MEASUREMENT rka_w "Additive adaptive Korrektur der relativen Kraftstoffmasse" SWORD rel_sw_b1536 1 100 -1536 1535.95 FORMAT "%8.3" /begin IF_DATA ASAP1B_KWP2000 KP_BLOB 0x380C6A EXTERN 0x2 /end IF_DATA /begin IF_DATA ETK KP_BLOB 0x380C6A EXTERN 0x2 /end IF_DATA /end MEASUREMENT
/begin MEASUREMENT rkbau_w "" SWORD rel_sw_b1536 1 100 -1536 1535.95 FORMAT "%8.3" /begin IF_DATA ASAP1B_KWP2000 KP_BLOB 0x380C1A EXTERN 0x2 /end IF_DATA /begin IF_DATA ETK KP_BLOB 0x380C1A EXTERN 0x2 /end IF_DATA /end MEASUREMENT
/begin MEASUREMENT rkr "Referenzpegel Klopfregelung" UBYTE spg_ub_b5 1 100 0 5 FORMAT "%5.3" ARRAY_SIZE 8 /begin IF_DATA ASAP1B_KWP2000 KP_BLOB 0x3803E1 EXTERN 0x1 /end IF_DATA /begin IF_DATA ETK KP_BLOB 0x3803E1 EXTERN 0x1 /end IF_DATA /end MEASUREMENT
/begin MEASUREMENT rkrmx "nach oben begrenzter Referenzpegel" UBYTE spg_ub_b5 1 100 0 5 FORMAT "%5.3" /begin IF_DATA ASAP1B_KWP2000 KP_BLOB 0xF888 INTERN 0x1 /end IF_DATA /begin IF_DATA ETK KP_BLOB 0xF888 INTERN 0x1 /end IF_DATA /end MEASUREMENT
/begin MEASUREMENT rkrmx1w "aktueller Wert der KL RKRMX1N" UBYTE spg_ub_b320 1 100 0 318.75 FORMAT "%5.1" /begin IF_DATA ASAP1B_KWP2000 KP_BLOB 0x3803D6 EXTERN 0x1 /end IF_DATA /begin IF_DATA ETK KP_BLOB 0x3803D6 EXTERN 0x1 /end IF_DATA /end MEASUREMENT
/begin MEASUREMENT rkrmx2w "aktueller Wert der KL RKRMX2N" UBYTE spg_ub_b320 1 100 0 318.75 FORMAT "%5.1" /begin IF_DATA ASAP1B_KWP2000 KP_BLOB 0x3803D7 EXTERN 0x1 /end IF_DATA /begin IF_DATA ETK KP_BLOB 0x3803D7 EXTERN 0x1 /end IF_DATA /end MEASUREMENT
/begin MEASUREMENT rkr_tst "Referenzpegel Klopfregelung rollierend mit Zyl.zähler" UBYTE spg_ub_b5 1 100 0 5 FORMAT "%5.3" /begin IF_DATA ASAP1B_KWP2000 KP_BLOB 0x3803E9 EXTERN 0x1 /end IF_DATA /begin IF_DATA ETK KP_BLOB 0x3803E9 EXTERN 0x1 /end IF_DATA /end MEASUREMENT
/begin MEASUREMENT rkukg_w "rel. Kraftstoffmasse Übergangskompensation" SWORD rel_sw_b1536 1 100 -1536 1535.95 FORMAT "%8.3" /begin IF_DATA ASAP1B_KWP2000 KP_BLOB 0x380C1C EXTERN 0x2 /end IF_DATA /begin IF_DATA ETK KP_BLOB 0x380C1C EXTERN 0x2 /end IF_DATA /end MEASUREMENT
/begin MEASUREMENT rkukkl_w "Kurz- und Langzeitanteil der UK" SWORD rel_sw_q0p1875 1 100 -6144 6143.81 FORMAT "%8.3" /begin IF_DATA ASAP1B_KWP2000 KP_BLOB 0x380C1E EXTERN 0x2 /end IF_DATA /begin IF_DATA ETK KP_BLOB 0x380C1E EXTERN 0x2 /end IF_DATA /end MEASUREMENT
/begin MEASUREMENT rkukk_w "rk-Kurzzeitanteil der UK" SWORD rel_sw_q0p1875 1 100 -6144 6143.81 FORMAT "%8.3" /begin IF_DATA ASAP1B_KWP2000 KP_BLOB 0x380C20 EXTERN 0x2 /end IF_DATA /begin IF_DATA ETK KP_BLOB 0x380C20 EXTERN 0x2 /end IF_DATA /end MEASUREMENT
/begin MEASUREMENT rkukl_w "rk-Langzeitanteil der UK" SWORD rel_sw_q0p1875 1 100 -6144 6143.81 FORMAT "%8.3" /begin IF_DATA ASAP1B_KWP2000 KP_BLOB 0x380C22 EXTERN 0x2 /end IF_DATA /begin IF_DATA ETK KP_BLOB 0x380C22 EXTERN 0x2 /end IF_DATA /end MEASUREMENT
/begin MEASUREMENT rkvau_w "" SWORD rel_sw_b1536 1 100 -1536 1535.95 FORMAT "%8.3" /begin IF_DATA ASAP1B_KWP2000 KP_BLOB 0x380C24 EXTERN 0x2 /end IF_DATA /begin IF_DATA ETK KP_BLOB 0x380C24 EXTERN 0x2 /end IF_DATA /end MEASUREMENT
/begin MEASUREMENT rk_w "relative Kraftstoffmasse" UWORD rel_uw_b3072 1 100 0 3071.95 FORMAT "%8.3" /begin IF_DATA ASAP1B_KWP2000 KP_BLOB 0x380C44 EXTERN 0x2 /end IF_DATA /begin IF_DATA ETK KP_BLOB 0x380C44 EXTERN 0x2 /end IF_DATA /end MEASUREMENT
/begin MEASUREMENT sdwfk_w "Speicherinhalt der Wandfilmdifferenz für Kurzzeitanteil" SWORD rel_sw_q0p1875 1 100 -6144 6143.81 FORMAT "%8.3" /begin IF_DATA ASAP1B_KWP2000 KP_BLOB 0x380C26 EXTERN 0x2 /end IF_DATA /begin IF_DATA ETK KP_BLOB 0x380C26 EXTERN 0x2 /end IF_DATA /end MEASUREMENT
/begin MEASUREMENT sdwfl_w "Speicherinhalt der Wandfilmdifferenz für Langzeitanteil" SWORD rel_sw_q0p1875 1 100 -6144 6143.81 FORMAT "%8.3" /begin IF_DATA ASAP1B_KWP2000 KP_BLOB 0x380C28 EXTERN 0x2 /end IF_DATA /begin IF_DATA ETK KP_BLOB 0x380C28 EXTERN 0x2 /end IF_DATA /end MEASUREMENT
/begin MEASUREMENT sen_c95 "Klopfsensoreingang am Klopfauswerte-IC" UBYTE dezsub1 1 100 1 256 FORMAT "%5.1" ARRAY_SIZE 8 /begin IF_DATA ASAP1B_KWP2000 KP_BLOB 0x3803C1 EXTERN 0x1 /end IF_DATA /begin IF_DATA ETK KP_BLOB 0x3803C1 EXTERN 0x1 /end IF_DATA /end MEASUREMENT
/begin MEASUREMENT stkrlx "Laststützstelle für die KR-Adaption" UBYTE dez 1 100 0 255 FORMAT "%5.1" /begin IF_DATA ASAP1B_KWP2000 KP_BLOB 0x380410 EXTERN 0x1 /end IF_DATA /begin IF_DATA ETK KP_BLOB 0x380410 EXTERN 0x1 /end IF_DATA /end MEASUREMENT
/begin MEASUREMENT stkrnx "Drehzahlstützstelle für die KR-Adaption" UBYTE dez 1 100 0 255 FORMAT "%5.1" /begin IF_DATA ASAP1B_KWP2000 KP_BLOB 0x380411 EXTERN 0x1 /end IF_DATA /begin IF_DATA ETK KP_BLOB 0x380411 EXTERN 0x1 /end IF_DATA /end MEASUREMENT
/begin MEASUREMENT tans "Ansaugluft - Temperatur" UBYTE temp_ub_q0p75_o48 1 100 -48 143.25 FORMAT "%5.1" /begin IF_DATA ASAP1B_KWP2000 KP_BLOB 0x3803A5 EXTERN 0x1 /end IF_DATA /begin IF_DATA ETK KP_BLOB 0x3803A5 EXTERN 0x1 /end IF_DATA /end MEASUREMENT
/begin MEASUREMENT tansab "Ansauglufttemperatur beim Abstellen" UBYTE temp_ub_q0p75_o48 1 100 -48 143.25 FORMAT "%5.1" /begin IF_DATA ASAP1B_KWP2000 KP_BLOB 0x382858 EXTERN 0x1 /end IF_DATA /begin IF_DATA ETK KP_BLOB 0x382858 EXTERN 0x1 /end IF_DATA /end MEASUREMENT
/begin MEASUREMENT tanslin "Ansauglufttemperatur, linearisiert und umgerechnet" UBYTE temp_ub_q0p75_o48 1 100 -48 143.25 FORMAT "%5.1" /begin IF_DATA ASAP1B_KWP2000 KP_BLOB 0x3803A6 EXTERN 0x1 /end IF_DATA /begin IF_DATA ETK KP_BLOB 0x3803A6 EXTERN 0x1 /end IF_DATA /end MEASUREMENT
/begin MEASUREMENT tats "Abgastemperatur aus Sensor ( 8 bit  5 Grad /inc)" UBYTE temp_ub_q5_o50 1 100 -50 1225 FORMAT "%5.0" /begin IF_DATA ASAP1B_KWP2000 KP_BLOB 0x38044A EXTERN 0x1 /end IF_DATA /begin IF_DATA ETK KP_BLOB 0x38044A EXTERN 0x1 /end IF_DATA /end MEASUREMENT
/begin MEASUREMENT tats2 "Abgastemperatur aus Sensor ( 8 bit 5 Grad/inc) Bank2" UBYTE temp_ub_q5_o50 1 100 -50 1225 FORMAT "%5.0" /begin IF_DATA ASAP1B_KWP2000 KP_BLOB 0x38044B EXTERN 0x1 /end IF_DATA /begin IF_DATA ETK KP_BLOB 0x38044B EXTERN 0x1 /end IF_DATA /end MEASUREMENT
/begin MEASUREMENT tats2_w "Abgastemperatur aus Sensor Bank 2" UWORD temp_uw_q0p0195_o50 1 100 -50 1229.98 FORMAT "%8.3" /begin IF_DATA ASAP1B_KWP2000 KP_BLOB 0x3813A4 EXTERN 0x2 /end IF_DATA /begin IF_DATA ETK KP_BLOB 0x3813A4 EXTERN 0x2 /end IF_DATA /end MEASUREMENT
/begin MEASUREMENT tats_w "Abgastemperatur aus Sensor" UWORD temp_uw_q0p0195_o50 1 100 -50 1229.98 FORMAT "%8.3" /begin IF_DATA ASAP1B_KWP2000 KP_BLOB 0x3813A6 EXTERN 0x2 /end IF_DATA /begin IF_DATA ETK KP_BLOB 0x3813A6 EXTERN 0x2 /end IF_DATA /end MEASUREMENT
/begin MEASUREMENT tedi "Istwert der Einschaltdauer der LSU-Heizung nach Start" UBYTE t10msxs_ub_b2p55 1 100 0 2.55 FORMAT "%5.3" /begin IF_DATA ASAP1B_KWP2000 KP_BLOB 0x38044C EXTERN 0x1 /end IF_DATA /begin IF_DATA ETK KP_BLOB 0x38044C EXTERN 0x1 /end IF_DATA /end MEASUREMENT
/begin MEASUREMENT tedi2 "Istwert der Einschaltdauer der LSU-Heizung Bank2 nach Start" UBYTE t10msxs_ub_b2p55 1 100 0 2.55 FORMAT "%5.3" /begin IF_DATA ASAP1B_KWP2000 KP_BLOB 0x38044D EXTERN 0x1 /end IF_DATA /begin IF_DATA ETK KP_BLOB 0x38044D EXTERN 0x1 /end IF_DATA /end MEASUREMENT
/begin MEASUREMENT tedst "Einschaltdauer der LSU-Heizung nach Start" UBYTE t10msxs_ub_b2p55 1 100 0 2.55 FORMAT "%5.3" /begin IF_DATA ASAP1B_KWP2000 KP_BLOB 0x38044E EXTERN 0x1 /end IF_DATA /begin IF_DATA ETK KP_BLOB 0x38044E EXTERN 0x1 /end IF_DATA /end MEASUREMENT
/begin MEASUREMENT tedst2 "Einschaltdauer der Heizung LSU2 nach Start" UBYTE t10msxs_ub_b2p55 1 100 0 2.55 FORMAT "%5.3" /begin IF_DATA ASAP1B_KWP2000 KP_BLOB 0x38044F EXTERN 0x1 /end IF_DATA /begin IF_DATA ETK KP_BLOB 0x38044F EXTERN 0x1 /end IF_DATA /end MEASUREMENT
/begin MEASUREMENT tedtml "Einschaltdauer der LSU-Heizung abhängig von der Abgastemperatur und ml" UBYTE t10msxs_ub_b2p55 1 100 0 2.55 FORMAT "%5.3" /begin IF_DATA ASAP1B_KWP2000 KP_BLOB 0x380450 EXTERN 0x1 /end IF_DATA /begin IF_DATA ETK KP_BLOB 0x380450 EXTERN 0x1 /end IF_DATA /end MEASUREMENT
/begin MEASUREMENT tedtml2 "Einschaltdauer der LSU-Heizung abhängig von der Abgastemperatur2 und ml" UBYTE t10msxs_ub_b2p55 1 100 0 2.55 FORMAT "%5.3" /begin IF_DATA ASAP1B_KWP2000 KP_BLOB 0x380451 EXTERN 0x1 /end IF_DATA /begin IF_DATA ETK KP_BLOB 0x380451 EXTERN 0x1 /end IF_DATA /end MEASUREMENT
/begin MEASUREMENT tedub "korrigierte Einschaltdauer der LSU-Heizung" UBYTE t10msxs_ub_b2p55 1 100 0 2.55 FORMAT "%5.3" /begin IF_DATA ASAP1B_KWP2000 KP_BLOB 0x380452 EXTERN 0x1 /end IF_DATA /begin IF_DATA ETK KP_BLOB 0x380452 EXTERN 0x1 /end IF_DATA /end MEASUREMENT
/begin MEASUREMENT tedub2 "korrigierte Einschaltdauer der LSU-Heizung Bank2" UBYTE t10msxs_ub_b2p55 1 100 0 2.55 FORMAT "%5.3" /begin IF_DATA ASAP1B_KWP2000 KP_BLOB 0x380453 EXTERN 0x1 /end IF_DATA /begin IF_DATA ETK KP_BLOB 0x380453 EXTERN 0x1 /end IF_DATA /end MEASUREMENT
/begin MEASUREMENT tfuel "Kraftstofftemperatur" UBYTE temp_ub_q1_o40 1 100 -40 215 FORMAT "%5.1" /begin IF_DATA ASAP1B_KWP2000 KP_BLOB 0x380448 EXTERN 0x1 /end IF_DATA /begin IF_DATA ETK KP_BLOB 0x380448 EXTERN 0x1 /end IF_DATA /end MEASUREMENT
/begin MEASUREMENT tfuellin "Kraftstofftemperatur, linearisiert und umgerechnet" UBYTE temp_ub_q1_o40 1 100 -40 215 FORMAT "%5.1" /begin IF_DATA ASAP1B_KWP2000 KP_BLOB 0x380449 EXTERN 0x1 /end IF_DATA /begin IF_DATA ETK KP_BLOB 0x380449 EXTERN 0x1 /end IF_DATA /end MEASUREMENT
/begin MEASUREMENT tmew "Motortemperatur-Ersatzwert aus Modell" UBYTE temp_ub_q0p75_o48 1 100 -48 143.25 FORMAT "%5.1" /begin IF_DATA ASAP1B_KWP2000 KP_BLOB 0x3803A7 EXTERN 0x1 /end IF_DATA /begin IF_DATA ETK KP_BLOB 0x3803A7 EXTERN 0x1 /end IF_DATA /end MEASUREMENT
/begin MEASUREMENT tmfa_w "Meßfensteranfang Klopfregelung" UWORD tknockcon_sy 1 100 0 0.209712 FORMAT "%8.6" /begin IF_DATA ASAP1B_KWP2000 KP_BLOB 0x380CC2 EXTERN 0x2 /end IF_DATA /begin IF_DATA ETK KP_BLOB 0x380CC2 EXTERN 0x2 /end IF_DATA /end MEASUREMENT
/begin MEASUREMENT tmfln_w "Meßfensterlänge während Nulltest, KR" UWORD tknockcon_sy 1 100 0 0.209712 FORMAT "%8.6" /begin IF_DATA ASAP1B_KWP2000 KP_BLOB 0x380CC4 EXTERN 0x2 /end IF_DATA /begin IF_DATA ETK KP_BLOB 0x380CC4 EXTERN 0x2 /end IF_DATA /end MEASUREMENT
/begin MEASUREMENT tmfl_w "Meßfensterlänge Klopfregelung" UWORD tknockcon_sy 1 100 0 0.209712 FORMAT "%8.6" /begin IF_DATA ASAP1B_KWP2000 KP_BLOB 0x380CC6 EXTERN 0x2 /end IF_DATA /begin IF_DATA ETK KP_BLOB 0x380CC6 EXTERN 0x2 /end IF_DATA /end MEASUREMENT
/begin MEASUREMENT tmot "Motor-Temperatur" UBYTE temp_ub_q0p75_o48 1 100 -48 143.25 FORMAT "%5.1" /begin IF_DATA ASAP1B_KWP2000 KP_BLOB 0x3803A8 EXTERN 0x1 /end IF_DATA /begin IF_DATA ETK KP_BLOB 0x3803A8 EXTERN 0x1 /end IF_DATA /end MEASUREMENT
/begin MEASUREMENT tmotab "Motortemperatur beim Abstellen" UBYTE temp_ub_q0p75_o48 1 100 -48 143.25 FORMAT "%5.1" /begin IF_DATA ASAP1B_KWP2000 KP_BLOB 0x382859 EXTERN 0x1 /end IF_DATA /begin IF_DATA ETK KP_BLOB 0x382859 EXTERN 0x1 /end IF_DATA /end MEASUREMENT
/begin MEASUREMENT tmotlin "Motortemperatur, linearisiert und umgerechnet" UBYTE temp_ub_q0p75_o48 1 100 -48 143.25 FORMAT "%5.1" /begin IF_DATA ASAP1B_KWP2000 KP_BLOB 0x3803A9 EXTERN 0x1 /end IF_DATA /begin IF_DATA ETK KP_BLOB 0x3803A9 EXTERN 0x1 /end IF_DATA /end MEASUREMENT
/begin MEASUREMENT tmotvt "Motortemperatur vor Tiefpaßfilter" UBYTE temp_ub_q0p75_o48 1 100 -48 143.25 FORMAT "%5.1" /begin IF_DATA ASAP1B_KWP2000 KP_BLOB 0x3803AA EXTERN 0x1 /end IF_DATA /begin IF_DATA ETK KP_BLOB 0x3803AA EXTERN 0x1 /end IF_DATA /end MEASUREMENT
/begin MEASUREMENT tmrw "Motortemperatur-Referenzwert aus Modell" UBYTE temp_ub_q0p75_o48 1 100 -48 143.25 FORMAT "%5.1" /begin IF_DATA ASAP1B_KWP2000 KP_BLOB 0x3803AB EXTERN 0x1 /end IF_DATA /begin IF_DATA ETK KP_BLOB 0x3803AB EXTERN 0x1 /end IF_DATA /end MEASUREMENT
/begin MEASUREMENT tmrwend "Endwert für Referenzwert Motortemperatur-Modell" UBYTE temp_ub_q0p75_o48 1 100 -48 143.25 FORMAT "%5.1" /begin IF_DATA ASAP1B_KWP2000 KP_BLOB 0x3803AC EXTERN 0x1 /end IF_DATA /begin IF_DATA ETK KP_BLOB 0x3803AC EXTERN 0x1 /end IF_DATA /end MEASUREMENT
/begin MEASUREMENT tmst "Motorstarttemperatur" UBYTE temp_ub_q0p75_o48 1 100 -48 143.25 FORMAT "%5.1" /begin IF_DATA ASAP1B_KWP2000 KP_BLOB 0x3803AD EXTERN 0x1 /end IF_DATA /begin IF_DATA ETK KP_BLOB 0x3803AD EXTERN 0x1 /end IF_DATA /end MEASUREMENT
/begin MEASUREMENT toel "Öltemperatur" UBYTE temp_ub_q1_o40 1 100 -40 215 FORMAT "%5.1" /begin IF_DATA ASAP1B_KWP2000 KP_BLOB 0x380446 EXTERN 0x1 /end IF_DATA /begin IF_DATA ETK KP_BLOB 0x380446 EXTERN 0x1 /end IF_DATA /end MEASUREMENT
/begin MEASUREMENT toellin "(Motor-)Oeltemperatur, linearisiert und umgerechnet" UBYTE temp_ub_q1_o40 1 100 -40 215 FORMAT "%5.1" /begin IF_DATA ASAP1B_KWP2000 KP_BLOB 0x380447 EXTERN 0x1 /end IF_DATA /begin IF_DATA ETK KP_BLOB 0x380447 EXTERN 0x1 /end IF_DATA /end MEASUREMENT
/begin MEASUREMENT tpnt_aktiv "Aktivierung von KR-Funktionen" UBYTE dez 1 100 0 255 FORMAT "%5.1" /begin IF_DATA ASAP1B_KWP2000 KP_BLOB 0x3803C9 EXTERN 0x1 /end IF_DATA /begin IF_DATA ETK KP_BLOB 0x3803C9 EXTERN 0x1 /end IF_DATA /end MEASUREMENT
/begin MEASUREMENT tzabgl "Timer für TABGL" UBYTE t10msxs_ub_b2p55 1 100 0 2.55 FORMAT "%5.3" /begin IF_DATA ASAP1B_KWP2000 KP_BLOB 0x38035B EXTERN 0x1 /end IF_DATA /begin IF_DATA ETK KP_BLOB 0x38035B EXTERN 0x1 /end IF_DATA /end MEASUREMENT
/begin MEASUREMENT tzabgl2 "Timer für TABGL Bank2" UBYTE t10msxs_ub_b2p55 1 100 0 2.55 FORMAT "%5.3" /begin IF_DATA ASAP1B_KWP2000 KP_BLOB 0x38035C EXTERN 0x1 /end IF_DATA /begin IF_DATA ETK KP_BLOB 0x38035C EXTERN 0x1 /end IF_DATA /end MEASUREMENT
/begin MEASUREMENT tzabgs "Timer für TABGS" UBYTE t100msxs_ub_b25p5 1 100 0 25.5 FORMAT "%5.2" /begin IF_DATA ASAP1B_KWP2000 KP_BLOB 0x38035D EXTERN 0x1 /end IF_DATA /begin IF_DATA ETK KP_BLOB 0x38035D EXTERN 0x1 /end IF_DATA /end MEASUREMENT
/begin MEASUREMENT tzlena "Timer für TVENA" UBYTE t10msxs_ub_b2p55 1 100 0 2.55 FORMAT "%5.3" /begin IF_DATA ASAP1B_KWP2000 KP_BLOB 0x38035E EXTERN 0x1 /end IF_DATA /begin IF_DATA ETK KP_BLOB 0x38035E EXTERN 0x1 /end IF_DATA /end MEASUREMENT
/begin MEASUREMENT tzlena2 "Timer für TVENA Bank2" UBYTE t10msxs_ub_b2p55 1 100 0 2.55 FORMAT "%5.3" /begin IF_DATA ASAP1B_KWP2000 KP_BLOB 0x38035F EXTERN 0x1 /end IF_DATA /begin IF_DATA ETK KP_BLOB 0x38035F EXTERN 0x1 /end IF_DATA /end MEASUREMENT
/begin MEASUREMENT tzstbb "Timer für TSTBB" UBYTE t100msxs_ub_b25p5 1 100 0 25.5 FORMAT "%5.2" /begin IF_DATA ASAP1B_KWP2000 KP_BLOB 0x380360 EXTERN 0x1 /end IF_DATA /begin IF_DATA ETK KP_BLOB 0x380360 EXTERN 0x1 /end IF_DATA /end MEASUREMENT
/begin MEASUREMENT tzstbb2 "Timer für TSTBB Bank2" UBYTE t100msxs_ub_b25p5 1 100 0 25.5 FORMAT "%5.2" /begin IF_DATA ASAP1B_KWP2000 KP_BLOB 0x380361 EXTERN 0x1 /end IF_DATA /begin IF_DATA ETK KP_BLOB 0x380361 EXTERN 0x1 /end IF_DATA /end MEASUREMENT
/begin MEASUREMENT UADKI "eingelesener Integratorwert von Klopfauswerteschaltung" UWORD dez 1 100 0 65535 FORMAT "%8.2" /begin IF_DATA ASAP1B_KWP2000 KP_BLOB 0xF87E INTERN 0x2 /end IF_DATA /begin IF_DATA ETK KP_BLOB 0xF87E INTERN 0x2 /end IF_DATA /end MEASUREMENT
/begin MEASUREMENT uats_kge "Abgastemperatur-Rohwert, Zwischengrösse" UWORD spg_uw_q0p00488 1 100 0 319.995 FORMAT "%8.4" /begin IF_DATA ASAP1B_KWP2000 KP_BLOB 0x3813A8 EXTERN 0x2 /end IF_DATA /begin IF_DATA ETK KP_BLOB 0x3813A8 EXTERN 0x2 /end IF_DATA /end MEASUREMENT
/begin MEASUREMENT ub "Batteriespannung" UBYTE spg_ubatt 1 100 0 17.3655 FORMAT "%5.2" /begin IF_DATA ASAP1B_KWP2000 KP_BLOB 0x380362 EXTERN 0x1 /end IF_DATA /begin IF_DATA ETK KP_BLOB 0x380362 EXTERN 0x1 /end IF_DATA /end MEASUREMENT
/begin MEASUREMENT udsm_w "Drucksensorspannung über ein Segment gemittelt (word)" UWORD spg_uw_b5 1 100 0 319.995 FORMAT "%8.4" /begin IF_DATA ASAP1B_KWP2000 KP_BLOB 0x380BB8 EXTERN 0x2 /end IF_DATA /begin IF_DATA ETK KP_BLOB 0x380BB8 EXTERN 0x2 /end IF_DATA /end MEASUREMENT
/begin MEASUREMENT usvkk2_w "LSU-Spannung vor Kat, korrigiert Bank2" UWORD spg_uw_q0p00488 1 100 0 319.995 FORMAT "%8.4" /begin IF_DATA ASAP1B_KWP2000 KP_BLOB 0x380A96 EXTERN 0x2 /end IF_DATA /begin IF_DATA ETK KP_BLOB 0x380A96 EXTERN 0x2 /end IF_DATA /end MEASUREMENT
/begin MEASUREMENT usvkk_w "LSU-Spannung vor Kat, korrigiert" UWORD spg_uw_q0p00488 1 100 0 319.995 FORMAT "%8.4" /begin IF_DATA ASAP1B_KWP2000 KP_BLOB 0x380A98 EXTERN 0x2 /end IF_DATA /begin IF_DATA ETK KP_BLOB 0x380A98 EXTERN 0x2 /end IF_DATA /end MEASUREMENT
/begin MEASUREMENT uulsuf2_w "gefilterte Sondenspannung vor Kat einer Breitbandlambdasonde Bank2" UWORD spg_uw_q0p00488 1 100 0 319.995 FORMAT "%8.4" /begin IF_DATA ASAP1B_KWP2000 KP_BLOB 0x380A9A EXTERN 0x2 /end IF_DATA /begin IF_DATA ETK KP_BLOB 0x380A9A EXTERN 0x2 /end IF_DATA /end MEASUREMENT
/begin MEASUREMENT uulsuf_w "gefilterte Sondenspannung vor Kat einer Breitbandlambdasonde" UWORD spg_uw_q0p00488 1 100 0 319.995 FORMAT "%8.4" /begin IF_DATA ASAP1B_KWP2000 KP_BLOB 0x380A9C EXTERN 0x2 /end IF_DATA /begin IF_DATA ETK KP_BLOB 0x380A9C EXTERN 0x2 /end IF_DATA /end MEASUREMENT
/begin MEASUREMENT vfzg "Fahrzeuggeschwindigkeit" UBYTE vfzg_ub_q1p25 1 100 0 318.75 FORMAT "%5.1" /begin IF_DATA ASAP1B_KWP2000 KP_BLOB 0x380300 EXTERN 0x1 /end IF_DATA /begin IF_DATA ETK KP_BLOB 0x380300 EXTERN 0x1 /end IF_DATA /end MEASUREMENT
/begin MEASUREMENT vfzgmph_w "Fahrzeuggeschwindigkeit in mph" UWORD vfzgmph_uw_b318 1 100 0 318.205 FORMAT "%8.4" /begin IF_DATA ASAP1B_KWP2000 KP_BLOB 0x3804B4 EXTERN 0x2 /end IF_DATA /begin IF_DATA ETK KP_BLOB 0x3804B4 EXTERN 0x2 /end IF_DATA /end MEASUREMENT
/begin MEASUREMENT vfzg_w "Fahrzeuggeschwindigkeit" UWORD vfzg_uw_b512 1 100 0 511.992 FORMAT "%8.4" /begin IF_DATA ASAP1B_KWP2000 KP_BLOB 0x3804B6 EXTERN 0x2 /end IF_DATA /begin IF_DATA ETK KP_BLOB 0x3804B6 EXTERN 0x2 /end IF_DATA /end MEASUREMENT
/begin MEASUREMENT vfzroh_w "Fahrzeuggeschwindigkeit Ausgabewert an SCAN-Tool" UWORD vfzg_uw_b512 1 100 0 511.992 FORMAT "%8.4" /begin IF_DATA ASAP1B_KWP2000 KP_BLOB 0x3804B8 EXTERN 0x2 /end IF_DATA /begin IF_DATA ETK KP_BLOB 0x3804B8 EXTERN 0x2 /end IF_DATA /end MEASUREMENT
/begin MEASUREMENT virkr "Verhältnis Integrator / Referenzpegel Klopfregelung" UBYTE fak_ub_b16 1 100 0 15.9375 FORMAT "%5.2" /begin IF_DATA ASAP1B_KWP2000 KP_BLOB 0xF889 INTERN 0x1 /end IF_DATA /begin IF_DATA ETK KP_BLOB 0xF889 INTERN 0x1 /end IF_DATA /end MEASUREMENT
/begin MEASUREMENT vkr "Verstärkungsstufe für Eingangsverstärkung Klopf-IC" UBYTE dez 1 100 0 255 FORMAT "%5.1" ARRAY_SIZE 8 /begin IF_DATA ASAP1B_KWP2000 KP_BLOB 0x3803EA EXTERN 0x1 /end IF_DATA /begin IF_DATA ETK KP_BLOB 0x3803EA EXTERN 0x1 /end IF_DATA /end MEASUREMENT
/begin MEASUREMENT vkr_tst "Verstärkungsstufe für Eingangsverstärkung Klopf-IC rollierend mit Zyl.zähler" UBYTE dez 1 100 0 255 FORMAT "%5.1" /begin IF_DATA ASAP1B_KWP2000 KP_BLOB 0x3803F2 EXTERN 0x1 /end IF_DATA /begin IF_DATA ETK KP_BLOB 0x3803F2 EXTERN 0x1 /end IF_DATA /end MEASUREMENT
/begin MEASUREMENT wdkba "Drosselklappenwinkel bezogen auf unteren Anschlag" UBYTE relDK_ub_b100 1 100 0 100 FORMAT "%5.1" /begin IF_DATA ASAP1B_KWP2000 KP_BLOB 0x380345 EXTERN 0x1 /end IF_DATA /begin IF_DATA ETK KP_BLOB 0x380345 EXTERN 0x1 /end IF_DATA /end MEASUREMENT
/begin MEASUREMENT wdkbal_w "Drosselklappenwinkel, bezogen auf unteren Anschlag (0..100%)" UWORD relDK_uw_b100 1 100 0 100 FORMAT "%8.4" /begin IF_DATA ASAP1B_KWP2000 KP_BLOB 0x3809C8 EXTERN 0x2 /end IF_DATA /begin IF_DATA ETK KP_BLOB 0x3809C8 EXTERN 0x2 /end IF_DATA /end MEASUREMENT
/begin MEASUREMENT wdkba_w "Drosselklappenwinkel bezogen auf unteren Anschlag" SWORD relDK_q0p02441 1 100 -800 799.976 FORMAT "%8.4" /begin IF_DATA ASAP1B_KWP2000 KP_BLOB 0x3809CA EXTERN 0x2 /end IF_DATA /begin IF_DATA ETK KP_BLOB 0x3809CA EXTERN 0x2 /end IF_DATA /end MEASUREMENT
/begin MEASUREMENT wdklmman_w "gelernter Leerlaufwinkel der manuellen DK-Justierung" UWORD relDK_uw_b100 1 100 0 100 FORMAT "%8.4" /begin IF_DATA ASAP1B_KWP2000 KP_BLOB 0x382AE0 EXTERN 0x2 /end IF_DATA /begin IF_DATA ETK KP_BLOB 0x382AE0 EXTERN 0x2 /end IF_DATA /end MEASUREMENT
/begin MEASUREMENT wdklmn_w "minim. gelernter Leerlaufwinkel wdklm waehrend eines Betriebszustandes 16 Bits" UWORD relDK_uw_b100 1 100 0 100 FORMAT "%8.4" /begin IF_DATA ASAP1B_KWP2000 KP_BLOB 0x3809C4 EXTERN 0x2 /end IF_DATA /begin IF_DATA ETK KP_BLOB 0x3809C4 EXTERN 0x2 /end IF_DATA /end MEASUREMENT
/begin MEASUREMENT wdklm_w "gelernter Leerlaufwinkel 16 Bits" UWORD relDK_uw_b100 1 100 0 100 FORMAT "%8.4" /begin IF_DATA ASAP1B_KWP2000 KP_BLOB 0x382AE2 EXTERN 0x2 /end IF_DATA /begin IF_DATA ETK KP_BLOB 0x382AE2 EXTERN 0x2 /end IF_DATA /end MEASUREMENT
/begin MEASUREMENT wdkmanctr "Anzahl der durchgeführten Speichervorgänge der manuellen DK-Justierung" UWORD dez 1 100 0 65535 FORMAT "%8.2" /begin IF_DATA ASAP1B_KWP2000 KP_BLOB 0x3809CC EXTERN 0x2 /end IF_DATA /begin IF_DATA ETK KP_BLOB 0x3809CC EXTERN 0x2 /end IF_DATA /end MEASUREMENT
/begin MEASUREMENT wdkmanmode "aktueller Modus der manuellen DK-Justierung" UBYTE msd_text_throttle_1 1 100 0 255 FORMAT "%5.1" /begin IF_DATA ASAP1B_KWP2000 KP_BLOB 0x380346 EXTERN 0x1 /end IF_DATA /begin IF_DATA ETK KP_BLOB 0x380346 EXTERN 0x1 /end IF_DATA /end MEASUREMENT
/begin MEASUREMENT wdk_w "Winkel Drosselklappe 16 Bits" UWORD relDK_uw_b100 1 100 0 100 FORMAT "%8.4" /begin IF_DATA ASAP1B_KWP2000 KP_BLOB 0x3809CE EXTERN 0x2 /end IF_DATA /begin IF_DATA ETK KP_BLOB 0x3809CE EXTERN 0x2 /end IF_DATA /end MEASUREMENT
/begin MEASUREMENT wea "Winkelmarke Einspritzabbruch" UBYTE zw_ub_q6 1 100 0 1530 FORMAT "%5.0" /begin IF_DATA ASAP1B_KWP2000 KP_BLOB 0x380389 EXTERN 0x1 /end IF_DATA /begin IF_DATA ETK KP_BLOB 0x380389 EXTERN 0x1 /end IF_DATA /end MEASUREMENT
/begin MEASUREMENT wee "Winkel Einspritzende im Normalbetrieb" UBYTE zw_ub_q6 1 100 0 1530 FORMAT "%5.0" /begin IF_DATA ASAP1B_KWP2000 KP_BLOB 0x38038B EXTERN 0x1 /end IF_DATA /begin IF_DATA ETK KP_BLOB 0x38038B EXTERN 0x1 /end IF_DATA /end MEASUREMENT
/begin MEASUREMENT weehl "Winkel Einspritzende bei hoher Last" UBYTE zw_ub_q6 1 100 0 1530 FORMAT "%5.0" /begin IF_DATA ASAP1B_KWP2000 KP_BLOB 0x38038A EXTERN 0x1 /end IF_DATA /begin IF_DATA ETK KP_BLOB 0x38038A EXTERN 0x1 /end IF_DATA /end MEASUREMENT
/begin MEASUREMENT weer "Winkel Einspritzende resultierend" UBYTE kw_q2p8125 1 100 0 717.188 FORMAT "%5.1" /begin IF_DATA ASAP1B_KWP2000 KP_BLOB 0x38038C EXTERN 0x1 /end IF_DATA /begin IF_DATA ETK KP_BLOB 0x38038C EXTERN 0x1 /end IF_DATA /end MEASUREMENT
/begin MEASUREMENT weeubg "Winkel Einspritzende ohne Änderungsbegrenzung" UBYTE zw_ub_q6 1 100 0 1530 FORMAT "%5.0" /begin IF_DATA ASAP1B_KWP2000 KP_BLOB 0x38038D EXTERN 0x1 /end IF_DATA /begin IF_DATA ETK KP_BLOB 0x38038D EXTERN 0x1 /end IF_DATA /end MEASUREMENT
/begin MEASUREMENT wf_w "Wandfilmmenge" SWORD rel_sw_q0p1875 1 100 -6144 6143.81 FORMAT "%8.3" /begin IF_DATA ASAP1B_KWP2000 KP_BLOB 0x380C2A EXTERN 0x2 /end IF_DATA /begin IF_DATA ETK KP_BLOB 0x380C2A EXTERN 0x2 /end IF_DATA /end MEASUREMENT
/begin MEASUREMENT wkr "zylinderindividuelle Zündwinkelspätverstellung KR" UBYTE zw_ub_qn0p75 1 100 -191.25 0 FORMAT "%5.1" ARRAY_SIZE 8 /begin IF_DATA ASAP1B_KWP2000 KP_BLOB 0xF88A INTERN 0x1 /end IF_DATA /begin IF_DATA ETK KP_BLOB 0xF88A INTERN 0x1 /end IF_DATA /end MEASUREMENT
/begin MEASUREMENT wkra "last und drehzahlabh. Adaptionskennfeld f. wkr" UBYTE zw_ub_qn0p75 1 100 -191.25 0 FORMAT "%5.1" ARRAY_SIZE 195 /begin IF_DATA ASAP1B_KWP2000 KP_BLOB 0x382862 EXTERN 0x1 /end IF_DATA /begin IF_DATA ETK KP_BLOB 0x382862 EXTERN 0x1 /end IF_DATA /end MEASUREMENT
/begin MEASUREMENT wkratst "wkra mit Synchro-Raster rollierend" UBYTE zw_ub_qn0p75 1 100 -191.25 0 FORMAT "%5.1" /begin IF_DATA ASAP1B_KWP2000 KP_BLOB 0x380412 EXTERN 0x1 /end IF_DATA /begin IF_DATA ETK KP_BLOB 0x380412 EXTERN 0x1 /end IF_DATA /end MEASUREMENT
/begin MEASUREMENT wkrdy "Zündwinkelspätverstellung bei KR-Dynamik" UBYTE zw_ub_qn0p75 1 100 -191.25 0 FORMAT "%5.1" /begin IF_DATA ASAP1B_KWP2000 KP_BLOB 0xF880 INTERN 0x1 /end IF_DATA /begin IF_DATA ETK KP_BLOB 0xF880 INTERN 0x1 /end IF_DATA /end MEASUREMENT
/begin MEASUREMENT wkrdya "adaptierter Zündwinkel bei KR-Dynamik" UBYTE zw_ub_qn0p75 1 100 -191.25 0 FORMAT "%5.1" ARRAY_SIZE 8 /begin IF_DATA ASAP1B_KWP2000 KP_BLOB 0x38285A EXTERN 0x1 /end IF_DATA /begin IF_DATA ETK KP_BLOB 0x38285A EXTERN 0x1 /end IF_DATA /end MEASUREMENT
/begin MEASUREMENT wkrm "Mittelwert der zylinderindividuellen ZW-Spätverstellungen durch KR" UBYTE zw_ub_qn0p75 1 100 -191.25 0 FORMAT "%5.1" /begin IF_DATA ASAP1B_KWP2000 KP_BLOB 0xF892 INTERN 0x1 /end IF_DATA /begin IF_DATA ETK KP_BLOB 0xF892 INTERN 0x1 /end IF_DATA /end MEASUREMENT
/begin MEASUREMENT wkrma "Mittelwert der ZW-Spätverstellungen KR, allgemein (im Notlauf mit Sicherheit)" UBYTE zw_ub_qn0p75 1 100 -191.25 0 FORMAT "%5.1" /begin IF_DATA ASAP1B_KWP2000 KP_BLOB 0xF893 INTERN 0x1 /end IF_DATA /begin IF_DATA ETK KP_BLOB 0xF893 INTERN 0x1 /end IF_DATA /end MEASUREMENT
/begin MEASUREMENT wkr_tst "zyl.ind. ZW-Spätverstellung, rollierend" UBYTE zw_ub_qn0p75 1 100 -191.25 0 FORMAT "%5.1" /begin IF_DATA ASAP1B_KWP2000 KP_BLOB 0x380413 EXTERN 0x1 /end IF_DATA /begin IF_DATA ETK KP_BLOB 0x380413 EXTERN 0x1 /end IF_DATA /end MEASUREMENT
/begin MEASUREMENT wmfa "Meßfensteranfang in Grad Kurbelwinkel" UBYTE zw_ub_q0p75 1 100 0 191.25 FORMAT "%5.1" /begin IF_DATA ASAP1B_KWP2000 KP_BLOB 0x3803CA EXTERN 0x1 /end IF_DATA /begin IF_DATA ETK KP_BLOB 0x3803CA EXTERN 0x1 /end IF_DATA /end MEASUREMENT
/begin MEASUREMENT wmfl "Meßfensterlänge in Grad Kurbelwinkel" UBYTE zw_ub_q0p75 1 100 0 191.25 FORMAT "%5.1" /begin IF_DATA ASAP1B_KWP2000 KP_BLOB 0x3803CB EXTERN 0x1 /end IF_DATA /begin IF_DATA ETK KP_BLOB 0x3803CB EXTERN 0x1 /end IF_DATA /end MEASUREMENT
/begin MEASUREMENT zaldy "Zündungszähler für Abregelung Lastdynamik" UBYTE dez 1 100 0 255 FORMAT "%5.1" /begin IF_DATA ASAP1B_KWP2000 KP_BLOB 0x3803CD EXTERN 0x1 /end IF_DATA /begin IF_DATA ETK KP_BLOB 0x3803CD EXTERN 0x1 /end IF_DATA /end MEASUREMENT
/begin MEASUREMENT zbale "Abregelfaktor Langzeitanteil bei BA" UBYTE fak_ub_b0p125 1 100 0 0.124512 FORMAT "%5.3" /begin IF_DATA ASAP1B_KWP2000 KP_BLOB 0x380398 EXTERN 0x1 /end IF_DATA /begin IF_DATA ETK KP_BLOB 0x380398 EXTERN 0x1 /end IF_DATA /end MEASUREMENT
/begin MEASUREMENT zkrvf "Zähler, bestimmt die Frequenz der zyl.-individuellen Zündwinkelfrühverstellung" UBYTE dez 1 100 0 255 FORMAT "%5.1" ARRAY_SIZE 8 /begin IF_DATA ASAP1B_KWP2000 KP_BLOB 0x380414 EXTERN 0x1 /end IF_DATA /begin IF_DATA ETK KP_BLOB 0x380414 EXTERN 0x1 /end IF_DATA /end MEASUREMENT
/begin MEASUREMENT zldy "Zündungszähler für Lastdynamik" UBYTE dez 1 100 0 255 FORMAT "%5.1" /begin IF_DATA ASAP1B_KWP2000 KP_BLOB 0xF881 INTERN 0x1 /end IF_DATA /begin IF_DATA ETK KP_BLOB 0xF881 INTERN 0x1 /end IF_DATA /end MEASUREMENT
/begin MEASUREMENT zndy "Zündungszähler für Drehzahldynamik" UBYTE dez 1 100 0 255 FORMAT "%5.1" /begin IF_DATA ASAP1B_KWP2000 KP_BLOB 0xF882 INTERN 0x1 /end IF_DATA /begin IF_DATA ETK KP_BLOB 0xF882 INTERN 0x1 /end IF_DATA /end MEASUREMENT
/begin MEASUREMENT zvale "Abregelfaktor Langzeitanteil bei VA" UBYTE fak_ub_b0p125 1 100 0 0.124512 FORMAT "%5.3" /begin IF_DATA ASAP1B_KWP2000 KP_BLOB 0x380399 EXTERN 0x1 /end IF_DATA /begin IF_DATA ETK KP_BLOB 0x380399 EXTERN 0x1 /end IF_DATA /end MEASUREMENT
/begin MEASUREMENT zzgs "Zündungszähler Getriebeschaltfunktion" UBYTE dez 1 100 0 255 FORMAT "%5.1" /begin IF_DATA ASAP1B_KWP2000 KP_BLOB 0xF918 INTERN 0x1 /end IF_DATA /begin IF_DATA ETK KP_BLOB 0xF918 INTERN 0x1 /end IF_DATA /end MEASUREMENT
/begin MEASUREMENT zzwdykr "Zündungszähler bei gesetztem Bit B_zwkra=1 während der KR-Dynamik" UWORD dez 1 100 0 65535 FORMAT "%8.2" /begin IF_DATA ASAP1B_KWP2000 KP_BLOB 0xF884 INTERN 0x2 /end IF_DATA /begin IF_DATA ETK KP_BLOB 0xF884 INTERN 0x2 /end IF_DATA /end MEASUREMENT
/begin MEASUREMENT zzwdymd "Zündungszähler bei nicht gesetztem Bit B_zwkra=0 während der KR-Dynamik" UWORD dez 1 100 0 65535 FORMAT "%8.2" /begin IF_DATA ASAP1B_KWP2000 KP_BLOB 0xF886 INTERN 0x2 /end IF_DATA /begin IF_DATA ETK KP_BLOB 0xF886 INTERN 0x2 /end IF_DATA /end MEASUREMENT
/begin MEASUREMENT zzylkr "Zylinderzähler der Klopfregelung" UBYTE dez 1 100 0 255 FORMAT "%5.1" /begin IF_DATA ASAP1B_KWP2000 KP_BLOB 0xF87C INTERN 0x1 /end IF_DATA /begin IF_DATA ETK KP_BLOB 0xF87C INTERN 0x1 /end IF_DATA /end MEASUREMENT
/begin MEASUREMENT z_tpnt_a "KR: Zähler für die Freigabe von Nulltest oder Testimpuls" UBYTE dez 1 100 0 255 FORMAT "%5.1" /begin IF_DATA ASAP1B_KWP2000 KP_BLOB 0x3803CC EXTERN 0x1 /end IF_DATA /begin IF_DATA ETK KP_BLOB 0x3803CC EXTERN 0x1 /end IF_DATA /end MEASUREMENT
/begin FUNCTION ESUK "Injection: transient compensation"
 /begin DEF_CHARACTERISTIC FWFN DUKK TNSUUK ZUKK FVANST DRLPUK RKBAUM RKVAUM RKUKKLU ZUKNST KFBAKL KFVAKL KFABAK KFAVAK FUKNSTM WFRL ZBALM ZVALM /end DEF_CHARACTERISTIC
 /begin REF_CHARACTERISTIC /end REF_CHARACTERISTIC
 /begin IN_MEASUREMENT anzti B_ll B_sa B_st B_stend drlp_w nmot nmot_w rlp_w tmot tmst /end IN_MEASUREMENT
 /begin OUT_MEASUREMENT B_ba B_bag B_ukg B_va B_vag rkukg_w /end OUT_MEASUREMENT
 /begin LOC_MEASUREMENT abak anztis avak B_drlpuk B_redkl B_uk1 B_ukk B_vaau B_vakl B_val dwfk_w dwfl_w dwf_w fbakl_w fbans fbans_w fvakl_w fvans rkbau_w rkukkl_w rkukk_w rkukl_w rkvau_w sdwfk_w sdwfl_w wf_w zbale zvale /end LOC_MEASUREMENT
 /begin SUB_FUNCTION /end SUB_FUNCTION
/end FUNCTION
/begin FUNCTION ESVW "Einspritzung: Berechnung der Vorlagerungswinkel"
 /begin DEF_CHARACTERISTIC SRL08GKUB SNM08GKUB STM08GKUB CWVWKNWS DWEEMX WEESTN ZZWEETM WEESTM WEAN WEEHLN WDKEEHL WEEM KFWEEK KFWEE /end DEF_CHARACTERISTIC
 /begin REF_CHARACTERISTIC /end REF_CHARACTERISTIC
 /begin IN_MEASUREMENT B_stend nmot rl tmot tmst uzkw_w vsvw wdkba /end IN_MEASUREMENT
 /begin OUT_MEASUREMENT esst_snm08gkub esst_srl08gkub esst_stm08gkub wea wee weehl weer weeubg /end OUT_MEASUREMENT
 /begin LOC_MEASUREMENT B_eehl B_kfwee /end LOC_MEASUREMENT
 /begin SUB_FUNCTION /end SUB_FUNCTION
/end FUNCTION
/begin FUNCTION ESWE "Einspritzung Schubabschalten Wiedereinsetzen" /begin DEF_CHARACTERISTIC FIMWU FIMHU /end DEF_CHARACTERISTIC /begin REF_CHARACTERISTIC /end REF_CHARACTERISTIC /begin IN_MEASUREMENT anzti B_ll B_sa /end IN_MEASUREMENT /begin OUT_MEASUREMENT fwe /end OUT_MEASUREMENT /begin LOC_MEASUREMENT anzwefim azylwe B_afwe B_fwe /end LOC_MEASUREMENT /begin SUB_FUNCTION /end SUB_FUNCTION /end FUNCTION
/begin FUNCTION ESWL "Einspritzung Warmlauf" /begin DEF_CHARACTERISTIC ZKLANSWL ATISLATM LASWLTM KFLASWLR KFFWL KFFWLW /end DEF_CHARACTERISTIC /begin REF_CHARACTERISTIC SNM12ESUB SRL12ESUB STM12ESUB STS12ESUB /end REF_CHARACTERISTIC
 /begin IN_MEASUREMENT anztib_w B_lrnda B_lrnda2 B_stend esst_snm12esub esst_srl12esub esst_stm12esub esst_sts12esub lamns_w nmot rl tmot tmst /end IN_MEASUREMENT
 /begin OUT_MEASUREMENT fwl lamnswl_w /end OUT_MEASUREMENT
 /begin LOC_MEASUREMENT lamwl_w /end LOC_MEASUREMENT
 /begin SUB_FUNCTION /end SUB_FUNCTION
/end FUNCTION
/begin FUNCTION evi1 "" /begin DEF_CHARACTERISTIC /end DEF_CHARACTERISTIC /begin REF_CHARACTERISTIC /end REF_CHARACTERISTIC
 /begin IN_MEASUREMENT B_spontan0 B_spontan1 B_spontan2 B_spontan3 B_spontan4 B_spontan5 B_spontan6 B_spontan7 B_ti_cha0 B_ti_cha1 B_ti_cha2 B_ti_cha3 B_ti_cha4 B_ti_cha5 B_ti_cha6 B_ti_cha7 B_ti_out0 B_ti_out1 B_ti_out2 B_ti_out3 B_ti_out4 B_ti_out5 B_ti_out6 B_ti_out7 B_ti_wai0 B_ti_wai1 B_ti_wai2 B_ti_wai3 B_ti_wai4 B_ti_wai5 B_ti_wai6 B_ti_wai7 cc_cha_0 cc_cha_1 cc_cha_2 cc_cha_3 cc_cha_4 cc_cha_5 cc_cha_6 cc_cha_7 ti_tvu_w /end IN_MEASUREMENT
 /begin OUT_MEASUREMENT /end OUT_MEASUREMENT
 /begin LOC_MEASUREMENT /end LOC_MEASUREMENT
 /begin SUB_FUNCTION /end SUB_FUNCTION
/end FUNCTION
/begin FUNCTION GGATS "Gebergröße Abgastemperatursensor" /begin DEF_CHARACTERISTIC CWATS UATSDMN UATSDMX TATSLI TDATS /end DEF_CHARACTERISTIC /begin REF_CHARACTERISTIC /end REF_CHARACTERISTIC /begin IN_MEASUREMENT B_pwf uats2_w uats_w /end IN_MEASUREMENT /begin OUT_MEASUREMENT tats tats2 tats2_w tats_w /end OUT_MEASUREMENT /begin LOC_MEASUREMENT uats_kge /end LOC_MEASUREMENT /begin SUB_FUNCTION /end SUB_FUNCTION /end FUNCTION
/begin FUNCTION GGDKG "Gebergröße Drosselklappenwinkel"
 /begin DEF_CHARACTERISTIC CWWDKFKT WDKMAN WDKLMMAX DWDKLA NDSVL QDPSLL RLDSVL WKLLX ZWDK WDKNLN WDKSLN WDKVLN /end DEF_CHARACTERISTIC
 /begin REF_CHARACTERISTIC WDKDU /end REF_CHARACTERISTIC
 /begin IN_MEASUREMENT B_nmot B_pwf B_st ml nmot rl uwdk_w /end IN_MEASUREMENT
 /begin OUT_MEASUREMENT B_dkgini B_ll B_vl dwdkba_w wdkba wdkbal_w wdkba_w wdklmman_w wdkmanctr wdkmanmode wdk_w /end OUT_MEASUREMENT
 /begin LOC_MEASUREMENT wdklmn_w wdklm_w /end LOC_MEASUREMENT
 /begin SUB_FUNCTION /end SUB_FUNCTION
/end FUNCTION
/begin FUNCTION GGDSAS "Gebergröße Drucksensoren außerhalb Saugrohr"
 /begin DEF_CHARACTERISTIC DSLGRAD DSLOFS NDSVLU TDDFL TDDSVLU UADPLMN UADPLMX PUE PUMX PUMN DSUGRAD DPDSVLU DSUOFS FHOE UADPUMN UADPUMX TDDFU ZDSU PVDKMN PVDKMX DPUPVDK LDFK /end DEF_CHARACTERISTIC
 /begin REF_CHARACTERISTIC /end REF_CHARACTERISTIC
 /begin IN_MEASUREMENT B_nmot ftu ml_w nmot pspvdk_w ps_w udsl_w udsu_w /end IN_MEASUREMENT
 /begin OUT_MEASUREMENT B_hag fho fho_w fpvdkds fpvdkds_w frhol_w pu pus_w pu_w pvdkds pvdkds_w pvdks_w /end OUT_MEASUREMENT
 /begin LOC_MEASUREMENT anzudsl_w B_turbo dpvdkspu_w fpvdkdsl_w fpvdkdsu_w GGDSASlokbits ldfki_w pspvdkds_w pvdkdsl_w pvdkdsu_w /end LOC_MEASUREMENT
 /begin SUB_FUNCTION /end SUB_FUNCTION
/end FUNCTION
/begin FUNCTION GGDSS "Gebergröße Drucksensor Saugrohrdruck" /begin DEF_CHARACTERISTIC DSSGRAD DSSOFS /end DEF_CHARACTERISTIC /begin REF_CHARACTERISTIC /end REF_CHARACTERISTIC /begin IN_MEASUREMENT udss_w /end IN_MEASUREMENT /begin OUT_MEASUREMENT psdss psdss_w udsm_w /end OUT_MEASUREMENT /begin LOC_MEASUREMENT /end LOC_MEASUREMENT /begin SUB_FUNCTION /end SUB_FUNCTION /end FUNCTION
/begin FUNCTION GGKS "Gebergröße Klopfsensor"
 /begin DEF_CHARACTERISTIC SENZZYL0 SENZZYL1 SENZZYL2 SENZZYL3 SENZZYL4 SENZZYL5 SENZZYL6 SENZZYL7 DKROKMX DKROKO FMFKR KEMLN KFMAKR /end DEF_CHARACTERISTIC
 /begin REF_CHARACTERISTIC SNM16KRUB SRL04KRUB KRFHT CDKRTP TMKR /end REF_CHARACTERISTIC
 /begin IN_MEASUREMENT B_kr B_st B_stend B_tmkr esst_snm16krub esst_srl04krub nmot rl tmot tn2 xzskrnt xzskrof xzskrtp /end IN_MEASUREMENT
 /begin OUT_MEASUREMENT B_c95bf0 B_c95bf1 B_c95bf2 B_c95bf3 B_c95ks3 B_dnt B_dntb B_dtp B_dtpb B_ntini B_tpnt_aw B_tpnt_e igokr_w ikr ikrma ikrme ikrmen ikrmet ikr_tst iokkr ks_sym sen_c95 tmfa_w tmfln_w tmfl_w tpnt_aktiv UADKI wmfa wmfl zzylkr z_tpnt_a /end OUT_MEASUREMENT
 /begin LOC_MEASUREMENT /end LOC_MEASUREMENT
 /begin SUB_FUNCTION /end SUB_FUNCTION
/end FUNCTION
/begin FUNCTION GGLSU "Gebersignal LSU"
 /begin DEF_CHARACTERISTIC CWGGLSU SDLAA SDLAB TABGL TABGS TSTBB TVLENA ULSUAMN ULSUAMX USABGL ZFDUSVK ZFUULSU LALIUS /end DEF_CHARACTERISTIC
 /begin REF_CHARACTERISTIC /end REF_CHARACTERISTIC
 /begin IN_MEASUREMENT B_ehlsu B_ehlsu2 B_elsu B_elsu2 B_hsv B_hsv2 B_ll B_pwf B_stend uulsuv2_w uulsuv_w /end IN_MEASUREMENT
 /begin OUT_MEASUREMENT B_lsuab B_lsuab2 B_sbbvk B_sbbvk2 kusvk2_w kusvk_w lamsoni lamsoni2 lamsoni2_w lamsoni_w /end OUT_MEASUREMENT
 /begin LOC_MEASUREMENT B_abll B_abll2 dlam2_w dlam_w iusvkk_w tzabgl tzabgl2 tzabgs tzlena tzlena2 tzstbb tzstbb2 usvkk2_w usvkk_w uulsuf2_w uulsuf_w /end LOC_MEASUREMENT
 /begin SUB_FUNCTION /end SUB_FUNCTION
/end FUNCTION
/begin FUNCTION GGPFUEL "Gebergröße Kraftstoffdrucksensor, incl. Diagnose"
 /begin DEF_CHARACTERISTIC PFUELDE UPFUELDMN UPFUELDMX PFUELGRAD PFUELOFS TDPFUEL ZPFUEL /end DEF_CHARACTERISTIC
 /begin REF_CHARACTERISTIC /end REF_CHARACTERISTIC
 /begin IN_MEASUREMENT B_pwf upfuel /end IN_MEASUREMENT
 /begin OUT_MEASUREMENT pfuel pfuels /end OUT_MEASUREMENT
 /begin LOC_MEASUREMENT /end LOC_MEASUREMENT
 /begin SUB_FUNCTION /end SUB_FUNCTION
/end FUNCTION
/begin FUNCTION GGPOEL "Gebergröße Öldrucksensor, incl. Diagnose" /begin DEF_CHARACTERISTIC POELDE UPOELDMN UPOELDMX POELGRAD POELOFS TDPOEL ZPOEL /end DEF_CHARACTERISTIC /begin REF_CHARACTERISTIC /end REF_CHARACTERISTIC /begin IN_MEASUREMENT B_pwf upoel /end IN_MEASUREMENT /begin OUT_MEASUREMENT poel poels /end OUT_MEASUREMENT /begin LOC_MEASUREMENT /end LOC_MEASUREMENT /begin SUB_FUNCTION /end SUB_FUNCTION /end FUNCTION
/begin FUNCTION GGTFA "Gebergröße TFA Temperaturfühler Ansaugluft" /begin DEF_CHARACTERISTIC TADE TADMN TADMX TANSELI TDNSTA TDTA TDTAL /end DEF_CHARACTERISTIC /begin REF_CHARACTERISTIC /end REF_CHARACTERISTIC /begin IN_MEASUREMENT B_ll B_pwf B_sa B_stend wtans /end IN_MEASUREMENT /begin OUT_MEASUREMENT tans tansab tanslin /end OUT_MEASUREMENT /begin LOC_MEASUREMENT /end LOC_MEASUREMENT /begin SUB_FUNCTION /end SUB_FUNCTION /end FUNCTION
/begin FUNCTION GGTFM "Gebergröße TFM Temperaturfühler Motor (/-Kühlmittel)"
 /begin DEF_CHARACTERISTIC DTMTE DTMTR TMOTELI TMDMX TMDMN DTMDMA TDTM TMDMMER TMDMMEE TMDMMA TMDMMAU TADMM /end DEF_CHARACTERISTIC
 /begin REF_CHARACTERISTIC /end REF_CHARACTERISTIC
 /begin IN_MEASUREMENT B_nmot B_pwf B_sa B_st B_stend ml tans toel wtmot /end IN_MEASUREMENT
 /begin OUT_MEASUREMENT tmew tmot tmotab tmotlin tmotvt tmrw tmrwend tmst /end OUT_MEASUREMENT
 /begin LOC_MEASUREMENT /end LOC_MEASUREMENT
 /begin SUB_FUNCTION /end SUB_FUNCTION
/end FUNCTION
/begin FUNCTION GGTFOL "Gebergröße TFOL Temperaturfühler (Motor-)Oel" /begin DEF_CHARACTERISTIC TOLDE TOLDMN TOLDMX TOLELI TDNSTOL TDTOL /end DEF_CHARACTERISTIC /begin REF_CHARACTERISTIC /end REF_CHARACTERISTIC /begin IN_MEASUREMENT B_pwf B_stend utol /end IN_MEASUREMENT /begin OUT_MEASUREMENT toel toellin /end OUT_MEASUREMENT /begin LOC_MEASUREMENT /end LOC_MEASUREMENT /begin SUB_FUNCTION /end SUB_FUNCTION /end FUNCTION
/begin FUNCTION GGTFUEL "" /begin DEF_CHARACTERISTIC TFUELDE TFUELDMN TFUELDMX TFUELELI TDNSTFUEL TDTFUEL /end DEF_CHARACTERISTIC /begin REF_CHARACTERISTIC /end REF_CHARACTERISTIC /begin IN_MEASUREMENT B_pwf B_stend utfuel /end IN_MEASUREMENT /begin OUT_MEASUREMENT tfuel tfuellin /end OUT_MEASUREMENT /begin LOC_MEASUREMENT /end LOC_MEASUREMENT /begin SUB_FUNCTION /end SUB_FUNCTION /end FUNCTION
/begin FUNCTION GGUB "5.10      Gebergröße Batteriespannung, inkl.Diagnose" /begin DEF_CHARACTERISTIC TDNSUB TDUB UBDE UBDMN1 UBDMN2 UBDMX /end DEF_CHARACTERISTIC /begin REF_CHARACTERISTIC /end REF_CHARACTERISTIC /begin IN_MEASUREMENT B_stend vfzg wub /end IN_MEASUREMENT /begin OUT_MEASUREMENT ub /end OUT_MEASUREMENT /begin LOC_MEASUREMENT /end LOC_MEASUREMENT /begin SUB_FUNCTION /end SUB_FUNCTION /end FUNCTION
/begin FUNCTION GGVFZG "Gebergröße Fahrzeuggeschwindigkeit" /begin DEF_CHARACTERISTIC CLRDISTLAP AIMRU ZFV NDV RLDV TDV TMDV VDMN VFZMN UMRAD /end DEF_CHARACTERISTIC /begin REF_CHARACTERISTIC /end REF_CHARACTERISTIC
 /begin IN_MEASUREMENT B_evloc B_laptrg B_memcardn ltdistkm_w ltdistm_w nmot rl tmot /end IN_MEASUREMENT
 /begin OUT_MEASUREMENT aimvpm bfzgl_b B_vnull distkm_w distlap_w distm_w ltdistcr_w vfzg vfzgmph_w vfzg_w vfzroh_w /end OUT_MEASUREMENT
 /begin LOC_MEASUREMENT /end LOC_MEASUREMENT
 /begin SUB_FUNCTION /end SUB_FUNCTION
/end FUNCTION
/begin FUNCTION GK "Gemischkontrolle" /begin DEF_CHARACTERISTIC FRKAP KFBS /end DEF_CHARACTERISTIC /begin REF_CHARACTERISTIC /end REF_CHARACTERISTIC
 /begin IN_MEASUREMENT fns fr2_w fra2_w fra_w fr_w fstva_w fst_w fwe fwl lamns_w lamsons2_w lamsons_w nmot rka2_w rka_w rkukg_w rl rlp_w /end IN_MEASUREMENT
 /begin OUT_MEASUREMENT kfbs2_w kfbs_w rk2_w rk_w /end OUT_MEASUREMENT
 /begin LOC_MEASUREMENT fvst_w /end LOC_MEASUREMENT
 /begin SUB_FUNCTION /end SUB_FUNCTION
/end FUNCTION
/begin FUNCTION GSMD "Getriebeschaltfunktion" /begin DEF_CHARACTERISTIC UGSSW TDGSH CWGSPOL NMOTMNGS RLMNGS MIREDGSZ /end DEF_CHARACTERISTIC /begin REF_CHARACTERISTIC /end REF_CHARACTERISTIC /begin IN_MEASUREMENT nmot rl ugs_w /end IN_MEASUREMENT /begin OUT_MEASUREMENT B_gs B_gssw migs_w zzgs /end OUT_MEASUREMENT /begin LOC_MEASUREMENT /end LOC_MEASUREMENT /begin SUB_FUNCTION /end SUB_FUNCTION /end FUNCTION
/begin FUNCTION HLSU "Heizung stetige Lambdasonde LSU"
 /begin DEF_CHARACTERISTIC KEDPOS KEDNEG TABGMHS TEDTP TLSUVH TMOTSH TVLSUWU TLSUTA KFLSUED KFLSUED2 /end DEF_CHARACTERISTIC
 /begin REF_CHARACTERISTIC /end REF_CHARACTERISTIC
 /begin IN_MEASUREMENT B_atmtpa B_atmtpa2 B_sbbvk B_sbbvk2 B_st B_stend ml tabgm tabgm2 tans tmot ub /end IN_MEASUREMENT
 /begin OUT_MEASUREMENT B_hsv B_hsv2 B_hsve B_hsve2 /end OUT_MEASUREMENT
 /begin LOC_MEASUREMENT B_hmx B_hmx2 B_stoe B_wu B_wu2 tedi tedi2 tedst tedst2 tedtml tedtml2 tedub tedub2 /end LOC_MEASUREMENT
 /begin SUB_FUNCTION /end SUB_FUNCTION
/end FUNCTION
/begin FUNCTION INDEX_ATS "" /begin DEF_CHARACTERISTIC /end DEF_CHARACTERISTIC /begin REF_CHARACTERISTIC /end REF_CHARACTERISTIC /begin IN_MEASUREMENT /end IN_MEASUREMENT /begin OUT_MEASUREMENT /end OUT_MEASUREMENT /begin LOC_MEASUREMENT /end LOC_MEASUREMENT /begin SUB_FUNCTION /end SUB_FUNCTION /end FUNCTION
/begin FUNCTION INDEX_DDG "" /begin DEF_CHARACTERISTIC /end DEF_CHARACTERISTIC /begin REF_CHARACTERISTIC /end REF_CHARACTERISTIC /begin IN_MEASUREMENT /end IN_MEASUREMENT /begin OUT_MEASUREMENT /end OUT_MEASUREMENT /begin LOC_MEASUREMENT /end LOC_MEASUREMENT /begin SUB_FUNCTION /end SUB_FUNCTION /end FUNCTION
/begin FUNCTION INDEX_DDKG "" /begin DEF_CHARACTERISTIC /end DEF_CHARACTERISTIC /begin REF_CHARACTERISTIC /end REF_CHARACTERISTIC /begin IN_MEASUREMENT /end IN_MEASUREMENT /begin OUT_MEASUREMENT /end OUT_MEASUREMENT /begin LOC_MEASUREMENT /end LOC_MEASUREMENT /begin SUB_FUNCTION /end SUB_FUNCTION /end FUNCTION
/begin FUNCTION INDEX_DDSS "" /begin DEF_CHARACTERISTIC /end DEF_CHARACTERISTIC /begin REF_CHARACTERISTIC /end REF_CHARACTERISTIC /begin IN_MEASUREMENT /end IN_MEASUREMENT /begin OUT_MEASUREMENT /end OUT_MEASUREMENT /begin LOC_MEASUREMENT /end LOC_MEASUREMENT /begin SUB_FUNCTION /end SUB_FUNCTION /end FUNCTION
/begin FUNCTION INDEX_DEKON "" /begin DEF_CHARACTERISTIC /end DEF_CHARACTERISTIC /begin REF_CHARACTERISTIC /end REF_CHARACTERISTIC /begin IN_MEASUREMENT /end IN_MEASUREMENT /begin OUT_MEASUREMENT /end OUT_MEASUREMENT /begin LOC_MEASUREMENT /end LOC_MEASUREMENT /begin SUB_FUNCTION /end SUB_FUNCTION /end FUNCTION
/begin FUNCTION INDEX_DFPM "" /begin DEF_CHARACTERISTIC /end DEF_CHARACTERISTIC /begin REF_CHARACTERISTIC /end REF_CHARACTERISTIC /begin IN_MEASUREMENT /end IN_MEASUREMENT /begin OUT_MEASUREMENT /end OUT_MEASUREMENT /begin LOC_MEASUREMENT /end LOC_MEASUREMENT /begin SUB_FUNCTION /end SUB_FUNCTION /end FUNCTION
/begin FUNCTION INDEX_DHLSU "" /begin DEF_CHARACTERISTIC /end DEF_CHARACTERISTIC /begin REF_CHARACTERISTIC /end REF_CHARACTERISTIC /begin IN_MEASUREMENT /end IN_MEASUREMENT /begin OUT_MEASUREMENT /end OUT_MEASUREMENT /begin LOC_MEASUREMENT /end LOC_MEASUREMENT /begin SUB_FUNCTION /end SUB_FUNCTION /end FUNCTION
/begin FUNCTION INDEX_DKRNT "" /begin DEF_CHARACTERISTIC /end DEF_CHARACTERISTIC /begin REF_CHARACTERISTIC /end REF_CHARACTERISTIC /begin IN_MEASUREMENT /end IN_MEASUREMENT /begin OUT_MEASUREMENT /end OUT_MEASUREMENT /begin LOC_MEASUREMENT /end LOC_MEASUREMENT /begin SUB_FUNCTION /end SUB_FUNCTION /end FUNCTION
/begin FUNCTION INDEX_DKRS "" /begin DEF_CHARACTERISTIC /end DEF_CHARACTERISTIC /begin REF_CHARACTERISTIC /end REF_CHARACTERISTIC /begin IN_MEASUREMENT /end IN_MEASUREMENT /begin OUT_MEASUREMENT /end OUT_MEASUREMENT /begin LOC_MEASUREMENT /end LOC_MEASUREMENT /begin SUB_FUNCTION /end SUB_FUNCTION /end FUNCTION
/begin FUNCTION INDEX_DKRTP "" /begin DEF_CHARACTERISTIC /end DEF_CHARACTERISTIC /begin REF_CHARACTERISTIC /end REF_CHARACTERISTIC /begin IN_MEASUREMENT /end IN_MEASUREMENT /begin OUT_MEASUREMENT /end OUT_MEASUREMENT /begin LOC_MEASUREMENT /end LOC_MEASUREMENT /begin SUB_FUNCTION /end SUB_FUNCTION /end FUNCTION
/begin FUNCTION INDEX_DLSU "" /begin DEF_CHARACTERISTIC /end DEF_CHARACTERISTIC /begin REF_CHARACTERISTIC /end REF_CHARACTERISTIC /begin IN_MEASUREMENT /end IN_MEASUREMENT /begin OUT_MEASUREMENT /end OUT_MEASUREMENT /begin LOC_MEASUREMENT /end LOC_MEASUREMENT /begin SUB_FUNCTION /end SUB_FUNCTION /end FUNCTION
/begin FUNCTION INDEX_DPH "" /begin DEF_CHARACTERISTIC /end DEF_CHARACTERISTIC /begin REF_CHARACTERISTIC /end REF_CHARACTERISTIC /begin IN_MEASUREMENT /end IN_MEASUREMENT /begin OUT_MEASUREMENT /end OUT_MEASUREMENT /begin LOC_MEASUREMENT /end LOC_MEASUREMENT /begin SUB_FUNCTION /end SUB_FUNCTION /end FUNCTION
/begin FUNCTION INDEX_DUMMY_D "" /begin DEF_CHARACTERISTIC /end DEF_CHARACTERISTIC /begin REF_CHARACTERISTIC /end REF_CHARACTERISTIC /begin IN_MEASUREMENT /end IN_MEASUREMENT /begin OUT_MEASUREMENT /end OUT_MEASUREMENT /begin LOC_MEASUREMENT /end LOC_MEASUREMENT /begin SUB_FUNCTION /end SUB_FUNCTION /end FUNCTION
/begin FUNCTION INDEX_GGDSAS "" /begin DEF_CHARACTERISTIC /end DEF_CHARACTERISTIC /begin REF_CHARACTERISTIC /end REF_CHARACTERISTIC /begin IN_MEASUREMENT /end IN_MEASUREMENT /begin OUT_MEASUREMENT /end OUT_MEASUREMENT /begin LOC_MEASUREMENT /end LOC_MEASUREMENT /begin SUB_FUNCTION /end SUB_FUNCTION /end FUNCTION
/begin FUNCTION INDEX_GGPFUEL "" /begin DEF_CHARACTERISTIC /end DEF_CHARACTERISTIC /begin REF_CHARACTERISTIC /end REF_CHARACTERISTIC /begin IN_MEASUREMENT /end IN_MEASUREMENT /begin OUT_MEASUREMENT /end OUT_MEASUREMENT /begin LOC_MEASUREMENT /end LOC_MEASUREMENT /begin SUB_FUNCTION /end SUB_FUNCTION /end FUNCTION
/begin FUNCTION INDEX_GGPOEL "" /begin DEF_CHARACTERISTIC /end DEF_CHARACTERISTIC /begin REF_CHARACTERISTIC /end REF_CHARACTERISTIC /begin IN_MEASUREMENT /end IN_MEASUREMENT /begin OUT_MEASUREMENT /end OUT_MEASUREMENT /begin LOC_MEASUREMENT /end LOC_MEASUREMENT /begin SUB_FUNCTION /end SUB_FUNCTION /end FUNCTION
/begin FUNCTION INDEX_GGTFA "" /begin DEF_CHARACTERISTIC /end DEF_CHARACTERISTIC /begin REF_CHARACTERISTIC /end REF_CHARACTERISTIC /begin IN_MEASUREMENT /end IN_MEASUREMENT /begin OUT_MEASUREMENT /end OUT_MEASUREMENT /begin LOC_MEASUREMENT /end LOC_MEASUREMENT /begin SUB_FUNCTION /end SUB_FUNCTION /end FUNCTION
/begin FUNCTION INDEX_GGTFM "" /begin DEF_CHARACTERISTIC /end DEF_CHARACTERISTIC /begin REF_CHARACTERISTIC /end REF_CHARACTERISTIC /begin IN_MEASUREMENT /end IN_MEASUREMENT /begin OUT_MEASUREMENT /end OUT_MEASUREMENT /begin LOC_MEASUREMENT /end LOC_MEASUREMENT /begin SUB_FUNCTION /end SUB_FUNCTION /end FUNCTION
/begin FUNCTION INDEX_GGTFOL "" /begin DEF_CHARACTERISTIC /end DEF_CHARACTERISTIC /begin REF_CHARACTERISTIC /end REF_CHARACTERISTIC /begin IN_MEASUREMENT /end IN_MEASUREMENT /begin OUT_MEASUREMENT /end OUT_MEASUREMENT /begin LOC_MEASUREMENT /end LOC_MEASUREMENT /begin SUB_FUNCTION /end SUB_FUNCTION /end FUNCTION
/begin FUNCTION INDEX_GGTFUEL "" /begin DEF_CHARACTERISTIC /end DEF_CHARACTERISTIC /begin REF_CHARACTERISTIC /end REF_CHARACTERISTIC /begin IN_MEASUREMENT /end IN_MEASUREMENT /begin OUT_MEASUREMENT /end OUT_MEASUREMENT /begin LOC_MEASUREMENT /end LOC_MEASUREMENT /begin SUB_FUNCTION /end SUB_FUNCTION /end FUNCTION
/begin FUNCTION INDEX_GGUB "" /begin DEF_CHARACTERISTIC /end DEF_CHARACTERISTIC /begin REF_CHARACTERISTIC /end REF_CHARACTERISTIC /begin IN_MEASUREMENT /end IN_MEASUREMENT /begin OUT_MEASUREMENT /end OUT_MEASUREMENT /begin LOC_MEASUREMENT /end LOC_MEASUREMENT /begin SUB_FUNCTION /end SUB_FUNCTION /end FUNCTION
/begin FUNCTION INDEX_GGVFZG "" /begin DEF_CHARACTERISTIC /end DEF_CHARACTERISTIC /begin REF_CHARACTERISTIC /end REF_CHARACTERISTIC /begin IN_MEASUREMENT /end IN_MEASUREMENT /begin OUT_MEASUREMENT /end OUT_MEASUREMENT /begin LOC_MEASUREMENT /end LOC_MEASUREMENT /begin SUB_FUNCTION /end SUB_FUNCTION /end FUNCTION
/begin FUNCTION INDEX_GSMD "" /begin DEF_CHARACTERISTIC /end DEF_CHARACTERISTIC /begin REF_CHARACTERISTIC /end REF_CHARACTERISTIC /begin IN_MEASUREMENT /end IN_MEASUREMENT /begin OUT_MEASUREMENT /end OUT_MEASUREMENT /begin LOC_MEASUREMENT /end LOC_MEASUREMENT /begin SUB_FUNCTION /end SUB_FUNCTION /end FUNCTION
/begin FUNCTION INDEX_KWPDATR "" /begin DEF_CHARACTERISTIC /end DEF_CHARACTERISTIC /begin REF_CHARACTERISTIC /end REF_CHARACTERISTIC /begin IN_MEASUREMENT /end IN_MEASUREMENT /begin OUT_MEASUREMENT /end OUT_MEASUREMENT /begin LOC_MEASUREMENT /end LOC_MEASUREMENT /begin SUB_FUNCTION /end SUB_FUNCTION /end FUNCTION
/begin FUNCTION INDEX_LAPFUNC "" /begin DEF_CHARACTERISTIC /end DEF_CHARACTERISTIC /begin REF_CHARACTERISTIC /end REF_CHARACTERISTIC /begin IN_MEASUREMENT /end IN_MEASUREMENT /begin OUT_MEASUREMENT /end OUT_MEASUREMENT /begin LOC_MEASUREMENT /end LOC_MEASUREMENT /begin SUB_FUNCTION /end SUB_FUNCTION /end FUNCTION
/begin FUNCTION KRDY "Klopfregelung Dynamik"
 /begin DEF_CHARACTERISTIC KFDYES KFDYESOF AZKRLDYN AZKRNDYN NGKRWN DYADMX DYADS DYAMNV DYAVF FKELDYA PZWKRA TMDYNA CWKR NKRUM /end DEF_CHARACTERISTIC
 /begin REF_CHARACTERISTIC SNM16KRUB SRL04DYUB /end REF_CHARACTERISTIC
 /begin IN_MEASUREMENT B_kl B_kr B_ll B_pwf B_tmkr B_zwkraa drlp_w drl_w dwdkba_w esst_snm16krub esst_srl04dyub kek krfkw ngas_w nmot rl rlp_w rl_w stkrnx tmot virkr zzylkr /end IN_MEASUREMENT
 /begin OUT_MEASUREMENT B_krldy B_krldya B_krldyf B_krndy B_wkrdyw drlkrdy dwdkkr dyesofv dyesv lkrnew lkrold ngkrv_w wkrdy zaldy zldy zndy zzwdykr zzwdymd /end OUT_MEASUREMENT
 /begin LOC_MEASUREMENT B_drlkrdy B_kldynrm B_kldystk wkrdya /end LOC_MEASUREMENT
 /begin SUB_FUNCTION /end SUB_FUNCTION
/end FUNCTION
/begin FUNCTION KRKE "Klopferkennung"
 /begin DEF_CHARACTERISTIC ZYRKR KRKFKS KSZA FKELDY FKENDY KRFTP1 KRFTP2 KRFTP3 KRVST REFINI DKEMAP2 DKEMAP3 RKRMX1N RKRMX2N KE1N KE2N KE3N KE4N KE5N KE6N KE7N KE8N /end DEF_CHARACTERISTIC
 /begin REF_CHARACTERISTIC SNM16KRUB /end REF_CHARACTERISTIC
 /begin IN_MEASUREMENT B_c95ks3 B_dnt B_dntb B_dtp B_dtpb B_kr B_krldy B_krndy B_mappos2 B_mappos3 B_phsok B_st esst_snm16krub ikr ikrma ikrme nmot zzylkr /end IN_MEASUREMENT
 /begin OUT_MEASUREMENT B_c95_g0 B_c95_g1 B_c95_g2 B_kl ke kek kek_tst rkr rkrmx rkrmx1w rkrmx2w rkr_tst virkr vkr vkr_tst /end OUT_MEASUREMENT
 /begin LOC_MEASUREMENT /end LOC_MEASUREMENT
 /begin SUB_FUNCTION /end SUB_FUNCTION
/end FUNCTION
/begin FUNCTION KRRA "Klopfregelung mit Adaption der zylinderindividuellen Spätverstellung"
 /begin DEF_CHARACTERISTIC TMKR TMKRA KRNMDY KRLMDY KRWKRUM KRDWA KRALH KRANH KRAN1 KRAN2 KRAN3 KRAN4 KRAN5 KRAN6 KRAN7 LKRN KRMXN KRVFSN KRVFN KRFKN KRAL1N KRAL2N DWKRMSN KRDWSN /end DEF_CHARACTERISTIC
 /begin REF_CHARACTERISTIC SNM16KRUB /end REF_CHARACTERISTIC
 /begin IN_MEASUREMENT B_kl B_krdws B_krldy B_krldya B_krndy B_pwf B_stend esst_snm16krub nmot rl tmot wkrdy zwkrafld zzylkr /end IN_MEASUREMENT
 /begin OUT_MEASUREMENT B_kr B_tmkr B_zwkraa dwkr dwkrz krfkw krvfakt lkrw stkrnx wkr wkra wkratst wkrm wkrma wkr_tst /end OUT_MEASUREMENT
 /begin LOC_MEASUREMENT B_kra B_wkral B_zwkrum dwkrmsw kral1w kral2w krdwsw krmxw krvfsw krvfw stkrlx zkrvf /end LOC_MEASUREMENT
 /begin SUB_FUNCTION /end SUB_FUNCTION
/end FUNCTION
/begin FUNCTION KVA "Ausgangssignal: Kraftstoff-Verbrauchs-Anzeige" /begin DEF_CHARACTERISTIC CLRKVA KVACAL /end DEF_CHARACTERISTIC /begin REF_CHARACTERISTIC FRLFSDP /end REF_CHARACTERISTIC /begin IN_MEASUREMENT B_sa dpus_w te2_w te_w /end IN_MEASUREMENT /begin OUT_MEASUREMENT kvges_w kvlapold_w kvlap_w /end OUT_MEASUREMENT /begin LOC_MEASUREMENT /end LOC_MEASUREMENT /begin SUB_FUNCTION /end SUB_FUNCTION /end FUNCTION
/begin FUNCTION KWP2000F "" /begin DEF_CHARACTERISTIC /end DEF_CHARACTERISTIC /begin REF_CHARACTERISTIC /end REF_CHARACTERISTIC /begin IN_MEASUREMENT bbsu bbsu2 nmot /end IN_MEASUREMENT /begin OUT_MEASUREMENT /end OUT_MEASUREMENT /begin LOC_MEASUREMENT /end LOC_MEASUREMENT /begin SUB_FUNCTION /end SUB_FUNCTION /end FUNCTION
/begin FUNCTION KWPDATR "" /begin DEF_CHARACTERISTIC /end DEF_CHARACTERISTIC /begin REF_CHARACTERISTIC /end REF_CHARACTERISTIC
 /begin IN_MEASUREMENT bbdcy bbwuc B_dcy B_ekp B_evloc B_hsve B_hsve2 B_kl15 B_krdws B_ll B_lr B_mil B_milblk B_vl B_wuc B_zwappl dtc1_high dtc1_low dtc1_stat dtc2_high dtc2_low dtc2_stat dwkrz fcmEnd fr2_w fra2_w fra_w fr_w lamsoni2_w lamsoni_w milstat nmot nmot_w psdss_w rkat2_w rkat_w rkrn_w rl_w tanslin ti_b1 tmotlin uhsv uhsv2 vfzg wdkba wub zwzyl1 /end IN_MEASUREMENT
 /begin OUT_MEASUREMENT bbsu bbsu2 B_csu B_csu2 /end OUT_MEASUREMENT
 /begin LOC_MEASUREMENT /end LOC_MEASUREMENT
 /begin SUB_FUNCTION /end SUB_FUNCTION
/end FUNCTION
/begin FUNCTION KWPDIAG "" /begin DEF_CHARACTERISTIC FTNR RBSWNR DDI RBHWNR /end DEF_CHARACTERISTIC /begin REF_CHARACTERISTIC DATAVERS /end REF_CHARACTERISTIC /begin IN_MEASUREMENT B_kl15 B_nlEEPR cb_13 swOffDlBits /end IN_MEASUREMENT /begin OUT_MEASUREMENT dummy1 /end OUT_MEASUREMENT /begin LOC_MEASUREMENT /end LOC_MEASUREMENT /begin SUB_FUNCTION /end SUB_FUNCTION /end FUNCTION
/begin FUNCTION KWPFLAB "" /begin DEF_CHARACTERISTIC /end DEF_CHARACTERISTIC /begin REF_CHARACTERISTIC /end REF_CHARACTERISTIC /begin IN_MEASUREMENT nmot /end IN_MEASUREMENT /begin OUT_MEASUREMENT /end OUT_MEASUREMENT /begin LOC_MEASUREMENT /end LOC_MEASUREMENT /begin SUB_FUNCTION /end SUB_FUNCTION /end FUNCTION
/begin FUNCTION KWPSTDA "" /begin DEF_CHARACTERISTIC /end DEF_CHARACTERISTIC /begin REF_CHARACTERISTIC /end REF_CHARACTERISTIC /begin IN_MEASUREMENT fcmEnd FCMTab ffzdfp /end IN_MEASUREMENT /begin OUT_MEASUREMENT dtc1_high dtc1_low dtc1_stat dtc2_high dtc2_low dtc2_stat /end OUT_MEASUREMENT /begin LOC_MEASUREMENT /end LOC_MEASUREMENT /begin SUB_FUNCTION /end SUB_FUNCTION /end FUNCTION
/begin FUNCTION LAMBTS "Lambda Bauteileschutz"
 /begin DEF_CHARACTERISTIC SRL12GKUB SNM16GKUB KFLBTS KFFDLBTS DLBTS ZDLBTS TABGBTS DTBTS /end DEF_CHARACTERISTIC
 /begin REF_CHARACTERISTIC ETADZW /end REF_CHARACTERISTIC
 /begin IN_MEASUREMENT dzw_kge etazwist nmot rl tabgm_w zwgru zwopt /end IN_MEASUREMENT
 /begin OUT_MEASUREMENT dlambts_w esst_snm16gkub esst_srl12gkub lambts_w /end OUT_MEASUREMENT
 /begin LOC_MEASUREMENT B_tabgbts detazwbs dzwg etazwg etazwim /end LOC_MEASUREMENT
 /begin SUB_FUNCTION /end SUB_FUNCTION
/end FUNCTION
/begin FUNCTION LAMFAW "2.20      Lambda Fahrerwunsch" /begin DEF_CHARACTERISTIC KFLAMMP1 KFLAMMP2 KFLAMMP3 /end DEF_CHARACTERISTIC /begin REF_CHARACTERISTIC /end REF_CHARACTERISTIC /begin IN_MEASUREMENT B_mappos2 B_mappos3 nmot wdkba /end IN_MEASUREMENT /begin OUT_MEASUREMENT lamfa_w /end OUT_MEASUREMENT /begin LOC_MEASUREMENT /end LOC_MEASUREMENT /begin SUB_FUNCTION /end SUB_FUNCTION /end FUNCTION
/begin FUNCTION LAMKO "Lambdakoordination" /begin DEF_CHARACTERISTIC LAMLGF LAMLGMTM /end DEF_CHARACTERISTIC /begin REF_CHARACTERISTIC STM12ESUB /end REF_CHARACTERISTIC
 /begin IN_MEASUREMENT B_bevab B_bevab2 dlambts_w esst_stm12esub lambts_w lamfa_w lamnswl_w tmot /end IN_MEASUREMENT
 /begin OUT_MEASUREMENT B_lalgf lambas lamsons2_w lamsons_w /end OUT_MEASUREMENT
 /begin LOC_MEASUREMENT B_lamnswl lamlgm lamsubg_w lams_w /end LOC_MEASUREMENT
 /begin SUB_FUNCTION /end SUB_FUNCTION
/end FUNCTION
/begin FUNCTION LAPFUNC "Rundenfunktionen"
 /begin DEF_CHARACTERISTIC TLAPTRGBLK TLAPTRGE DATAVERS TDLAP CWLAPTRG CLRLAPCTR CWCLRLAP VFZLAPMN LLAP FLLAPMAX FLLAPMIN /end DEF_CHARACTERISTIC
 /begin REF_CHARACTERISTIC /end REF_CHARACTERISTIC
 /begin IN_MEASUREMENT B_memcardn B_memlap B_memrec distlap_w kvges_w kvlapold_w kvlap_w vfzg /end IN_MEASUREMENT
 /begin OUT_MEASUREMENT B_lapcan B_lapin B_lappin B_lapset B_laptrg B_laptrgb B_llapmn B_vfzlapmn lapctr laptiap_w laptime laptimeold laptimeo_h laptimeo_l laptime_h laptime_l laptioap_w /end OUT_MEASUREMENT
 /begin LOC_MEASUREMENT /end LOC_MEASUREMENT
 /begin SUB_FUNCTION /end SUB_FUNCTION
/end FUNCTION
/begin FUNCTION LRA "Adaptive Vorsteuerung für Lambdaregelung"
 /begin DEF_CHARACTERISTIC NOLRA FRAMX FRAMN RKATMX RKATMN RKAZMX RKAZMN NRKAB NO1 NU3 N0 MLO1 MLU2 MLO3 RLU2 RLU3 RLO3 ZKFRA ZKRKAT ZKRKAZ /end DEF_CHARACTERISTIC
 /begin REF_CHARACTERISTIC /end REF_CHARACTERISTIC
 /begin IN_MEASUREMENT B_lra B_lra2 B_pwf frm2_w frm_w ml_w nmot rl /end IN_MEASUREMENT
 /begin OUT_MEASUREMENT B_fra B_lrare B_lrare2 B_nofra B_norkat B_norkaz B_rkat B_rkaz fra2_w fra_w rka2_w rkat2_w rkat_w rkaz2_w rkaz_w rka_w /end OUT_MEASUREMENT
 /begin LOC_MEASUREMENT dfrm2_w dfrm_w /end LOC_MEASUREMENT
 /begin SUB_FUNCTION /end SUB_FUNCTION
/end FUNCTION
/begin COMPU_METHOD bfzg_sb_q0p217 "" RAT_FUNC "%6.3" "m/s^2" COEFFS 0 1 0 0 0 0.217 /end COMPU_METHOD
/begin COMPU_METHOD B_TRUE "boolsche Zustände, positive Logik" TAB_VERB "%6.3" "" COMPU_TAB_REF B_TRUE /end COMPU_METHOD
/begin COMPU_VTAB B_TRUE "boolsche Zustände, positive Logik" TAB_VERB 2 0 "----" 1 "TRUE" /end COMPU_VTAB
/begin COMPU_METHOD dez "1 : 1 Umrechnug (dez/hex)" RAT_FUNC "%6.2" "" COEFFS 0 1 0 0 0 1 /end COMPU_METHOD
/begin COMPU_METHOD dezsub1 "" RAT_FUNC "%6.2" "-" COEFFS 0 1 -1 0 0 1 /end COMPU_METHOD
/begin COMPU_METHOD dgrad_uw_q0p015 "" RAT_FUNC "%6.4" "hPa/V" COEFFS 0 65536 0 0 0 1024 /end COMPU_METHOD
/begin COMPU_METHOD dgrad_uw_q0p125 "" RAT_FUNC "%6.5" "bar/V" COEFFS 0 65536 0 0 0 12.8 /end COMPU_METHOD
/begin COMPU_METHOD distm_uw_q0p0 "" RAT_FUNC "%6.2" "m" COEFFS 0 1 0 0 0 1 /end COMPU_METHOD
/begin COMPU_METHOD distm_uw_q0p1 "" RAT_FUNC "%6.3" "m" COEFFS 0 10 0 0 0 1 /end COMPU_METHOD
/begin COMPU_METHOD distm_uw_q2p0 "" RAT_FUNC "%6.2" "m" COEFFS 0 1 0 0 0 2 /end COMPU_METHOD
/begin COMPU_METHOD dist_uw_q0p1 "" RAT_FUNC "%6.2" "km" COEFFS 0 1 0 0 0 1 /end COMPU_METHOD
/begin COMPU_METHOD fak_sb_b0p25 "" RAT_FUNC "%6.4" "-" COEFFS 0 256 0 0 0 0.5 /end COMPU_METHOD
/begin COMPU_METHOD fak_sb_b1 "" RAT_FUNC "%6.4" "-" COEFFS 0 256 0 0 0 2 /end COMPU_METHOD
/begin COMPU_METHOD fak_sw_b1 "" RAT_FUNC "%7.6" "-" COEFFS 0 65536 0 0 0 2 /end COMPU_METHOD
/begin COMPU_METHOD fak_sw_b256 "" RAT_FUNC "%6.4" "-" COEFFS 0 65536 0 0 0 512 /end COMPU_METHOD
/begin COMPU_METHOD fak_sw_b8 "" RAT_FUNC "%6.5" "-" COEFFS 0 65536 0 0 0 16 /end COMPU_METHOD
/begin COMPU_METHOD fak_ub_b0p125 "" RAT_FUNC "%6.5" "-" COEFFS 0 256 0 0 0 0.125 /end COMPU_METHOD
/begin COMPU_METHOD fak_ub_b1 "" RAT_FUNC "%6.4" "-" COEFFS 0 256 0 0 0 1 /end COMPU_METHOD
/begin COMPU_METHOD fak_ub_b16 "" RAT_FUNC "%6.4" "-" COEFFS 0 256 0 0 0 16 /end COMPU_METHOD
/begin COMPU_METHOD fak_ub_b2 "" RAT_FUNC "%6.4" "-" COEFFS 0 256 0 0 0 2 /end COMPU_METHOD
/begin COMPU_METHOD fak_ub_b4 "" RAT_FUNC "%6.4" "-" COEFFS 0 256 0 0 0 4 /end COMPU_METHOD
/begin COMPU_METHOD fak_ub_b8 "" RAT_FUNC "%6.4" "-" COEFFS 0 256 0 0 0 8 /end COMPU_METHOD
/begin COMPU_METHOD fak_uw_b0p5 "" RAT_FUNC "%8.7" "-" COEFFS 0 65536 0 0 0 0.5 /end COMPU_METHOD
/begin COMPU_METHOD fak_uw_b1 "" RAT_FUNC "%7.6" "-" COEFFS 0 65536 0 0 0 1 /end COMPU_METHOD
/begin COMPU_METHOD fak_uw_b16 "" RAT_FUNC "%6.5" "-" COEFFS 0 65536 0 0 0 16 /end COMPU_METHOD
/begin COMPU_METHOD fak_uw_b2 "" RAT_FUNC "%7.6" "-" COEFFS 0 65536 0 0 0 2 /end COMPU_METHOD
/begin COMPU_METHOD fak_uw_b4 "" RAT_FUNC "%7.6" "-" COEFFS 0 65536 0 0 0 4 /end COMPU_METHOD
/begin COMPU_METHOD fak_uw_b64 "" RAT_FUNC "%6.5" "-" COEFFS 0 65536 0 0 0 64 /end COMPU_METHOD
/begin COMPU_METHOD fak_uw_b8 "" RAT_FUNC "%6.5" "-" COEFFS 0 65536 0 0 0 8 /end COMPU_METHOD
/begin COMPU_METHOD fak_uw_q0p001 "" RAT_FUNC "%6.4" "imp/m" COEFFS 0 65536 0 0 0 65.536 /end COMPU_METHOD
/begin COMPU_METHOD fmfkr_dez "" RAT_FUNC "%6.2" "kHz" COEFFS 0 1 0 0 0 1 /end COMPU_METHOD
/begin COMPU_METHOD KennText "" RAT_FUNC "%6.2" "" COEFFS 0 1 0 0 0 1 /end COMPU_METHOD
/begin COMPU_METHOD kw_q2p8125 "" RAT_FUNC "%6.2" "°KW" COEFFS 0 1 0 0 0 2.8125 /end COMPU_METHOD
/begin COMPU_METHOD msd_cons_uw_0 "" RAT_FUNC "%6.5" "ltr" COEFFS 0 65535 0 0 0 26.8435 /end COMPU_METHOD
/begin COMPU_METHOD msd_cons_uw_1 "" RAT_FUNC "%6.4" "ltr" COEFFS 0 65535 0 0 0 858.993 /end COMPU_METHOD
/begin COMPU_METHOD msd_gk1 "" RAT_FUNC "%7.6" "--" COEFFS 0 32768 0 0 0 1 /end COMPU_METHOD
/begin COMPU_METHOD msd_lapnumber_ub_0 "" RAT_FUNC "%6.2" "laps" COEFFS 0 1 0 0 0 1 /end COMPU_METHOD
/begin COMPU_METHOD msd_laptime_ul_0 "" RAT_FUNC "%6.4" "sec" COEFFS 0 100 0 0 0 1 /end COMPU_METHOD
/begin COMPU_METHOD msd_laptime_ul_1 "" RAT_FUNC "%6.0" "sec" COEFFS 0 100 0 0 0 65536 /end COMPU_METHOD
/begin COMPU_METHOD msd_laptime_uw_0 "" RAT_FUNC "%6.4" "sec" COEFFS 0 100 0 0 0 2 /end COMPU_METHOD
/begin COMPU_METHOD msd_laptime_uw_1 "" RAT_FUNC "%6.4" "sec" COEFFS 0 100 0 0 0 1 /end COMPU_METHOD
/begin COMPU_METHOD msd_poil_ub_0 "" RAT_FUNC "%6.4" "bar" COEFFS 0 255 0 0 0 16 /end COMPU_METHOD
/begin COMPU_METHOD msd_text_throttle_1 "" TAB_VERB "%6.3" "" COMPU_TAB_REF msd_text_throttle_1 /end COMPU_METHOD
/begin COMPU_VTAB msd_text_throttle_1 "" TAB_VERB 7 0 "range error" 1 "adjust mode" 2 "value stored" 3 "write error" 4 "normal mode" 5 "read error" 6 "condition error" /end COMPU_VTAB
/begin COMPU_METHOD m_ub_b1020 "" RAT_FUNC "%6.2" "kg/h" COEFFS 0 1 0 0 0 4 /end COMPU_METHOD
/begin COMPU_METHOD m_uw_b6553p5 "" RAT_FUNC "%6.3" "kg/h" COEFFS 0 1 0 0 0 0.1 /end COMPU_METHOD
/begin COMPU_METHOD nmotg_sw_q0p39 "" RAT_FUNC "%6.3" "U/min/s" COEFFS 0 1 0 0 0 0.39063 /end COMPU_METHOD
/begin COMPU_METHOD nmot_ub_q40 "" RAT_FUNC "%6.1" "Upm" COEFFS 0 1 0 0 0 40 /end COMPU_METHOD
/begin COMPU_METHOD p_sw_q0p039 "" RAT_FUNC "%6.4" "hPa" COEFFS 0 256 0 0 0 10 /end COMPU_METHOD
/begin COMPU_METHOD p_ub_q10 "" RAT_FUNC "%6.1" "hPa" COEFFS 0 1 0 0 0 10 /end COMPU_METHOD
/begin COMPU_METHOD p_ub_q5 "" RAT_FUNC "%6.2" "hPa" COEFFS 0 1 0 0 0 5 /end COMPU_METHOD
/begin COMPU_METHOD p_uw_q0p039 "" RAT_FUNC "%6.4" "hPa" COEFFS 0 256 0 0 0 10 /end COMPU_METHOD
/begin COMPU_METHOD relDK_q0p02441 "" RAT_FUNC "%6.4" "% DK" COEFFS 0 65536 0 0 0 1600 /end COMPU_METHOD
/begin COMPU_METHOD relDK_ub_b100 "" RAT_FUNC "%6.3" "% DK" COEFFS 0 255 0 0 0 100 /end COMPU_METHOD
/begin COMPU_METHOD relDK_uw_b100 "" RAT_FUNC "%6.4" "% DK" COEFFS 0 65535 0 0 0 100 /end COMPU_METHOD
/begin COMPU_METHOD rel_sw_b1536 "" RAT_FUNC "%6.4" "%" COEFFS 0 65536 0 0 0 3072 /end COMPU_METHOD
/begin COMPU_METHOD rel_sw_q0p0234 "" RAT_FUNC "%6.4" "%/seg" COEFFS 0 32 0 0 0 0.75 /end COMPU_METHOD
/begin COMPU_METHOD rel_sw_q0p1875 "" RAT_FUNC "%6.3" "%" COEFFS 0 65536 0 0 0 12288 /end COMPU_METHOD
/begin COMPU_METHOD rel_ub_b100 "" RAT_FUNC "%6.3" "%" COEFFS 0 256 0 0 0 100 /end COMPU_METHOD
/begin COMPU_METHOD rel_ub_b127p5 "" RAT_FUNC "%6.3" "%" COEFFS 0 2 0 0 0 1 /end COMPU_METHOD
/begin COMPU_METHOD rel_ub_b1p4941 "" RAT_FUNC "%6.4" "" COEFFS 0 256 0 0 0 1.5 /end COMPU_METHOD
/begin COMPU_METHOD rel_ub_b99p6 "" RAT_FUNC "%6.3" "%" COEFFS 0 256 0 0 0 100 /end COMPU_METHOD
/begin COMPU_METHOD rel_ub_q0p75 "" RAT_FUNC "%6.3" "%" COEFFS 0 1 0 0 0 0.75 /end COMPU_METHOD
/begin COMPU_METHOD rel_uw_b100 "" RAT_FUNC "%6.4" "%" COEFFS 0 65536 0 0 0 100 /end COMPU_METHOD
/begin COMPU_METHOD rel_uw_b256p0 "" RAT_FUNC "%7.6" "-" COEFFS 0 65536 0 0 0 4 /end COMPU_METHOD
/begin COMPU_METHOD rel_uw_b3072 "" RAT_FUNC "%6.4" "%" COEFFS 0 65536 0 0 0 3072 /end COMPU_METHOD
/begin COMPU_METHOD rel_uw_b6144 "" RAT_FUNC "%6.3" "%" COEFFS 0 65536 0 0 0 6144 /end COMPU_METHOD
/begin COMPU_METHOD rel_uw_q0p0234 "" RAT_FUNC "%6.4" "%" COEFFS 0 32 0 0 0 0.75 /end COMPU_METHOD
/begin COMPU_METHOD spgg_sw_b3052 "" RAT_FUNC "%6.3" "V/s" COEFFS 0 1 0 0 0 0.0931323 /end COMPU_METHOD
/begin COMPU_METHOD spg_sw_q0p00488 "" RAT_FUNC "%6.4" "V" COEFFS 0 1024 0 0 0 5 /end COMPU_METHOD
/begin COMPU_METHOD spg_ubatt "" RAT_FUNC "%6.4" "V" COEFFS 0 1 0 0 0 0.0681 /end COMPU_METHOD
/begin COMPU_METHOD spg_ub_b320 "" RAT_FUNC "%6.2" "V" COEFFS 0 1 0 0 0 1.25 /end COMPU_METHOD
/begin COMPU_METHOD spg_ub_b5 "" RAT_FUNC "%6.4" "V" COEFFS 0 255 0 0 0 5 /end COMPU_METHOD
/begin COMPU_METHOD spg_ub_q0p019 "" RAT_FUNC "%6.4" "V" COEFFS 0 256 0 0 0 5 /end COMPU_METHOD
/begin COMPU_METHOD spg_uw_b5 "" RAT_FUNC "%6.4" "V" COEFFS 0 1024 0 0 0 5 /end COMPU_METHOD
/begin COMPU_METHOD spg_uw_q0p00488 "" RAT_FUNC "%6.4" "V" COEFFS 0 1024 0 0 0 5 /end COMPU_METHOD
/begin COMPU_METHOD t100msxs_ub_b255 "" RAT_FUNC "%6.2" "s" COEFFS 0 1 0 0 0 1 /end COMPU_METHOD
/begin COMPU_METHOD t100msxs_ub_b25p5 "" RAT_FUNC "%6.3" "s" COEFFS 0 1 0 0 0 0.1 /end COMPU_METHOD
/begin COMPU_METHOD t100msxs_uw_b6553p5 "" RAT_FUNC "%6.3" "s" COEFFS 0 1 0 0 0 0.1 /end COMPU_METHOD
/begin COMPU_METHOD t10msxs_ub_b2p55 "" RAT_FUNC "%6.4" "s" COEFFS 0 1 0 0 0 0.01 /end COMPU_METHOD
/begin COMPU_METHOD t1sxs_ub_b255 "" RAT_FUNC "%6.2" "s" COEFFS 0 1 0 0 0 1 /end COMPU_METHOD
/begin COMPU_METHOD t200msxs_ub_b51 "" RAT_FUNC "%6.3" "s" COEFFS 0 1 0 0 0 0.2 /end COMPU_METHOD
/begin COMPU_METHOD temp_sb_b0p093 "" RAT_FUNC "%6.5" "Grad C" COEFFS 0 512 0 0 0 0.375 /end COMPU_METHOD
/begin COMPU_METHOD temp_ub_b191p25 "" RAT_FUNC "%6.3" "Grad C" COEFFS 0 1 0 0 0 0.75 /end COMPU_METHOD
/begin COMPU_METHOD temp_ub_q0p75_o48 "" RAT_FUNC "%6.2" "Grad C" COEFFS 0 1 48 0 0 0.75 /end COMPU_METHOD
/begin COMPU_METHOD temp_ub_q1_o40 "" RAT_FUNC "%6.2" "Grad C" COEFFS 0 1 40 0 0 1 /end COMPU_METHOD
/begin COMPU_METHOD temp_ub_q5_o50 "" RAT_FUNC "%6.2" "Grad C" COEFFS 0 1 50 0 0 5 /end COMPU_METHOD
/begin COMPU_METHOD temp_uw_q0p0195 "" RAT_FUNC "%6.4" "Grad C" COEFFS 0 256 0 0 0 5 /end COMPU_METHOD
/begin COMPU_METHOD temp_uw_q0p0195_o50 "" RAT_FUNC "%6.2" "Grad C" COEFFS 0 256 12800 0 0 5 /end COMPU_METHOD
/begin COMPU_METHOD tgrad_ub_b99p6 "" RAT_FUNC "%6.3" "ms/s" COEFFS 0 1 0 0 0 0.390625 /end COMPU_METHOD
/begin COMPU_METHOD tknockcon_sy "" RAT_FUNC "%8.7" "s" COEFFS 0 312500 0 0 0 1 /end COMPU_METHOD
/begin COMPU_METHOD umrad_uw_q0p1 "" RAT_FUNC "%6.2" "mm" COEFFS 0 1 0 0 0 1 /end COMPU_METHOD
/begin COMPU_METHOD vfzgmph_uw_b318 "" RAT_FUNC "%6.4" "mph" COEFFS 0 65536 0 0 0 318.21 /end COMPU_METHOD
/begin COMPU_METHOD vfzg_ub_q0p1 "" RAT_FUNC "%6.3" "Km/h" COEFFS 0 10 0 0 0 1 /end COMPU_METHOD
/begin COMPU_METHOD vfzg_ub_q1p25 "" RAT_FUNC "%6.2" "km/h" COEFFS 0 1 0 0 0 1.25 /end COMPU_METHOD
/begin COMPU_METHOD vfzg_uw_b512 "" RAT_FUNC "%6.4" "km/h" COEFFS 0 65536 0 0 0 512 /end COMPU_METHOD
/begin COMPU_METHOD zk100msxs_ub_b25p5 "" RAT_FUNC "%6.3" "s" COEFFS 0 0 256 0 10 0 /end COMPU_METHOD
/begin COMPU_METHOD zk100msxs_uw_b6553 "" RAT_FUNC "%6.1" "s" COEFFS 0 0 65536 0 10 0 /end COMPU_METHOD
/begin COMPU_METHOD zk10msxs_uw_b655 "" RAT_FUNC "%6.2" "s" COEFFS 0 0 65536 0 100 0 /end COMPU_METHOD
/begin COMPU_METHOD zk200msxs_uw_b5 "" RAT_FUNC "%7.6" "1/s" COEFFS 0 65536 0 0 0 5 /end COMPU_METHOD
/begin COMPU_METHOD zk200msxs_uw_b960 "" RAT_FUNC "%6.4" "%/s" COEFFS 0 65536 0 0 0 960 /end COMPU_METHOD
/begin COMPU_METHOD zw_sb_q0p75 "" RAT_FUNC "%6.3" "grad KW" COEFFS 0 255 0 0 0 191.25 /end COMPU_METHOD
/begin COMPU_METHOD zw_ub_q0p75 "" RAT_FUNC "%6.3" "Grad KW" COEFFS 0 255 0 0 0 191.25 /end COMPU_METHOD
/begin COMPU_METHOD zw_ub_q6 "" RAT_FUNC "%6.2" "Grad KW" COEFFS 0 255 0 0 0 1530 /end COMPU_METHOD
/begin COMPU_METHOD zw_ub_qn0p75 "" RAT_FUNC "%6.4" "grad KW" COEFFS 0 1 0 0 0 -0.75 /end COMPU_METHOD
/begin RECORD_LAYOUT FklWUb FNC_VALUES 1 UBYTE COLUMN_DIR DIRECT /end RECORD_LAYOUT
/begin RECORD_LAYOUT FklWUw FNC_VALUES 1 UWORD COLUMN_DIR DIRECT /end RECORD_LAYOUT
/begin RECORD_LAYOUT GkfWUb FNC_VALUES 1 UBYTE COLUMN_DIR DIRECT /end RECORD_LAYOUT
/begin RECORD_LAYOUT GkfWUw FNC_VALUES 1 UWORD COLUMN_DIR DIRECT /end RECORD_LAYOUT
/begin RECORD_LAYOUT GklWSb FNC_VALUES 1 SBYTE COLUMN_DIR DIRECT /end RECORD_LAYOUT
/begin RECORD_LAYOUT GklWSw FNC_VALUES 1 SWORD COLUMN_DIR DIRECT /end RECORD_LAYOUT
/begin RECORD_LAYOUT GklWUb FNC_VALUES 1 UBYTE COLUMN_DIR DIRECT /end RECORD_LAYOUT
/begin RECORD_LAYOUT GklWUw FNC_VALUES 1 UWORD COLUMN_DIR DIRECT /end RECORD_LAYOUT
/begin RECORD_LAYOUT KfAxUbAyUbSstxUbSstyUbWSb NO_AXIS_PTS_X 1 UBYTE NO_AXIS_PTS_Y 2 UBYTE AXIS_PTS_X 3 UBYTE INDEX_INCR DIRECT AXIS_PTS_Y 4 UBYTE INDEX_INCR DIRECT FNC_VALUES 5 SBYTE COLUMN_DIR DIRECT /end RECORD_LAYOUT
/begin RECORD_LAYOUT KfAxUbAyUbSstxUbSstyUbWUb NO_AXIS_PTS_X 1 UBYTE NO_AXIS_PTS_Y 2 UBYTE AXIS_PTS_X 3 UBYTE INDEX_INCR DIRECT AXIS_PTS_Y 4 UBYTE INDEX_INCR DIRECT FNC_VALUES 5 UBYTE COLUMN_DIR DIRECT /end RECORD_LAYOUT
/begin RECORD_LAYOUT KlAUbSstUbWSb NO_AXIS_PTS_X 1 UBYTE AXIS_PTS_X 2 UBYTE INDEX_INCR DIRECT FNC_VALUES 3 SBYTE COLUMN_DIR DIRECT /end RECORD_LAYOUT
/begin RECORD_LAYOUT KlAUbSstUbWUb NO_AXIS_PTS_X 1 UBYTE AXIS_PTS_X 2 UBYTE INDEX_INCR DIRECT FNC_VALUES 3 UBYTE COLUMN_DIR DIRECT /end RECORD_LAYOUT
/begin RECORD_LAYOUT KlAUbSstUbWUw NO_AXIS_PTS_X 1 UBYTE AXIS_PTS_X 2 UBYTE INDEX_INCR DIRECT FNC_VALUES 3 UWORD COLUMN_DIR DIRECT /end RECORD_LAYOUT
/begin RECORD_LAYOUT KlAUwSstUwWUw NO_AXIS_PTS_X 1 UWORD AXIS_PTS_X 2 UWORD INDEX_INCR DIRECT FNC_VALUES 3 UWORD COLUMN_DIR DIRECT /end RECORD_LAYOUT
/begin RECORD_LAYOUT KwbUb FNC_VALUES 1 UBYTE COLUMN_DIR DIRECT /end RECORD_LAYOUT
/begin RECORD_LAYOUT KwSb FNC_VALUES 1 SBYTE COLUMN_DIR DIRECT /end RECORD_LAYOUT
/begin RECORD_LAYOUT KwSw FNC_VALUES 1 SWORD COLUMN_DIR DIRECT /end RECORD_LAYOUT
/begin RECORD_LAYOUT KwUb FNC_VALUES 1 UBYTE COLUMN_DIR DIRECT /end RECORD_LAYOUT
/begin RECORD_LAYOUT KwUw FNC_VALUES 1 UWORD COLUMN_DIR DIRECT /end RECORD_LAYOUT
/begin RECORD_LAYOUT SstAUbSstUb NO_AXIS_PTS_X 1 UBYTE AXIS_PTS_X 2 UBYTE INDEX_INCR DIRECT /end RECORD_LAYOUT
/end MODULE
/end PROJECT
