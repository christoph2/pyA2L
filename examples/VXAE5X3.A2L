/begin PROJECT DPU-2XX "Visteon Diesel"
/begin HEADER " " VERSION "1" PROJECT_NO Global /end HEADER
/begin MODULE ENGINE "International Engine Controller"
/begin MOD_COMMON " " BYTE_ORDER MSB_FIRST /end MOD_COMMON
/begin CHARACTERISTIC PNPM_LVL "NUMBER OF PEDAL COMPARE FAILURE COUNTS FOR FLAG TO SET" VALUE 0x5676D SD_UBYTE 0 SC_PNPM_LVL 1 254 /end CHARACTERISTIC
/begin COMPU_METHOD SC_PNPM_LVL "PNPM_LVL conversion" RAT_FUNC "%3.0" "Unitless" COEFFS 0 1 0 0 0 1 /end COMPU_METHOD
/begin MEASUREMENT POKE_CNT "Number of poke attempts to ram" UBYTE MC_POKE_CNT 0 0 0 0 ECU_ADDRESS 0x3FABF8 /end MEASUREMENT
/begin COMPU_METHOD MC_POKE_CNT "POKE_CNT conversion" RAT_FUNC "%3.0" "Unitless" COEFFS 0 1 0 0 0 1 /end COMPU_METHOD
/begin CHARACTERISTIC POKE_ENA "RAM poke enable flag for PTEC" VALUE 0x5790F SD_UBYTE 0 SC_POKE_ENA 0 1 /end CHARACTERISTIC
/begin COMPU_METHOD SC_POKE_ENA "POKE_ENA conversion" RAT_FUNC "%3.0" "Unitless" COEFFS 0 1 0 0 0 1 /end COMPU_METHOD
/begin CHARACTERISTIC POKE_F "Floating point value to poke for PTEC RAM" VALUE 0x57908 SD_FLOAT32_IEEE 0 SC_POKE_F -32000 64000 /end CHARACTERISTIC
/begin COMPU_METHOD SC_POKE_F "POKE_F conversion" RAT_FUNC "%10.5" "Unitless" COEFFS 0 1 0 0 0 1 /end COMPU_METHOD
/begin CHARACTERISTIC POKE_I "Interger value to poke for PTEC RAM" VALUE 0x57904 SD_SLONG 0 SC_POKE_I -2.14748e+09 2.14748e+09 /end CHARACTERISTIC
/begin COMPU_METHOD SC_POKE_I "POKE_I conversion" RAT_FUNC "%10.0" "Unitless" COEFFS 0 1 0 0 0 1 /end COMPU_METHOD
/begin CHARACTERISTIC POKE_OFF "Offset into RAM for parpoke" VALUE 0x5790C SD_UWORD 0 SC_POKE_OFF 0 28671 /end CHARACTERISTIC
/begin COMPU_METHOD SC_POKE_OFF "POKE_OFF conversion" RAT_FUNC "%5.0" "Unitless" COEFFS 0 1 0 0 0 1 /end COMPU_METHOD
/begin MEASUREMENT POKE_STATUS "Status of last RAM poke; 0= success, 1= bad address, 2=bad type, 3=bad alignment, 4=Illegal float value" UBYTE MC_POKE_STATUS 0 0 0 0 ECU_ADDRESS 0x3FABF9 /end MEASUREMENT
/begin COMPU_METHOD MC_POKE_STATUS "POKE_STATUS conversion" RAT_FUNC "%3.0" "Unitless" COEFFS 0 1 0 0 0 1 /end COMPU_METHOD
/begin CHARACTERISTIC POKE_TYPE "Type of ram to be poked; 0=float,1=int byte, 2= int hword, 4 = int word" VALUE 0x5790E SD_UBYTE 0 SC_POKE_TYPE 0 4 /end CHARACTERISTIC
/begin COMPU_METHOD SC_POKE_TYPE "POKE_TYPE conversion" RAT_FUNC "%3.0" "Unitless" COEFFS 0 1 0 0 0 1 /end COMPU_METHOD
/begin CHARACTERISTIC PP23_SCDELT "DIFFERENCE THRESHOLD BETWEEN ipps2-3 COMPARISONS FOR short circuit" VALUE 0x56754 SD_FLOAT32_IEEE 0 SC_PP23_SCDELT 0 1023 /end CHARACTERISTIC
/begin COMPU_METHOD SC_PP23_SCDELT "PP23_SCDELT conversion" RAT_FUNC "%10.5" "unitless" COEFFS 0 1 0 0 0 1 /end COMPU_METHOD
/begin CHARACTERISTIC PPC_CHECKSUM "ROM Checksum for PPC Applications" VALUE 0x57952 SD_UWORD 0 SC_PPC_CHECKSUM 0 65535 /end CHARACTERISTIC
/begin COMPU_METHOD SC_PPC_CHECKSUM "PPC_CHECKSUM conversion" RAT_FUNC "%5.0" "unitless" COEFFS 0 1 0 0 0 1 /end COMPU_METHOD
/begin CHARACTERISTIC PPC_CHIPID "Chip ID" VALUE 0x57950 SD_UWORD 0 SC_PPC_CHIPID 0 65535 /end CHARACTERISTIC
/begin COMPU_METHOD SC_PPC_CHIPID "PPC_CHIPID conversion" RAT_FUNC "%5.0" "unitless" COEFFS 0 1 0 0 0 1 /end COMPU_METHOD
/begin CHARACTERISTIC PPC_SUM_END1 "End of 1st region used to calculate checksum" VALUE 0x57B38 SD_ULONG 0 SC_PPC_SUM_END1 0 1e+07 /end CHARACTERISTIC
/begin COMPU_METHOD SC_PPC_SUM_END1 "PPC_SUM_END1 conversion" RAT_FUNC "%10.0" "unitless" COEFFS 0 1 0 0 0 1 /end COMPU_METHOD
/begin CHARACTERISTIC PPC_SUM_START1 "Start addr of 1st region for checksum calculation" VALUE 0x57B3C SD_ULONG 0 SC_PPC_SUM_START1 0 1e+07 /end CHARACTERISTIC
/begin COMPU_METHOD SC_PPC_SUM_START1 "PPC_SUM_START1 conversion" RAT_FUNC "%10.0" "unitless" COEFFS 0 1 0 0 0 1 /end COMPU_METHOD
/begin MEASUREMENT PPFMFLG_A[0] "ARRAY OF PEDAL POSITION  FAILURE FLAGS" UBYTE MC_PPFMFLG_A 0 0 0 1 ECU_ADDRESS 0x3FA19C /end MEASUREMENT
/begin COMPU_METHOD MC_PPFMFLG_A "PPFMFLG_A conversion" RAT_FUNC "%3.0" "Unitless" COEFFS 0 1 0 0 0 1 /end COMPU_METHOD
/begin MEASUREMENT PPFMFLG_A[1] "ARRAY OF PEDAL POSITION  FAILURE FLAGS" UBYTE MC_PPFMFLG_A 0 0 0 1 ECU_ADDRESS 0x3FA19D /end MEASUREMENT
/begin MEASUREMENT PPFMFLG_A[2] "ARRAY OF PEDAL POSITION  FAILURE FLAGS" UBYTE MC_PPFMFLG_A 0 0 0 1 ECU_ADDRESS 0x3FA19E /end MEASUREMENT
/begin MEASUREMENT PPS "Accelerator pedal position sensor value." FLOAT32_IEEE MC_PPS 0 0 0 0 ECU_ADDRESS 0x3FA190 /end MEASUREMENT
/begin COMPU_METHOD MC_PPS "PPS conversion" RAT_FUNC "%10.5" "Unitless" COEFFS 0 1 0 0 0 1 /end COMPU_METHOD
/begin MEASUREMENT PPSBAR_A[0] "ARRAY OF PPS_BAR VALUES FOR PPS SENSORS" FLOAT32_IEEE MC_PPSBAR_A 0 0 0 1023 ECU_ADDRESS 0x3F9A3C /end MEASUREMENT
/begin COMPU_METHOD MC_PPSBAR_A "PPSBAR_A conversion" RAT_FUNC "%10.5" "unitless" COEFFS 0 1 0 0 0 1 /end COMPU_METHOD
/begin MEASUREMENT PPSBAR_A[1] "ARRAY OF PPS_BAR VALUES FOR PPS SENSORS" FLOAT32_IEEE MC_PPSBAR_A 0 0 0 1023 ECU_ADDRESS 0x3F9A40 /end MEASUREMENT
/begin MEASUREMENT PPSBAR_A[2] "ARRAY OF PPS_BAR VALUES FOR PPS SENSORS" FLOAT32_IEEE MC_PPSBAR_A 0 0 0 1023 ECU_ADDRESS 0x3F9A44 /end MEASUREMENT
/begin CHARACTERISTIC PPS_ACRATE_OFF "Instantaneous pedal position delta change above which launch cutout logic is active" VALUE 0x5626C SD_FLOAT32_IEEE 0 SC_PPS_ACRATE_OFF 0 1023.98 /end CHARACTERISTIC
/begin COMPU_METHOD SC_PPS_ACRATE_OFF "PPS_ACRATE_OFF conversion" RAT_FUNC "%10.5" "ADct" COEFFS 0 1 0 0 0 1 /end COMPU_METHOD
/begin CHARACTERISTIC PPS_AC_ON "Pedal position below which A/C launch cutout is deactivated" VALUE 0x5625C SD_FLOAT32_IEEE 0 SC_PPS_AC_ON 0 1023.98 /end CHARACTERISTIC
/begin COMPU_METHOD SC_PPS_AC_ON "PPS_AC_ON conversion" RAT_FUNC "%10.5" "ADct" COEFFS 0 1 0 0 0 1 /end COMPU_METHOD
/begin MEASUREMENT PPS_A[0] "ARRAY OF PPS VALUES FOR PPS SENSORS" FLOAT32_IEEE MC_PPS_A 0 0 0 1023 ECU_ADDRESS 0x3F9A48 /end MEASUREMENT
/begin COMPU_METHOD MC_PPS_A "PPS_A conversion" RAT_FUNC "%10.5" "ADct/V" COEFFS 0 1 0 0 0 1 /end COMPU_METHOD
/begin MEASUREMENT PPS_A[1] "ARRAY OF PPS VALUES FOR PPS SENSORS" FLOAT32_IEEE MC_PPS_A 0 0 0 1023 ECU_ADDRESS 0x3F9A4C /end MEASUREMENT
/begin MEASUREMENT PPS_A[2] "ARRAY OF PPS VALUES FOR PPS SENSORS" FLOAT32_IEEE MC_PPS_A 0 0 0 1023 ECU_ADDRESS 0x3F9A50 /end MEASUREMENT
/begin CHARACTERISTIC PPS_DELTA "Accelerator pedal position A/D counts, CT/PT delta value." VALUE 0x56786 SD_UWORD 0 SC_PPS_DELTA 0 1023 /end CHARACTERISTIC
/begin COMPU_METHOD SC_PPS_DELTA "PPS_DELTA conversion" RAT_FUNC "%5.0" "ADct" COEFFS 0 1 0 0 0 1 /end COMPU_METHOD
/begin CHARACTERISTIC PPS_DELTA_CH "Accelerator pedal position A/D counts, PPS_DELTA plus hysteresis value." VALUE 0x56784 SD_UWORD 0 SC_PPS_DELTA_CH 0 1023 /end CHARACTERISTIC
/begin COMPU_METHOD SC_PPS_DELTA_CH "PPS_DELTA_CH conversion" RAT_FUNC "%5.0" "ADct" COEFFS 0 1 0 0 0 1 /end COMPU_METHOD
/begin CHARACTERISTIC PPS_IDLE_MAX "Idle window maximum pedal position value" VALUE 0x5673C SD_FLOAT32_IEEE 0 SC_PPS_IDLE_MAX 0 1023 /end CHARACTERISTIC
/begin COMPU_METHOD SC_PPS_IDLE_MAX "PPS_IDLE_MAX conversion" RAT_FUNC "%10.5" "ADct" COEFFS 0 1 0 0 0 1 /end COMPU_METHOD
/begin CHARACTERISTIC PPS_IDLE_MIN "Idle window minimum pedal position value" VALUE 0x56740 SD_FLOAT32_IEEE 0 SC_PPS_IDLE_MIN 0 1023 /end CHARACTERISTIC
/begin COMPU_METHOD SC_PPS_IDLE_MIN "PPS_IDLE_MIN conversion" RAT_FUNC "%10.5" "ADct" COEFFS 0 1 0 0 0 1 /end COMPU_METHOD
/begin CHARACTERISTIC PPS_IDLE_TR_DEF "" VALUE 0x56750 SD_FLOAT32_IEEE 0 SC_PPS_IDLE_TR_DEF 0 1023 /end CHARACTERISTIC
/begin COMPU_METHOD SC_PPS_IDLE_TR_DEF "PPS_IDLE_TR_DEF conversion" RAT_FUNC "%10.5" "unitless" COEFFS 0 1 0 0 0 1 /end COMPU_METHOD
/begin MEASUREMENT PPS_IDLE_TR_PT "" FLOAT32_IEEE MC_PPS_IDLE_TR_PT 0 0 0 0 ECU_ADDRESS 0x3FA180 /end MEASUREMENT
/begin COMPU_METHOD MC_PPS_IDLE_TR_PT "PPS_IDLE_TR_PT conversion" RAT_FUNC "%10.5" "Unitless" COEFFS 0 1 0 0 0 1 /end COMPU_METHOD
/begin CHARACTERISTIC PPS_LAUNCH_SW "Flag to switch PPS launch in A/C" VALUE 0x562A8 SD_UBYTE 0 SC_PPS_LAUNCH_SW 0 1 /end CHARACTERISTIC
/begin COMPU_METHOD SC_PPS_LAUNCH_SW "PPS_LAUNCH_SW conversion" RAT_FUNC "%3.0" "flag" COEFFS 0 1 0 0 0 1 /end COMPU_METHOD
/begin CHARACTERISTIC PPS_LCH_CUT "Pedal position above which launch cutout is active" VALUE 0x56270 SD_FLOAT32_IEEE 0 SC_PPS_LCH_CUT 0 1023.98 /end CHARACTERISTIC
/begin COMPU_METHOD SC_PPS_LCH_CUT "PPS_LCH_CUT conversion" RAT_FUNC "%10.5" "ADct" COEFFS 0 1 0 0 0 1 /end COMPU_METHOD
/begin MEASUREMENT PPS_RATCH_A[0] "ARRAY OF PPS_RATCH VALUES FOR PPS SENSORS" FLOAT32_IEEE MC_PPS_RATCH_A 0 0 0 1023 ECU_ADDRESS 0x3F9A54 /end MEASUREMENT
/begin COMPU_METHOD MC_PPS_RATCH_A "PPS_RATCH_A conversion" RAT_FUNC "%10.5" "unitless" COEFFS 0 1 0 0 0 1 /end COMPU_METHOD
/begin MEASUREMENT PPS_RATCH_A[1] "ARRAY OF PPS_RATCH VALUES FOR PPS SENSORS" FLOAT32_IEEE MC_PPS_RATCH_A 0 0 0 1023 ECU_ADDRESS 0x3F9A58 /end MEASUREMENT
/begin MEASUREMENT PPS_RATCH_A[2] "ARRAY OF PPS_RATCH VALUES FOR PPS SENSORS" FLOAT32_IEEE MC_PPS_RATCH_A 0 0 0 1023 ECU_ADDRESS 0x3F9A5C /end MEASUREMENT
/begin CHARACTERISTIC PPS_RATCH_A_DEF[0] "" VALUE 0x4217C SD_FLOAT32_IEEE 0 SC_PPS_RATCH_A_DEF 0 1023 /end CHARACTERISTIC
/begin COMPU_METHOD SC_PPS_RATCH_A_DEF "PPS_RATCH_A_DEF conversion" RAT_FUNC "%10.5" "unitless" COEFFS 0 1 0 0 0 1 /end COMPU_METHOD
/begin CHARACTERISTIC PPS_RATCH_A_DEF[1] "" VALUE 0x42180 SD_FLOAT32_IEEE 0 SC_PPS_RATCH_A_DEF 0 1023 /end CHARACTERISTIC
/begin CHARACTERISTIC PPS_RATCH_A_DEF[2] "" VALUE 0x42184 SD_FLOAT32_IEEE 0 SC_PPS_RATCH_A_DEF 0 1023 /end CHARACTERISTIC
/begin CHARACTERISTIC PPS_RATCH_A_MIN[0] "" VALUE 0x42170 SD_FLOAT32_IEEE 0 SC_PPS_RATCH_A_MIN 0 1023 /end CHARACTERISTIC
/begin COMPU_METHOD SC_PPS_RATCH_A_MIN "PPS_RATCH_A_MIN conversion" RAT_FUNC "%10.5" "unitless" COEFFS 0 1 0 0 0 1 /end COMPU_METHOD
/begin CHARACTERISTIC PPS_RATCH_A_MIN[1] "" VALUE 0x42174 SD_FLOAT32_IEEE 0 SC_PPS_RATCH_A_MIN 0 1023 /end CHARACTERISTIC
/begin CHARACTERISTIC PPS_RATCH_A_MIN[2] "" VALUE 0x42178 SD_FLOAT32_IEEE 0 SC_PPS_RATCH_A_MIN 0 1023 /end CHARACTERISTIC
/begin CHARACTERISTIC PPS_RATIV_A[0] "INITIAL VALUE OF  PEDAL  RATCH  UNITS ARE COUNTS" VALUE 0x42164 SD_FLOAT32_IEEE 0 SC_PPS_RATIV_A 0 1023 /end CHARACTERISTIC
/begin COMPU_METHOD SC_PPS_RATIV_A "PPS_RATIV_A conversion" RAT_FUNC "%10.5" "ADCT" COEFFS 0 1 0 0 0 1 /end COMPU_METHOD
/begin CHARACTERISTIC PPS_RATIV_A[1] "INITIAL VALUE OF  PEDAL  RATCH  UNITS ARE COUNTS" VALUE 0x42168 SD_FLOAT32_IEEE 0 SC_PPS_RATIV_A 0 1023 /end CHARACTERISTIC
/begin CHARACTERISTIC PPS_RATIV_A[2] "INITIAL VALUE OF  PEDAL  RATCH  UNITS ARE COUNTS" VALUE 0x4216C SD_FLOAT32_IEEE 0 SC_PPS_RATIV_A 0 1023 /end CHARACTERISTIC
/begin MEASUREMENT PPS_REL "Minimum relative accelerator pedal position." FLOAT32_IEEE MC_PPS_REL 0 0 0 0 ECU_ADDRESS 0x3FA198 /end MEASUREMENT
/begin COMPU_METHOD MC_PPS_REL "PPS_REL conversion" RAT_FUNC "%10.5" "Unitless" COEFFS 0 1 0 0 0 1 /end COMPU_METHOD
/begin MEASUREMENT PPS_REL_A[0] "ARRAY OF PPS VALUES FOR PPS SENSORS" FLOAT32_IEEE MC_PPS_REL_A 0 0 0 1023 ECU_ADDRESS 0x3F9A60 /end MEASUREMENT
/begin COMPU_METHOD MC_PPS_REL_A "PPS_REL_A conversion" RAT_FUNC "%10.5" "unitless" COEFFS 0 1 0 0 0 1 /end COMPU_METHOD
/begin MEASUREMENT PPS_REL_A[1] "ARRAY OF PPS VALUES FOR PPS SENSORS" FLOAT32_IEEE MC_PPS_REL_A 0 0 0 1023 ECU_ADDRESS 0x3F9A64 /end MEASUREMENT
/begin MEASUREMENT PPS_REL_A[2] "ARRAY OF PPS VALUES FOR PPS SENSORS" FLOAT32_IEEE MC_PPS_REL_A 0 0 0 1023 ECU_ADDRESS 0x3F9A68 /end MEASUREMENT
/begin MEASUREMENT PPS_REL_FIL "Filtered minimum relative accelerator pedal position." FLOAT32_IEEE MC_PPS_REL_FIL 0 0 0 0 ECU_ADDRESS 0x3FA194 /end MEASUREMENT
/begin COMPU_METHOD MC_PPS_REL_FIL "PPS_REL_FIL conversion" RAT_FUNC "%10.5" "Unitless" COEFFS 0 1 0 0 0 1 /end COMPU_METHOD
/begin CHARACTERISTIC PPS_REL_MAX_DEF "" VALUE 0x5674C SD_FLOAT32_IEEE 0 SC_PPS_REL_MAX_DEF 0 1023 /end CHARACTERISTIC
/begin COMPU_METHOD SC_PPS_REL_MAX_DEF "PPS_REL_MAX_DEF conversion" RAT_FUNC "%10.5" "unitless" COEFFS 0 1 0 0 0 1 /end COMPU_METHOD
/begin MEASUREMENT PPS_REL_MAX_VAR "" FLOAT32_IEEE MC_PPS_REL_MAX_VAR 0 0 0 0 ECU_ADDRESS 0x3FA17C /end MEASUREMENT
/begin COMPU_METHOD MC_PPS_REL_MAX_VAR "PPS_REL_MAX_VAR conversion" RAT_FUNC "%10.5" "Unitless" COEFFS 0 1 0 0 0 1 /end COMPU_METHOD
/begin CHARACTERISTIC PPS_SCALE1 "MULTIPLIER FOR PPS_REL ON SENSOR 1" VALUE 0x56764 SD_FLOAT32_IEEE 0 SC_PPS_SCALE1 0 2 /end CHARACTERISTIC
/begin COMPU_METHOD SC_PPS_SCALE1 "PPS_SCALE1 conversion" RAT_FUNC "%10.5" "Unitless" COEFFS 0 1 0 0 0 1 /end COMPU_METHOD
/begin CHARACTERISTIC PPS_SCALE2 "MULTIPLIER FOR PPS_REL ON SENSOR 2" VALUE 0x56760 SD_FLOAT32_IEEE 0 SC_PPS_SCALE2 0 2 /end CHARACTERISTIC
/begin COMPU_METHOD SC_PPS_SCALE2 "PPS_SCALE2 conversion" RAT_FUNC "%10.5" "Unitless" COEFFS 0 1 0 0 0 1 /end COMPU_METHOD
/begin CHARACTERISTIC PPS_SCALE3 "MULTIPLIER FOR PPS_REL ON SENSOR 3" VALUE 0x5675C SD_FLOAT32_IEEE 0 SC_PPS_SCALE3 0 2 /end CHARACTERISTIC
/begin COMPU_METHOD SC_PPS_SCALE3 "PPS_SCALE3 conversion" RAT_FUNC "%10.5" "Unitless" COEFFS 0 1 0 0 0 1 /end COMPU_METHOD
/begin MEASUREMENT PPS_STATE "PPS SENSOR FAILURE INDICATOR" UBYTE MC_PPS_STATE 0 0 0 0 ECU_ADDRESS 0x3FA1B5 /end MEASUREMENT
/begin COMPU_METHOD MC_PPS_STATE "PPS_STATE conversion" RAT_FUNC "%3.0" "Unitless" COEFFS 0 1 0 0 0 1 /end COMPU_METHOD
/begin MEASUREMENT PPS_TC_VAR "Accelerator pedal position filter time constant" FLOAT32_IEEE MC_PPS_TC_VAR 0 0 0 0 ECU_ADDRESS 0x3FA184 /end MEASUREMENT
/begin COMPU_METHOD MC_PPS_TC_VAR "PPS_TC_VAR conversion" RAT_FUNC "%10.5" "Unitless" COEFFS 0 1 0 0 0 1 /end COMPU_METHOD
/begin CHARACTERISTIC PPS_THBP2 "Accelerator pedal position PT/WOT breakpoint." VALUE 0x56782 SD_UWORD 0 SC_PPS_THBP2 0 1023 /end CHARACTERISTIC
/begin COMPU_METHOD SC_PPS_THBP2 "PPS_THBP2 conversion" RAT_FUNC "%5.0" "ADct" COEFFS 0 1 0 0 0 1 /end COMPU_METHOD
/begin CHARACTERISTIC PPS_THBP2_SH "Accelerator pedal position  A/D counts, PPS_THBP2 plus hysteresis." VALUE 0x56780 SD_UWORD 0 SC_PPS_THBP2_SH 0 1023 /end CHARACTERISTIC
/begin COMPU_METHOD SC_PPS_THBP2_SH "PPS_THBP2_SH conversion" RAT_FUNC "%5.0" "ADct" COEFFS 0 1 0 0 0 1 /end COMPU_METHOD
/begin CHARACTERISTIC PP_DELTA "DIFFERENCE THRESHOLD BETWEEN PPS_REL COMPARISONS FOR FAILURE" VALUE 0x56758 SD_FLOAT32_IEEE 0 SC_PP_DELTA 0 1023 /end CHARACTERISTIC
/begin COMPU_METHOD SC_PP_DELTA "PP_DELTA conversion" RAT_FUNC "%10.5" "unitless" COEFFS 0 1 0 0 0 1 /end COMPU_METHOD
/begin CHARACTERISTIC PP_NUM "INDICATOR OF WHICH PPS SENSOR IS INVERTED SLOPE" VALUE 0x5676C SD_UBYTE 0 SC_PP_NUM 0 2 /end CHARACTERISTIC
/begin COMPU_METHOD SC_PP_NUM "PP_NUM conversion" RAT_FUNC "%3.0" "Unitless" COEFFS 0 1 0 0 0 1 /end COMPU_METHOD
/begin MEASUREMENT PREV_BP_MALF_STATUS_FLG "Indicates malf failure during previous cycle" UBYTE MC_PREV_BP_MALF_STATUS_FLG 0 0 0 0 ECU_ADDRESS 0x3F9F4D /end MEASUREMENT
/begin COMPU_METHOD MC_PREV_BP_MALF_STATUS_FLG "PREV_BP_MALF_STATUS_FLG conversion" RAT_FUNC "%3.0" "Unitless" COEFFS 0 1 0 0 0 1 /end COMPU_METHOD
/begin MEASUREMENT PREV_EBP_MALF_STATUS_FLG "Indicate malf failure during previouse cycle" UBYTE MC_PREV_EBP_MALF_STATUS_FLG 0 0 0 0 ECU_ADDRESS 0x3FA211 /end MEASUREMENT
/begin COMPU_METHOD MC_PREV_EBP_MALF_STATUS_FLG "PREV_EBP_MALF_STATUS_FLG conversion" RAT_FUNC "%3.0" "Unitless" COEFFS 0 1 0 0 0 1 /end COMPU_METHOD
/begin MEASUREMENT PREV_ECT_MALF_STATUS_FLG "indicates malf failure during previous cycle" UBYTE MC_PREV_ECT_MALF_STATUS_FLG 0 0 0 0 ECU_ADDRESS 0x3F9FDE /end MEASUREMENT
/begin COMPU_METHOD MC_PREV_ECT_MALF_STATUS_FLG "PREV_ECT_MALF_STATUS_FLG conversion" RAT_FUNC "%3.0" "Unitless" COEFFS 0 1 0 0 0 1 /end COMPU_METHOD
/begin MEASUREMENT PREV_EGRP_MALF_STATUS_FLG "Indicates egrp malf failure during previous cycle" UBYTE MC_PREV_EGRP_MALF_STATUS_FLG 0 0 0 0 ECU_ADDRESS 0x3FA005 /end MEASUREMENT
/begin COMPU_METHOD MC_PREV_EGRP_MALF_STATUS_FLG "PREV_EGRP_MALF_STATUS_FLG conversion" RAT_FUNC "%3.0" "Unitless" COEFFS 0 1 0 0 0 1 /end COMPU_METHOD
/begin MEASUREMENT PREV_EOT_MALF_STATUS_FLG "indicates malf failure during previous cycle" UBYTE MC_PREV_EOT_MALF_STATUS_FLG 0 0 0 0 ECU_ADDRESS 0x3F9F9E /end MEASUREMENT
/begin COMPU_METHOD MC_PREV_EOT_MALF_STATUS_FLG "PREV_EOT_MALF_STATUS_FLG conversion" RAT_FUNC "%3.0" "Unitless" COEFFS 0 1 0 0 0 1 /end COMPU_METHOD
/begin MEASUREMENT PREV_IAT_MALF_STATUS_FLG "Indicates malf failure during previous cycle" UBYTE MC_PREV_IAT_MALF_STATUS_FLG 0 0 0 0 ECU_ADDRESS 0x3FA1E1 /end MEASUREMENT
/begin COMPU_METHOD MC_PREV_IAT_MALF_STATUS_FLG "PREV_IAT_MALF_STATUS_FLG conversion" RAT_FUNC "%3.0" "Unitless" COEFFS 0 1 0 0 0 1 /end COMPU_METHOD
/begin MEASUREMENT PREV_ICP_MALF_STATUS_FLG "indicates malf failure during previous cycle" UBYTE MC_PREV_ICP_MALF_STATUS_FLG 0 0 0 0 ECU_ADDRESS 0x3FA043 /end MEASUREMENT
/begin COMPU_METHOD MC_PREV_ICP_MALF_STATUS_FLG "PREV_ICP_MALF_STATUS_FLG conversion" RAT_FUNC "%3.0" "Unitless" COEFFS 0 1 0 0 0 1 /end COMPU_METHOD
/begin MEASUREMENT PREV_ITHP_MALF_STATUS_FLG "Indicates malf failure during previous cycle" UBYTE MC_PREV_ITHP_MALF_STATUS_FLG 0 0 0 0 ECU_ADDRESS 0x3FA23E /end MEASUREMENT
/begin COMPU_METHOD MC_PREV_ITHP_MALF_STATUS_FLG "PREV_ITHP_MALF_STATUS_FLG conversion" RAT_FUNC "%3.0" "Unitless" COEFFS 0 1 0 0 0 1 /end COMPU_METHOD
/begin MEASUREMENT PREV_IVPWR_MALF_STATUS_FLG "Indicates malf failure during previous cycle" UBYTE MC_PREV_IVPWR_MALF_STATUS_FLG 0 0 0 0 ECU_ADDRESS 0x3FA265 /end MEASUREMENT
/begin COMPU_METHOD MC_PREV_IVPWR_MALF_STATUS_FLG "PREV_IVPWR_MALF_STATUS_FLG conversion" RAT_FUNC "%3.0" "Unitless" COEFFS 0 1 0 0 0 1 /end COMPU_METHOD
/begin MEASUREMENT PREV_MAF_MALF_STATUS_FLG "Indicates malf failure during previous cycle" UBYTE MC_PREV_MAF_MALF_STATUS_FLG 0 0 0 0 ECU_ADDRESS 0x3FA08F /end MEASUREMENT
/begin COMPU_METHOD MC_PREV_MAF_MALF_STATUS_FLG "PREV_MAF_MALF_STATUS_FLG conversion" RAT_FUNC "%3.0" "Unitless" COEFFS 0 1 0 0 0 1 /end COMPU_METHOD
/begin MEASUREMENT PREV_MAP_MALF_STATUS_FLG "Indicates malf failure during previous cycle" UBYTE MC_PREV_MAP_MALF_STATUS_FLG 0 0 0 0 ECU_ADDRESS 0x3FA0C1 /end MEASUREMENT
/begin COMPU_METHOD MC_PREV_MAP_MALF_STATUS_FLG "PREV_MAP_MALF_STATUS_FLG conversion" RAT_FUNC "%3.0" "Unitless" COEFFS 0 1 0 0 0 1 /end COMPU_METHOD
/begin MEASUREMENT PREV_MAT_MALF_STATUS_FLG "Indicates mat malf failure during previous cycle" UBYTE MC_PREV_MAT_MALF_STATUS_FLG 0 0 0 0 ECU_ADDRESS 0x3FA0ED /end MEASUREMENT
/begin COMPU_METHOD MC_PREV_MAT_MALF_STATUS_FLG "PREV_MAT_MALF_STATUS_FLG conversion" RAT_FUNC "%3.0" "Unitless" COEFFS 0 1 0 0 0 1 /end COMPU_METHOD
/begin MEASUREMENT PTO_ACTIVE "Signal which is used to disable monitors affected by PTO." UBYTE MC_PTO_ACTIVE 0 0 0 0 ECU_ADDRESS 0x3F9EDC /end MEASUREMENT
/begin COMPU_METHOD MC_PTO_ACTIVE "PTO_ACTIVE conversion" RAT_FUNC "%3.0" "Unitless" COEFFS 0 1 0 0 0 1 /end COMPU_METHOD
/begin MEASUREMENT PTO_ENGAGED "Signal from PTO hardware indicating PTO is engaged; 1=engaged, 0=not engaged." UBYTE MC_PTO_ENGAGED 0 0 0 0 ECU_ADDRESS 0x3FA155 /end MEASUREMENT
/begin COMPU_METHOD MC_PTO_ENGAGED "PTO_ENGAGED conversion" RAT_FUNC "%3.0" "Unitless" COEFFS 0 1 0 0 0 1 /end COMPU_METHOD
/begin CHARACTERISTIC PTO_TST_SW "Mapped byte of sys_PTO_SW flag bits in the order(0..7): {cat,ccm,purg,sair,fuel,ego,egr,mis}." VALUE 0x56383 SD_UBYTE 0 SC_PTO_TST_SW 0 255 /end CHARACTERISTIC
/begin COMPU_METHOD SC_PTO_TST_SW "PTO_TST_SW conversion" RAT_FUNC "%3.0" "MAPPED_BYTE" COEFFS 0 1 0 0 0 1 /end COMPU_METHOD
/begin MEASUREMENT PTR_TABLE_0 "Special RCON Shadow Table 0" ULONG MC_PTR_TABLE_0 0 0 0 0 ECU_ADDRESS 0x3FAD88 /end MEASUREMENT
/begin COMPU_METHOD MC_PTR_TABLE_0 "PTR_TABLE_0 conversion" RAT_FUNC "%10.0" "Unitless" COEFFS 0 1 0 0 0 1 /end COMPU_METHOD
/begin MEASUREMENT PTR_TABLE_1 "Special RCON Shadow Table 1" ULONG MC_PTR_TABLE_1 0 0 0 0 ECU_ADDRESS 0x3FAD84 /end MEASUREMENT
/begin COMPU_METHOD MC_PTR_TABLE_1 "PTR_TABLE_1 conversion" RAT_FUNC "%10.0" "Unitless" COEFFS 0 1 0 0 0 1 /end COMPU_METHOD
/begin MEASUREMENT PTR_TABLE_2 "Special RCON Shadow Table 2" ULONG MC_PTR_TABLE_2 0 0 0 0 ECU_ADDRESS 0x3FAD80 /end MEASUREMENT
/begin COMPU_METHOD MC_PTR_TABLE_2 "PTR_TABLE_2 conversion" RAT_FUNC "%10.0" "Unitless" COEFFS 0 1 0 0 0 1 /end COMPU_METHOD
/begin MEASUREMENT PTR_TABLE_3 "Special RCON Shadow Table 3" ULONG MC_PTR_TABLE_3 0 0 0 0 ECU_ADDRESS 0x3FAD7C /end MEASUREMENT
/begin COMPU_METHOD MC_PTR_TABLE_3 "PTR_TABLE_3 conversion" RAT_FUNC "%10.0" "Unitless" COEFFS 0 1 0 0 0 1 /end COMPU_METHOD
/begin MEASUREMENT PUMP "FUEL PUMP MODE FIT FLAG; 1->ENABLE" UBYTE MC_PUMP 0 0 0 0 ECU_ADDRESS 0x3FAAC1 /end MEASUREMENT
/begin COMPU_METHOD MC_PUMP "PUMP conversion" RAT_FUNC "%3.0" "Unitless" COEFFS 0 1 0 0 0 1 /end COMPU_METHOD
/begin MEASUREMENT PURG_COUNT "Count of the number of complete purge tests since KAM reset." UBYTE MC_PURG_COUNT 0 0 0 0 ECU_ADDRESS 0x3FAEE9 /end MEASUREMENT
/begin COMPU_METHOD MC_PURG_COUNT "PURG_COUNT conversion" RAT_FUNC "%3.0" "Unitless" COEFFS 0 1 0 0 0 1 /end COMPU_METHOD
/begin CHARACTERISTIC PURG_DEL_TM "Time delay between succesive runs of the PURG monitor." VALUE 0x5637E SD_UBYTE 0 SC_PURG_DEL_TM 0 127 /end CHARACTERISTIC
/begin COMPU_METHOD SC_PURG_DEL_TM "PURG_DEL_TM conversion" RAT_FUNC "%3.0" "s" COEFFS 0 1 0 0 0 1 /end COMPU_METHOD
/begin MEASUREMENT PURG_DEL_TMR "Time since abort of the PURG monitor." FLOAT32_IEEE MC_PURG_DEL_TMR 0 0 0 0 ECU_ADDRESS 0x3F9F0C /end MEASUREMENT
/begin COMPU_METHOD MC_PURG_DEL_TMR "PURG_DEL_TMR conversion" RAT_FUNC "%10.5" "Unitless" COEFFS 0 1 0 0 0 1 /end COMPU_METHOD
/begin MEASUREMENT PURG_FMEM "PURG system FMEM flag.  1 -> don't run PURG monitor due to FMEM." UBYTE MC_PURG_FMEM 0 0 0 0 ECU_ADDRESS 0x3F9F05 /end MEASUREMENT
/begin COMPU_METHOD MC_PURG_FMEM "PURG_FMEM conversion" RAT_FUNC "%3.0" "Unitless" COEFFS 0 1 0 0 0 1 /end COMPU_METHOD
/begin MEASUREMENT PURG_MON "OBDII monitor flag for evaporative purge; 1=>all purge faults been monitored since power-up" UBYTE MC_PURG_MON 0 0 0 0 ECU_ADDRESS 0x3FADDB /end MEASUREMENT
/begin COMPU_METHOD MC_PURG_MON "PURG_MON conversion" RAT_FUNC "%3.0" "Unitless" COEFFS 0 1 0 0 0 1 /end COMPU_METHOD
/begin MEASUREMENT PURG_TST_ENA "OBD-II Purge Test enable flag. (1 => test enabled)" UBYTE MC_PURG_TST_ENA 0 0 0 0 ECU_ADDRESS 0x3F9EE5 /end MEASUREMENT
/begin COMPU_METHOD MC_PURG_TST_ENA "PURG_TST_ENA conversion" RAT_FUNC "%3.0" "Unitless" COEFFS 0 1 0 0 0 1 /end COMPU_METHOD
/begin MEASUREMENT PURG_TST_RDY "PURGE TEST READY FLAG; 1 -> ALL LOCAL CONDITIONS HAVE BEEN MET; READY TO RUN PURGE TEST." UBYTE MC_PURG_TST_RDY 0 0 0 0 ECU_ADDRESS 0x3FADCE /end MEASUREMENT
/begin COMPU_METHOD MC_PURG_TST_RDY "PURG_TST_RDY conversion" RAT_FUNC "%3.0" "Unitless" COEFFS 0 1 0 0 0 1 /end COMPU_METHOD
/begin MEASUREMENT PUTMR "Time after CPU power-up." FLOAT32_IEEE MC_PUTMR 0 0 0 0 ECU_ADDRESS 0x3FABB4 /end MEASUREMENT
/begin COMPU_METHOD MC_PUTMR "PUTMR conversion" RAT_FUNC "%10.5" "Unitless" COEFFS 0 1 0 0 0 1 /end COMPU_METHOD
/begin MEASUREMENT PWR_RESET_FLG "Indicates the master clock time has reset" UBYTE MC_PWR_RESET_FLG 0 0 0 0 ECU_ADDRESS 0x3FAC08 /end MEASUREMENT
/begin COMPU_METHOD MC_PWR_RESET_FLG "PWR_RESET_FLG conversion" RAT_FUNC "%3.0" "Unitless" COEFFS 0 1 0 0 0 1 /end COMPU_METHOD
/begin MEASUREMENT QBIC_COMMAND_ERROR "QBIC command error counter." UBYTE MC_QBIC_COMMAND_ERROR 0 0 0 0 ECU_ADDRESS 0x3FAE6A /end MEASUREMENT
/begin COMPU_METHOD MC_QBIC_COMMAND_ERROR "QBIC_COMMAND_ERROR conversion" RAT_FUNC "%3.0" "Unitless" COEFFS 0 1 0 0 0 1 /end COMPU_METHOD
/begin MEASUREMENT QBIC_HOST_WATCHDOG_ERROR "QBIC host watchdog error counter." UBYTE MC_QBIC_HOST_WATCHDOG_ERROR 0 0 0 0 ECU_ADDRESS 0x3FAE66 /end MEASUREMENT
/begin COMPU_METHOD MC_QBIC_HOST_WATCHDOG_ERROR "QBIC_HOST_WATCHDOG_ERROR conversion" RAT_FUNC "%3.0" "Unitless" COEFFS 0 1 0 0 0 1 /end COMPU_METHOD
/begin MEASUREMENT QBIC_NETWORK_FAULT "SCP network fault counter." UBYTE MC_QBIC_NETWORK_FAULT 0 0 0 0 ECU_ADDRESS 0x3FAE69 /end MEASUREMENT
/begin COMPU_METHOD MC_QBIC_NETWORK_FAULT "QBIC_NETWORK_FAULT conversion" RAT_FUNC "%3.0" "Unitless" COEFFS 0 1 0 0 0 1 /end COMPU_METHOD
/begin MEASUREMENT QBIC_OTHER_STATUS_VALID "QBIC other status valid counter." UBYTE MC_QBIC_OTHER_STATUS_VALID 0 0 0 0 ECU_ADDRESS 0x3FAE6D /end MEASUREMENT
/begin COMPU_METHOD MC_QBIC_OTHER_STATUS_VALID "QBIC_OTHER_STATUS_VALID conversion" RAT_FUNC "%3.0" "Unitless" COEFFS 0 1 0 0 0 1 /end COMPU_METHOD
/begin MEASUREMENT QBIC_POWER_FAIL_ERROR "QBIC power fail error counter." UBYTE MC_QBIC_POWER_FAIL_ERROR 0 0 0 0 ECU_ADDRESS 0x3FAE67 /end MEASUREMENT
/begin COMPU_METHOD MC_QBIC_POWER_FAIL_ERROR "QBIC_POWER_FAIL_ERROR conversion" RAT_FUNC "%3.0" "Unitless" COEFFS 0 1 0 0 0 1 /end COMPU_METHOD
/begin MEASUREMENT QBIC_RECEIVER_FIFO_OVERRUN "QBIC receiver FIFO overrun counter." UBYTE MC_QBIC_RECEIVER_FIFO_OVERRUN 0 0 0 0 ECU_ADDRESS 0x3FAE6B /end MEASUREMENT
/begin COMPU_METHOD MC_QBIC_RECEIVER_FIFO_OVERRUN "QBIC_RECEIVER_FIFO_OVERRUN conversion" RAT_FUNC "%3.0" "Unitless" COEFFS 0 1 0 0 0 1 /end COMPU_METHOD
/begin CHARACTERISTIC R "" VALUE 0x56FBC SD_FLOAT32_IEEE 0 SC_R 0 1 /end CHARACTERISTIC
/begin COMPU_METHOD SC_R "R conversion" RAT_FUNC "%10.5" "unitless" COEFFS 0 1 0 0 0 1 /end COMPU_METHOD
/begin MEASUREMENT RAW_PEDAL_3TRACK[0] "Previous loop A/D value" FLOAT32_IEEE MC_RAW_PEDAL_3TRACK 0 0 0 1023 ECU_ADDRESS 0x3FA174 /end MEASUREMENT
/begin COMPU_METHOD MC_RAW_PEDAL_3TRACK "RAW_PEDAL_3TRACK conversion" RAT_FUNC "%10.5" "ADct" COEFFS 0 1 0 0 0 1 /end COMPU_METHOD
/begin MEASUREMENT RAW_PEDAL_3TRACK[1] "Previous loop A/D value" FLOAT32_IEEE MC_RAW_PEDAL_3TRACK 0 0 0 1023 ECU_ADDRESS 0x3FA178 /end MEASUREMENT
/begin MEASUREMENT RDSP_FILT "Filtered road speed (km/hr)" FLOAT32_IEEE MC_RDSP_FILT 0 0 0 0 ECU_ADDRESS 0x3FA014 /end MEASUREMENT
/begin COMPU_METHOD MC_RDSP_FILT "RDSP_FILT conversion" RAT_FUNC "%10.5" "Unitless" COEFFS 0 1 0 0 0 1 /end COMPU_METHOD
/begin MEASUREMENT READY_FLAGS "Bitmapped register containing OBDII ready flags & MIL_ON flag." UBYTE MC_READY_FLAGS 0 0 0 0 ECU_ADDRESS 0x3FAEE5 /end MEASUREMENT
/begin COMPU_METHOD MC_READY_FLAGS "READY_FLAGS conversion" RAT_FUNC "%3.0" "Unitless" COEFFS 0 1 0 0 0 1 /end COMPU_METHOD
/begin MEASUREMENT RENUM_PKT "Diagnostic tool has requested renumbering of Rapid Data packets to include group information." UBYTE MC_RENUM_PKT 0 0 0 0 ECU_ADDRESS 0x3FAB15 /end MEASUREMENT
/begin COMPU_METHOD MC_RENUM_PKT "RENUM_PKT conversion" RAT_FUNC "%3.0" "Unitless" COEFFS 0 1 0 0 0 1 /end COMPU_METHOD
/begin MEASUREMENT RESEED_I "0=Allow reseed of  governor 'I' term" UBYTE MC_RESEED_I 0 0 0 0 ECU_ADDRESS 0x3FA2EF /end MEASUREMENT
/begin COMPU_METHOD MC_RESEED_I "RESEED_I conversion" RAT_FUNC "%3.0" "Unitless" COEFFS 0 1 0 0 0 1 /end COMPU_METHOD
/begin MEASUREMENT RESET_DONE "OBDII reset occurred last loop." UBYTE MC_RESET_DONE 0 0 0 0 ECU_ADDRESS 0x3F9EB9 /end MEASUREMENT
/begin COMPU_METHOD MC_RESET_DONE "RESET_DONE conversion" RAT_FUNC "%3.0" "Unitless" COEFFS 0 1 0 0 0 1 /end COMPU_METHOD
/begin CHARACTERISTIC RESET_KAM "Calibration switch to reset KAM, 1 - resets and initializes KAM parameters" VALUE 0x5758D SD_UBYTE 0 SC_RESET_KAM 0 1 /end CHARACTERISTIC
/begin COMPU_METHOD SC_RESET_KAM "RESET_KAM conversion" RAT_FUNC "%3.0" "unitless" COEFFS 0 1 0 0 0 1 /end COMPU_METHOD
/begin MEASUREMENT RESET_TRIPS_FLG "1 = An OBD-II trip reset is requested internal to the diagnostic executive" UBYTE MC_RESET_TRIPS_FLG 0 0 0 0 ECU_ADDRESS 0x3F9F19 /end MEASUREMENT
/begin COMPU_METHOD MC_RESET_TRIPS_FLG "RESET_TRIPS_FLG conversion" RAT_FUNC "%3.0" "Unitless" COEFFS 0 1 0 0 0 1 /end COMPU_METHOD
/begin MEASUREMENT RESULTS "Flag indicating self-test results are available. 1->results available." UBYTE MC_RESULTS 0 0 0 0 ECU_ADDRESS 0x3F9ED9 /end MEASUREMENT
/begin COMPU_METHOD MC_RESULTS "RESULTS conversion" RAT_FUNC "%3.0" "Unitless" COEFFS 0 1 0 0 0 1 /end COMPU_METHOD
/begin MEASUREMENT RMFGOV_PI "Raw PI value, unclamped (mg/stroke)" FLOAT32_IEEE MC_RMFGOV_PI 0 0 0 0 ECU_ADDRESS 0x3FA2A4 /end MEASUREMENT
/begin COMPU_METHOD MC_RMFGOV_PI "RMFGOV_PI conversion" RAT_FUNC "%10.5" "Unitless" COEFFS 0 1 0 0 0 1 /end COMPU_METHOD
/begin MEASUREMENT ROL_ODO_ACC "Rolling odometer used to accumulate frational kilometers." FLOAT32_IEEE MC_ROL_ODO_ACC 0 0 0 0 ECU_ADDRESS 0x3FAEEC /end MEASUREMENT
/begin COMPU_METHOD MC_ROL_ODO_ACC "ROL_ODO_ACC conversion" RAT_FUNC "%10.5" "Unitless" COEFFS 0 1 0 0 0 1 /end COMPU_METHOD
/begin CHARACTERISTIC ROM_ENCRYPTION_KEYS[0] "Encryption keys for encrypted checksum" VALUE 0x541AC SD_ULONG 0 SC_ROM_ENCRYPTION_KEYS 0 1e+07 /end CHARACTERISTIC
/begin COMPU_METHOD SC_ROM_ENCRYPTION_KEYS "ROM_ENCRYPTION_KEYS conversion" RAT_FUNC "%10.0" "unitless" COEFFS 0 1 0 0 0 1 /end COMPU_METHOD
/begin CHARACTERISTIC ROM_ENCRYPTION_KEYS[1] "Encryption keys for encrypted checksum" VALUE 0x541B0 SD_ULONG 0 SC_ROM_ENCRYPTION_KEYS 0 1e+07 /end CHARACTERISTIC
/begin CHARACTERISTIC ROM_ENCRYPTION_KEYS[2] "Encryption keys for encrypted checksum" VALUE 0x541B4 SD_ULONG 0 SC_ROM_ENCRYPTION_KEYS 0 1e+07 /end CHARACTERISTIC
/begin CHARACTERISTIC ROM_ENCRYPTION_KEYS[3] "Encryption keys for encrypted checksum" VALUE 0x541B8 SD_ULONG 0 SC_ROM_ENCRYPTION_KEYS 0 1e+07 /end CHARACTERISTIC
/begin CHARACTERISTIC ROM_ENCRYPTION_KEYS[4] "Encryption keys for encrypted checksum" VALUE 0x541BC SD_ULONG 0 SC_ROM_ENCRYPTION_KEYS 0 1e+07 /end CHARACTERISTIC
/begin CHARACTERISTIC ROM_ENCRYPTION_KEYS[5] "Encryption keys for encrypted checksum" VALUE 0x541C0 SD_ULONG 0 SC_ROM_ENCRYPTION_KEYS 0 1e+07 /end CHARACTERISTIC
/begin CHARACTERISTIC ROM_ENCRYPTION_KEYS[6] "Encryption keys for encrypted checksum" VALUE 0x541C4 SD_ULONG 0 SC_ROM_ENCRYPTION_KEYS 0 1e+07 /end CHARACTERISTIC
/begin CHARACTERISTIC ROM_ENCRYPTION_KEYS[7] "Encryption keys for encrypted checksum" VALUE 0x541C8 SD_ULONG 0 SC_ROM_ENCRYPTION_KEYS 0 1e+07 /end CHARACTERISTIC
/begin MEASUREMENT RPD_PKT_EN[0] "Enable bits for Rapid Packets.  (1=Packet Enable, 0 = Packet Disabled.)" UBYTE MC_RPD_PKT_EN 0 0 0 1 ECU_ADDRESS 0x3F9CD0 /end MEASUREMENT
/begin COMPU_METHOD MC_RPD_PKT_EN "RPD_PKT_EN conversion" RAT_FUNC "%3.0" "unitless" COEFFS 0 1 0 0 0 1 /end COMPU_METHOD
/begin MEASUREMENT RPD_PKT_EN[10] "Enable bits for Rapid Packets.  (1=Packet Enable, 0 = Packet Disabled.)" UBYTE MC_RPD_PKT_EN 0 0 0 1 ECU_ADDRESS 0x3F9CDA /end MEASUREMENT
/begin MEASUREMENT RPD_PKT_EN[11] "Enable bits for Rapid Packets.  (1=Packet Enable, 0 = Packet Disabled.)" UBYTE MC_RPD_PKT_EN 0 0 0 1 ECU_ADDRESS 0x3F9CDB /end MEASUREMENT
/begin MEASUREMENT RPD_PKT_EN[12] "Enable bits for Rapid Packets.  (1=Packet Enable, 0 = Packet Disabled.)" UBYTE MC_RPD_PKT_EN 0 0 0 1 ECU_ADDRESS 0x3F9CDC /end MEASUREMENT
/begin MEASUREMENT RPD_PKT_EN[13] "Enable bits for Rapid Packets.  (1=Packet Enable, 0 = Packet Disabled.)" UBYTE MC_RPD_PKT_EN 0 0 0 1 ECU_ADDRESS 0x3F9CDD /end MEASUREMENT
/begin MEASUREMENT RPD_PKT_EN[14] "Enable bits for Rapid Packets.  (1=Packet Enable, 0 = Packet Disabled.)" UBYTE MC_RPD_PKT_EN 0 0 0 1 ECU_ADDRESS 0x3F9CDE /end MEASUREMENT
/begin MEASUREMENT RPD_PKT_EN[1] "Enable bits for Rapid Packets.  (1=Packet Enable, 0 = Packet Disabled.)" UBYTE MC_RPD_PKT_EN 0 0 0 1 ECU_ADDRESS 0x3F9CD1 /end MEASUREMENT
/begin MEASUREMENT RPD_PKT_EN[2] "Enable bits for Rapid Packets.  (1=Packet Enable, 0 = Packet Disabled.)" UBYTE MC_RPD_PKT_EN 0 0 0 1 ECU_ADDRESS 0x3F9CD2 /end MEASUREMENT
/begin MEASUREMENT RPD_PKT_EN[3] "Enable bits for Rapid Packets.  (1=Packet Enable, 0 = Packet Disabled.)" UBYTE MC_RPD_PKT_EN 0 0 0 1 ECU_ADDRESS 0x3F9CD3 /end MEASUREMENT
/begin MEASUREMENT RPD_PKT_EN[4] "Enable bits for Rapid Packets.  (1=Packet Enable, 0 = Packet Disabled.)" UBYTE MC_RPD_PKT_EN 0 0 0 1 ECU_ADDRESS 0x3F9CD4 /end MEASUREMENT
/begin MEASUREMENT RPD_PKT_EN[5] "Enable bits for Rapid Packets.  (1=Packet Enable, 0 = Packet Disabled.)" UBYTE MC_RPD_PKT_EN 0 0 0 1 ECU_ADDRESS 0x3F9CD5 /end MEASUREMENT
/begin MEASUREMENT RPD_PKT_EN[6] "Enable bits for Rapid Packets.  (1=Packet Enable, 0 = Packet Disabled.)" UBYTE MC_RPD_PKT_EN 0 0 0 1 ECU_ADDRESS 0x3F9CD6 /end MEASUREMENT
/begin MEASUREMENT RPD_PKT_EN[7] "Enable bits for Rapid Packets.  (1=Packet Enable, 0 = Packet Disabled.)" UBYTE MC_RPD_PKT_EN 0 0 0 1 ECU_ADDRESS 0x3F9CD7 /end MEASUREMENT
/begin MEASUREMENT RPD_PKT_EN[8] "Enable bits for Rapid Packets.  (1=Packet Enable, 0 = Packet Disabled.)" UBYTE MC_RPD_PKT_EN 0 0 0 1 ECU_ADDRESS 0x3F9CD8 /end MEASUREMENT
/begin MEASUREMENT RPD_PKT_EN[9] "Enable bits for Rapid Packets.  (1=Packet Enable, 0 = Packet Disabled.)" UBYTE MC_RPD_PKT_EN 0 0 0 1 ECU_ADDRESS 0x3F9CD9 /end MEASUREMENT
/begin MEASUREMENT RPD_PKT_PTR "Index pointer indicating  Rapid Data Packet that will be checked next." UBYTE MC_RPD_PKT_PTR 0 0 0 0 ECU_ADDRESS 0x3FAB60 /end MEASUREMENT
/begin COMPU_METHOD MC_RPD_PKT_PTR "RPD_PKT_PTR conversion" RAT_FUNC "%3.0" "Unitless" COEFFS 0 1 0 0 0 1 /end COMPU_METHOD
/begin MEASUREMENT RUN_CNTR "Run mode latch counter" ULONG MC_RUN_CNTR 0 0 0 0 ECU_ADDRESS 0x3FA3D8 /end MEASUREMENT
/begin COMPU_METHOD MC_RUN_CNTR "RUN_CNTR conversion" RAT_FUNC "%10.0" "Unitless" COEFFS 0 1 0 0 0 1 /end COMPU_METHOD
/begin MEASUREMENT RUN_LATCH_FLG "engine in run mode" UBYTE MC_RUN_LATCH_FLG 0 0 0 0 ECU_ADDRESS 0x3FA3DD /end MEASUREMENT
/begin COMPU_METHOD MC_RUN_LATCH_FLG "RUN_LATCH_FLG conversion" RAT_FUNC "%3.0" "Unitless" COEFFS 0 1 0 0 0 1 /end COMPU_METHOD
/begin CHARACTERISTIC RUN_MIN "# of run mode iterations needed to latch run mode" VALUE 0x56AD4 SD_ULONG 0 SC_RUN_MIN 0 255 /end CHARACTERISTIC
/begin COMPU_METHOD SC_RUN_MIN "RUN_MIN conversion" RAT_FUNC "%10.0" "unitless" COEFFS 0 1 0 0 0 1 /end COMPU_METHOD
/begin MEASUREMENT RUN_MODE_OTM "OTM MODE: 1-> ENABLE, 0->DISABLE" UBYTE MC_RUN_MODE_OTM 0 0 0 0 ECU_ADDRESS 0x3FABA1 /end MEASUREMENT
/begin COMPU_METHOD MC_RUN_MODE_OTM "RUN_MODE_OTM conversion" RAT_FUNC "%3.0" "Unitless" COEFFS 0 1 0 0 0 1 /end COMPU_METHOD
/begin MEASUREMENT RUN_TMR "TIME IN RUN MODE" FLOAT32_IEEE MC_RUN_TMR 0 0 0 0 ECU_ADDRESS 0x3FABB0 /end MEASUREMENT
/begin COMPU_METHOD MC_RUN_TMR "RUN_TMR conversion" RAT_FUNC "%10.5" "Unitless" COEFFS 0 1 0 0 0 1 /end COMPU_METHOD
/begin MEASUREMENT RX_INCODE1 "First byte of incode data received over SCP network for ANTI-THEFT coded access." UBYTE MC_RX_INCODE1 0 0 0 0 ECU_ADDRESS 0x3FAB5B /end MEASUREMENT
/begin COMPU_METHOD MC_RX_INCODE1 "RX_INCODE1 conversion" RAT_FUNC "%3.0" "Unitless" COEFFS 0 1 0 0 0 1 /end COMPU_METHOD
/begin MEASUREMENT RX_INCODE2 "Second byte of incode data received over SCP network for ANTI-THEFT coded access." UBYTE MC_RX_INCODE2 0 0 0 0 ECU_ADDRESS 0x3FAB5A /end MEASUREMENT
/begin COMPU_METHOD MC_RX_INCODE2 "RX_INCODE2 conversion" RAT_FUNC "%3.0" "Unitless" COEFFS 0 1 0 0 0 1 /end COMPU_METHOD
/begin MEASUREMENT SAIR_COUNT "Count of the number of complete sair tests since KAM reset." UBYTE MC_SAIR_COUNT 0 0 0 0 ECU_ADDRESS 0x3FAEE8 /end MEASUREMENT
/begin COMPU_METHOD MC_SAIR_COUNT "SAIR_COUNT conversion" RAT_FUNC "%3.0" "Unitless" COEFFS 0 1 0 0 0 1 /end COMPU_METHOD
/begin CHARACTERISTIC SAIR_DEL_TM "Time delay between succesive runs of the SAIR monitor." VALUE 0x5637D SD_UBYTE 0 SC_SAIR_DEL_TM 0 127 /end CHARACTERISTIC
/begin COMPU_METHOD SC_SAIR_DEL_TM "SAIR_DEL_TM conversion" RAT_FUNC "%3.0" "s" COEFFS 0 1 0 0 0 1 /end COMPU_METHOD
/begin MEASUREMENT SAIR_DEL_TMR "Time since abort of the SAIR monitor." FLOAT32_IEEE MC_SAIR_DEL_TMR 0 0 0 0 ECU_ADDRESS 0x3F9F10 /end MEASUREMENT
/begin COMPU_METHOD MC_SAIR_DEL_TMR "SAIR_DEL_TMR conversion" RAT_FUNC "%10.5" "Unitless" COEFFS 0 1 0 0 0 1 /end COMPU_METHOD
/begin CHARACTERISTIC SAIR_ER_DONE "VAlue for state of ER_STATUS to indicate that the engine running secondary air test is complete." VALUE 0x5782E SD_UBYTE 0 SC_SAIR_ER_DONE 0 100 /end CHARACTERISTIC
/begin COMPU_METHOD SC_SAIR_ER_DONE "SAIR_ER_DONE conversion" RAT_FUNC "%3.0" "unitless" COEFFS 0 1 0 0 0 1 /end COMPU_METHOD
/begin CHARACTERISTIC SAIR_ER_INIT "Value for state of ER_STATUS to request the engine running secondary air test" VALUE 0x5782F SD_UBYTE 0 SC_SAIR_ER_INIT 0 100 /end CHARACTERISTIC
/begin COMPU_METHOD SC_SAIR_ER_INIT "SAIR_ER_INIT conversion" RAT_FUNC "%3.0" "unitless" COEFFS 0 1 0 0 0 1 /end COMPU_METHOD
/begin MEASUREMENT SAIR_FMEM "SAIR system FMEM flag.  1 -> don't run SAIR monitor due to FMEM." UBYTE MC_SAIR_FMEM 0 0 0 0 ECU_ADDRESS 0x3F9F04 /end MEASUREMENT
/begin COMPU_METHOD MC_SAIR_FMEM "SAIR_FMEM conversion" RAT_FUNC "%3.0" "Unitless" COEFFS 0 1 0 0 0 1 /end COMPU_METHOD
/begin MEASUREMENT SAIR_MON "Secomdary air has been monitored for OBD-II trip" UBYTE MC_SAIR_MON 0 0 0 0 ECU_ADDRESS 0x3FADDA /end MEASUREMENT
/begin COMPU_METHOD MC_SAIR_MON "SAIR_MON conversion" RAT_FUNC "%3.0" "Unitless" COEFFS 0 1 0 0 0 1 /end COMPU_METHOD
/begin MEASUREMENT SAIR_TST_ENA "OBD-II Secondary Air Test enable flag. (1 => test enabled)" UBYTE MC_SAIR_TST_ENA 0 0 0 0 ECU_ADDRESS 0x3F9EE4 /end MEASUREMENT
/begin COMPU_METHOD MC_SAIR_TST_ENA "SAIR_TST_ENA conversion" RAT_FUNC "%3.0" "Unitless" COEFFS 0 1 0 0 0 1 /end COMPU_METHOD
/begin MEASUREMENT SAIR_TST_RDY "SAIR test ready flag; 1-> all local conditoins have been met; ready to run test." UBYTE MC_SAIR_TST_RDY 0 0 0 0 ECU_ADDRESS 0x3FADCF /end MEASUREMENT
/begin COMPU_METHOD MC_SAIR_TST_RDY "SAIR_TST_RDY conversion" RAT_FUNC "%3.0" "Unitless" COEFFS 0 1 0 0 0 1 /end COMPU_METHOD
/begin MEASUREMENT SCCS_OFF_PID "The speed control OFF switch position ( 1 = switch activation detected)" UBYTE MC_SCCS_OFF_PID 0 0 0 0 ECU_ADDRESS 0x3FADBC /end MEASUREMENT
/begin COMPU_METHOD MC_SCCS_OFF_PID "SCCS_OFF_PID conversion" RAT_FUNC "%3.0" "Unitless" COEFFS 0 1 0 0 0 1 /end COMPU_METHOD
/begin MEASUREMENT SCCS_ON_PID "The speed control ON switch position ( 1 = switch activation detected)" UBYTE MC_SCCS_ON_PID 0 0 0 0 ECU_ADDRESS 0x3FADBB /end MEASUREMENT
/begin COMPU_METHOD MC_SCCS_ON_PID "SCCS_ON_PID conversion" RAT_FUNC "%3.0" "Unitless" COEFFS 0 1 0 0 0 1 /end COMPU_METHOD
/begin MEASUREMENT SCPEO_EXIT "Siganl to abort the engine off self test." UBYTE MC_SCPEO_EXIT 0 0 0 0 ECU_ADDRESS 0x3F9EEA /end MEASUREMENT
/begin COMPU_METHOD MC_SCPEO_EXIT "SCPEO_EXIT conversion" RAT_FUNC "%3.0" "Unitless" COEFFS 0 1 0 0 0 1 /end COMPU_METHOD
/begin MEASUREMENT SCPEO_START "Siganl to start the engine off self test." UBYTE MC_SCPEO_START 0 0 0 0 ECU_ADDRESS 0x3F9EED /end MEASUREMENT
/begin COMPU_METHOD MC_SCPEO_START "SCPEO_START conversion" RAT_FUNC "%3.0" "Unitless" COEFFS 0 1 0 0 0 1 /end COMPU_METHOD
/begin MEASUREMENT SCPER_EXIT "Signal to abort the engine running self test." UBYTE MC_SCPER_EXIT 0 0 0 0 ECU_ADDRESS 0x3F9EE9 /end MEASUREMENT
/begin COMPU_METHOD MC_SCPER_EXIT "SCPER_EXIT conversion" RAT_FUNC "%3.0" "Unitless" COEFFS 0 1 0 0 0 1 /end COMPU_METHOD
/begin MEASUREMENT SCPER_START "Signal to start the engine running self test." UBYTE MC_SCPER_START 0 0 0 0 ECU_ADDRESS 0x3F9EEC /end MEASUREMENT
/begin COMPU_METHOD MC_SCPER_START "SCPER_START conversion" RAT_FUNC "%3.0" "Unitless" COEFFS 0 1 0 0 0 1 /end COMPU_METHOD
/begin MEASUREMENT SCPOTM_EXIT "Signal to abort the output test mode diagnostic procedure." UBYTE MC_SCPOTM_EXIT 0 0 0 0 ECU_ADDRESS 0x3F9EE8 /end MEASUREMENT
/begin COMPU_METHOD MC_SCPOTM_EXIT "SCPOTM_EXIT conversion" RAT_FUNC "%3.0" "Unitless" COEFFS 0 1 0 0 0 1 /end COMPU_METHOD
/begin MEASUREMENT SCPOTM_START "Siganl to start output test mode diagnostic procedure." UBYTE MC_SCPOTM_START 0 0 0 0 ECU_ADDRESS 0x3F9EEB /end MEASUREMENT
/begin COMPU_METHOD MC_SCPOTM_START "SCPOTM_START conversion" RAT_FUNC "%3.0" "Unitless" COEFFS 0 1 0 0 0 1 /end COMPU_METHOD
/begin MEASUREMENT SCP_ACC_TIM "New Time delay for Timed Secure Access to be stored into EEPROM" UWORD MC_SCP_ACC_TIM 0 0 0 0 ECU_ADDRESS 0x3FAB34 /end MEASUREMENT
/begin COMPU_METHOD MC_SCP_ACC_TIM "SCP_ACC_TIM conversion" RAT_FUNC "%5.0" "Unitless" COEFFS 0 1 0 0 0 1 /end COMPU_METHOD
/begin MEASUREMENT SCP_B0_TMR "Indicates time elapsed since the last receipt of 'Request No Stored Codes' message.  Message Mode ID = B0 hex." FLOAT32_IEEE MC_SCP_B0_TMR 0 0 0 0 ECU_ADDRESS 0x3FAB0C /end MEASUREMENT
/begin COMPU_METHOD MC_SCP_B0_TMR "SCP_B0_TMR conversion" RAT_FUNC "%10.5" "Unitless" COEFFS 0 1 0 0 0 1 /end COMPU_METHOD
/begin MEASUREMENT SCP_COD_ACC "Flag indicating SCP has requested ANTI-THEFT to change to coded access mode." UBYTE MC_SCP_COD_ACC 0 0 0 0 ECU_ADDRESS 0x3FAB59 /end MEASUREMENT
/begin COMPU_METHOD MC_SCP_COD_ACC "SCP_COD_ACC conversion" RAT_FUNC "%3.0" "Unitless" COEFFS 0 1 0 0 0 1 /end COMPU_METHOD
/begin MEASUREMENT SCP_DIAG_ST "Current level of On-Demand State Machine" UBYTE MC_SCP_DIAG_ST 0 0 0 0 ECU_ADDRESS 0x3FAB14 /end MEASUREMENT
/begin COMPU_METHOD MC_SCP_DIAG_ST "SCP_DIAG_ST conversion" RAT_FUNC "%3.0" "Unitless" COEFFS 0 1 0 0 0 1 /end COMPU_METHOD
/begin CHARACTERISTIC SCP_DT1 "Time delay to begin transmitting SCP network initialization message set." VALUE 0x57622 SD_UWORD 0 SC_SCP_DT1 0 65535 /end CHARACTERISTIC
/begin COMPU_METHOD SC_SCP_DT1 "SCP_DT1 conversion" RAT_FUNC "%5.0" "ms" COEFFS 0 1 0 0 0 1 /end COMPU_METHOD
/begin CHARACTERISTIC SCP_DT2 "Time delay to begin transmitting SCP status request messages." VALUE 0x57620 SD_UWORD 0 SC_SCP_DT2 0 65535 /end CHARACTERISTIC
/begin COMPU_METHOD SC_SCP_DT2 "SCP_DT2 conversion" RAT_FUNC "%5.0" "ms" COEFFS 0 1 0 0 0 1 /end COMPU_METHOD
/begin MEASUREMENT SCP_DWNLD_ST "Current level of Download & Execute State Machine." UBYTE MC_SCP_DWNLD_ST 0 0 0 0 ECU_ADDRESS 0x3FAB2E /end MEASUREMENT
/begin COMPU_METHOD MC_SCP_DWNLD_ST "SCP_DWNLD_ST conversion" RAT_FUNC "%3.0" "Unitless" COEFFS 0 1 0 0 0 1 /end COMPU_METHOD
/begin MEASUREMENT SCP_EOT_TMR "Time since last Engine Oil Temperature message recieved." ULONG MC_SCP_EOT_TMR 0 0 0 0 ECU_ADDRESS 0x3FAAC8 /end MEASUREMENT
/begin COMPU_METHOD MC_SCP_EOT_TMR "SCP_EOT_TMR conversion" RAT_FUNC "%10.0" "Unitless" COEFFS 0 1 0 0 0 1 /end COMPU_METHOD
/begin MEASUREMENT SCP_ERA_KEYS "Flag indicating SCP has requested that all keys stored be erased by the ANTI-THEFT feature." UBYTE MC_SCP_ERA_KEYS 0 0 0 0 ECU_ADDRESS 0x3FAB58 /end MEASUREMENT
/begin COMPU_METHOD MC_SCP_ERA_KEYS "SCP_ERA_KEYS conversion" RAT_FUNC "%3.0" "Unitless" COEFFS 0 1 0 0 0 1 /end COMPU_METHOD
/begin MEASUREMENT SCP_FLI_LVL "Encoded fuel level information supplied over SCP." UBYTE MC_SCP_FLI_LVL 0 0 0 0 ECU_ADDRESS 0x3FAA31 /end MEASUREMENT
/begin COMPU_METHOD MC_SCP_FLI_LVL "SCP_FLI_LVL conversion" RAT_FUNC "%3.0" "Unitless" COEFFS 0 1 0 0 0 1 /end COMPU_METHOD
/begin CHARACTERISTIC SCP_FLI_TM "Time with no message recieved to set SCP fuel level input fault." VALUE 0x57420 SD_FLOAT32_IEEE 0 SC_SCP_FLI_TM 0 31.875 /end CHARACTERISTIC
/begin COMPU_METHOD SC_SCP_FLI_TM "SCP_FLI_TM conversion" RAT_FUNC "%10.5" "s" COEFFS 0 1 0 0 0 1 /end COMPU_METHOD
/begin MEASUREMENT SCP_FLI_TMR "SCP fuel level input fault timer, indicating time since last FLI message recieved." FLOAT32_IEEE MC_SCP_FLI_TMR 0 0 0 0 ECU_ADDRESS 0x3FAA20 /end MEASUREMENT
/begin COMPU_METHOD MC_SCP_FLI_TMR "SCP_FLI_TMR conversion" RAT_FUNC "%10.5" "Unitless" COEFFS 0 1 0 0 0 1 /end COMPU_METHOD
/begin MEASUREMENT SCP_IMS_SENT "Flag indicating the the initial message set has been sent this power-up." UBYTE MC_SCP_IMS_SENT 0 0 0 0 ECU_ADDRESS 0x3FAAEF /end MEASUREMENT
/begin COMPU_METHOD MC_SCP_IMS_SENT "SCP_IMS_SENT conversion" RAT_FUNC "%3.0" "Unitless" COEFFS 0 1 0 0 0 1 /end COMPU_METHOD
/begin MEASUREMENT SCP_INCD1 "First byte of incode to be stored in EEPROM.  Request to store comes via SCP_IOCD_WRT." UBYTE MC_SCP_INCD1 0 0 0 0 ECU_ADDRESS 0x3FAB57 /end MEASUREMENT
/begin COMPU_METHOD MC_SCP_INCD1 "SCP_INCD1 conversion" RAT_FUNC "%3.0" "Unitless" COEFFS 0 1 0 0 0 1 /end COMPU_METHOD
/begin MEASUREMENT SCP_INCD2 "Second byte of Incode to be stored in EEPROM.  Request comes via SCP_IOCD_WRT." UBYTE MC_SCP_INCD2 0 0 0 0 ECU_ADDRESS 0x3FAB56 /end MEASUREMENT
/begin COMPU_METHOD MC_SCP_INCD2 "SCP_INCD2 conversion" RAT_FUNC "%3.0" "Unitless" COEFFS 0 1 0 0 0 1 /end COMPU_METHOD
/begin MEASUREMENT SCP_INCD_ARR "Flag used to indicate to ANTI-THEFT logic when SCP has recieved an incode for coded access." UBYTE MC_SCP_INCD_ARR 0 0 0 0 ECU_ADDRESS 0x3FAB3C /end MEASUREMENT
/begin COMPU_METHOD MC_SCP_INCD_ARR "SCP_INCD_ARR conversion" RAT_FUNC "%3.0" "Unitless" COEFFS 0 1 0 0 0 1 /end COMPU_METHOD
/begin MEASUREMENT SCP_IOCD_WRT "Flag indicating to ANTI-THEFT that a Incode/Outcode write has been requested over SCP." UBYTE MC_SCP_IOCD_WRT 0 0 0 0 ECU_ADDRESS 0x3FAB55 /end MEASUREMENT
/begin COMPU_METHOD MC_SCP_IOCD_WRT "SCP_IOCD_WRT conversion" RAT_FUNC "%3.0" "Unitless" COEFFS 0 1 0 0 0 1 /end COMPU_METHOD
/begin MEASUREMENT SCP_KAM_RST "Flag requesting a complete KAM reset do to SCP diagnostic request message." UBYTE MC_SCP_KAM_RST 0 0 0 0 ECU_ADDRESS 0x3FAB5C /end MEASUREMENT
/begin COMPU_METHOD MC_SCP_KAM_RST "SCP_KAM_RST conversion" RAT_FUNC "%3.0" "Unitless" COEFFS 0 1 0 0 0 1 /end COMPU_METHOD
/begin MEASUREMENT SCP_KEYS_REQ "Minimum number of keys required to be stored before PATS is enabled." UBYTE MC_SCP_KEYS_REQ 0 0 0 0 ECU_ADDRESS 0x3FAB54 /end MEASUREMENT
/begin COMPU_METHOD MC_SCP_KEYS_REQ "SCP_KEYS_REQ conversion" RAT_FUNC "%3.0" "Unitless" COEFFS 0 1 0 0 0 1 /end COMPU_METHOD
/begin MEASUREMENT SCP_LED_OFF "Flag indicating SCP has requested that the Anti-Theft indicator be turned off." UBYTE MC_SCP_LED_OFF 0 0 0 0 ECU_ADDRESS 0x3FAB53 /end MEASUREMENT
/begin COMPU_METHOD MC_SCP_LED_OFF "SCP_LED_OFF conversion" RAT_FUNC "%3.0" "Unitless" COEFFS 0 1 0 0 0 1 /end COMPU_METHOD
/begin MEASUREMENT SCP_LED_ON "Flag indicating SCP has requested that the Anti-Theft indicator be turned on." UBYTE MC_SCP_LED_ON 0 0 0 0 ECU_ADDRESS 0x3FAB52 /end MEASUREMENT
/begin COMPU_METHOD MC_SCP_LED_ON "SCP_LED_ON conversion" RAT_FUNC "%3.0" "Unitless" COEFFS 0 1 0 0 0 1 /end COMPU_METHOD
/begin MEASUREMENT SCP_LRN_DIS "Flag indicating SCP has requested the ANTI-THEFT feature to disable any spare key learning." UBYTE MC_SCP_LRN_DIS 0 0 0 0 ECU_ADDRESS 0x3FAB51 /end MEASUREMENT
/begin COMPU_METHOD MC_SCP_LRN_DIS "SCP_LRN_DIS conversion" RAT_FUNC "%3.0" "Unitless" COEFFS 0 1 0 0 0 1 /end COMPU_METHOD
/begin MEASUREMENT SCP_LRN_ENA "Flag indicating SCP has requested the ANTI-THEFT feature to enable spare key learning." UBYTE MC_SCP_LRN_ENA 0 0 0 0 ECU_ADDRESS 0x3FAB50 /end MEASUREMENT
/begin COMPU_METHOD MC_SCP_LRN_ENA "SCP_LRN_ENA conversion" RAT_FUNC "%3.0" "Unitless" COEFFS 0 1 0 0 0 1 /end COMPU_METHOD
/begin MEASUREMENT SCP_LRN_KEY "Flag indicating SCP requests ANTI-THEFT to learn a new key." UBYTE MC_SCP_LRN_KEY 0 0 0 0 ECU_ADDRESS 0x3FAB4F /end MEASUREMENT
/begin COMPU_METHOD MC_SCP_LRN_KEY "SCP_LRN_KEY conversion" RAT_FUNC "%3.0" "Unitless" COEFFS 0 1 0 0 0 1 /end COMPU_METHOD
/begin MEASUREMENT SCP_MIL_TMR "Time interval elapsed between 2 consecutive MIL_STATUS SCP messages." ULONG MC_SCP_MIL_TMR 0 0 0 0 ECU_ADDRESS 0x3FAAD0 /end MEASUREMENT
/begin COMPU_METHOD MC_SCP_MIL_TMR "SCP_MIL_TMR conversion" RAT_FUNC "%10.0" "Unitless" COEFFS 0 1 0 0 0 1 /end COMPU_METHOD
/begin MEASUREMENT SCP_NO_DTCS "When set, indicates that the No DTCs should be stored." UBYTE MC_SCP_NO_DTCS 0 0 0 0 ECU_ADDRESS 0x3FAB5D /end MEASUREMENT
/begin COMPU_METHOD MC_SCP_NO_DTCS "SCP_NO_DTCS conversion" RAT_FUNC "%3.0" "Unitless" COEFFS 0 1 0 0 0 1 /end COMPU_METHOD
/begin MEASUREMENT SCP_NO_STRTS "Number of starts enabled by B&A enable, before PATS will be disabled if the minimum keys have not been stored." UBYTE MC_SCP_NO_STRTS 0 0 0 0 ECU_ADDRESS 0x3FAB4E /end MEASUREMENT
/begin COMPU_METHOD MC_SCP_NO_STRTS "SCP_NO_STRTS conversion" RAT_FUNC "%3.0" "Unitless" COEFFS 0 1 0 0 0 1 /end COMPU_METHOD
/begin MEASUREMENT SCP_OUTCD1 "First byte of Outcode to be stored in EEPROM.  Requested via SCP_IOCS_WRT." UBYTE MC_SCP_OUTCD1 0 0 0 0 ECU_ADDRESS 0x3FAB4D /end MEASUREMENT
/begin COMPU_METHOD MC_SCP_OUTCD1 "SCP_OUTCD1 conversion" RAT_FUNC "%3.0" "Unitless" COEFFS 0 1 0 0 0 1 /end COMPU_METHOD
/begin MEASUREMENT SCP_OUTCD2 "Second byte of Outcode to be stored in EEPROM.  Requested via SCP_IOCD_WRT." UBYTE MC_SCP_OUTCD2 0 0 0 0 ECU_ADDRESS 0x3FAB4C /end MEASUREMENT
/begin COMPU_METHOD MC_SCP_OUTCD2 "SCP_OUTCD2 conversion" RAT_FUNC "%3.0" "Unitless" COEFFS 0 1 0 0 0 1 /end COMPU_METHOD
/begin MEASUREMENT SCP_OUT_REQ "Request for outcode." UBYTE MC_SCP_OUT_REQ 0 0 0 0 ECU_ADDRESS 0x3FAB3B /end MEASUREMENT
/begin COMPU_METHOD MC_SCP_OUT_REQ "SCP_OUT_REQ conversion" RAT_FUNC "%3.0" "Unitless" COEFFS 0 1 0 0 0 1 /end COMPU_METHOD
/begin MEASUREMENT SCP_PACKET[0][0] "Rapid Packet information, can be either an address or PID number depending how [packet][position] was defined." ULONG MC_SCP_PACKET 0 0 0 1e+07 ECU_ADDRESS 0x3F9BA4 /end MEASUREMENT
/begin COMPU_METHOD MC_SCP_PACKET "SCP_PACKET conversion" RAT_FUNC "%10.0" "unitless" COEFFS 0 1 0 0 0 1 /end COMPU_METHOD
/begin MEASUREMENT SCP_PACKET[0][10] "Rapid Packet information, can be either an address or PID number depending how [packet][position] was defined." ULONG MC_SCP_PACKET 0 0 0 1e+07 ECU_ADDRESS 0x3F9BCC /end MEASUREMENT
/begin MEASUREMENT SCP_PACKET[0][11] "Rapid Packet information, can be either an address or PID number depending how [packet][position] was defined." ULONG MC_SCP_PACKET 0 0 0 1e+07 ECU_ADDRESS 0x3F9BD0 /end MEASUREMENT
/begin MEASUREMENT SCP_PACKET[0][12] "Rapid Packet information, can be either an address or PID number depending how [packet][position] was defined." ULONG MC_SCP_PACKET 0 0 0 1e+07 ECU_ADDRESS 0x3F9BD4 /end MEASUREMENT
/begin MEASUREMENT SCP_PACKET[0][13] "Rapid Packet information, can be either an address or PID number depending how [packet][position] was defined." ULONG MC_SCP_PACKET 0 0 0 1e+07 ECU_ADDRESS 0x3F9BD8 /end MEASUREMENT
/begin MEASUREMENT SCP_PACKET[0][14] "Rapid Packet information, can be either an address or PID number depending how [packet][position] was defined." ULONG MC_SCP_PACKET 0 0 0 1e+07 ECU_ADDRESS 0x3F9BDC /end MEASUREMENT
/begin MEASUREMENT SCP_PACKET[0][1] "Rapid Packet information, can be either an address or PID number depending how [packet][position] was defined." ULONG MC_SCP_PACKET 0 0 0 1e+07 ECU_ADDRESS 0x3F9BA8 /end MEASUREMENT
/begin MEASUREMENT SCP_PACKET[0][2] "Rapid Packet information, can be either an address or PID number depending how [packet][position] was defined." ULONG MC_SCP_PACKET 0 0 0 1e+07 ECU_ADDRESS 0x3F9BAC /end MEASUREMENT
/begin MEASUREMENT SCP_PACKET[0][3] "Rapid Packet information, can be either an address or PID number depending how [packet][position] was defined." ULONG MC_SCP_PACKET 0 0 0 1e+07 ECU_ADDRESS 0x3F9BB0 /end MEASUREMENT
/begin MEASUREMENT SCP_PACKET[0][4] "Rapid Packet information, can be either an address or PID number depending how [packet][position] was defined." ULONG MC_SCP_PACKET 0 0 0 1e+07 ECU_ADDRESS 0x3F9BB4 /end MEASUREMENT
/begin MEASUREMENT SCP_PACKET[0][5] "Rapid Packet information, can be either an address or PID number depending how [packet][position] was defined." ULONG MC_SCP_PACKET 0 0 0 1e+07 ECU_ADDRESS 0x3F9BB8 /end MEASUREMENT
/begin MEASUREMENT SCP_PACKET[0][6] "Rapid Packet information, can be either an address or PID number depending how [packet][position] was defined." ULONG MC_SCP_PACKET 0 0 0 1e+07 ECU_ADDRESS 0x3F9BBC /end MEASUREMENT
/begin MEASUREMENT SCP_PACKET[0][7] "Rapid Packet information, can be either an address or PID number depending how [packet][position] was defined." ULONG MC_SCP_PACKET 0 0 0 1e+07 ECU_ADDRESS 0x3F9BC0 /end MEASUREMENT
/begin MEASUREMENT SCP_PACKET[0][8] "Rapid Packet information, can be either an address or PID number depending how [packet][position] was defined." ULONG MC_SCP_PACKET 0 0 0 1e+07 ECU_ADDRESS 0x3F9BC4 /end MEASUREMENT
/begin MEASUREMENT SCP_PACKET[0][9] "Rapid Packet information, can be either an address or PID number depending how [packet][position] was defined." ULONG MC_SCP_PACKET 0 0 0 1e+07 ECU_ADDRESS 0x3F9BC8 /end MEASUREMENT
/begin MEASUREMENT SCP_PACKET[1][0] "Rapid Packet information, can be either an address or PID number depending how [packet][position] was defined." ULONG MC_SCP_PACKET 0 0 0 1e+07 ECU_ADDRESS 0x3F9BE0 /end MEASUREMENT
/begin MEASUREMENT SCP_PACKET[1][10] "Rapid Packet information, can be either an address or PID number depending how [packet][position] was defined." ULONG MC_SCP_PACKET 0 0 0 1e+07 ECU_ADDRESS 0x3F9C08 /end MEASUREMENT
/begin MEASUREMENT SCP_PACKET[1][11] "Rapid Packet information, can be either an address or PID number depending how [packet][position] was defined." ULONG MC_SCP_PACKET 0 0 0 1e+07 ECU_ADDRESS 0x3F9C0C /end MEASUREMENT
/begin MEASUREMENT SCP_PACKET[1][12] "Rapid Packet information, can be either an address or PID number depending how [packet][position] was defined." ULONG MC_SCP_PACKET 0 0 0 1e+07 ECU_ADDRESS 0x3F9C10 /end MEASUREMENT
/begin MEASUREMENT SCP_PACKET[1][13] "Rapid Packet information, can be either an address or PID number depending how [packet][position] was defined." ULONG MC_SCP_PACKET 0 0 0 1e+07 ECU_ADDRESS 0x3F9C14 /end MEASUREMENT
/begin MEASUREMENT SCP_PACKET[1][14] "Rapid Packet information, can be either an address or PID number depending how [packet][position] was defined." ULONG MC_SCP_PACKET 0 0 0 1e+07 ECU_ADDRESS 0x3F9C18 /end MEASUREMENT
/begin MEASUREMENT SCP_PACKET[1][1] "Rapid Packet information, can be either an address or PID number depending how [packet][position] was defined." ULONG MC_SCP_PACKET 0 0 0 1e+07 ECU_ADDRESS 0x3F9BE4 /end MEASUREMENT
/begin MEASUREMENT SCP_PACKET[1][2] "Rapid Packet information, can be either an address or PID number depending how [packet][position] was defined." ULONG MC_SCP_PACKET 0 0 0 1e+07 ECU_ADDRESS 0x3F9BE8 /end MEASUREMENT
/begin MEASUREMENT SCP_PACKET[1][3] "Rapid Packet information, can be either an address or PID number depending how [packet][position] was defined." ULONG MC_SCP_PACKET 0 0 0 1e+07 ECU_ADDRESS 0x3F9BEC /end MEASUREMENT
/begin MEASUREMENT SCP_PACKET[1][4] "Rapid Packet information, can be either an address or PID number depending how [packet][position] was defined." ULONG MC_SCP_PACKET 0 0 0 1e+07 ECU_ADDRESS 0x3F9BF0 /end MEASUREMENT
/begin MEASUREMENT SCP_PACKET[1][5] "Rapid Packet information, can be either an address or PID number depending how [packet][position] was defined." ULONG MC_SCP_PACKET 0 0 0 1e+07 ECU_ADDRESS 0x3F9BF4 /end MEASUREMENT
/begin MEASUREMENT SCP_PACKET[1][6] "Rapid Packet information, can be either an address or PID number depending how [packet][position] was defined." ULONG MC_SCP_PACKET 0 0 0 1e+07 ECU_ADDRESS 0x3F9BF8 /end MEASUREMENT
/begin MEASUREMENT SCP_PACKET[1][7] "Rapid Packet information, can be either an address or PID number depending how [packet][position] was defined." ULONG MC_SCP_PACKET 0 0 0 1e+07 ECU_ADDRESS 0x3F9BFC /end MEASUREMENT
/begin MEASUREMENT SCP_PACKET[1][8] "Rapid Packet information, can be either an address or PID number depending how [packet][position] was defined." ULONG MC_SCP_PACKET 0 0 0 1e+07 ECU_ADDRESS 0x3F9C00 /end MEASUREMENT
/begin MEASUREMENT SCP_PACKET[1][9] "Rapid Packet information, can be either an address or PID number depending how [packet][position] was defined." ULONG MC_SCP_PACKET 0 0 0 1e+07 ECU_ADDRESS 0x3F9C04 /end MEASUREMENT
/begin MEASUREMENT SCP_PACKET[2][0] "Rapid Packet information, can be either an address or PID number depending how [packet][position] was defined." ULONG MC_SCP_PACKET 0 0 0 1e+07 ECU_ADDRESS 0x3F9C1C /end MEASUREMENT
/begin MEASUREMENT SCP_PACKET[2][10] "Rapid Packet information, can be either an address or PID number depending how [packet][position] was defined." ULONG MC_SCP_PACKET 0 0 0 1e+07 ECU_ADDRESS 0x3F9C44 /end MEASUREMENT
/begin MEASUREMENT SCP_PACKET[2][11] "Rapid Packet information, can be either an address or PID number depending how [packet][position] was defined." ULONG MC_SCP_PACKET 0 0 0 1e+07 ECU_ADDRESS 0x3F9C48 /end MEASUREMENT
/begin MEASUREMENT SCP_PACKET[2][12] "Rapid Packet information, can be either an address or PID number depending how [packet][position] was defined." ULONG MC_SCP_PACKET 0 0 0 1e+07 ECU_ADDRESS 0x3F9C4C /end MEASUREMENT
/begin MEASUREMENT SCP_PACKET[2][13] "Rapid Packet information, can be either an address or PID number depending how [packet][position] was defined." ULONG MC_SCP_PACKET 0 0 0 1e+07 ECU_ADDRESS 0x3F9C50 /end MEASUREMENT
/begin MEASUREMENT SCP_PACKET[2][14] "Rapid Packet information, can be either an address or PID number depending how [packet][position] was defined." ULONG MC_SCP_PACKET 0 0 0 1e+07 ECU_ADDRESS 0x3F9C54 /end MEASUREMENT
/begin MEASUREMENT SCP_PACKET[2][1] "Rapid Packet information, can be either an address or PID number depending how [packet][position] was defined." ULONG MC_SCP_PACKET 0 0 0 1e+07 ECU_ADDRESS 0x3F9C20 /end MEASUREMENT
/begin MEASUREMENT SCP_PACKET[2][2] "Rapid Packet information, can be either an address or PID number depending how [packet][position] was defined." ULONG MC_SCP_PACKET 0 0 0 1e+07 ECU_ADDRESS 0x3F9C24 /end MEASUREMENT
/begin MEASUREMENT SCP_PACKET[2][3] "Rapid Packet information, can be either an address or PID number depending how [packet][position] was defined." ULONG MC_SCP_PACKET 0 0 0 1e+07 ECU_ADDRESS 0x3F9C28 /end MEASUREMENT
/begin MEASUREMENT SCP_PACKET[2][4] "Rapid Packet information, can be either an address or PID number depending how [packet][position] was defined." ULONG MC_SCP_PACKET 0 0 0 1e+07 ECU_ADDRESS 0x3F9C2C /end MEASUREMENT
/begin MEASUREMENT SCP_PACKET[2][5] "Rapid Packet information, can be either an address or PID number depending how [packet][position] was defined." ULONG MC_SCP_PACKET 0 0 0 1e+07 ECU_ADDRESS 0x3F9C30 /end MEASUREMENT
/begin MEASUREMENT SCP_PACKET[2][6] "Rapid Packet information, can be either an address or PID number depending how [packet][position] was defined." ULONG MC_SCP_PACKET 0 0 0 1e+07 ECU_ADDRESS 0x3F9C34 /end MEASUREMENT
/begin MEASUREMENT SCP_PACKET[2][7] "Rapid Packet information, can be either an address or PID number depending how [packet][position] was defined." ULONG MC_SCP_PACKET 0 0 0 1e+07 ECU_ADDRESS 0x3F9C38 /end MEASUREMENT
/begin MEASUREMENT SCP_PACKET[2][8] "Rapid Packet information, can be either an address or PID number depending how [packet][position] was defined." ULONG MC_SCP_PACKET 0 0 0 1e+07 ECU_ADDRESS 0x3F9C3C /end MEASUREMENT
/begin MEASUREMENT SCP_PACKET[2][9] "Rapid Packet information, can be either an address or PID number depending how [packet][position] was defined." ULONG MC_SCP_PACKET 0 0 0 1e+07 ECU_ADDRESS 0x3F9C40 /end MEASUREMENT
/begin MEASUREMENT SCP_PACKET[3][0] "Rapid Packet information, can be either an address or PID number depending how [packet][position] was defined." ULONG MC_SCP_PACKET 0 0 0 1e+07 ECU_ADDRESS 0x3F9C58 /end MEASUREMENT
/begin MEASUREMENT SCP_PACKET[3][10] "Rapid Packet information, can be either an address or PID number depending how [packet][position] was defined." ULONG MC_SCP_PACKET 0 0 0 1e+07 ECU_ADDRESS 0x3F9C80 /end MEASUREMENT
/begin MEASUREMENT SCP_PACKET[3][11] "Rapid Packet information, can be either an address or PID number depending how [packet][position] was defined." ULONG MC_SCP_PACKET 0 0 0 1e+07 ECU_ADDRESS 0x3F9C84 /end MEASUREMENT
/begin MEASUREMENT SCP_PACKET[3][12] "Rapid Packet information, can be either an address or PID number depending how [packet][position] was defined." ULONG MC_SCP_PACKET 0 0 0 1e+07 ECU_ADDRESS 0x3F9C88 /end MEASUREMENT
/begin MEASUREMENT SCP_PACKET[3][13] "Rapid Packet information, can be either an address or PID number depending how [packet][position] was defined." ULONG MC_SCP_PACKET 0 0 0 1e+07 ECU_ADDRESS 0x3F9C8C /end MEASUREMENT
/begin MEASUREMENT SCP_PACKET[3][14] "Rapid Packet information, can be either an address or PID number depending how [packet][position] was defined." ULONG MC_SCP_PACKET 0 0 0 1e+07 ECU_ADDRESS 0x3F9C90 /end MEASUREMENT
/begin MEASUREMENT SCP_PACKET[3][1] "Rapid Packet information, can be either an address or PID number depending how [packet][position] was defined." ULONG MC_SCP_PACKET 0 0 0 1e+07 ECU_ADDRESS 0x3F9C5C /end MEASUREMENT
/begin MEASUREMENT SCP_PACKET[3][2] "Rapid Packet information, can be either an address or PID number depending how [packet][position] was defined." ULONG MC_SCP_PACKET 0 0 0 1e+07 ECU_ADDRESS 0x3F9C60 /end MEASUREMENT
/begin MEASUREMENT SCP_PACKET[3][3] "Rapid Packet information, can be either an address or PID number depending how [packet][position] was defined." ULONG MC_SCP_PACKET 0 0 0 1e+07 ECU_ADDRESS 0x3F9C64 /end MEASUREMENT
/begin MEASUREMENT SCP_PACKET[3][4] "Rapid Packet information, can be either an address or PID number depending how [packet][position] was defined." ULONG MC_SCP_PACKET 0 0 0 1e+07 ECU_ADDRESS 0x3F9C68 /end MEASUREMENT
/begin MEASUREMENT SCP_PACKET[3][5] "Rapid Packet information, can be either an address or PID number depending how [packet][position] was defined." ULONG MC_SCP_PACKET 0 0 0 1e+07 ECU_ADDRESS 0x3F9C6C /end MEASUREMENT
/begin MEASUREMENT SCP_PACKET[3][6] "Rapid Packet information, can be either an address or PID number depending how [packet][position] was defined." ULONG MC_SCP_PACKET 0 0 0 1e+07 ECU_ADDRESS 0x3F9C70 /end MEASUREMENT
/begin MEASUREMENT SCP_PACKET[3][7] "Rapid Packet information, can be either an address or PID number depending how [packet][position] was defined." ULONG MC_SCP_PACKET 0 0 0 1e+07 ECU_ADDRESS 0x3F9C74 /end MEASUREMENT
/begin MEASUREMENT SCP_PACKET[3][8] "Rapid Packet information, can be either an address or PID number depending how [packet][position] was defined." ULONG MC_SCP_PACKET 0 0 0 1e+07 ECU_ADDRESS 0x3F9C78 /end MEASUREMENT
/begin MEASUREMENT SCP_PACKET[3][9] "Rapid Packet information, can be either an address or PID number depending how [packet][position] was defined." ULONG MC_SCP_PACKET 0 0 0 1e+07 ECU_ADDRESS 0x3F9C7C /end MEASUREMENT
/begin MEASUREMENT SCP_PACKET[4][0] "Rapid Packet information, can be either an address or PID number depending how [packet][position] was defined." ULONG MC_SCP_PACKET 0 0 0 1e+07 ECU_ADDRESS 0x3F9C94 /end MEASUREMENT
/begin MEASUREMENT SCP_PACKET[4][10] "Rapid Packet information, can be either an address or PID number depending how [packet][position] was defined." ULONG MC_SCP_PACKET 0 0 0 1e+07 ECU_ADDRESS 0x3F9CBC /end MEASUREMENT
/begin MEASUREMENT SCP_PACKET[4][11] "Rapid Packet information, can be either an address or PID number depending how [packet][position] was defined." ULONG MC_SCP_PACKET 0 0 0 1e+07 ECU_ADDRESS 0x3F9CC0 /end MEASUREMENT
/begin MEASUREMENT SCP_PACKET[4][12] "Rapid Packet information, can be either an address or PID number depending how [packet][position] was defined." ULONG MC_SCP_PACKET 0 0 0 1e+07 ECU_ADDRESS 0x3F9CC4 /end MEASUREMENT
/begin MEASUREMENT SCP_PACKET[4][13] "Rapid Packet information, can be either an address or PID number depending how [packet][position] was defined." ULONG MC_SCP_PACKET 0 0 0 1e+07 ECU_ADDRESS 0x3F9CC8 /end MEASUREMENT
/begin MEASUREMENT SCP_PACKET[4][14] "Rapid Packet information, can be either an address or PID number depending how [packet][position] was defined." ULONG MC_SCP_PACKET 0 0 0 1e+07 ECU_ADDRESS 0x3F9CCC /end MEASUREMENT
/begin MEASUREMENT SCP_PACKET[4][1] "Rapid Packet information, can be either an address or PID number depending how [packet][position] was defined." ULONG MC_SCP_PACKET 0 0 0 1e+07 ECU_ADDRESS 0x3F9C98 /end MEASUREMENT
/begin MEASUREMENT SCP_PACKET[4][2] "Rapid Packet information, can be either an address or PID number depending how [packet][position] was defined." ULONG MC_SCP_PACKET 0 0 0 1e+07 ECU_ADDRESS 0x3F9C9C /end MEASUREMENT
/begin MEASUREMENT SCP_PACKET[4][3] "Rapid Packet information, can be either an address or PID number depending how [packet][position] was defined." ULONG MC_SCP_PACKET 0 0 0 1e+07 ECU_ADDRESS 0x3F9CA0 /end MEASUREMENT
/begin MEASUREMENT SCP_PACKET[4][4] "Rapid Packet information, can be either an address or PID number depending how [packet][position] was defined." ULONG MC_SCP_PACKET 0 0 0 1e+07 ECU_ADDRESS 0x3F9CA4 /end MEASUREMENT
/begin MEASUREMENT SCP_PACKET[4][5] "Rapid Packet information, can be either an address or PID number depending how [packet][position] was defined." ULONG MC_SCP_PACKET 0 0 0 1e+07 ECU_ADDRESS 0x3F9CA8 /end MEASUREMENT
/begin MEASUREMENT SCP_PACKET[4][6] "Rapid Packet information, can be either an address or PID number depending how [packet][position] was defined." ULONG MC_SCP_PACKET 0 0 0 1e+07 ECU_ADDRESS 0x3F9CAC /end MEASUREMENT
/begin MEASUREMENT SCP_PACKET[4][7] "Rapid Packet information, can be either an address or PID number depending how [packet][position] was defined." ULONG MC_SCP_PACKET 0 0 0 1e+07 ECU_ADDRESS 0x3F9CB0 /end MEASUREMENT
/begin MEASUREMENT SCP_PACKET[4][8] "Rapid Packet information, can be either an address or PID number depending how [packet][position] was defined." ULONG MC_SCP_PACKET 0 0 0 1e+07 ECU_ADDRESS 0x3F9CB4 /end MEASUREMENT
/begin MEASUREMENT SCP_PACKET[4][9] "Rapid Packet information, can be either an address or PID number depending how [packet][position] was defined." ULONG MC_SCP_PACKET 0 0 0 1e+07 ECU_ADDRESS 0x3F9CB8 /end MEASUREMENT
/begin MEASUREMENT SCP_RD_DSIZE "Counter indicating the number of Rapid Data messages loaded to be transmitted." UBYTE MC_SCP_RD_DSIZE 0 0 0 0 ECU_ADDRESS 0x3FAB61 /end MEASUREMENT
/begin COMPU_METHOD MC_SCP_RD_DSIZE "SCP_RD_DSIZE conversion" RAT_FUNC "%3.0" "Unitless" COEFFS 0 1 0 0 0 1 /end COMPU_METHOD
/begin MEASUREMENT SCP_RX_DSIZE "Number of diagnostic SCP messages received by the PCM" UBYTE MC_SCP_RX_DSIZE 0 0 0 0 ECU_ADDRESS 0x3FAA34 /end MEASUREMENT
/begin COMPU_METHOD MC_SCP_RX_DSIZE "SCP_RX_DSIZE conversion" RAT_FUNC "%3.0" "Unitless" COEFFS 0 1 0 0 0 1 /end COMPU_METHOD
/begin MEASUREMENT SCP_SETACTIM "Flag indicating ANTI-THEFT should change the secure access time delay." UBYTE MC_SCP_SETACTIM 0 0 0 0 ECU_ADDRESS 0x3FAB4B /end MEASUREMENT
/begin COMPU_METHOD MC_SCP_SETACTIM "SCP_SETACTIM conversion" RAT_FUNC "%3.0" "Unitless" COEFFS 0 1 0 0 0 1 /end COMPU_METHOD
/begin MEASUREMENT SCP_SET_BAEN "Flag requesting ANTI-THEFT Update the number of starts available with less than minimum number of keys have been stored." UBYTE MC_SCP_SET_BAEN 0 0 0 0 ECU_ADDRESS 0x3FAB4A /end MEASUREMENT
/begin COMPU_METHOD MC_SCP_SET_BAEN "SCP_SET_BAEN conversion" RAT_FUNC "%3.0" "Unitless" COEFFS 0 1 0 0 0 1 /end COMPU_METHOD
/begin MEASUREMENT SCP_SET_KEYS "Flag indicating ANTI-THEFT should set the minimum keys required to enable PATS." UBYTE MC_SCP_SET_KEYS 0 0 0 0 ECU_ADDRESS 0x3FAB49 /end MEASUREMENT
/begin COMPU_METHOD MC_SCP_SET_KEYS "SCP_SET_KEYS conversion" RAT_FUNC "%3.0" "Unitless" COEFFS 0 1 0 0 0 1 /end COMPU_METHOD
/begin MEASUREMENT SCP_STRT_TIM "Flag indicating ANTI-THEFT should begin security time access." UBYTE MC_SCP_STRT_TIM 0 0 0 0 ECU_ADDRESS 0x3FAB3A /end MEASUREMENT
/begin COMPU_METHOD MC_SCP_STRT_TIM "SCP_STRT_TIM conversion" RAT_FUNC "%3.0" "Unitless" COEFFS 0 1 0 0 0 1 /end COMPU_METHOD
/begin MEASUREMENT SCP_SVMD_DIS "Disable PATS service mode capability." UBYTE MC_SCP_SVMD_DIS 0 0 0 0 ECU_ADDRESS 0x3FAB48 /end MEASUREMENT
/begin COMPU_METHOD MC_SCP_SVMD_DIS "SCP_SVMD_DIS conversion" RAT_FUNC "%3.0" "Unitless" COEFFS 0 1 0 0 0 1 /end COMPU_METHOD
/begin MEASUREMENT SCP_SVMD_ENA "Enable PATS service mode capability." UBYTE MC_SCP_SVMD_ENA 0 0 0 0 ECU_ADDRESS 0x3FAB47 /end MEASUREMENT
/begin COMPU_METHOD MC_SCP_SVMD_ENA "SCP_SVMD_ENA conversion" RAT_FUNC "%3.0" "Unitless" COEFFS 0 1 0 0 0 1 /end COMPU_METHOD
/begin MEASUREMENT SCP_TIM_ACC "Flag indicating SCP has requested ANTI-THEFT to change to timed access mode." UBYTE MC_SCP_TIM_ACC 0 0 0 0 ECU_ADDRESS 0x3FAB46 /end MEASUREMENT
/begin COMPU_METHOD MC_SCP_TIM_ACC "SCP_TIM_ACC conversion" RAT_FUNC "%3.0" "Unitless" COEFFS 0 1 0 0 0 1 /end COMPU_METHOD
/begin MEASUREMENT SCP_TMR "SCP network initialization timer." UWORD MC_SCP_TMR 0 0 0 0 ECU_ADDRESS 0x3FAAEC /end MEASUREMENT
/begin COMPU_METHOD MC_SCP_TMR "SCP_TMR conversion" RAT_FUNC "%5.0" "Unitless" COEFFS 0 1 0 0 0 1 /end COMPU_METHOD
/begin MEASUREMENT SCP_TRX_OFF "Flag indicating ANTI-THEFT should switch pats transceiver OFF.." UBYTE MC_SCP_TRX_OFF 0 0 0 0 ECU_ADDRESS 0x3FAB45 /end MEASUREMENT
/begin COMPU_METHOD MC_SCP_TRX_OFF "SCP_TRX_OFF conversion" RAT_FUNC "%3.0" "Unitless" COEFFS 0 1 0 0 0 1 /end COMPU_METHOD
/begin MEASUREMENT SCP_TRX_ON "Flag indicating ANTI-THEFT should continously transmit enable." UBYTE MC_SCP_TRX_ON 0 0 0 0 ECU_ADDRESS 0x3FAB44 /end MEASUREMENT
/begin COMPU_METHOD MC_SCP_TRX_ON "SCP_TRX_ON conversion" RAT_FUNC "%3.0" "Unitless" COEFFS 0 1 0 0 0 1 /end COMPU_METHOD
/begin MEASUREMENT SCP_TST_REQ "Last On-Demand test which was requested by Offboard Unit (this powerup)" UBYTE MC_SCP_TST_REQ 0 0 0 0 ECU_ADDRESS 0x3FAB39 /end MEASUREMENT
/begin COMPU_METHOD MC_SCP_TST_REQ "SCP_TST_REQ conversion" RAT_FUNC "%3.0" "Unitless" COEFFS 0 1 0 0 0 1 /end COMPU_METHOD
/begin MEASUREMENT SCP_TX_DSIZE "Number of PCM SCP_DIAGNOSTIC messages to be transmitted." UBYTE MC_SCP_TX_DSIZE 0 0 0 0 ECU_ADDRESS 0x3FAAF0 /end MEASUREMENT
/begin COMPU_METHOD MC_SCP_TX_DSIZE "SCP_TX_DSIZE conversion" RAT_FUNC "%3.0" "Unitless" COEFFS 0 1 0 0 0 1 /end COMPU_METHOD
/begin MEASUREMENT SCP_TX_READY "Flag set when the PCM is ready to start regular transmission of periodic and event driven messages." UBYTE MC_SCP_TX_READY 0 0 0 0 ECU_ADDRESS 0x3FAAEE /end MEASUREMENT
/begin COMPU_METHOD MC_SCP_TX_READY "SCP_TX_READY conversion" RAT_FUNC "%3.0" "Unitless" COEFFS 0 1 0 0 0 1 /end COMPU_METHOD
/begin MEASUREMENT SCP_UP "Flag to indicate that the EBC chip has been successfully initialized." UBYTE MC_SCP_UP 0 0 0 0 ECU_ADDRESS 0x3FAB00 /end MEASUREMENT
/begin COMPU_METHOD MC_SCP_UP "SCP_UP conversion" RAT_FUNC "%3.0" "Unitless" COEFFS 0 1 0 0 0 1 /end COMPU_METHOD
/begin MEASUREMENT SCP_UTKEY_0 "Least significant byte of unlimited transponder security key." UBYTE MC_SCP_UTKEY_0 0 0 0 0 ECU_ADDRESS 0x3FAB43 /end MEASUREMENT
/begin COMPU_METHOD MC_SCP_UTKEY_0 "SCP_UTKEY_0 conversion" RAT_FUNC "%3.0" "Unitless" COEFFS 0 1 0 0 0 1 /end COMPU_METHOD
/begin MEASUREMENT SCP_UTKEY_1 "2nd LSByte of unlimited transponder security key." UBYTE MC_SCP_UTKEY_1 0 0 0 0 ECU_ADDRESS 0x3FAB42 /end MEASUREMENT
/begin COMPU_METHOD MC_SCP_UTKEY_1 "SCP_UTKEY_1 conversion" RAT_FUNC "%3.0" "Unitless" COEFFS 0 1 0 0 0 1 /end COMPU_METHOD
/begin MEASUREMENT SCP_UTKEY_2 "2nd MSByte of unlimited transponder security key." UBYTE MC_SCP_UTKEY_2 0 0 0 0 ECU_ADDRESS 0x3FAB41 /end MEASUREMENT
/begin COMPU_METHOD MC_SCP_UTKEY_2 "SCP_UTKEY_2 conversion" RAT_FUNC "%3.0" "Unitless" COEFFS 0 1 0 0 0 1 /end COMPU_METHOD
/begin MEASUREMENT SCP_UTKEY_3 "MSByte of unlimited transponder security key." UBYTE MC_SCP_UTKEY_3 0 0 0 0 ECU_ADDRESS 0x3FAB40 /end MEASUREMENT
/begin COMPU_METHOD MC_SCP_UTKEY_3 "SCP_UTKEY_3 conversion" RAT_FUNC "%3.0" "Unitless" COEFFS 0 1 0 0 0 1 /end COMPU_METHOD
/begin MEASUREMENT SCP_UTKEY_AR "Flag indicating SCP has received UT security key data, and it is ready to be processed by the ANTI-THEFT feature." UBYTE MC_SCP_UTKEY_AR 0 0 0 0 ECU_ADDRESS 0x3FAB3F /end MEASUREMENT
/begin COMPU_METHOD MC_SCP_UTKEY_AR "SCP_UTKEY_AR conversion" RAT_FUNC "%3.0" "Unitless" COEFFS 0 1 0 0 0 1 /end COMPU_METHOD
/begin MEASUREMENT SCP_UTMD_OFF "Flag indicating SCP has requested the ANTI-THEFT feature to switch off unlimited transponder mode." UBYTE MC_SCP_UTMD_OFF 0 0 0 0 ECU_ADDRESS 0x3FAB3E /end MEASUREMENT
/begin COMPU_METHOD MC_SCP_UTMD_OFF "SCP_UTMD_OFF conversion" RAT_FUNC "%3.0" "Unitless" COEFFS 0 1 0 0 0 1 /end COMPU_METHOD
/begin MEASUREMENT SCP_UTMD_ON "Flag indicating SCP has requested the ANTI-THEFT feature to switch on unlimited transponder mode." UBYTE MC_SCP_UTMD_ON 0 0 0 0 ECU_ADDRESS 0x3FAB3D /end MEASUREMENT
/begin COMPU_METHOD MC_SCP_UTMD_ON "SCP_UTMD_ON conversion" RAT_FUNC "%3.0" "Unitless" COEFFS 0 1 0 0 0 1 /end COMPU_METHOD
/begin MEASUREMENT SEC_ACC_ST_K "KAM Version of SEC_ACC_STAT, takes values AAh 'granted', 55h 'in_prog' or 33h 'denied'" UBYTE MC_SEC_ACC_ST_K 0 0 0 0 ECU_ADDRESS 0x3FB044 /end MEASUREMENT
/begin COMPU_METHOD MC_SEC_ACC_ST_K "SEC_ACC_ST_K conversion" RAT_FUNC "%3.0" "Unitless" COEFFS 0 1 0 0 0 1 /end COMPU_METHOD
/begin MEASUREMENT SEQ_NUM "Upper nibble of Rapid Packet identifier used to indicate group number to improve sequencing." UBYTE MC_SEQ_NUM 0 0 0 0 ECU_ADDRESS 0x3FAB62 /end MEASUREMENT
/begin COMPU_METHOD MC_SEQ_NUM "SEQ_NUM conversion" RAT_FUNC "%3.0" "Unitless" COEFFS 0 1 0 0 0 1 /end COMPU_METHOD
/begin MEASUREMENT SHADOW_TABLE_INFO "Special RCON Shadow Table Structure" ULONG MC_SHADOW_TABLE_INFO 0 0 0 0 ECU_ADDRESS 0x3FAD8C /end MEASUREMENT
/begin COMPU_METHOD MC_SHADOW_TABLE_INFO "SHADOW_TABLE_INFO conversion" RAT_FUNC "%10.0" "Unitless" COEFFS 0 1 0 0 0 1 /end COMPU_METHOD
/begin MEASUREMENT SHPCA_SRC "Shift point calculation source sent to transmission for shift scheduling" UBYTE MC_SHPCA_SRC 0 0 0 0 ECU_ADDRESS 0x3FA14F /end MEASUREMENT
/begin COMPU_METHOD MC_SHPCA_SRC "SHPCA_SRC conversion" RAT_FUNC "%3.0" "Unitless" COEFFS 0 1 0 0 0 1 /end COMPU_METHOD
/begin CHARACTERISTIC SIDBLOCK_ADR "NOT A REAL PARAMETER, Used to simulate software generated pointer to the start of the Software ID Block.." VALUE 0x57B34 SD_ULONG 0 SC_SIDBLOCK_ADR 8192 -256 /end CHARACTERISTIC
/begin COMPU_METHOD SC_SIDBLOCK_ADR "SIDBLOCK_ADR conversion" RAT_FUNC "%10.0" "HEX VALUES" COEFFS 0 1 0 0 0 1 /end COMPU_METHOD
/begin CHARACTERISTIC SKSF "System voltage multiplication factor" VALUE 0x5680C SD_FLOAT32_IEEE 0 SC_SKSF 0 30 /end CHARACTERISTIC
/begin COMPU_METHOD SC_SKSF "SKSF conversion" RAT_FUNC "%10.5" "V" COEFFS 0 1 0 0 0 1 /end COMPU_METHOD
/begin MEASUREMENT SOIDES_M "Main Desired timing (crnk deg BTDC)" FLOAT32_IEEE MC_SOIDES_M 0 0 0 0 ECU_ADDRESS 0x3FA4A0 /end MEASUREMENT
/begin COMPU_METHOD MC_SOIDES_M "SOIDES_M conversion" RAT_FUNC "%10.5" "Unitless" COEFFS 0 1 0 0 0 1 /end COMPU_METHOD
/begin CHARACTERISTIC SOIDES_M_MN "Main fuel pulse Start of Injection Desired Minimum" VALUE 0x56B54 SD_FLOAT32_IEEE 0 SC_SOIDES_M_MN -15 5 /end CHARACTERISTIC
/begin COMPU_METHOD SC_SOIDES_M_MN "SOIDES_M_MN conversion" RAT_FUNC "%10.5" "deg" COEFFS 0 1 0 0 0 1 /end COMPU_METHOD
/begin CHARACTERISTIC SOIDES_M_MX "Main fuel pulse Start of Injection Desired Maximum" VALUE 0x56B50 SD_FLOAT32_IEEE 0 SC_SOIDES_M_MX 0 135 /end CHARACTERISTIC
/begin COMPU_METHOD SC_SOIDES_M_MX "SOIDES_M_MX conversion" RAT_FUNC "%10.5" "deg" COEFFS 0 1 0 0 0 1 /end COMPU_METHOD
/begin MEASUREMENT SOIDES_P "Pilot Desired timing (crnk deg BTDC)" FLOAT32_IEEE MC_SOIDES_P 0 0 0 0 ECU_ADDRESS 0x3FA49C /end MEASUREMENT
/begin COMPU_METHOD MC_SOIDES_P "SOIDES_P conversion" RAT_FUNC "%10.5" "Unitless" COEFFS 0 1 0 0 0 1 /end COMPU_METHOD
/begin MEASUREMENT SOIDES_POST2 "Post Desired inj timing (crnk deg BTDC)" FLOAT32_IEEE MC_SOIDES_POST2 0 0 0 0 ECU_ADDRESS 0x3FAD6C /end MEASUREMENT
/begin COMPU_METHOD MC_SOIDES_POST2 "SOIDES_POST2 conversion" RAT_FUNC "%10.5" "Unitless" COEFFS 0 1 0 0 0 1 /end COMPU_METHOD
/begin CHARACTERISTIC SOIDES_P_MN "Pilot fuel pulse Start of Injection Desired Minimum" VALUE 0x56B64 SD_FLOAT32_IEEE 0 SC_SOIDES_P_MN -15 5 /end CHARACTERISTIC
/begin COMPU_METHOD SC_SOIDES_P_MN "SOIDES_P_MN conversion" RAT_FUNC "%10.5" "deg" COEFFS 0 1 0 0 0 1 /end COMPU_METHOD
/begin CHARACTERISTIC SOIDES_P_MX "Pilot fuel pulse Start of Injection Desired Maximum" VALUE 0x56B60 SD_FLOAT32_IEEE 0 SC_SOIDES_P_MX 0 135 /end CHARACTERISTIC
/begin COMPU_METHOD SC_SOIDES_P_MX "SOIDES_P_MX conversion" RAT_FUNC "%10.5" "deg" COEFFS 0 1 0 0 0 1 /end COMPU_METHOD
/begin CHARACTERISTIC SOI_M_CAL "Calibratable Start of Injection Desired for Main fuel pulse" VALUE 0x56B4C SD_FLOAT32_IEEE 0 SC_SOI_M_CAL -15 135 /end CHARACTERISTIC
/begin COMPU_METHOD SC_SOI_M_CAL "SOI_M_CAL conversion" RAT_FUNC "%10.5" "deg" COEFFS 0 1 0 0 0 1 /end COMPU_METHOD
/begin CHARACTERISTIC SOI_M_SEL "Select SOI_M_CAL scalar for SOIDES_M" VALUE 0x56B48 SD_FLOAT32_IEEE 0 SC_SOI_M_SEL 0 1 /end CHARACTERISTIC
/begin COMPU_METHOD SC_SOI_M_SEL "SOI_M_SEL conversion" RAT_FUNC "%10.5" "unitless" COEFFS 0 1 0 0 0 1 /end COMPU_METHOD
/begin CHARACTERISTIC SOI_P_CAL "Calibratable Start of Injection Desired for Pilot fuel pulse" VALUE 0x56B5C SD_FLOAT32_IEEE 0 SC_SOI_P_CAL -15 135 /end CHARACTERISTIC
/begin COMPU_METHOD SC_SOI_P_CAL "SOI_P_CAL conversion" RAT_FUNC "%10.5" "deg" COEFFS 0 1 0 0 0 1 /end COMPU_METHOD
/begin CHARACTERISTIC SOI_P_NOPIL "Calibratable SOIDES_P value when pilot fuelling is off" VALUE 0x56B44 SD_FLOAT32_IEEE 0 SC_SOI_P_NOPIL -360 360 /end CHARACTERISTIC
/begin COMPU_METHOD SC_SOI_P_NOPIL "SOI_P_NOPIL conversion" RAT_FUNC "%10.5" "deg" COEFFS 0 1 0 0 0 1 /end COMPU_METHOD
/begin CHARACTERISTIC SOI_P_SEL "Select SOI_P_CAL scalar for SOIDES_P" VALUE 0x56B58 SD_FLOAT32_IEEE 0 SC_SOI_P_SEL 0 1 /end CHARACTERISTIC
/begin COMPU_METHOD SC_SOI_P_SEL "SOI_P_SEL conversion" RAT_FUNC "%10.5" "unitless" COEFFS 0 1 0 0 0 1 /end COMPU_METHOD
/begin MEASUREMENT SPD_ERR_MODE "Vehicle Speed Control system failure mode flag." UBYTE MC_SPD_ERR_MODE 0 0 0 0 ECU_ADDRESS 0x3FADAA /end MEASUREMENT
/begin COMPU_METHOD MC_SPD_ERR_MODE "SPD_ERR_MODE conversion" RAT_FUNC "%3.0" "Unitless" COEFFS 0 1 0 0 0 1 /end COMPU_METHOD
/begin MEASUREMENT SPD_VID_HP "Flag indicating whether speed control hardware is present." UBYTE MC_SPD_VID_HP 0 0 0 0 ECU_ADDRESS 0x57B43 /end MEASUREMENT
/begin COMPU_METHOD MC_SPD_VID_HP "SPD_VID_HP conversion" RAT_FUNC "%3.0" "Unitless" COEFFS 0 1 0 0 0 1 /end COMPU_METHOD
/begin CHARACTERISTIC SP_EOT_HI_ALT "Pilot mode high altitude eot desired threshold" VALUE 0x56B30 SD_FLOAT32_IEEE 0 SC_SP_EOT_HI_ALT -300 300 /end CHARACTERISTIC
/begin COMPU_METHOD SC_SP_EOT_HI_ALT "SP_EOT_HI_ALT conversion" RAT_FUNC "%10.5" "degC" COEFFS 0 1 0 0 0 1 /end COMPU_METHOD
/begin CHARACTERISTIC SP_EOT_HYS_HI_ALT "Pilot mode high altitude eot hysterisis adder" VALUE 0x56B0C SD_FLOAT32_IEEE 0 SC_SP_EOT_HYS_HI_ALT 0 300 /end CHARACTERISTIC
/begin COMPU_METHOD SC_SP_EOT_HYS_HI_ALT "SP_EOT_HYS_HI_ALT conversion" RAT_FUNC "%10.5" "degC" COEFFS 0 1 0 0 0 1 /end COMPU_METHOD
/begin CHARACTERISTIC SP_EOT_HYS_LO_ALT "Pilot mode low altitude eot hysterisis adder" VALUE 0x56B04 SD_FLOAT32_IEEE 0 SC_SP_EOT_HYS_LO_ALT 0 300 /end CHARACTERISTIC
/begin COMPU_METHOD SC_SP_EOT_HYS_LO_ALT "SP_EOT_HYS_LO_ALT conversion" RAT_FUNC "%10.5" "degC" COEFFS 0 1 0 0 0 1 /end COMPU_METHOD
/begin CHARACTERISTIC SP_EOT_HYS_MED_ALT "Pilot mode medium altitude eot hysterisis adder" VALUE 0x56B08 SD_FLOAT32_IEEE 0 SC_SP_EOT_HYS_MED_ALT 0 300 /end CHARACTERISTIC
/begin COMPU_METHOD SC_SP_EOT_HYS_MED_ALT "SP_EOT_HYS_MED_ALT conversion" RAT_FUNC "%10.5" "degC" COEFFS 0 1 0 0 0 1 /end COMPU_METHOD
/begin CHARACTERISTIC SP_EOT_LO_ALT "Pilot mode  low altitude eot desired threshold" VALUE 0x56B28 SD_FLOAT32_IEEE 0 SC_SP_EOT_LO_ALT -300 300 /end CHARACTERISTIC
/begin COMPU_METHOD SC_SP_EOT_LO_ALT "SP_EOT_LO_ALT conversion" RAT_FUNC "%10.5" "degC" COEFFS 0 1 0 0 0 1 /end COMPU_METHOD
/begin CHARACTERISTIC SP_EOT_MED_ALT "Pilot mode  medium altitude eot desired threshold" VALUE 0x56B2C SD_FLOAT32_IEEE 0 SC_SP_EOT_MED_ALT -300 300 /end CHARACTERISTIC
/begin COMPU_METHOD SC_SP_EOT_MED_ALT "SP_EOT_MED_ALT conversion" RAT_FUNC "%10.5" "degC" COEFFS 0 1 0 0 0 1 /end COMPU_METHOD
/begin CHARACTERISTIC SP_HOT_EOT_HYS_MAX "Pilot mode eot maximum hysterisis threshold" VALUE 0x56AE4 SD_FLOAT32_IEEE 0 SC_SP_HOT_EOT_HYS_MAX 0 500 /end CHARACTERISTIC
/begin COMPU_METHOD SC_SP_HOT_EOT_HYS_MAX "SP_HOT_EOT_HYS_MAX conversion" RAT_FUNC "%10.5" "degC" COEFFS 0 1 0 0 0 1 /end COMPU_METHOD
/begin CHARACTERISTIC SP_HOT_EOT_MAX "Pilot mode eot maximum threshold" VALUE 0x56AE8 SD_FLOAT32_IEEE 0 SC_SP_HOT_EOT_MAX 0 500 /end CHARACTERISTIC
/begin COMPU_METHOD SC_SP_HOT_EOT_MAX "SP_HOT_EOT_MAX conversion" RAT_FUNC "%10.5" "degC" COEFFS 0 1 0 0 0 1 /end COMPU_METHOD
/begin CHARACTERISTIC SP_MFDES_HI_ALT "Pilot mode high altitude mass fuel desired threshold in mg/stroke" VALUE 0x56B18 SD_FLOAT32_IEEE 0 SC_SP_MFDES_HI_ALT 0 150 /end CHARACTERISTIC
/begin COMPU_METHOD SC_SP_MFDES_HI_ALT "SP_MFDES_HI_ALT conversion" RAT_FUNC "%10.5" "unitless" COEFFS 0 1 0 0 0 1 /end COMPU_METHOD
/begin CHARACTERISTIC SP_MFDES_HYS_HI_ALT "Pilot mode high altitude mass fuel hysterisis adder in mg/stroke" VALUE 0x56AF4 SD_FLOAT32_IEEE 0 SC_SP_MFDES_HYS_HI_ALT 0 30 /end CHARACTERISTIC
/begin COMPU_METHOD SC_SP_MFDES_HYS_HI_ALT "SP_MFDES_HYS_HI_ALT conversion" RAT_FUNC "%10.5" "unitless" COEFFS 0 1 0 0 0 1 /end COMPU_METHOD
/begin CHARACTERISTIC SP_MFDES_HYS_LO_ALT "Pilot mode low altitude mass fuel hysterisis adder in mg/stroke" VALUE 0x56AEC SD_FLOAT32_IEEE 0 SC_SP_MFDES_HYS_LO_ALT 0 30 /end CHARACTERISTIC
/begin COMPU_METHOD SC_SP_MFDES_HYS_LO_ALT "SP_MFDES_HYS_LO_ALT conversion" RAT_FUNC "%10.5" "unitless" COEFFS 0 1 0 0 0 1 /end COMPU_METHOD
/begin CHARACTERISTIC SP_MFDES_HYS_MED_ALT "Pilot mode medium altitude mass fuel hysterisis adder in mg/stroke" VALUE 0x56AF0 SD_FLOAT32_IEEE 0 SC_SP_MFDES_HYS_MED_ALT 0 30 /end CHARACTERISTIC
/begin COMPU_METHOD SC_SP_MFDES_HYS_MED_ALT "SP_MFDES_HYS_MED_ALT conversion" RAT_FUNC "%10.5" "unitless" COEFFS 0 1 0 0 0 1 /end COMPU_METHOD
/begin CHARACTERISTIC SP_MFDES_LO_ALT "Pilot mode low altitude mass fuel desired threshold in mg/stroke" VALUE 0x56B10 SD_FLOAT32_IEEE 0 SC_SP_MFDES_LO_ALT 0 150 /end CHARACTERISTIC
/begin COMPU_METHOD SC_SP_MFDES_LO_ALT "SP_MFDES_LO_ALT conversion" RAT_FUNC "%10.5" "unitless" COEFFS 0 1 0 0 0 1 /end COMPU_METHOD
/begin CHARACTERISTIC SP_MFDES_MED_ALT "Pilot mode medium altitude mass fuel desired threshold in mg/stroke" VALUE 0x56B14 SD_FLOAT32_IEEE 0 SC_SP_MFDES_MED_ALT 0 150 /end CHARACTERISTIC
/begin COMPU_METHOD SC_SP_MFDES_MED_ALT "SP_MFDES_MED_ALT conversion" RAT_FUNC "%10.5" "unitless" COEFFS 0 1 0 0 0 1 /end COMPU_METHOD
/begin MEASUREMENT SP_MODE_SEL "single pilot mode select" UBYTE MC_SP_MODE_SEL 0 0 0 0 ECU_ADDRESS 0x3FA3E4 /end MEASUREMENT
/begin COMPU_METHOD MC_SP_MODE_SEL "SP_MODE_SEL conversion" RAT_FUNC "%3.0" "Unitless" COEFFS 0 1 0 0 0 1 /end COMPU_METHOD
/begin MEASUREMENT SP_MODE_TMR "SP mode latch timer" ULONG MC_SP_MODE_TMR 0 0 0 0 ECU_ADDRESS 0x3FA3FC /end MEASUREMENT
/begin COMPU_METHOD MC_SP_MODE_TMR "SP_MODE_TMR conversion" RAT_FUNC "%10.0" "Unitless" COEFFS 0 1 0 0 0 1 /end COMPU_METHOD
/begin CHARACTERISTIC SP_NOPLT_TM "Time delay after startup to allow pilot mode" VALUE 0x56AE0 SD_ULONG 0 SC_SP_NOPLT_TM 0 300000 /end CHARACTERISTIC
/begin COMPU_METHOD SC_SP_NOPLT_TM "SP_NOPLT_TM conversion" RAT_FUNC "%10.0" "ms" COEFFS 0 1 0 0 0 1 /end COMPU_METHOD
/begin CHARACTERISTIC SP_N_HI_ALT "Pilot mode high altitude engine speed threshold" VALUE 0x56B24 SD_FLOAT32_IEEE 0 SC_SP_N_HI_ALT 0 8000 /end CHARACTERISTIC
/begin COMPU_METHOD SC_SP_N_HI_ALT "SP_N_HI_ALT conversion" RAT_FUNC "%10.5" "RPM" COEFFS 0 1 0 0 0 1 /end COMPU_METHOD
/begin CHARACTERISTIC SP_N_HYS_HI_ALT "Pilot mode high altitude engine speed hysterisis adder" VALUE 0x56B00 SD_FLOAT32_IEEE 0 SC_SP_N_HYS_HI_ALT 0 8000 /end CHARACTERISTIC
/begin COMPU_METHOD SC_SP_N_HYS_HI_ALT "SP_N_HYS_HI_ALT conversion" RAT_FUNC "%10.5" "RPM" COEFFS 0 1 0 0 0 1 /end COMPU_METHOD
/begin CHARACTERISTIC SP_N_HYS_LO_ALT "Pilot mode low  altitude engine speed hysterisis adder" VALUE 0x56AF8 SD_FLOAT32_IEEE 0 SC_SP_N_HYS_LO_ALT 0 8000 /end CHARACTERISTIC
/begin COMPU_METHOD SC_SP_N_HYS_LO_ALT "SP_N_HYS_LO_ALT conversion" RAT_FUNC "%10.5" "RPM" COEFFS 0 1 0 0 0 1 /end COMPU_METHOD
/begin CHARACTERISTIC SP_N_HYS_MED_ALT "Pilot mode medium  altitude engine speed hysterisis adder" VALUE 0x56AFC SD_FLOAT32_IEEE 0 SC_SP_N_HYS_MED_ALT 0 8000 /end CHARACTERISTIC
/begin COMPU_METHOD SC_SP_N_HYS_MED_ALT "SP_N_HYS_MED_ALT conversion" RAT_FUNC "%10.5" "RPM" COEFFS 0 1 0 0 0 1 /end COMPU_METHOD
/begin CHARACTERISTIC SP_N_LO_ALT "Pilot mode low  altitude engine speed threshold" VALUE 0x56B1C SD_FLOAT32_IEEE 0 SC_SP_N_LO_ALT 0 8000 /end CHARACTERISTIC
/begin COMPU_METHOD SC_SP_N_LO_ALT "SP_N_LO_ALT conversion" RAT_FUNC "%10.5" "RPM" COEFFS 0 1 0 0 0 1 /end COMPU_METHOD
/begin CHARACTERISTIC SP_N_MED_ALT "Pilot mode medium altitude engine speed threshold" VALUE 0x56B20 SD_FLOAT32_IEEE 0 SC_SP_N_MED_ALT 0 8000 /end CHARACTERISTIC
/begin COMPU_METHOD SC_SP_N_MED_ALT "SP_N_MED_ALT conversion" RAT_FUNC "%10.5" "RPM" COEFFS 0 1 0 0 0 1 /end COMPU_METHOD
/begin MEASUREMENT START_MOTOR_FLAG "" UBYTE MC_START_MOTOR_FLAG 0 0 0 0 ECU_ADDRESS 0x3FA154 /end MEASUREMENT
/begin COMPU_METHOD MC_START_MOTOR_FLAG "START_MOTOR_FLAG conversion" RAT_FUNC "%3.0" "Unitless" COEFFS 0 1 0 0 0 1 /end COMPU_METHOD
/begin MEASUREMENT STATE "" SLONG MC_STATE 0 0 0 0 ECU_ADDRESS 0x3FAC1C /end MEASUREMENT
/begin COMPU_METHOD MC_STATE "STATE conversion" RAT_FUNC "%10.0" "Unitless" COEFFS 0 1 0 0 0 1 /end COMPU_METHOD
/begin MEASUREMENT STRT_DISABLE "Flag indicating that the STARTER MOTOR CONTROL strategy is disabling the starter motor.  1 = Starter motor disabled" UBYTE MC_STRT_DISABLE 0 0 0 0 ECU_ADDRESS 0x3FA153 /end MEASUREMENT
/begin COMPU_METHOD MC_STRT_DISABLE "STRT_DISABLE conversion" RAT_FUNC "%3.0" "Unitless" COEFFS 0 1 0 0 0 1 /end COMPU_METHOD
/begin CHARACTERISTIC STRT_DISABLE_MTX_DEF "" VALUE 0x566B5 SD_UBYTE 0 SC_STRT_DISABLE_MTX_DEF 0 1 /end CHARACTERISTIC
/begin COMPU_METHOD SC_STRT_DISABLE_MTX_DEF "STRT_DISABLE_MTX_DEF conversion" RAT_FUNC "%3.0" "unitless" COEFFS 0 1 0 0 0 1 /end COMPU_METHOD
/begin CHARACTERISTIC STRT_EN_PATS_DEF "" VALUE 0x566B4 SD_UBYTE 0 SC_STRT_EN_PATS_DEF 0 1 /end CHARACTERISTIC
/begin COMPU_METHOD SC_STRT_EN_PATS_DEF "STRT_EN_PATS_DEF conversion" RAT_FUNC "%3.0" "unitless" COEFFS 0 1 0 0 0 1 /end COMPU_METHOD
/begin MEASUREMENT SYNC_LOC_FLG "Camshaft sync located flag" UBYTE MC_SYNC_LOC_FLG 0 0 0 0 ECU_ADDRESS 0x3FA05C /end MEASUREMENT
/begin COMPU_METHOD MC_SYNC_LOC_FLG "SYNC_LOC_FLG conversion" RAT_FUNC "%3.0" "Unitless" COEFFS 0 1 0 0 0 1 /end COMPU_METHOD
/begin MEASUREMENT TASKTIMER_16MS "" FLOAT32_IEEE MC_TASKTIMER_16MS 0 0 0 0 ECU_ADDRESS 0x3FAF6C /end MEASUREMENT
/begin COMPU_METHOD MC_TASKTIMER_16MS "TASKTIMER_16MS conversion" RAT_FUNC "%10.5" "Unitless" COEFFS 0 1 0 0 0 1 /end COMPU_METHOD
/begin MEASUREMENT TASKTIMER_30MS "" FLOAT32_IEEE MC_TASKTIMER_30MS 0 0 0 0 ECU_ADDRESS 0x3FAF60 /end MEASUREMENT
/begin COMPU_METHOD MC_TASKTIMER_30MS "TASKTIMER_30MS conversion" RAT_FUNC "%10.5" "Unitless" COEFFS 0 1 0 0 0 1 /end COMPU_METHOD
/begin MEASUREMENT TASKTIMER_4MS "" FLOAT32_IEEE MC_TASKTIMER_4MS 0 0 0 0 ECU_ADDRESS 0x3FAF64 /end MEASUREMENT
/begin COMPU_METHOD MC_TASKTIMER_4MS "TASKTIMER_4MS conversion" RAT_FUNC "%10.5" "Unitless" COEFFS 0 1 0 0 0 1 /end COMPU_METHOD
/begin MEASUREMENT TASKTIMER_8MS "" FLOAT32_IEEE MC_TASKTIMER_8MS 0 0 0 0 ECU_ADDRESS 0x3FAF5C /end MEASUREMENT
/begin COMPU_METHOD MC_TASKTIMER_8MS "TASKTIMER_8MS conversion" RAT_FUNC "%10.5" "Unitless" COEFFS 0 1 0 0 0 1 /end COMPU_METHOD
/begin MEASUREMENT TASKTIMER_BG "" FLOAT32_IEEE MC_TASKTIMER_BG 0 0 0 0 ECU_ADDRESS 0x3FAFC4 /end MEASUREMENT
/begin COMPU_METHOD MC_TASKTIMER_BG "TASKTIMER_BG conversion" RAT_FUNC "%10.5" "Unitless" COEFFS 0 1 0 0 0 1 /end COMPU_METHOD
/begin MEASUREMENT TASKTIMER_PIP "" FLOAT32_IEEE MC_TASKTIMER_PIP 0 0 0 0 ECU_ADDRESS 0x3FADFC /end MEASUREMENT
/begin COMPU_METHOD MC_TASKTIMER_PIP "TASKTIMER_PIP conversion" RAT_FUNC "%10.5" "Unitless" COEFFS 0 1 0 0 0 1 /end COMPU_METHOD
/begin MEASUREMENT TCSTRT "Coolant temperature at start." FLOAT32_IEEE MC_TCSTRT 0 0 0 0 ECU_ADDRESS 0x3FACA4 /end MEASUREMENT
/begin COMPU_METHOD MC_TCSTRT "TCSTRT conversion" RAT_FUNC "%10.5" "Unitless" COEFFS 0 1 0 0 0 1 /end COMPU_METHOD
/begin CHARACTERISTIC TC_BP_REC "Time constant for BP filter during fault recovery and during failure occurance before malf is set" VALUE 0x56434 SD_FLOAT32_IEEE 0 SC_TC_BP_REC 0 64 /end CHARACTERISTIC
/begin COMPU_METHOD SC_TC_BP_REC "TC_BP_REC conversion" RAT_FUNC "%10.5" "s" COEFFS 0 1 0 0 0 1 /end COMPU_METHOD
/begin CHARACTERISTIC TC_EBP_REC "Time constant for EBP filter" VALUE 0x567C4 SD_FLOAT32_IEEE 0 SC_TC_EBP_REC 0 65535 /end CHARACTERISTIC
/begin COMPU_METHOD SC_TC_EBP_REC "TC_EBP_REC conversion" RAT_FUNC "%10.5" "unitless" COEFFS 0 1 0 0 0 1 /end COMPU_METHOD
/begin CHARACTERISTIC TC_ECT_REC "Time constant for ECT filter." VALUE 0x56504 SD_FLOAT32_IEEE 0 SC_TC_ECT_REC 0 64 /end CHARACTERISTIC
/begin COMPU_METHOD SC_TC_ECT_REC "TC_ECT_REC conversion" RAT_FUNC "%10.5" "s" COEFFS 0 1 0 0 0 1 /end COMPU_METHOD
/begin CHARACTERISTIC TC_EGRP_REC "Time constant for EGRP filter during fault recovery and during failure occurance before malf is set" VALUE 0x5654C SD_FLOAT32_IEEE 0 SC_TC_EGRP_REC 0 64 /end CHARACTERISTIC
/begin COMPU_METHOD SC_TC_EGRP_REC "TC_EGRP_REC conversion" RAT_FUNC "%10.5" "s" COEFFS 0 1 0 0 0 1 /end COMPU_METHOD
/begin CHARACTERISTIC TC_EOT_REC "time constant for eot filter" VALUE 0x56490 SD_FLOAT32_IEEE 0 SC_TC_EOT_REC 0 64 /end CHARACTERISTIC
/begin COMPU_METHOD SC_TC_EOT_REC "TC_EOT_REC conversion" RAT_FUNC "%10.5" "s" COEFFS 0 1 0 0 0 1 /end COMPU_METHOD
/begin CHARACTERISTIC TC_IAT_REC "Time constant for IAT filter during fault recovery and during failure occurance before malf is set" VALUE 0x56788 SD_FLOAT32_IEEE 0 SC_TC_IAT_REC 0 64 /end CHARACTERISTIC
/begin COMPU_METHOD SC_TC_IAT_REC "TC_IAT_REC conversion" RAT_FUNC "%10.5" "s" COEFFS 0 1 0 0 0 1 /end COMPU_METHOD
/begin CHARACTERISTIC TC_ICP_DES "Time constant for filtering ICP_DES" VALUE 0x56C84 SD_FLOAT32_IEEE 0 SC_TC_ICP_DES 0 63.999 /end CHARACTERISTIC
/begin COMPU_METHOD SC_TC_ICP_DES "TC_ICP_DES conversion" RAT_FUNC "%10.5" "s" COEFFS 0 1 0 0 0 1 /end COMPU_METHOD
/begin CHARACTERISTIC TC_ICP_REC "time constant for icp filter" VALUE 0x56574 SD_FLOAT32_IEEE 0 SC_TC_ICP_REC 0 64 /end CHARACTERISTIC
/begin COMPU_METHOD SC_TC_ICP_REC "TC_ICP_REC conversion" RAT_FUNC "%10.5" "s" COEFFS 0 1 0 0 0 1 /end COMPU_METHOD
/begin CHARACTERISTIC TC_ITHP_REC "Time constant for ITHP filter during fault recovery and during failure occurance before malf is set" VALUE 0x567E0 SD_FLOAT32_IEEE 0 SC_TC_ITHP_REC 0 64 /end CHARACTERISTIC
/begin COMPU_METHOD SC_TC_ITHP_REC "TC_ITHP_REC conversion" RAT_FUNC "%10.5" "s" COEFFS 0 1 0 0 0 1 /end COMPU_METHOD
/begin CHARACTERISTIC TC_IVPWR_REC "Time constant for IVPWR filter during fault recovery and during failure occurance before malf is set" VALUE 0x5681C SD_FLOAT32_IEEE 0 SC_TC_IVPWR_REC 0 64 /end CHARACTERISTIC
/begin COMPU_METHOD SC_TC_IVPWR_REC "TC_IVPWR_REC conversion" RAT_FUNC "%10.5" "s" COEFFS 0 1 0 0 0 1 /end COMPU_METHOD
/begin CHARACTERISTIC TC_MAF "Time constant for filtering 'MAF'" VALUE 0x565E4 SD_FLOAT32_IEEE 0 SC_TC_MAF 0 64 /end CHARACTERISTIC
/begin COMPU_METHOD SC_TC_MAF "TC_MAF conversion" RAT_FUNC "%10.5" "s" COEFFS 0 1 0 0 0 1 /end COMPU_METHOD
/begin CHARACTERISTIC TC_MAF_REC "Time constant for MAF filter during fault recovery and during failure occurance before malf is set" VALUE 0x565E0 SD_FLOAT32_IEEE 0 SC_TC_MAF_REC 0 64 /end CHARACTERISTIC
/begin COMPU_METHOD SC_TC_MAF_REC "TC_MAF_REC conversion" RAT_FUNC "%10.5" "s" COEFFS 0 1 0 0 0 1 /end COMPU_METHOD
/begin CHARACTERISTIC TC_MAP_REC "Time constant for MAP filter during fault recovery and during failure occurance before malf is set" VALUE 0x56630 SD_FLOAT32_IEEE 0 SC_TC_MAP_REC 0 64 /end CHARACTERISTIC
/begin COMPU_METHOD SC_TC_MAP_REC "TC_MAP_REC conversion" RAT_FUNC "%10.5" "s" COEFFS 0 1 0 0 0 1 /end COMPU_METHOD
/begin CHARACTERISTIC TC_MAT_REC "Time constant for MAT filter during fault recovery and during failure occurance before malf is set" VALUE 0x5663C SD_FLOAT32_IEEE 0 SC_TC_MAT_REC 0 64 /end CHARACTERISTIC
/begin COMPU_METHOD SC_TC_MAT_REC "TC_MAT_REC conversion" RAT_FUNC "%10.5" "s" COEFFS 0 1 0 0 0 1 /end COMPU_METHOD
/begin CHARACTERISTIC TC_PPS_MAX "Pedal position filter constant" VALUE 0x56748 SD_FLOAT32_IEEE 0 SC_TC_PPS_MAX 0 64 /end CHARACTERISTIC
/begin COMPU_METHOD SC_TC_PPS_MAX "TC_PPS_MAX conversion" RAT_FUNC "%10.5" "s" COEFFS 0 1 0 0 0 1 /end COMPU_METHOD
/begin CHARACTERISTIC TC_PPS_MIN "Pedal position filter constant" VALUE 0x56744 SD_FLOAT32_IEEE 0 SC_TC_PPS_MIN 0 64 /end CHARACTERISTIC
/begin COMPU_METHOD SC_TC_PPS_MIN "TC_PPS_MIN conversion" RAT_FUNC "%10.5" "s" COEFFS 0 1 0 0 0 1 /end COMPU_METHOD
/begin CHARACTERISTIC TEMPFB "Minimum ECT required to start ATMR2 timer." VALUE 0x57884 SD_FLOAT32_IEEE 0 SC_TEMPFB -40 254 /end CHARACTERISTIC
/begin COMPU_METHOD SC_TEMPFB "TEMPFB conversion" RAT_FUNC "%10.5" "not appl" COEFFS 0 1 0 0 0 1 /end COMPU_METHOD
/begin CHARACTERISTIC TESTIDMAP_1 "Bitmap containing supported Test IDs in the range 01h to 10h" VALUE 0x5774A SD_UWORD 0 SC_TESTIDMAP_1 0 65535 /end CHARACTERISTIC
/begin COMPU_METHOD SC_TESTIDMAP_1 "TESTIDMAP_1 conversion" RAT_FUNC "%5.0" "NONE" COEFFS 0 1 0 0 0 1 /end COMPU_METHOD
/begin CHARACTERISTIC TESTIDMAP_2 "Bitmap containing supported Test IDs in the range 11h to 20h" VALUE 0x57748 SD_UWORD 0 SC_TESTIDMAP_2 0 65535 /end CHARACTERISTIC
/begin COMPU_METHOD SC_TESTIDMAP_2 "TESTIDMAP_2 conversion" RAT_FUNC "%5.0" "NONE" COEFFS 0 1 0 0 0 1 /end COMPU_METHOD
/begin CHARACTERISTIC TESTIDMAP_3 "Bitmap containing supported Test IDs in the range 21h to 30h" VALUE 0x57746 SD_UWORD 0 SC_TESTIDMAP_3 0 65535 /end CHARACTERISTIC
/begin COMPU_METHOD SC_TESTIDMAP_3 "TESTIDMAP_3 conversion" RAT_FUNC "%5.0" "NONE" COEFFS 0 1 0 0 0 1 /end COMPU_METHOD
/begin CHARACTERISTIC TESTIDMAP_4 "Bitmap containing supported Test IDs in the range 31h to 40h" VALUE 0x57744 SD_UWORD 0 SC_TESTIDMAP_4 0 65535 /end CHARACTERISTIC
/begin COMPU_METHOD SC_TESTIDMAP_4 "TESTIDMAP_4 conversion" RAT_FUNC "%5.0" "NONE" COEFFS 0 1 0 0 0 1 /end COMPU_METHOD
/begin CHARACTERISTIC TESTIDMAP_5 "Bitmap containing supported Test IDs in the range 41h to 50h" VALUE 0x57742 SD_UWORD 0 SC_TESTIDMAP_5 0 65535 /end CHARACTERISTIC
/begin COMPU_METHOD SC_TESTIDMAP_5 "TESTIDMAP_5 conversion" RAT_FUNC "%5.0" "NONE" COEFFS 0 1 0 0 0 1 /end COMPU_METHOD
/begin CHARACTERISTIC TESTIDMAP_6 "Bitmap containing supported Test IDs in the range 51h to 60h" VALUE 0x57740 SD_UWORD 0 SC_TESTIDMAP_6 0 65535 /end CHARACTERISTIC
/begin COMPU_METHOD SC_TESTIDMAP_6 "TESTIDMAP_6 conversion" RAT_FUNC "%5.0" "NONE" COEFFS 0 1 0 0 0 1 /end COMPU_METHOD
/begin MEASUREMENT TEST_KAM_FPA_ERROR "Floating point kam error" UBYTE MC_TEST_KAM_FPA_ERROR 0 0 0 0 ECU_ADDRESS 0x3FAF30 /end MEASUREMENT
/begin COMPU_METHOD MC_TEST_KAM_FPA_ERROR "TEST_KAM_FPA_ERROR conversion" RAT_FUNC "%3.0" "Unitless" COEFFS 0 1 0 0 0 1 /end COMPU_METHOD
/begin MEASUREMENT TFMFLG "Throttle position sensor FMEM flag." UBYTE MC_TFMFLG 0 0 0 0 ECU_ADDRESS 0x3FA152 /end MEASUREMENT
/begin COMPU_METHOD MC_TFMFLG "TFMFLG conversion" RAT_FUNC "%3.0" "Unitless" COEFFS 0 1 0 0 0 1 /end COMPU_METHOD
/begin CHARACTERISTIC THRMHP "Thermactor/super/inlet air control switch =0 DISABLES THERMACTOR, SUPERCHARGER, AND I.A.C LOGIC/OUTP" VALUE 0x3FADA5 SD_UBYTE 0 SC_THRMHP 0 3 /end CHARACTERISTIC
/begin COMPU_METHOD SC_THRMHP "THRMHP conversion" RAT_FUNC "%3.0" "ENUMERATED" COEFFS 0 1 0 0 0 1 /end COMPU_METHOD
/begin MEASUREMENT TOOTHPERIOD[0] "" UWORD MC_TOOTHPERIOD 0 0 0 1 ECU_ADDRESS 0x3FA966 /end MEASUREMENT
/begin COMPU_METHOD MC_TOOTHPERIOD "TOOTHPERIOD conversion" RAT_FUNC "%5.0" "s" COEFFS 0 1 0 0 0 1 /end COMPU_METHOD
/begin MEASUREMENT TOOTHPERIOD[1] "" UWORD MC_TOOTHPERIOD 0 0 0 1 ECU_ADDRESS 0x3FA968 /end MEASUREMENT
/begin MEASUREMENT TOOTHPERIOD[2] "" UWORD MC_TOOTHPERIOD 0 0 0 1 ECU_ADDRESS 0x3FA96A /end MEASUREMENT
/begin MEASUREMENT TOOTHPERIOD[3] "" UWORD MC_TOOTHPERIOD 0 0 0 1 ECU_ADDRESS 0x3FA96C /end MEASUREMENT
/begin MEASUREMENT TOOTHPERIOD[4] "" UWORD MC_TOOTHPERIOD 0 0 0 1 ECU_ADDRESS 0x3FA96E /end MEASUREMENT
/begin MEASUREMENT TOOTHPERIOD[5] "" UWORD MC_TOOTHPERIOD 0 0 0 1 ECU_ADDRESS 0x3FA970 /end MEASUREMENT
/begin MEASUREMENT TORQUE "Net engine torque to trans, used by output driver" FLOAT32_IEEE MC_TORQUE 0 0 0 0 ECU_ADDRESS 0x3FA52C /end MEASUREMENT
/begin COMPU_METHOD MC_TORQUE "TORQUE conversion" RAT_FUNC "%10.5" "Unitless" COEFFS 0 1 0 0 0 1 /end COMPU_METHOD
/begin CHARACTERISTIC TORQUE_PEAK "Engine peak torque value (Net Torque), in Newton-meters for SCP. Cal with 4Nm per bit, range 0 - 1020Nm. 00h=unk." VALUE 0x57717 SD_UBYTE 0 SC_TORQUE_PEAK 0 1020 /end CHARACTERISTIC
/begin COMPU_METHOD SC_TORQUE_PEAK "TORQUE_PEAK conversion" RAT_FUNC "%3.0" "NM" COEFFS 0 1 0 0 0 1 /end COMPU_METHOD
/begin MEASUREMENT TOT "Transmission oil temperature, deg F." FLOAT32_IEEE MC_TOT 0 0 0 0 ECU_ADDRESS 0x3FA120 /end MEASUREMENT
/begin COMPU_METHOD MC_TOT "TOT conversion" RAT_FUNC "%10.5" "Unitless" COEFFS 0 1 0 0 0 1 /end COMPU_METHOD
/begin CHARACTERISTIC TOTAL_DISP "" VALUE 0x56FB8 SD_FLOAT32_IEEE 0 SC_TOTAL_DISP 0 1 /end CHARACTERISTIC
/begin COMPU_METHOD SC_TOTAL_DISP "TOTAL_DISP conversion" RAT_FUNC "%10.5" "unitless" COEFFS 0 1 0 0 0 1 /end COMPU_METHOD
/begin MEASUREMENT TOT_DEGC "Transmission oil temperature, deg C." FLOAT32_IEEE MC_TOT_DEGC 0 0 0 0 ECU_ADDRESS 0x3FA124 /end MEASUREMENT
/begin COMPU_METHOD MC_TOT_DEGC "TOT_DEGC conversion" RAT_FUNC "%10.5" "Unitless" COEFFS 0 1 0 0 0 1 /end COMPU_METHOD
/begin CHARACTERISTIC TOT_EN_SW "TOT Control enable switch. 1-> Enabled" VALUE 0x57280 SD_UBYTE 0 SC_TOT_EN_SW 0 1 /end CHARACTERISTIC
/begin COMPU_METHOD SC_TOT_EN_SW "TOT_EN_SW conversion" RAT_FUNC "%3.0" "unitless" COEFFS 0 1 0 0 0 1 /end COMPU_METHOD
/begin MEASUREMENT TOT_FM_FLG "TOT failure mode flag; 1 -> TOT fmem in progress." UBYTE MC_TOT_FM_FLG 0 0 0 0 ECU_ADDRESS 0x3FA151 /end MEASUREMENT
/begin COMPU_METHOD MC_TOT_FM_FLG "TOT_FM_FLG conversion" RAT_FUNC "%3.0" "Unitless" COEFFS 0 1 0 0 0 1 /end COMPU_METHOD
/begin MEASUREMENT TPO_DTY "" FLOAT32_IEEE MC_TPO_DTY 0 0 0 0 ECU_ADDRESS 0x3FA1AC /end MEASUREMENT
/begin COMPU_METHOD MC_TPO_DTY "TPO_DTY conversion" RAT_FUNC "%10.5" "Unitless" COEFFS 0 1 0 0 0 1 /end COMPU_METHOD
/begin CHARACTERISTIC TPO_PERIOD "Throttle position PWM output period." VALUE 0x57710 SD_ULONG 0 SC_TPO_PERIOD 0 65535 /end CHARACTERISTIC
/begin COMPU_METHOD SC_TPO_PERIOD "TPO_PERIOD conversion" RAT_FUNC "%10.0" "ms" COEFFS 0 1 0 0 0 1 /end COMPU_METHOD
/begin MEASUREMENT TP_CNTS "A/D input for throttle position." SLONG MC_TP_CNTS 0 0 0 0 ECU_ADDRESS 0x3FAAA4 /end MEASUREMENT
/begin COMPU_METHOD MC_TP_CNTS "TP_CNTS conversion" RAT_FUNC "%10.0" "Unitless" COEFFS 0 1 0 0 0 1 /end COMPU_METHOD
/begin MEASUREMENT TP_FIL "Intermittent fault filter for the TP sensor." UBYTE MC_TP_FIL 0 0 0 0 ECU_ADDRESS 0x3F9EF7 /end MEASUREMENT
/begin COMPU_METHOD MC_TP_FIL "TP_FIL conversion" RAT_FUNC "%3.0" "Unitless" COEFFS 0 1 0 0 0 1 /end COMPU_METHOD
/begin MEASUREMENT TP_FIL_MAX "HIGHEST VALUE THE FAULT FILTER TP_FIL SEES." UBYTE MC_TP_FIL_MAX 0 0 0 0 ECU_ADDRESS 0x3FAEDA /end MEASUREMENT
/begin COMPU_METHOD MC_TP_FIL_MAX "TP_FIL_MAX conversion" RAT_FUNC "%3.0" "Unitless" COEFFS 0 1 0 0 0 1 /end COMPU_METHOD
/begin CHARACTERISTIC TP_HI_ER_V "TP sensor maximum voltage." VALUE 0x57570 SD_FLOAT32_IEEE 0 SC_TP_HI_ER_V 0 12 /end CHARACTERISTIC
/begin COMPU_METHOD SC_TP_HI_ER_V "TP_HI_ER_V conversion" RAT_FUNC "%10.5" "V" COEFFS 0 1 0 0 0 1 /end COMPU_METHOD
/begin MEASUREMENT TP_INT "Fag set when intermittent is detected on the TP sensor." UBYTE MC_TP_INT 0 0 0 0 ECU_ADDRESS 0x3F9EF6 /end MEASUREMENT
/begin COMPU_METHOD MC_TP_INT "TP_INT conversion" RAT_FUNC "%3.0" "Unitless" COEFFS 0 1 0 0 0 1 /end COMPU_METHOD
/begin CHARACTERISTIC TP_LO_ER_V "TP sensor minimum voltage." VALUE 0x5756C SD_FLOAT32_IEEE 0 SC_TP_LO_ER_V 0 12 /end CHARACTERISTIC
/begin COMPU_METHOD SC_TP_LO_ER_V "TP_LO_ER_V conversion" RAT_FUNC "%10.5" "V" COEFFS 0 1 0 0 0 1 /end COMPU_METHOD
/begin CHARACTERISTIC TP_LVL "Fault level for intermittent TP sensor." VALUE 0x563A3 SD_UBYTE 0 SC_TP_LVL 0 255 /end CHARACTERISTIC
/begin COMPU_METHOD SC_TP_LVL "TP_LVL conversion" RAT_FUNC "%3.0" "LEVEL" COEFFS 0 1 0 0 0 1 /end COMPU_METHOD
/begin MEASUREMENT TP_RAW[0] "Absolute angular position of throttle" FLOAT32_IEEE MC_TP_RAW 0 0 0 100 ECU_ADDRESS 0x3F9B1C /end MEASUREMENT
/begin COMPU_METHOD MC_TP_RAW "TP_RAW conversion" RAT_FUNC "%10.5" "deg" COEFFS 0 1 0 0 0 1 /end COMPU_METHOD
/begin MEASUREMENT TP_RAW[1] "Absolute angular position of throttle" FLOAT32_IEEE MC_TP_RAW 0 0 0 100 ECU_ADDRESS 0x3F9B20 /end MEASUREMENT
/begin MEASUREMENT TP_RAW[2] "Absolute angular position of throttle" FLOAT32_IEEE MC_TP_RAW 0 0 0 100 ECU_ADDRESS 0x3F9B24 /end MEASUREMENT
/begin MEASUREMENT TP_STATUS[0] "Status of Throttle Position high level driver ( 0 = ok )" UBYTE MC_TP_STATUS 0 0 0 255 ECU_ADDRESS 0x3FAAA0 /end MEASUREMENT
/begin COMPU_METHOD MC_TP_STATUS "TP_STATUS conversion" RAT_FUNC "%3.0" "unitless" COEFFS 0 1 0 0 0 1 /end COMPU_METHOD
/begin MEASUREMENT TP_STATUS[1] "Status of Throttle Position high level driver ( 0 = ok )" UBYTE MC_TP_STATUS 0 0 0 255 ECU_ADDRESS 0x3FAAA1 /end MEASUREMENT
/begin MEASUREMENT TP_STATUS[2] "Status of Throttle Position high level driver ( 0 = ok )" UBYTE MC_TP_STATUS 0 0 0 255 ECU_ADDRESS 0x3FAAA2 /end MEASUREMENT
/begin MEASUREMENT TQE_BRK "Engine torque at flywheel" FLOAT32_IEEE MC_TQE_BRK 0 0 0 0 ECU_ADDRESS 0x3FA11C /end MEASUREMENT
/begin COMPU_METHOD MC_TQE_BRK "TQE_BRK conversion" RAT_FUNC "%10.5" "Unitless" COEFFS 0 1 0 0 0 1 /end COMPU_METHOD
/begin MEASUREMENT TQE_MAX_SFT "Maximum torque allowed during a shift requested by transmission." FLOAT32_IEEE MC_TQE_MAX_SFT 0 0 0 0 ECU_ADDRESS 0x3FAFB8 /end MEASUREMENT
/begin COMPU_METHOD MC_TQE_MAX_SFT "TQE_MAX_SFT conversion" RAT_FUNC "%10.5" "Unitless" COEFFS 0 1 0 0 0 1 /end COMPU_METHOD
/begin MEASUREMENT TQE_MAX_TRAN "Maximum allowable input torque requested by transmission (shifting and non-shifting)." FLOAT32_IEEE MC_TQE_MAX_TRAN 0 0 0 0 ECU_ADDRESS 0x3FAFBC /end MEASUREMENT
/begin COMPU_METHOD MC_TQE_MAX_TRAN "TQE_MAX_TRAN conversion" RAT_FUNC "%10.5" "Unitless" COEFFS 0 1 0 0 0 1 /end COMPU_METHOD
/begin MEASUREMENT TQE_MIN_SFT "Minimum torque allowed during a shift requested by transmission." FLOAT32_IEEE MC_TQE_MIN_SFT 0 0 0 0 ECU_ADDRESS 0x3FB01C /end MEASUREMENT
/begin COMPU_METHOD MC_TQE_MIN_SFT "TQE_MIN_SFT conversion" RAT_FUNC "%10.5" "Unitless" COEFFS 0 1 0 0 0 1 /end COMPU_METHOD
/begin MEASUREMENT TQ_ACCESSORIES "" FLOAT32_IEEE MC_TQ_ACCESSORIES 0 0 0 0 ECU_ADDRESS 0x3FA554 /end MEASUREMENT
/begin COMPU_METHOD MC_TQ_ACCESSORIES "TQ_ACCESSORIES conversion" RAT_FUNC "%10.5" "Unitless" COEFFS 0 1 0 0 0 1 /end COMPU_METHOD
/begin MEASUREMENT TQ_ACCY1 "" FLOAT32_IEEE MC_TQ_ACCY1 0 0 0 0 ECU_ADDRESS 0x3FA560 /end MEASUREMENT
/begin COMPU_METHOD MC_TQ_ACCY1 "TQ_ACCY1 conversion" RAT_FUNC "%10.5" "Unitless" COEFFS 0 1 0 0 0 1 /end COMPU_METHOD
/begin MEASUREMENT TQ_ACCY2 "" FLOAT32_IEEE MC_TQ_ACCY2 0 0 0 0 ECU_ADDRESS 0x3FA55C /end MEASUREMENT
/begin COMPU_METHOD MC_TQ_ACCY2 "TQ_ACCY2 conversion" RAT_FUNC "%10.5" "Unitless" COEFFS 0 1 0 0 0 1 /end COMPU_METHOD
/begin CHARACTERISTIC TQ_ADDER_SELECT "Flag indicates bypass of the torque modifying terms in torque limiting" VALUE 0x56DC0 SD_UBYTE 0 SC_TQ_ADDER_SELECT 0 1 /end CHARACTERISTIC
/begin COMPU_METHOD SC_TQ_ADDER_SELECT "TQ_ADDER_SELECT conversion" RAT_FUNC "%3.0" "unitless" COEFFS 0 1 0 0 0 1 /end COMPU_METHOD
/begin MEASUREMENT TQ_AIRC1 "" FLOAT32_IEEE MC_TQ_AIRC1 0 0 0 0 ECU_ADDRESS 0x3FA564 /end MEASUREMENT
/begin COMPU_METHOD MC_TQ_AIRC1 "TQ_AIRC1 conversion" RAT_FUNC "%10.5" "Unitless" COEFFS 0 1 0 0 0 1 /end COMPU_METHOD
/begin MEASUREMENT TQ_AIRPMP_ACT_FLG "" UBYTE MC_TQ_AIRPMP_ACT_FLG 0 0 0 0 ECU_ADDRESS 0x56D65 /end MEASUREMENT
/begin COMPU_METHOD MC_TQ_AIRPMP_ACT_FLG "TQ_AIRPMP_ACT_FLG conversion" RAT_FUNC "%3.0" "Unitless" COEFFS 0 1 0 0 0 1 /end COMPU_METHOD
/begin MEASUREMENT TQ_AIR_PUMP "" FLOAT32_IEEE MC_TQ_AIR_PUMP 0 0 0 0 ECU_ADDRESS 0x3FA510 /end MEASUREMENT
/begin COMPU_METHOD MC_TQ_AIR_PUMP "TQ_AIR_PUMP conversion" RAT_FUNC "%10.5" "Unitless" COEFFS 0 1 0 0 0 1 /end COMPU_METHOD
/begin MEASUREMENT TQ_COMB "" FLOAT32_IEEE MC_TQ_COMB 0 0 0 0 ECU_ADDRESS 0x3FA54C /end MEASUREMENT
/begin COMPU_METHOD MC_TQ_COMB "TQ_COMB conversion" RAT_FUNC "%10.5" "Unitless" COEFFS 0 1 0 0 0 1 /end COMPU_METHOD
/begin MEASUREMENT TQ_COMB_ACT_FLG "" UBYTE MC_TQ_COMB_ACT_FLG 0 0 0 0 ECU_ADDRESS 0x56D64 /end MEASUREMENT
/begin COMPU_METHOD MC_TQ_COMB_ACT_FLG "TQ_COMB_ACT_FLG conversion" RAT_FUNC "%3.0" "Unitless" COEFFS 0 1 0 0 0 1 /end COMPU_METHOD
/begin MEASUREMENT TQ_COMB_MULT "" FLOAT32_IEEE MC_TQ_COMB_MULT 0 0 0 0 ECU_ADDRESS 0x3FA558 /end MEASUREMENT
/begin COMPU_METHOD MC_TQ_COMB_MULT "TQ_COMB_MULT conversion" RAT_FUNC "%10.5" "Unitless" COEFFS 0 1 0 0 0 1 /end COMPU_METHOD
/begin MEASUREMENT TQ_DELTAP "" FLOAT32_IEEE MC_TQ_DELTAP 0 0 0 0 ECU_ADDRESS 0x3FA584 /end MEASUREMENT
/begin COMPU_METHOD MC_TQ_DELTAP "TQ_DELTAP conversion" RAT_FUNC "%10.5" "Unitless" COEFFS 0 1 0 0 0 1 /end COMPU_METHOD
/begin MEASUREMENT TQ_DELTAP_ERR "" FLOAT32_IEEE MC_TQ_DELTAP_ERR 0 0 0 0 ECU_ADDRESS 0x3FA580 /end MEASUREMENT
/begin COMPU_METHOD MC_TQ_DELTAP_ERR "TQ_DELTAP_ERR conversion" RAT_FUNC "%10.5" "Unitless" COEFFS 0 1 0 0 0 1 /end COMPU_METHOD
/begin MEASUREMENT TQ_DELTAP_NORM "" FLOAT32_IEEE MC_TQ_DELTAP_NORM 0 0 0 0 ECU_ADDRESS 0x3FA588 /end MEASUREMENT
/begin COMPU_METHOD MC_TQ_DELTAP_NORM "TQ_DELTAP_NORM conversion" RAT_FUNC "%10.5" "Unitless" COEFFS 0 1 0 0 0 1 /end COMPU_METHOD
/begin MEASUREMENT TQ_DP_HIALT "" FLOAT32_IEEE MC_TQ_DP_HIALT 0 0 0 0 ECU_ADDRESS 0x3FA51C /end MEASUREMENT
/begin COMPU_METHOD MC_TQ_DP_HIALT "TQ_DP_HIALT conversion" RAT_FUNC "%10.5" "Unitless" COEFFS 0 1 0 0 0 1 /end COMPU_METHOD
/begin MEASUREMENT TQ_DP_HIALT_TERM "" FLOAT32_IEEE MC_TQ_DP_HIALT_TERM 0 0 0 0 ECU_ADDRESS 0x3FA594 /end MEASUREMENT
/begin COMPU_METHOD MC_TQ_DP_HIALT_TERM "TQ_DP_HIALT_TERM conversion" RAT_FUNC "%10.5" "Unitless" COEFFS 0 1 0 0 0 1 /end COMPU_METHOD
/begin MEASUREMENT TQ_DP_LOALT "" FLOAT32_IEEE MC_TQ_DP_LOALT 0 0 0 0 ECU_ADDRESS 0x3FA514 /end MEASUREMENT
/begin COMPU_METHOD MC_TQ_DP_LOALT "TQ_DP_LOALT conversion" RAT_FUNC "%10.5" "Unitless" COEFFS 0 1 0 0 0 1 /end COMPU_METHOD
/begin MEASUREMENT TQ_DP_LOALT_TERM "" FLOAT32_IEEE MC_TQ_DP_LOALT_TERM 0 0 0 0 ECU_ADDRESS 0x3FA58C /end MEASUREMENT
/begin COMPU_METHOD MC_TQ_DP_LOALT_TERM "TQ_DP_LOALT_TERM conversion" RAT_FUNC "%10.5" "Unitless" COEFFS 0 1 0 0 0 1 /end COMPU_METHOD
/begin MEASUREMENT TQ_DP_MEDALT "" FLOAT32_IEEE MC_TQ_DP_MEDALT 0 0 0 0 ECU_ADDRESS 0x3FA518 /end MEASUREMENT
/begin COMPU_METHOD MC_TQ_DP_MEDALT "TQ_DP_MEDALT conversion" RAT_FUNC "%10.5" "Unitless" COEFFS 0 1 0 0 0 1 /end COMPU_METHOD
/begin MEASUREMENT TQ_DP_MEDALT_TERM "" FLOAT32_IEEE MC_TQ_DP_MEDALT_TERM 0 0 0 0 ECU_ADDRESS 0x3FA590 /end MEASUREMENT
/begin COMPU_METHOD MC_TQ_DP_MEDALT_TERM "TQ_DP_MEDALT_TERM conversion" RAT_FUNC "%10.5" "Unitless" COEFFS 0 1 0 0 0 1 /end COMPU_METHOD
/begin MEASUREMENT TQ_DTQ_DICP "" FLOAT32_IEEE MC_TQ_DTQ_DICP 0 0 0 0 ECU_ADDRESS 0x3FA570 /end MEASUREMENT
/begin COMPU_METHOD MC_TQ_DTQ_DICP "TQ_DTQ_DICP conversion" RAT_FUNC "%10.5" "Unitless" COEFFS 0 1 0 0 0 1 /end COMPU_METHOD
/begin MEASUREMENT TQ_FILT "" FLOAT32_IEEE MC_TQ_FILT 0 0 0 0 ECU_ADDRESS 0x3FA5A0 /end MEASUREMENT
/begin COMPU_METHOD MC_TQ_FILT "TQ_FILT conversion" RAT_FUNC "%10.5" "Unitless" COEFFS 0 1 0 0 0 1 /end COMPU_METHOD
/begin MEASUREMENT TQ_FRICTION "" FLOAT32_IEEE MC_TQ_FRICTION 0 0 0 0 ECU_ADDRESS 0x3FA50C /end MEASUREMENT
/begin COMPU_METHOD MC_TQ_FRICTION "TQ_FRICTION conversion" RAT_FUNC "%10.5" "Unitless" COEFFS 0 1 0 0 0 1 /end COMPU_METHOD
/begin MEASUREMENT TQ_HIALT_BASE "" FLOAT32_IEEE MC_TQ_HIALT_BASE 0 0 0 0 ECU_ADDRESS 0x3FA528 /end MEASUREMENT
/begin COMPU_METHOD MC_TQ_HIALT_BASE "TQ_HIALT_BASE conversion" RAT_FUNC "%10.5" "Unitless" COEFFS 0 1 0 0 0 1 /end COMPU_METHOD
/begin MEASUREMENT TQ_HIALT_TERM "" FLOAT32_IEEE MC_TQ_HIALT_TERM 0 0 0 0 ECU_ADDRESS 0x3FA57C /end MEASUREMENT
/begin COMPU_METHOD MC_TQ_HIALT_TERM "TQ_HIALT_TERM conversion" RAT_FUNC "%10.5" "Unitless" COEFFS 0 1 0 0 0 1 /end COMPU_METHOD
/begin CHARACTERISTIC TQ_ICPBASE "" VALUE 0x56D60 SD_FLOAT32_IEEE 0 SC_TQ_ICPBASE 0 40 /end CHARACTERISTIC
/begin COMPU_METHOD SC_TQ_ICPBASE "TQ_ICPBASE conversion" RAT_FUNC "%10.5" "unitless" COEFFS 0 1 0 0 0 1 /end COMPU_METHOD
/begin MEASUREMENT TQ_ICP_PUMP "" FLOAT32_IEEE MC_TQ_ICP_PUMP 0 0 0 0 ECU_ADDRESS 0x3FA56C /end MEASUREMENT
/begin COMPU_METHOD MC_TQ_ICP_PUMP "TQ_ICP_PUMP conversion" RAT_FUNC "%10.5" "Unitless" COEFFS 0 1 0 0 0 1 /end COMPU_METHOD
/begin CHARACTERISTIC TQ_INERTIA "" VALUE 0x56D58 SD_FLOAT32_IEEE 0 SC_TQ_INERTIA 0 100 /end CHARACTERISTIC
/begin COMPU_METHOD SC_TQ_INERTIA "TQ_INERTIA conversion" RAT_FUNC "%10.5" "unitless" COEFFS 0 1 0 0 0 1 /end COMPU_METHOD
/begin MEASUREMENT TQ_LOALT_BASE "" FLOAT32_IEEE MC_TQ_LOALT_BASE 0 0 0 0 ECU_ADDRESS 0x3FA520 /end MEASUREMENT
/begin COMPU_METHOD MC_TQ_LOALT_BASE "TQ_LOALT_BASE conversion" RAT_FUNC "%10.5" "Unitless" COEFFS 0 1 0 0 0 1 /end COMPU_METHOD
/begin MEASUREMENT TQ_LOALT_TERM "" FLOAT32_IEEE MC_TQ_LOALT_TERM 0 0 0 0 ECU_ADDRESS 0x3FA574 /end MEASUREMENT
/begin COMPU_METHOD MC_TQ_LOALT_TERM "TQ_LOALT_TERM conversion" RAT_FUNC "%10.5" "Unitless" COEFFS 0 1 0 0 0 1 /end COMPU_METHOD
/begin MEASUREMENT TQ_MAX_BRK_CF "Maximum brake torque EOT_C/BP_KPA based correction factor" FLOAT32_IEEE MC_TQ_MAX_BRK_CF 0 0 0 0 ECU_ADDRESS 0x3FA5DC /end MEASUREMENT
/begin COMPU_METHOD MC_TQ_MAX_BRK_CF "TQ_MAX_BRK_CF conversion" RAT_FUNC "%10.5" "Unitless" COEFFS 0 1 0 0 0 1 /end COMPU_METHOD
/begin MEASUREMENT TQ_MAX_BRK_RSP "Response back to the trans controller indicating max torque" FLOAT32_IEEE MC_TQ_MAX_BRK_RSP 0 0 0 0 ECU_ADDRESS 0x3FA5C8 /end MEASUREMENT
/begin COMPU_METHOD MC_TQ_MAX_BRK_RSP "TQ_MAX_BRK_RSP conversion" RAT_FUNC "%10.5" "Unitless" COEFFS 0 1 0 0 0 1 /end COMPU_METHOD
/begin MEASUREMENT TQ_MAX_COMB_TRQ "Desired maximum combustion torque to not exceed max brake torque" FLOAT32_IEEE MC_TQ_MAX_COMB_TRQ 0 0 0 0 ECU_ADDRESS 0x3FA5E0 /end MEASUREMENT
/begin COMPU_METHOD MC_TQ_MAX_COMB_TRQ "TQ_MAX_COMB_TRQ conversion" RAT_FUNC "%10.5" "Unitless" COEFFS 0 1 0 0 0 1 /end COMPU_METHOD
/begin MEASUREMENT TQ_MEDALT_BASE "" FLOAT32_IEEE MC_TQ_MEDALT_BASE 0 0 0 0 ECU_ADDRESS 0x3FA524 /end MEASUREMENT
/begin COMPU_METHOD MC_TQ_MEDALT_BASE "TQ_MEDALT_BASE conversion" RAT_FUNC "%10.5" "Unitless" COEFFS 0 1 0 0 0 1 /end COMPU_METHOD
/begin MEASUREMENT TQ_MEDALT_TERM "" FLOAT32_IEEE MC_TQ_MEDALT_TERM 0 0 0 0 ECU_ADDRESS 0x3FA578 /end MEASUREMENT
/begin COMPU_METHOD MC_TQ_MEDALT_TERM "TQ_MEDALT_TERM conversion" RAT_FUNC "%10.5" "Unitless" COEFFS 0 1 0 0 0 1 /end COMPU_METHOD
/begin MEASUREMENT TQ_MIN_BRK_CF "Minimum brake torque EOT_C/BP_KPA based correction factor" FLOAT32_IEEE MC_TQ_MIN_BRK_CF 0 0 0 0 ECU_ADDRESS 0x3FA5D8 /end MEASUREMENT
/begin COMPU_METHOD MC_TQ_MIN_BRK_CF "TQ_MIN_BRK_CF conversion" RAT_FUNC "%10.5" "Unitless" COEFFS 0 1 0 0 0 1 /end COMPU_METHOD
/begin MEASUREMENT TQ_MIN_BRK_RSP "Response back to the trans controller indicating min torque" FLOAT32_IEEE MC_TQ_MIN_BRK_RSP 0 0 0 0 ECU_ADDRESS 0x3FA5C4 /end MEASUREMENT
/begin COMPU_METHOD MC_TQ_MIN_BRK_RSP "TQ_MIN_BRK_RSP conversion" RAT_FUNC "%10.5" "Unitless" COEFFS 0 1 0 0 0 1 /end COMPU_METHOD
/begin CHARACTERISTIC TQ_MOD_DEFAULT "Default target torque for torque mod" VALUE 0x56DB0 SD_FLOAT32_IEEE 0 SC_TQ_MOD_DEFAULT 100 1100 /end CHARACTERISTIC
/begin COMPU_METHOD SC_TQ_MOD_DEFAULT "TQ_MOD_DEFAULT conversion" RAT_FUNC "%10.5" "lbf*ft" COEFFS 0 1 0 0 0 1 /end COMPU_METHOD
/begin CHARACTERISTIC TQ_MOD_EN_FLG "Torque modulation enable flag (1 = enabled)" VALUE 0x569B8 SD_UBYTE 0 SC_TQ_MOD_EN_FLG 0 1 /end CHARACTERISTIC
/begin COMPU_METHOD SC_TQ_MOD_EN_FLG "TQ_MOD_EN_FLG conversion" RAT_FUNC "%3.0" "unitless" COEFFS 0 1 0 0 0 1 /end COMPU_METHOD
/begin CHARACTERISTIC TQ_MOD_MAX_TIME "Maximum time that a single torque modulation request will be honored" VALUE 0x56DB4 SD_FLOAT32_IEEE 0 SC_TQ_MOD_MAX_TIME 0 100 /end CHARACTERISTIC
/begin COMPU_METHOD SC_TQ_MOD_MAX_TIME "TQ_MOD_MAX_TIME conversion" RAT_FUNC "%10.5" "s" COEFFS 0 1 0 0 0 1 /end COMPU_METHOD
/begin CHARACTERISTIC TQ_MOD_MAX_TORQUE "Upper limit for torque mod requests." VALUE 0x56DB8 SD_FLOAT32_IEEE 0 SC_TQ_MOD_MAX_TORQUE -400 1100 /end CHARACTERISTIC
/begin COMPU_METHOD SC_TQ_MOD_MAX_TORQUE "TQ_MOD_MAX_TORQUE conversion" RAT_FUNC "%10.5" "lbf*ft" COEFFS 0 1 0 0 0 1 /end COMPU_METHOD
/begin MEASUREMENT TQ_MOD_MFDES_LMX "Maximum fuel / stroke limit from torque modulation (mg/stroke)" FLOAT32_IEEE MC_TQ_MOD_MFDES_LMX 0 0 0 0 ECU_ADDRESS 0x3FA5BC /end MEASUREMENT
/begin COMPU_METHOD MC_TQ_MOD_MFDES_LMX "TQ_MOD_MFDES_LMX conversion" RAT_FUNC "%10.5" "Unitless" COEFFS 0 1 0 0 0 1 /end COMPU_METHOD
/begin MEASUREMENT TQ_MOD_TARGET "Resulting target maximum torque from torque modulation requests" FLOAT32_IEEE MC_TQ_MOD_TARGET 0 0 0 0 ECU_ADDRESS 0x3FA5D4 /end MEASUREMENT
/begin COMPU_METHOD MC_TQ_MOD_TARGET "TQ_MOD_TARGET conversion" RAT_FUNC "%10.5" "Unitless" COEFFS 0 1 0 0 0 1 /end COMPU_METHOD
/begin MEASUREMENT TQ_MOD_TIMER "Output of timer that runs once torque modulation is active" FLOAT32_IEEE MC_TQ_MOD_TIMER 0 0 0 0 ECU_ADDRESS 0x3FA5EC /end MEASUREMENT
/begin COMPU_METHOD MC_TQ_MOD_TIMER "TQ_MOD_TIMER conversion" RAT_FUNC "%10.5" "Unitless" COEFFS 0 1 0 0 0 1 /end COMPU_METHOD
/begin MEASUREMENT TQ_MOTORING_TORQUE "Uncorrected motoring torque of the engine at the requested rpm" FLOAT32_IEEE MC_TQ_MOTORING_TORQUE 0 0 0 0 ECU_ADDRESS 0x3FA5E4 /end MEASUREMENT
/begin COMPU_METHOD MC_TQ_MOTORING_TORQUE "TQ_MOTORING_TORQUE conversion" RAT_FUNC "%10.5" "Unitless" COEFFS 0 1 0 0 0 1 /end COMPU_METHOD
/begin MEASUREMENT TQ_ND "" FLOAT32_IEEE MC_TQ_ND 0 0 0 0 ECU_ADDRESS 0x3FA534 /end MEASUREMENT
/begin COMPU_METHOD MC_TQ_ND "TQ_ND conversion" RAT_FUNC "%10.5" "Unitless" COEFFS 0 1 0 0 0 1 /end COMPU_METHOD
/begin MEASUREMENT TQ_ND_RAW "" FLOAT32_IEEE MC_TQ_ND_RAW 0 0 0 0 ECU_ADDRESS 0x3FA544 /end MEASUREMENT
/begin COMPU_METHOD MC_TQ_ND_RAW "TQ_ND_RAW conversion" RAT_FUNC "%10.5" "Unitless" COEFFS 0 1 0 0 0 1 /end COMPU_METHOD
/begin MEASUREMENT TQ_ND_RAW_LST "" FLOAT32_IEEE MC_TQ_ND_RAW_LST 0 0 0 0 ECU_ADDRESS 0x3FA540 /end MEASUREMENT
/begin COMPU_METHOD MC_TQ_ND_RAW_LST "TQ_ND_RAW_LST conversion" RAT_FUNC "%10.5" "Unitless" COEFFS 0 1 0 0 0 1 /end COMPU_METHOD
/begin CHARACTERISTIC TQ_ND_TAU "" VALUE 0x56D5C SD_FLOAT32_IEEE 0 SC_TQ_ND_TAU 0 10 /end CHARACTERISTIC
/begin COMPU_METHOD SC_TQ_ND_TAU "TQ_ND_TAU conversion" RAT_FUNC "%10.5" "unitless" COEFFS 0 1 0 0 0 1 /end COMPU_METHOD
/begin MEASUREMENT TQ_NET_DS "Net engine torque compensated (phase lagged) for engine dynamics" FLOAT32_IEEE MC_TQ_NET_DS 0 0 0 0 ECU_ADDRESS 0x3FA59C /end MEASUREMENT
/begin COMPU_METHOD MC_TQ_NET_DS "TQ_NET_DS conversion" RAT_FUNC "%10.5" "Unitless" COEFFS 0 1 0 0 0 1 /end COMPU_METHOD
/begin MEASUREMENT TQ_PUMP "Torque losses due to the high pressure oil pump" FLOAT32_IEEE MC_TQ_PUMP 0 0 0 0 ECU_ADDRESS 0x3FA550 /end MEASUREMENT
/begin COMPU_METHOD MC_TQ_PUMP "TQ_PUMP conversion" RAT_FUNC "%10.5" "Unitless" COEFFS 0 1 0 0 0 1 /end COMPU_METHOD
/begin MEASUREMENT TQ_RAW "" FLOAT32_IEEE MC_TQ_RAW 0 0 0 0 ECU_ADDRESS 0x3FA568 /end MEASUREMENT
/begin COMPU_METHOD MC_TQ_RAW "TQ_RAW conversion" RAT_FUNC "%10.5" "Unitless" COEFFS 0 1 0 0 0 1 /end COMPU_METHOD
/begin CHARACTERISTIC TQ_REQ_N_MIN "Minimum engine speed queery that engine controler responds to." VALUE 0x56DBC SD_FLOAT32_IEEE 0 SC_TQ_REQ_N_MIN 0 8000 /end CHARACTERISTIC
/begin COMPU_METHOD SC_TQ_REQ_N_MIN "TQ_REQ_N_MIN conversion" RAT_FUNC "%10.5" "RPM" COEFFS 0 1 0 0 0 1 /end COMPU_METHOD
/begin MEASUREMENT TQ_SOURCE "Identifies the source of the torque control." UBYTE MC_TQ_SOURCE 0 0 0 0 ECU_ADDRESS 0x3FA14E /end MEASUREMENT
/begin COMPU_METHOD MC_TQ_SOURCE "TQ_SOURCE conversion" RAT_FUNC "%3.0" "Unitless" COEFFS 0 1 0 0 0 1 /end COMPU_METHOD
/begin MEASUREMENT TQ_SSMEAN "" FLOAT32_IEEE MC_TQ_SSMEAN 0 0 0 0 ECU_ADDRESS 0x3FA548 /end MEASUREMENT
/begin COMPU_METHOD MC_TQ_SSMEAN "TQ_SSMEAN conversion" RAT_FUNC "%10.5" "Unitless" COEFFS 0 1 0 0 0 1 /end COMPU_METHOD
/begin MEASUREMENT TQ_TAU "First order lag time constant" FLOAT32_IEEE MC_TQ_TAU 0 0 0 0 ECU_ADDRESS 0x3FA530 /end MEASUREMENT
/begin COMPU_METHOD MC_TQ_TAU "TQ_TAU conversion" RAT_FUNC "%10.5" "Unitless" COEFFS 0 1 0 0 0 1 /end COMPU_METHOD
/begin MEASUREMENT TQ_TORQUE_CURVE "Uncorrected maximum torque of the engine at the requested rpm" FLOAT32_IEEE MC_TQ_TORQUE_CURVE 0 0 0 0 ECU_ADDRESS 0x3FA5E8 /end MEASUREMENT
/begin COMPU_METHOD MC_TQ_TORQUE_CURVE "TQ_TORQUE_CURVE conversion" RAT_FUNC "%10.5" "Unitless" COEFFS 0 1 0 0 0 1 /end COMPU_METHOD
/begin MEASUREMENT TQ_TORQUE_MIN_ALLOW "Response back to the trans controller indicating zero fuel torque" FLOAT32_IEEE MC_TQ_TORQUE_MIN_ALLOW 0 0 0 0 ECU_ADDRESS 0x3FA5C0 /end MEASUREMENT
/begin COMPU_METHOD MC_TQ_TORQUE_MIN_ALLOW "TQ_TORQUE_MIN_ALLOW conversion" RAT_FUNC "%10.5" "Unitless" COEFFS 0 1 0 0 0 1 /end COMPU_METHOD
/begin MEASUREMENT TQ_TRANS "NET TORQUE INTO TORQUE CONVERTER" FLOAT32_IEEE MC_TQ_TRANS 0 0 0 0 ECU_ADDRESS 0x3FA53C /end MEASUREMENT
/begin COMPU_METHOD MC_TQ_TRANS "TQ_TRANS conversion" RAT_FUNC "%10.5" "Unitless" COEFFS 0 1 0 0 0 1 /end COMPU_METHOD
/begin MEASUREMENT TQ_TRGT "Target maximum torque" FLOAT32_IEEE MC_TQ_TRGT 0 0 0 0 ECU_ADDRESS 0x3FA5CC /end MEASUREMENT
/begin COMPU_METHOD MC_TQ_TRGT "TQ_TRGT conversion" RAT_FUNC "%10.5" "Unitless" COEFFS 0 1 0 0 0 1 /end COMPU_METHOD
/begin CHARACTERISTIC TQ_TRUNC_DEFAULT "Default target torque for torque truncation when a can failure is detected" VALUE 0x56DAC SD_FLOAT32_IEEE 0 SC_TQ_TRUNC_DEFAULT 100 1100 /end CHARACTERISTIC
/begin COMPU_METHOD SC_TQ_TRUNC_DEFAULT "TQ_TRUNC_DEFAULT conversion" RAT_FUNC "%10.5" "lbf*ft" COEFFS 0 1 0 0 0 1 /end COMPU_METHOD
/begin CHARACTERISTIC TQ_TRUNC_MIN "Minimum target torque allowed for torque truncation." VALUE 0x56DA8 SD_FLOAT32_IEEE 0 SC_TQ_TRUNC_MIN 100 1100 /end CHARACTERISTIC
/begin COMPU_METHOD SC_TQ_TRUNC_MIN "TQ_TRUNC_MIN conversion" RAT_FUNC "%10.5" "lbf*ft" COEFFS 0 1 0 0 0 1 /end COMPU_METHOD
/begin MEASUREMENT TQ_TRUNC_TARGET "Resulting target maximum torque from torque truncation requests" FLOAT32_IEEE MC_TQ_TRUNC_TARGET 0 0 0 0 ECU_ADDRESS 0x3FA5D0 /end MEASUREMENT
/begin COMPU_METHOD MC_TQ_TRUNC_TARGET "TQ_TRUNC_TARGET conversion" RAT_FUNC "%10.5" "Unitless" COEFFS 0 1 0 0 0 1 /end COMPU_METHOD
/begin CHARACTERISTIC TRANS_AXLE_1 "State encoded calibration of Transmission/Axle Type information for SCP, byte." VALUE 0x57716 SD_UBYTE 0 SC_TRANS_AXLE_1 0 255 /end CHARACTERISTIC
/begin COMPU_METHOD SC_TRANS_AXLE_1 "TRANS_AXLE_1 conversion" RAT_FUNC "%3.0" "UNITLESS" COEFFS 0 1 0 0 0 1 /end COMPU_METHOD
/begin MEASUREMENT TRANS_CAN_F_FLG "Flag indicating a detected problem with CAN causing defaults tobe used" UBYTE MC_TRANS_CAN_F_FLG 0 0 0 0 ECU_ADDRESS 0x3FA5F4 /end MEASUREMENT
/begin COMPU_METHOD MC_TRANS_CAN_F_FLG "TRANS_CAN_F_FLG conversion" RAT_FUNC "%3.0" "Unitless" COEFFS 0 1 0 0 0 1 /end COMPU_METHOD
/begin MEASUREMENT TRANS_DSDRPM "Minimum acceptable value of DSDRPM based on TOT from transmission." FLOAT32_IEEE MC_TRANS_DSDRPM 0 0 0 0 ECU_ADDRESS 0x3FB020 /end MEASUREMENT
/begin COMPU_METHOD MC_TRANS_DSDRPM "TRANS_DSDRPM conversion" RAT_FUNC "%10.5" "Unitless" COEFFS 0 1 0 0 0 1 /end COMPU_METHOD
/begin MEASUREMENT TRAN_LIM_RPM "Engine RPM limit due to transmission specific requirements. (PIP edge based fuel cut-out.)" FLOAT32_IEEE MC_TRAN_LIM_RPM 0 0 0 0 ECU_ADDRESS 0x3FB018 /end MEASUREMENT
/begin COMPU_METHOD MC_TRAN_LIM_RPM "TRAN_LIM_RPM conversion" RAT_FUNC "%10.5" "Unitless" COEFFS 0 1 0 0 0 1 /end COMPU_METHOD
/begin MEASUREMENT TRG_N_MIN "minimum target engine speed for closed throttle mode" FLOAT32_IEEE MC_TRG_N_MIN 0 0 0 0 ECU_ADDRESS 0x3FA114 /end MEASUREMENT
/begin COMPU_METHOD MC_TRG_N_MIN "TRG_N_MIN conversion" RAT_FUNC "%10.5" "Unitless" COEFFS 0 1 0 0 0 1 /end COMPU_METHOD
/begin MEASUREMENT TRG_N_T "Target engine speed requested by transmission." FLOAT32_IEEE MC_TRG_N_T 0 0 0 0 ECU_ADDRESS 0x3FB028 /end MEASUREMENT
/begin COMPU_METHOD MC_TRG_N_T "TRG_N_T conversion" RAT_FUNC "%10.5" "Unitless" COEFFS 0 1 0 0 0 1 /end COMPU_METHOD
/begin MEASUREMENT TRG_N_T_FLG "Flag to indicate transmission is requesting a target engine speed (trg_n_t)" UBYTE MC_TRG_N_T_FLG 0 0 0 0 ECU_ADDRESS 0x3FB027 /end MEASUREMENT
/begin COMPU_METHOD MC_TRG_N_T_FLG "TRG_N_T_FLG conversion" RAT_FUNC "%3.0" "Unitless" COEFFS 0 1 0 0 0 1 /end COMPU_METHOD
/begin MEASUREMENT TRIP "Flag indicating that an obdII trip has been completed; (1 => trip completed)." UBYTE MC_TRIP 0 0 0 0 ECU_ADDRESS 0x3F9F1A /end MEASUREMENT
/begin COMPU_METHOD MC_TRIP "TRIP conversion" RAT_FUNC "%3.0" "Unitless" COEFFS 0 1 0 0 0 1 /end COMPU_METHOD
/begin MEASUREMENT TRIP_COUNT "Count of number of completed OBD-II trips." UBYTE MC_TRIP_COUNT 0 0 0 0 ECU_ADDRESS 0x3FAEEB /end MEASUREMENT
/begin COMPU_METHOD MC_TRIP_COUNT "TRIP_COUNT conversion" RAT_FUNC "%3.0" "Unitless" COEFFS 0 1 0 0 0 1 /end COMPU_METHOD
/begin MEASUREMENT TRIP_MON_LST "bit0-7:cat_mon_lst,ccm_mon_lst,purg_mon_lst,sair_mon_lst,fuel_mon_lst,ego_mon_lst,egr_mon_lst,mis_mon_lst" UBYTE MC_TRIP_MON_LST 0 0 0 0 ECU_ADDRESS 0x3F9F1C /end MEASUREMENT
/begin COMPU_METHOD MC_TRIP_MON_LST "TRIP_MON_LST conversion" RAT_FUNC "%3.0" "Unitless" COEFFS 0 1 0 0 0 1 /end COMPU_METHOD
/begin MEASUREMENT TRIP_NOT_PRG "Flag that indicates all other OBDII monitors have completed except for purge." UBYTE MC_TRIP_NOT_PRG 0 0 0 0 ECU_ADDRESS 0x3F9F1B /end MEASUREMENT
/begin COMPU_METHOD MC_TRIP_NOT_PRG "TRIP_NOT_PRG conversion" RAT_FUNC "%3.0" "Unitless" COEFFS 0 1 0 0 0 1 /end COMPU_METHOD
/begin MEASUREMENT TSLVS_SCP "Time since last valid VEHICLE_SPEED_HI message was received over SCP" UWORD MC_TSLVS_SCP 0 0 0 0 ECU_ADDRESS 0x3FAA28 /end MEASUREMENT
/begin COMPU_METHOD MC_TSLVS_SCP "TSLVS_SCP conversion" RAT_FUNC "%5.0" "Unitless" COEFFS 0 1 0 0 0 1 /end COMPU_METHOD
/begin CHARACTERISTIC TYPEA_FL_MIL "Always flash MIL for type-A misfire; 1 = flash MIL." VALUE 0x56344 SD_UBYTE 0 SC_TYPEA_FL_MIL 0 1 /end CHARACTERISTIC
/begin COMPU_METHOD SC_TYPEA_FL_MIL "TYPEA_FL_MIL conversion" RAT_FUNC "%3.0" "unitless" COEFFS 0 1 0 0 0 1 /end COMPU_METHOD
/begin MEASUREMENT TYPE_A_MIS "Indicates to executive which misfire criteria" UBYTE MC_TYPE_A_MIS 0 0 0 0 ECU_ADDRESS 0x3FADD3 /end MEASUREMENT
/begin COMPU_METHOD MC_TYPE_A_MIS "TYPE_A_MIS conversion" RAT_FUNC "%3.0" "Unitless" COEFFS 0 1 0 0 0 1 /end COMPU_METHOD
/begin MEASUREMENT UNDSP "Underspeed flag." UBYTE MC_UNDSP 0 0 0 0 ECU_ADDRESS 0x3FA150 /end MEASUREMENT
/begin COMPU_METHOD MC_UNDSP "UNDSP conversion" RAT_FUNC "%3.0" "Unitless" COEFFS 0 1 0 0 0 1 /end COMPU_METHOD
/begin MEASUREMENT UNREALISTIC_N "Captured engine speed when exceeds max (6500)" FLOAT32_IEEE MC_UNREALISTIC_N 0 0 0 0 ECU_ADDRESS 0x3FA04C /end MEASUREMENT
/begin COMPU_METHOD MC_UNREALISTIC_N "UNREALISTIC_N conversion" RAT_FUNC "%10.5" "Unitless" COEFFS 0 1 0 0 0 1 /end COMPU_METHOD
/begin MEASUREMENT USPD_RUN_TMR "Time in underspeed or run mode." FLOAT32_IEEE MC_USPD_RUN_TMR 0 0 0 0 ECU_ADDRESS 0x3FABBC /end MEASUREMENT
/begin COMPU_METHOD MC_USPD_RUN_TMR "USPD_RUN_TMR conversion" RAT_FUNC "%10.5" "Unitless" COEFFS 0 1 0 0 0 1 /end COMPU_METHOD
/begin MEASUREMENT VBAT "Filtered battery voltage." FLOAT32_IEEE MC_VBAT 0 0 0 0 ECU_ADDRESS 0x3FAF58 /end MEASUREMENT
/begin COMPU_METHOD MC_VBAT "VBAT conversion" RAT_FUNC "%10.5" "Unitless" COEFFS 0 1 0 0 0 1 /end COMPU_METHOD
/begin CHARACTERISTIC VBAT_CCM_MIN "Minimum voltage to perform OSM tests." VALUE 0x57B58 SD_FLOAT32_IEEE 0 SC_VBAT_CCM_MIN 0 15.5 /end CHARACTERISTIC
/begin COMPU_METHOD SC_VBAT_CCM_MIN "VBAT_CCM_MIN conversion" RAT_FUNC "%10.5" "VOLTS" COEFFS 0 1 0 0 0 1 /end COMPU_METHOD
/begin MEASUREMENT VEGO_AMP11M6 "Amplitude (volts) of difference between rich and lean for bank1, fore HEGO. Not updated until EGO_MON=1" FLOAT32_IEEE MC_VEGO_AMP11M6 0 0 0 0 ECU_ADDRESS 0x3FAE28 /end MEASUREMENT
/begin COMPU_METHOD MC_VEGO_AMP11M6 "VEGO_AMP11M6 conversion" RAT_FUNC "%10.5" "Unitless" COEFFS 0 1 0 0 0 1 /end COMPU_METHOD
/begin MEASUREMENT VFD "Viscous fan speed output level." FLOAT32_IEEE MC_VFD 0 0 0 0 ECU_ADDRESS 0x3FA958 /end MEASUREMENT
/begin COMPU_METHOD MC_VFD "VFD conversion" RAT_FUNC "%10.5" "Unitless" COEFFS 0 1 0 0 0 1 /end COMPU_METHOD
/begin MEASUREMENT VFDES "Desired volumetric fuel quantity (mm**3/stroke)" FLOAT32_IEEE MC_VFDES 0 0 0 0 ECU_ADDRESS 0x3FA320 /end MEASUREMENT
/begin COMPU_METHOD MC_VFDES "VFDES conversion" RAT_FUNC "%10.5" "Unitless" COEFFS 0 1 0 0 0 1 /end COMPU_METHOD
/begin MEASUREMENT VFDES_M "Main volumetric fuel quantity (mm**3/stroke)" FLOAT32_IEEE MC_VFDES_M 0 0 0 0 ECU_ADDRESS 0x3FA31C /end MEASUREMENT
/begin COMPU_METHOD MC_VFDES_M "VFDES_M conversion" RAT_FUNC "%10.5" "Unitless" COEFFS 0 1 0 0 0 1 /end COMPU_METHOD
/begin MEASUREMENT VFDES_P "Pilot volumetric fuel quantity (mm**3/stroke)" FLOAT32_IEEE MC_VFDES_P 0 0 0 0 ECU_ADDRESS 0x3FA318 /end MEASUREMENT
/begin COMPU_METHOD MC_VFDES_P "VFDES_P conversion" RAT_FUNC "%10.5" "Unitless" COEFFS 0 1 0 0 0 1 /end COMPU_METHOD
/begin MEASUREMENT VFDES_POST2 "" FLOAT32_IEEE MC_VFDES_POST2 0 0 0 0 ECU_ADDRESS 0x3FAD68 /end MEASUREMENT
/begin COMPU_METHOD MC_VFDES_POST2 "VFDES_POST2 conversion" RAT_FUNC "%10.5" "Unitless" COEFFS 0 1 0 0 0 1 /end COMPU_METHOD
/begin MEASUREMENT VFDES_P_MIN "Pilot volumetric fuel quantity (mm**3/stroke)" FLOAT32_IEEE MC_VFDES_P_MIN 0 0 0 0 ECU_ADDRESS 0x3FA2F4 /end MEASUREMENT
/begin COMPU_METHOD MC_VFDES_P_MIN "VFDES_P_MIN conversion" RAT_FUNC "%10.5" "Unitless" COEFFS 0 1 0 0 0 1 /end COMPU_METHOD
/begin CHARACTERISTIC VFD_AC_DES "Desired viscous fan speed demanded by the A/C." VALUE 0x571E4 SD_FLOAT32_IEEE 0 SC_VFD_AC_DES 0 7000 /end CHARACTERISTIC
/begin COMPU_METHOD SC_VFD_AC_DES "VFD_AC_DES conversion" RAT_FUNC "%10.5" "RPM" COEFFS 0 1 0 0 0 1 /end COMPU_METHOD
/begin MEASUREMENT VFD_AC_FLG "Viscous fan demanded by A/C system." UBYTE MC_VFD_AC_FLG 0 0 0 0 ECU_ADDRESS 0x3FA90C /end MEASUREMENT
/begin COMPU_METHOD MC_VFD_AC_FLG "VFD_AC_FLG conversion" RAT_FUNC "%3.0" "Unitless" COEFFS 0 1 0 0 0 1 /end COMPU_METHOD
/begin CHARACTERISTIC VFD_AC_MAX "Viscous fan speed requested when high A/C head pressure detected." VALUE 0x571E0 SD_FLOAT32_IEEE 0 SC_VFD_AC_MAX 0 7000 /end CHARACTERISTIC
/begin COMPU_METHOD SC_VFD_AC_MAX "VFD_AC_MAX conversion" RAT_FUNC "%10.5" "RPM" COEFFS 0 1 0 0 0 1 /end COMPU_METHOD
/begin MEASUREMENT VFD_AC_N "Viscous fan speed requested by airconditioning." FLOAT32_IEEE MC_VFD_AC_N 0 0 0 0 ECU_ADDRESS 0x3FA908 /end MEASUREMENT
/begin COMPU_METHOD MC_VFD_AC_N "VFD_AC_N conversion" RAT_FUNC "%10.5" "Unitless" COEFFS 0 1 0 0 0 1 /end COMPU_METHOD
/begin CHARACTERISTIC VFD_AC_OPT "Optimum viscous fan speed when A/C is requested  with no high A/C head pressure" VALUE 0x571EC SD_FLOAT32_IEEE 0 SC_VFD_AC_OPT 0 7000 /end CHARACTERISTIC
/begin COMPU_METHOD SC_VFD_AC_OPT "VFD_AC_OPT conversion" RAT_FUNC "%10.5" "RPM" COEFFS 0 1 0 0 0 1 /end COMPU_METHOD
/begin CHARACTERISTIC VFD_AMB_MIN_DEGC "Set viscous fan to desired speed above this ambient temperature in degc." VALUE 0x571E8 SD_FLOAT32_IEEE 0 SC_VFD_AMB_MIN_DEGC -586 550 /end CHARACTERISTIC
/begin COMPU_METHOD SC_VFD_AMB_MIN_DEGC "VFD_AMB_MIN_DEGC conversion" RAT_FUNC "%10.5" "degC" COEFFS 0 1 0 0 0 1 /end COMPU_METHOD
/begin CHARACTERISTIC VFD_DESECT_DEGC "Desired ECT control point for Visctronic fan." VALUE 0x5720C SD_FLOAT32_IEEE 0 SC_VFD_DESECT_DEGC 0 123 /end CHARACTERISTIC
/begin COMPU_METHOD SC_VFD_DESECT_DEGC "VFD_DESECT_DEGC conversion" RAT_FUNC "%10.5" "degC" COEFFS 0 1 0 0 0 1 /end COMPU_METHOD
/begin CHARACTERISTIC VFD_DRV_RAT "Engine to fan drive ratio." VALUE 0x57220 SD_FLOAT32_IEEE 0 SC_VFD_DRV_RAT 0 10 /end CHARACTERISTIC
/begin COMPU_METHOD SC_VFD_DRV_RAT "VFD_DRV_RAT conversion" RAT_FUNC "%10.5" "unitless" COEFFS 0 1 0 0 0 1 /end COMPU_METHOD
/begin CHARACTERISTIC VFD_DTY_OFST "Final viscous fan output duty cycle offset" VALUE 0x5726C SD_FLOAT32_IEEE 0 SC_VFD_DTY_OFST 0 1 /end CHARACTERISTIC
/begin COMPU_METHOD SC_VFD_DTY_OFST "VFD_DTY_OFST conversion" RAT_FUNC "%10.5" "unitless" COEFFS 0 1 0 0 0 1 /end COMPU_METHOD
/begin MEASUREMENT VFD_ECT_ER_DEGC "ECT distance from desired ECT control point" FLOAT32_IEEE MC_VFD_ECT_ER_DEGC 0 0 0 0 ECU_ADDRESS 0x3FA910 /end MEASUREMENT
/begin COMPU_METHOD MC_VFD_ECT_ER_DEGC "VFD_ECT_ER_DEGC conversion" RAT_FUNC "%10.5" "Unitless" COEFFS 0 1 0 0 0 1 /end COMPU_METHOD
/begin CHARACTERISTIC VFD_ECT_HI_DEGC "ECT upper temp limit for max viscous fan speed." VALUE 0x57230 SD_FLOAT32_IEEE 0 SC_VFD_ECT_HI_DEGC -40 123 /end CHARACTERISTIC
/begin COMPU_METHOD SC_VFD_ECT_HI_DEGC "VFD_ECT_HI_DEGC conversion" RAT_FUNC "%10.5" "degC" COEFFS 0 1 0 0 0 1 /end COMPU_METHOD
/begin CHARACTERISTIC VFD_ECT_LO_DEGC "ECT lower temp limit for min viscous fan speed." VALUE 0x5722C SD_FLOAT32_IEEE 0 SC_VFD_ECT_LO_DEGC -40 123 /end CHARACTERISTIC
/begin COMPU_METHOD SC_VFD_ECT_LO_DEGC "VFD_ECT_LO_DEGC conversion" RAT_FUNC "%10.5" "degC" COEFFS 0 1 0 0 0 1 /end COMPU_METHOD
/begin MEASUREMENT VFD_ECT_N "Viscous fan speed requested by ect." FLOAT32_IEEE MC_VFD_ECT_N 0 0 0 0 ECU_ADDRESS 0x3FA918 /end MEASUREMENT
/begin COMPU_METHOD MC_VFD_ECT_N "VFD_ECT_N conversion" RAT_FUNC "%10.5" "Unitless" COEFFS 0 1 0 0 0 1 /end COMPU_METHOD
/begin CHARACTERISTIC VFD_ENG_BUF "Engine slip heat buffer." VALUE 0x57234 SD_FLOAT32_IEEE 0 SC_VFD_ENG_BUF 0 7000 /end CHARACTERISTIC
/begin COMPU_METHOD SC_VFD_ENG_BUF "VFD_ENG_BUF conversion" RAT_FUNC "%10.5" "RPM" COEFFS 0 1 0 0 0 1 /end COMPU_METHOD
/begin CHARACTERISTIC VFD_ENG_SLIP "In slip heat area above this engine RPM." VALUE 0x57228 SD_FLOAT32_IEEE 0 SC_VFD_ENG_SLIP 0 7000 /end CHARACTERISTIC
/begin COMPU_METHOD SC_VFD_ENG_SLIP "VFD_ENG_SLIP conversion" RAT_FUNC "%10.5" "RPM" COEFFS 0 1 0 0 0 1 /end COMPU_METHOD
/begin MEASUREMENT VFD_FAN_N "Viscous filtered fan speed, used in control regulator." FLOAT32_IEEE MC_VFD_FAN_N 0 0 0 0 ECU_ADDRESS 0x3FAD64 /end MEASUREMENT
/begin COMPU_METHOD MC_VFD_FAN_N "VFD_FAN_N conversion" RAT_FUNC "%10.5" "Unitless" COEFFS 0 1 0 0 0 1 /end COMPU_METHOD
/begin CHARACTERISTIC VFD_FAN_NMAX "Maximum reasonable filtered fan speed that can be expected." VALUE 0x57240 SD_FLOAT32_IEEE 0 SC_VFD_FAN_NMAX 0 7000 /end CHARACTERISTIC
/begin COMPU_METHOD SC_VFD_FAN_NMAX "VFD_FAN_NMAX conversion" RAT_FUNC "%10.5" "RPM" COEFFS 0 1 0 0 0 1 /end COMPU_METHOD
/begin CHARACTERISTIC VFD_FAN_SLIP "In slip heat area above this viscous fan RPM." VALUE 0x57224 SD_FLOAT32_IEEE 0 SC_VFD_FAN_SLIP 0 7000 /end CHARACTERISTIC
/begin COMPU_METHOD SC_VFD_FAN_SLIP "VFD_FAN_SLIP conversion" RAT_FUNC "%10.5" "RPM" COEFFS 0 1 0 0 0 1 /end COMPU_METHOD
/begin MEASUREMENT VFD_FB_ERLST "Viscous fan feedback error term last." FLOAT32_IEEE MC_VFD_FB_ERLST 0 0 0 0 ECU_ADDRESS 0x3FA950 /end MEASUREMENT
/begin COMPU_METHOD MC_VFD_FB_ERLST "VFD_FB_ERLST conversion" RAT_FUNC "%10.5" "Unitless" COEFFS 0 1 0 0 0 1 /end COMPU_METHOD
/begin MEASUREMENT VFD_FB_ERR "Viscous fan feedback error term." FLOAT32_IEEE MC_VFD_FB_ERR 0 0 0 0 ECU_ADDRESS 0x3FA954 /end MEASUREMENT
/begin COMPU_METHOD MC_VFD_FB_ERR "VFD_FB_ERR conversion" RAT_FUNC "%10.5" "Unitless" COEFFS 0 1 0 0 0 1 /end COMPU_METHOD
/begin MEASUREMENT VFD_FB_INLST "Viscous fan feedfback input control term last." FLOAT32_IEEE MC_VFD_FB_INLST 0 0 0 0 ECU_ADDRESS 0x3FA94C /end MEASUREMENT
/begin COMPU_METHOD MC_VFD_FB_INLST "VFD_FB_INLST conversion" RAT_FUNC "%10.5" "Unitless" COEFFS 0 1 0 0 0 1 /end COMPU_METHOD
/begin MEASUREMENT VFD_FFAN_N "Viscous fan filtered speed." FLOAT32_IEEE MC_VFD_FFAN_N 0 0 0 0 ECU_ADDRESS 0x3FA938 /end MEASUREMENT
/begin COMPU_METHOD MC_VFD_FFAN_N "VFD_FFAN_N conversion" RAT_FUNC "%10.5" "Unitless" COEFFS 0 1 0 0 0 1 /end COMPU_METHOD
/begin MEASUREMENT VFD_FF_ERLST "Viscous fan feedforward error term last." FLOAT32_IEEE MC_VFD_FF_ERLST 0 0 0 0 ECU_ADDRESS 0x3FA93C /end MEASUREMENT
/begin COMPU_METHOD MC_VFD_FF_ERLST "VFD_FF_ERLST conversion" RAT_FUNC "%10.5" "Unitless" COEFFS 0 1 0 0 0 1 /end COMPU_METHOD
/begin MEASUREMENT VFD_FF_ERR "Viscous fan feedforward error term." FLOAT32_IEEE MC_VFD_FF_ERR 0 0 0 0 ECU_ADDRESS 0x3FA948 /end MEASUREMENT
/begin COMPU_METHOD MC_VFD_FF_ERR "VFD_FF_ERR conversion" RAT_FUNC "%10.5" "Unitless" COEFFS 0 1 0 0 0 1 /end COMPU_METHOD
/begin MEASUREMENT VFD_FF_INLST "Viscous fan feedforward input control term last." FLOAT32_IEEE MC_VFD_FF_INLST 0 0 0 0 ECU_ADDRESS 0x3FA940 /end MEASUREMENT
/begin COMPU_METHOD MC_VFD_FF_INLST "VFD_FF_INLST conversion" RAT_FUNC "%10.5" "Unitless" COEFFS 0 1 0 0 0 1 /end COMPU_METHOD
/begin MEASUREMENT VFD_FF_INP "Viscous fan feedforward input control term." FLOAT32_IEEE MC_VFD_FF_INP 0 0 0 0 ECU_ADDRESS 0x3FA944 /end MEASUREMENT
/begin COMPU_METHOD MC_VFD_FF_INP "VFD_FF_INP conversion" RAT_FUNC "%10.5" "Unitless" COEFFS 0 1 0 0 0 1 /end COMPU_METHOD
/begin CHARACTERISTIC VFD_FREQ "Frequency for VFD." VALUE 0x57708 SD_FLOAT32_IEEE 0 SC_VFD_FREQ 3.5 30 /end CHARACTERISTIC
/begin COMPU_METHOD SC_VFD_FREQ "VFD_FREQ conversion" RAT_FUNC "%10.5" "HZ" COEFFS 0 1 0 0 0 1 /end COMPU_METHOD
/begin CHARACTERISTIC VFD_HP "Viscous fan hardware present." VALUE 0x57244 SD_UBYTE 0 SC_VFD_HP 0 1 /end CHARACTERISTIC
/begin COMPU_METHOD SC_VFD_HP "VFD_HP conversion" RAT_FUNC "%3.0" "unitless" COEFFS 0 1 0 0 0 1 /end COMPU_METHOD
/begin CHARACTERISTIC VFD_IK "Viscous fan integrator gain." VALUE 0x57204 SD_FLOAT32_IEEE 0 SC_VFD_IK 0 20 /end CHARACTERISTIC
/begin COMPU_METHOD SC_VFD_IK "VFD_IK conversion" RAT_FUNC "%10.5" "1/deg*s" COEFFS 0 1 0 0 0 1 /end COMPU_METHOD
/begin MEASUREMENT VFD_INTER "Integrator for VFD." FLOAT32_IEEE MC_VFD_INTER 0 0 0 0 ECU_ADDRESS 0x3FA914 /end MEASUREMENT
/begin COMPU_METHOD MC_VFD_INTER "VFD_INTER conversion" RAT_FUNC "%10.5" "Unitless" COEFFS 0 1 0 0 0 1 /end COMPU_METHOD
/begin CHARACTERISTIC VFD_INT_RPM "Base value for VFD integrator." VALUE 0x57200 SD_FLOAT32_IEEE 0 SC_VFD_INT_RPM 0 7000 /end CHARACTERISTIC
/begin COMPU_METHOD SC_VFD_INT_RPM "VFD_INT_RPM conversion" RAT_FUNC "%10.5" "RPM" COEFFS 0 1 0 0 0 1 /end COMPU_METHOD
/begin CHARACTERISTIC VFD_K1 "Viscous fan feedback constant, K1." VALUE 0x5727A SD_UWORD 0 SC_VFD_K1 0 1000 /end CHARACTERISTIC
/begin COMPU_METHOD SC_VFD_K1 "VFD_K1 conversion" RAT_FUNC "%5.0" "unitless" COEFFS 0 1 0 0 0 1 /end COMPU_METHOD
/begin CHARACTERISTIC VFD_K2 "Viscous fan feedback constant, K2." VALUE 0x57278 SD_UWORD 0 SC_VFD_K2 0 1000 /end CHARACTERISTIC
/begin COMPU_METHOD SC_VFD_K2 "VFD_K2 conversion" RAT_FUNC "%5.0" "unitless" COEFFS 0 1 0 0 0 1 /end COMPU_METHOD
/begin CHARACTERISTIC VFD_K3 "Viscous fan feedback constant, K3." VALUE 0x57276 SD_UWORD 0 SC_VFD_K3 0 1000 /end CHARACTERISTIC
/begin COMPU_METHOD SC_VFD_K3 "VFD_K3 conversion" RAT_FUNC "%5.0" "unitless" COEFFS 0 1 0 0 0 1 /end COMPU_METHOD
/begin CHARACTERISTIC VFD_K4 "Viscous fan feedforward constant, K4." VALUE 0x57274 SD_UWORD 0 SC_VFD_K4 0 1000 /end CHARACTERISTIC
/begin COMPU_METHOD SC_VFD_K4 "VFD_K4 conversion" RAT_FUNC "%5.0" "unitless" COEFFS 0 1 0 0 0 1 /end COMPU_METHOD
/begin CHARACTERISTIC VFD_K5 "Viscous fan feedforward constant, K5." VALUE 0x57272 SD_UWORD 0 SC_VFD_K5 0 1000 /end CHARACTERISTIC
/begin COMPU_METHOD SC_VFD_K5 "VFD_K5 conversion" RAT_FUNC "%5.0" "unitless" COEFFS 0 1 0 0 0 1 /end COMPU_METHOD
/begin CHARACTERISTIC VFD_K6 "Viscous fan feedforward constant, K6." VALUE 0x57270 SD_UWORD 0 SC_VFD_K6 0 1000 /end CHARACTERISTIC
/begin COMPU_METHOD SC_VFD_K6 "VFD_K6 conversion" RAT_FUNC "%5.0" "unitless" COEFFS 0 1 0 0 0 1 /end COMPU_METHOD
/begin CHARACTERISTIC VFD_MAX_IDLE "Stoplight mode below this idle rpm." VALUE 0x5721C SD_FLOAT32_IEEE 0 SC_VFD_MAX_IDLE 0 7000 /end CHARACTERISTIC
/begin COMPU_METHOD SC_VFD_MAX_IDLE "VFD_MAX_IDLE conversion" RAT_FUNC "%10.5" "RPM" COEFFS 0 1 0 0 0 1 /end COMPU_METHOD
/begin CHARACTERISTIC VFD_MAX_RPM "Maximum viscous fan speed demand." VALUE 0x57208 SD_FLOAT32_IEEE 0 SC_VFD_MAX_RPM 0 7000 /end CHARACTERISTIC
/begin COMPU_METHOD SC_VFD_MAX_RPM "VFD_MAX_RPM conversion" RAT_FUNC "%10.5" "RPM" COEFFS 0 1 0 0 0 1 /end COMPU_METHOD
/begin CHARACTERISTIC VFD_MIN_RPM "Minimum viscous fan speed clip demand." VALUE 0x57218 SD_FLOAT32_IEEE 0 SC_VFD_MIN_RPM 0 7000 /end CHARACTERISTIC
/begin COMPU_METHOD SC_VFD_MIN_RPM "VFD_MIN_RPM conversion" RAT_FUNC "%10.5" "RPM" COEFFS 0 1 0 0 0 1 /end COMPU_METHOD
/begin CHARACTERISTIC VFD_NMAX "Maximum reasonable fan speed that can be expected." VALUE 0x5733C SD_FLOAT32_IEEE 0 SC_VFD_NMAX 0 7000 /end CHARACTERISTIC
/begin COMPU_METHOD SC_VFD_NMAX "VFD_NMAX conversion" RAT_FUNC "%10.5" "RPM" COEFFS 0 1 0 0 0 1 /end COMPU_METHOD
/begin MEASUREMENT VFD_N_ERROR "Viscous fan error (requested - filtered)." FLOAT32_IEEE MC_VFD_N_ERROR 0 0 0 0 ECU_ADDRESS 0x3FA934 /end MEASUREMENT
/begin COMPU_METHOD MC_VFD_N_ERROR "VFD_N_ERROR conversion" RAT_FUNC "%10.5" "Unitless" COEFFS 0 1 0 0 0 1 /end COMPU_METHOD
/begin CHARACTERISTIC VFD_N_TC "Time constant for VFD_FAN_N." VALUE 0x57338 SD_FLOAT32_IEEE 0 SC_VFD_N_TC 0 63.99 /end CHARACTERISTIC
/begin COMPU_METHOD SC_VFD_N_TC "VFD_N_TC conversion" RAT_FUNC "%10.5" "unitless" COEFFS 0 1 0 0 0 1 /end COMPU_METHOD
/begin MEASUREMENT VFD_REQ_N "Viscous fan final output speed." FLOAT32_IEEE MC_VFD_REQ_N 0 0 0 0 ECU_ADDRESS 0x3FA92C /end MEASUREMENT
/begin COMPU_METHOD MC_VFD_REQ_N "VFD_REQ_N conversion" RAT_FUNC "%10.5" "Unitless" COEFFS 0 1 0 0 0 1 /end COMPU_METHOD
/begin CHARACTERISTIC VFD_SL1_DC "Stoplight mode 1 duty cycle:  phase out fan when cooling" VALUE 0x57268 SD_FLOAT32_IEEE 0 SC_VFD_SL1_DC 0 1 /end CHARACTERISTIC
/begin COMPU_METHOD SC_VFD_SL1_DC "VFD_SL1_DC conversion" RAT_FUNC "%10.5" "unitless" COEFFS 0 1 0 0 0 1 /end COMPU_METHOD
/begin MEASUREMENT VFD_SLIP_CTL "Viscous fan slip control mode; 0->off, 1->over temp., 2->under temp.." UBYTE MC_VFD_SLIP_CTL 0 0 0 0 ECU_ADDRESS 0x3FA920 /end MEASUREMENT
/begin COMPU_METHOD MC_VFD_SLIP_CTL "VFD_SLIP_CTL conversion" RAT_FUNC "%3.0" "Unitless" COEFFS 0 1 0 0 0 1 /end COMPU_METHOD
/begin CHARACTERISTIC VFD_SLIP_RPM "Viscous fan assumed off if fan-slip is greater than this." VALUE 0x57214 SD_FLOAT32_IEEE 0 SC_VFD_SLIP_RPM 0 7000 /end CHARACTERISTIC
/begin COMPU_METHOD SC_VFD_SLIP_RPM "VFD_SLIP_RPM conversion" RAT_FUNC "%10.5" "unitless" COEFFS 0 1 0 0 0 1 /end COMPU_METHOD
/begin MEASUREMENT VFD_SL_STATE "Stoplight mode: 0 = normal; 1 =  at idle, cooling; 2 = at  idle, high slip" UBYTE MC_VFD_SL_STATE 0 0 0 0 ECU_ADDRESS 0x3FA91C /end MEASUREMENT
/begin COMPU_METHOD MC_VFD_SL_STATE "VFD_SL_STATE conversion" RAT_FUNC "%3.0" "Unitless" COEFFS 0 1 0 0 0 1 /end COMPU_METHOD
/begin CHARACTERISTIC VFD_TEETH "Number of teeth on the Visctronic fan speed sensor." VALUE 0x57340 SD_UBYTE 0 SC_VFD_TEETH 6 18 /end CHARACTERISTIC
/begin COMPU_METHOD SC_VFD_TEETH "VFD_TEETH conversion" RAT_FUNC "%3.0" "unitless" COEFFS 0 1 0 0 0 1 /end COMPU_METHOD
/begin MEASUREMENT VFD_TOT_FLG "TOT fan speed calculation required; 1=yes." UBYTE MC_VFD_TOT_FLG 0 0 0 0 ECU_ADDRESS 0x3FA960 /end MEASUREMENT
/begin COMPU_METHOD MC_VFD_TOT_FLG "VFD_TOT_FLG conversion" RAT_FUNC "%3.0" "Unitless" COEFFS 0 1 0 0 0 1 /end COMPU_METHOD
/begin MEASUREMENT VFD_TOT_N "Viscous fan speed requested by TOT." FLOAT32_IEEE MC_VFD_TOT_N 0 0 0 0 ECU_ADDRESS 0x3FA95C /end MEASUREMENT
/begin COMPU_METHOD MC_VFD_TOT_N "VFD_TOT_N conversion" RAT_FUNC "%10.5" "Unitless" COEFFS 0 1 0 0 0 1 /end COMPU_METHOD
/begin CHARACTERISTIC VFD_TOT_N_CL_DEGC "Switch viscous fan off below this TOT if not required by other sources." VALUE 0x57238 SD_FLOAT32_IEEE 0 SC_VFD_TOT_N_CL_DEGC -40 260 /end CHARACTERISTIC
/begin COMPU_METHOD SC_VFD_TOT_N_CL_DEGC "VFD_TOT_N_CL_DEGC conversion" RAT_FUNC "%10.5" "degC" COEFFS 0 1 0 0 0 1 /end COMPU_METHOD
/begin CHARACTERISTIC VFD_TOT_N_SH_DEGC "Switch viscous fan on above this TOT." VALUE 0x5723C SD_FLOAT32_IEEE 0 SC_VFD_TOT_N_SH_DEGC -40 260 /end CHARACTERISTIC
/begin COMPU_METHOD SC_VFD_TOT_N_SH_DEGC "VFD_TOT_N_SH_DEGC conversion" RAT_FUNC "%10.5" "degC" COEFFS 0 1 0 0 0 1 /end COMPU_METHOD
/begin MEASUREMENT VFS1_I_OUT "Current that the uP is supposed to deliver to VFS1." FLOAT32_IEEE MC_VFS1_I_OUT 0 0 0 0 ECU_ADDRESS 0x3FAC3C /end MEASUREMENT
/begin COMPU_METHOD MC_VFS1_I_OUT "VFS1_I_OUT conversion" RAT_FUNC "%10.5" "Unitless" COEFFS 0 1 0 0 0 1 /end COMPU_METHOD
/begin MEASUREMENT VFS1_PRS "Final VFS1 Pressure Value" FLOAT32_IEEE MC_VFS1_PRS 0 0 0 0 ECU_ADDRESS 0x3FAC30 /end MEASUREMENT
/begin COMPU_METHOD MC_VFS1_PRS "VFS1_PRS conversion" RAT_FUNC "%10.5" "Unitless" COEFFS 0 1 0 0 0 1 /end COMPU_METHOD
/begin MEASUREMENT VFS2_I_OUT "Current that the uP is supposed to deliver to VFS2." FLOAT32_IEEE MC_VFS2_I_OUT 0 0 0 0 ECU_ADDRESS 0x3FAC38 /end MEASUREMENT
/begin COMPU_METHOD MC_VFS2_I_OUT "VFS2_I_OUT conversion" RAT_FUNC "%10.5" "Unitless" COEFFS 0 1 0 0 0 1 /end COMPU_METHOD
/begin MEASUREMENT VFS2_PRS "Final VFS2 Pressure Value" FLOAT32_IEEE MC_VFS2_PRS 0 0 0 0 ECU_ADDRESS 0x3FAC2C /end MEASUREMENT
/begin COMPU_METHOD MC_VFS2_PRS "VFS2_PRS conversion" RAT_FUNC "%10.5" "Unitless" COEFFS 0 1 0 0 0 1 /end COMPU_METHOD
/begin MEASUREMENT VFS_C_PRS "Commanded pressure for the transmission electronic pressure control C (EPC-C/VFS-C)" FLOAT32_IEEE MC_VFS_C_PRS 0 0 0 0 ECU_ADDRESS 0x3FAC28 /end MEASUREMENT
/begin COMPU_METHOD MC_VFS_C_PRS "VFS_C_PRS conversion" RAT_FUNC "%10.5" "Unitless" COEFFS 0 1 0 0 0 1 /end COMPU_METHOD
/begin CHARACTERISTIC VF_MAIN_CAL "Calibratable VFDES_M" VALUE 0x56A00 SD_FLOAT32_IEEE 0 SC_VF_MAIN_CAL 0 60 /end CHARACTERISTIC
/begin COMPU_METHOD SC_VF_MAIN_CAL "VF_MAIN_CAL conversion" RAT_FUNC "%10.5" "unitless" COEFFS 0 1 0 0 0 1 /end COMPU_METHOD
/begin CHARACTERISTIC VF_MAIN_SEL "Selects source of VFDES_M" VALUE 0x56A0D SD_UBYTE 0 SC_VF_MAIN_SEL 0 255 /end CHARACTERISTIC
/begin COMPU_METHOD SC_VF_MAIN_SEL "VF_MAIN_SEL conversion" RAT_FUNC "%3.0" "unitless" COEFFS 0 1 0 0 0 1 /end COMPU_METHOD
/begin CHARACTERISTIC VF_PILOT_CAL "Calibratable VFDES_P" VALUE 0x56A04 SD_FLOAT32_IEEE 0 SC_VF_PILOT_CAL 0 60 /end CHARACTERISTIC
/begin COMPU_METHOD SC_VF_PILOT_CAL "VF_PILOT_CAL conversion" RAT_FUNC "%10.5" "unitless" COEFFS 0 1 0 0 0 1 /end COMPU_METHOD
/begin MEASUREMENT VF_PILOT_MULTI "Volumetric fuel multiplier" FLOAT32_IEEE MC_VF_PILOT_MULTI 0 0 0 0 ECU_ADDRESS 0x3FA30C /end MEASUREMENT
/begin COMPU_METHOD MC_VF_PILOT_MULTI "VF_PILOT_MULTI conversion" RAT_FUNC "%10.5" "Unitless" COEFFS 0 1 0 0 0 1 /end COMPU_METHOD
/begin CHARACTERISTIC VF_PILOT_SEL "Selects source of VFDES_P" VALUE 0x56A0C SD_UBYTE 0 SC_VF_PILOT_SEL 0 255 /end CHARACTERISTIC
/begin COMPU_METHOD SC_VF_PILOT_SEL "VF_PILOT_SEL conversion" RAT_FUNC "%3.0" "unitless" COEFFS 0 1 0 0 0 1 /end COMPU_METHOD
/begin CHARACTERISTIC VGTFLT_COEFA "" VALUE 0x57148 SD_FLOAT32_IEEE 0 SC_VGTFLT_COEFA -50 50 /end CHARACTERISTIC
/begin COMPU_METHOD SC_VGTFLT_COEFA "VGTFLT_COEFA conversion" RAT_FUNC "%10.5" "unitless" COEFFS 0 1 0 0 0 1 /end COMPU_METHOD
/begin CHARACTERISTIC VGTFLT_COEFB "" VALUE 0x57144 SD_FLOAT32_IEEE 0 SC_VGTFLT_COEFB -50 50 /end CHARACTERISTIC
/begin COMPU_METHOD SC_VGTFLT_COEFB "VGTFLT_COEFB conversion" RAT_FUNC "%10.5" "unitless" COEFFS 0 1 0 0 0 1 /end COMPU_METHOD
/begin CHARACTERISTIC VGTFLT_COEFC "" VALUE 0x57140 SD_FLOAT32_IEEE 0 SC_VGTFLT_COEFC -50 50 /end CHARACTERISTIC
/begin COMPU_METHOD SC_VGTFLT_COEFC "VGTFLT_COEFC conversion" RAT_FUNC "%10.5" "unitless" COEFFS 0 1 0 0 0 1 /end COMPU_METHOD
/begin CHARACTERISTIC VGTFLT_COEFD "" VALUE 0x5713C SD_FLOAT32_IEEE 0 SC_VGTFLT_COEFD -50 50 /end CHARACTERISTIC
/begin COMPU_METHOD SC_VGTFLT_COEFD "VGTFLT_COEFD conversion" RAT_FUNC "%10.5" "unitless" COEFFS 0 1 0 0 0 1 /end COMPU_METHOD
/begin CHARACTERISTIC VGTFLT_COEFE "" VALUE 0x57138 SD_FLOAT32_IEEE 0 SC_VGTFLT_COEFE -50 50 /end CHARACTERISTIC
/begin COMPU_METHOD SC_VGTFLT_COEFE "VGTFLT_COEFE conversion" RAT_FUNC "%10.5" "unitless" COEFFS 0 1 0 0 0 1 /end COMPU_METHOD
/begin CHARACTERISTIC VGTFLT_COEFF "" VALUE 0x57134 SD_FLOAT32_IEEE 0 SC_VGTFLT_COEFF -50 50 /end CHARACTERISTIC
/begin COMPU_METHOD SC_VGTFLT_COEFF "VGTFLT_COEFF conversion" RAT_FUNC "%10.5" "unitless" COEFFS 0 1 0 0 0 1 /end COMPU_METHOD
/begin MEASUREMENT VGT_ACF "" FLOAT32_IEEE MC_VGT_ACF 0 0 0 0 ECU_ADDRESS 0x3FA8EC /end MEASUREMENT
/begin COMPU_METHOD MC_VGT_ACF "VGT_ACF conversion" RAT_FUNC "%10.5" "Unitless" COEFFS 0 1 0 0 0 1 /end COMPU_METHOD
/begin CHARACTERISTIC VGT_ALT_OSP_MULT "" VALUE 0x571CC SD_FLOAT32_IEEE 0 SC_VGT_ALT_OSP_MULT 0 2 /end CHARACTERISTIC
/begin COMPU_METHOD SC_VGT_ALT_OSP_MULT "VGT_ALT_OSP_MULT conversion" RAT_FUNC "%10.5" "unitless" COEFFS 0 1 0 0 0 1 /end COMPU_METHOD
/begin MEASUREMENT VGT_COLD_ADDR_MULT "" FLOAT32_IEEE MC_VGT_COLD_ADDR_MULT 0 0 0 0 ECU_ADDRESS 0x3FA8E8 /end MEASUREMENT
/begin COMPU_METHOD MC_VGT_COLD_ADDR_MULT "VGT_COLD_ADDR_MULT conversion" RAT_FUNC "%10.5" "Unitless" COEFFS 0 1 0 0 0 1 /end COMPU_METHOD
/begin MEASUREMENT VGT_DTY "VGT Duty cycle to  duce control" FLOAT32_IEEE MC_VGT_DTY 0 0 0 0 ECU_ADDRESS 0x3FA8E0 /end MEASUREMENT
/begin COMPU_METHOD MC_VGT_DTY "VGT_DTY conversion" RAT_FUNC "%10.5" "Unitless" COEFFS 0 1 0 0 0 1 /end COMPU_METHOD
/begin CHARACTERISTIC VGT_DUTY_CAL "" VALUE 0x571C0 SD_FLOAT32_IEEE 0 SC_VGT_DUTY_CAL 0 1 /end CHARACTERISTIC
/begin COMPU_METHOD SC_VGT_DUTY_CAL "VGT_DUTY_CAL conversion" RAT_FUNC "%10.5" "unitless" COEFFS 0 1 0 0 0 1 /end COMPU_METHOD
/begin CHARACTERISTIC VGT_DUTY_LMN "" VALUE 0x571BC SD_FLOAT32_IEEE 0 SC_VGT_DUTY_LMN 0 1 /end CHARACTERISTIC
/begin COMPU_METHOD SC_VGT_DUTY_LMN "VGT_DUTY_LMN conversion" RAT_FUNC "%10.5" "unitless" COEFFS 0 1 0 0 0 1 /end COMPU_METHOD
/begin MEASUREMENT VGT_DUTY_LMX "" FLOAT32_IEEE MC_VGT_DUTY_LMX 0 0 0 0 ECU_ADDRESS 0x3FA8DC /end MEASUREMENT
/begin COMPU_METHOD MC_VGT_DUTY_LMX "VGT_DUTY_LMX conversion" RAT_FUNC "%10.5" "Unitless" COEFFS 0 1 0 0 0 1 /end COMPU_METHOD
/begin CHARACTERISTIC VGT_DUTY_MAX "" VALUE 0x571B8 SD_FLOAT32_IEEE 0 SC_VGT_DUTY_MAX 0 1 /end CHARACTERISTIC
/begin COMPU_METHOD SC_VGT_DUTY_MAX "VGT_DUTY_MAX conversion" RAT_FUNC "%10.5" "unitless" COEFFS 0 1 0 0 0 1 /end COMPU_METHOD
/begin CHARACTERISTIC VGT_D_DTY_LMN "" VALUE 0x571C8 SD_FLOAT32_IEEE 0 SC_VGT_D_DTY_LMN -1 1 /end CHARACTERISTIC
/begin COMPU_METHOD SC_VGT_D_DTY_LMN "VGT_D_DTY_LMN conversion" RAT_FUNC "%10.5" "unitless" COEFFS 0 1 0 0 0 1 /end COMPU_METHOD
/begin CHARACTERISTIC VGT_D_DTY_LMX "" VALUE 0x571C4 SD_FLOAT32_IEEE 0 SC_VGT_D_DTY_LMX -1 1 /end CHARACTERISTIC
/begin COMPU_METHOD SC_VGT_D_DTY_LMX "VGT_D_DTY_LMX conversion" RAT_FUNC "%10.5" "unitless" COEFFS 0 1 0 0 0 1 /end COMPU_METHOD
/begin MEASUREMENT VGT_D_DUTY "" FLOAT32_IEEE MC_VGT_D_DUTY 0 0 0 0 ECU_ADDRESS 0x3FA8E4 /end MEASUREMENT
/begin COMPU_METHOD MC_VGT_D_DUTY "VGT_D_DUTY conversion" RAT_FUNC "%10.5" "Unitless" COEFFS 0 1 0 0 0 1 /end COMPU_METHOD
/begin CHARACTERISTIC VGT_EBPG_CAL "" VALUE 0x571B4 SD_FLOAT32_IEEE 0 SC_VGT_EBPG_CAL -100 250 /end CHARACTERISTIC
/begin COMPU_METHOD SC_VGT_EBPG_CAL "VGT_EBPG_CAL conversion" RAT_FUNC "%10.5" "unitless" COEFFS 0 1 0 0 0 1 /end COMPU_METHOD
/begin MEASUREMENT VGT_EBPG_COLD_ADDR "" FLOAT32_IEEE MC_VGT_EBPG_COLD_ADDR 0 0 0 0 ECU_ADDRESS 0x3FA8D8 /end MEASUREMENT
/begin COMPU_METHOD MC_VGT_EBPG_COLD_ADDR "VGT_EBPG_COLD_ADDR conversion" RAT_FUNC "%10.5" "Unitless" COEFFS 0 1 0 0 0 1 /end COMPU_METHOD
/begin MEASUREMENT VGT_EBPG_DES "" FLOAT32_IEEE MC_VGT_EBPG_DES 0 0 0 0 ECU_ADDRESS 0x3FA8D4 /end MEASUREMENT
/begin COMPU_METHOD MC_VGT_EBPG_DES "VGT_EBPG_DES conversion" RAT_FUNC "%10.5" "Unitless" COEFFS 0 1 0 0 0 1 /end COMPU_METHOD
/begin MEASUREMENT VGT_EBPG_DES_EGR "" FLOAT32_IEEE MC_VGT_EBPG_DES_EGR 0 0 0 0 ECU_ADDRESS 0x3FA8D0 /end MEASUREMENT
/begin COMPU_METHOD MC_VGT_EBPG_DES_EGR "VGT_EBPG_DES_EGR conversion" RAT_FUNC "%10.5" "Unitless" COEFFS 0 1 0 0 0 1 /end COMPU_METHOD
/begin MEASUREMENT VGT_EBPG_DES_EGR_HI "" FLOAT32_IEEE MC_VGT_EBPG_DES_EGR_HI 0 0 0 0 ECU_ADDRESS 0x3FA8CC /end MEASUREMENT
/begin COMPU_METHOD MC_VGT_EBPG_DES_EGR_HI "VGT_EBPG_DES_EGR_HI conversion" RAT_FUNC "%10.5" "Unitless" COEFFS 0 1 0 0 0 1 /end COMPU_METHOD
/begin MEASUREMENT VGT_EBPG_DES_EGR_LO "" FLOAT32_IEEE MC_VGT_EBPG_DES_EGR_LO 0 0 0 0 ECU_ADDRESS 0x3FA8C8 /end MEASUREMENT
/begin COMPU_METHOD MC_VGT_EBPG_DES_EGR_LO "VGT_EBPG_DES_EGR_LO conversion" RAT_FUNC "%10.5" "Unitless" COEFFS 0 1 0 0 0 1 /end COMPU_METHOD
/begin MEASUREMENT VGT_EBPG_DES_EGR_MED "" FLOAT32_IEEE MC_VGT_EBPG_DES_EGR_MED 0 0 0 0 ECU_ADDRESS 0x3FA8C4 /end MEASUREMENT
/begin COMPU_METHOD MC_VGT_EBPG_DES_EGR_MED "VGT_EBPG_DES_EGR_MED conversion" RAT_FUNC "%10.5" "Unitless" COEFFS 0 1 0 0 0 1 /end COMPU_METHOD
/begin CHARACTERISTIC VGT_EBPG_DES_LMN "" VALUE 0x571B0 SD_FLOAT32_IEEE 0 SC_VGT_EBPG_DES_LMN -100 250 /end CHARACTERISTIC
/begin COMPU_METHOD SC_VGT_EBPG_DES_LMN "VGT_EBPG_DES_LMN conversion" RAT_FUNC "%10.5" "unitless" COEFFS 0 1 0 0 0 1 /end COMPU_METHOD
/begin CHARACTERISTIC VGT_EBPG_DES_LMX "" VALUE 0x571AC SD_FLOAT32_IEEE 0 SC_VGT_EBPG_DES_LMX -100 250 /end CHARACTERISTIC
/begin COMPU_METHOD SC_VGT_EBPG_DES_LMX "VGT_EBPG_DES_LMX conversion" RAT_FUNC "%10.5" "unitless" COEFFS 0 1 0 0 0 1 /end COMPU_METHOD
/begin MEASUREMENT VGT_EBPG_DES_NEGR "" FLOAT32_IEEE MC_VGT_EBPG_DES_NEGR 0 0 0 0 ECU_ADDRESS 0x3FA8C0 /end MEASUREMENT
/begin COMPU_METHOD MC_VGT_EBPG_DES_NEGR "VGT_EBPG_DES_NEGR conversion" RAT_FUNC "%10.5" "Unitless" COEFFS 0 1 0 0 0 1 /end COMPU_METHOD
/begin MEASUREMENT VGT_EBPG_DES_NEGR_HI "" FLOAT32_IEEE MC_VGT_EBPG_DES_NEGR_HI 0 0 0 0 ECU_ADDRESS 0x3FA8BC /end MEASUREMENT
/begin COMPU_METHOD MC_VGT_EBPG_DES_NEGR_HI "VGT_EBPG_DES_NEGR_HI conversion" RAT_FUNC "%10.5" "Unitless" COEFFS 0 1 0 0 0 1 /end COMPU_METHOD
/begin MEASUREMENT VGT_EBPG_DES_NEGR_LO "" FLOAT32_IEEE MC_VGT_EBPG_DES_NEGR_LO 0 0 0 0 ECU_ADDRESS 0x3FA8B8 /end MEASUREMENT
/begin COMPU_METHOD MC_VGT_EBPG_DES_NEGR_LO "VGT_EBPG_DES_NEGR_LO conversion" RAT_FUNC "%10.5" "Unitless" COEFFS 0 1 0 0 0 1 /end COMPU_METHOD
/begin MEASUREMENT VGT_EBPG_DES_NEGR_MED "" FLOAT32_IEEE MC_VGT_EBPG_DES_NEGR_MED 0 0 0 0 ECU_ADDRESS 0x3FA8B4 /end MEASUREMENT
/begin COMPU_METHOD MC_VGT_EBPG_DES_NEGR_MED "VGT_EBPG_DES_NEGR_MED conversion" RAT_FUNC "%10.5" "Unitless" COEFFS 0 1 0 0 0 1 /end COMPU_METHOD
/begin MEASUREMENT VGT_EBPG_DES_SLEW "" FLOAT32_IEEE MC_VGT_EBPG_DES_SLEW 0 0 0 0 ECU_ADDRESS 0x3FA8B0 /end MEASUREMENT
/begin COMPU_METHOD MC_VGT_EBPG_DES_SLEW "VGT_EBPG_DES_SLEW conversion" RAT_FUNC "%10.5" "Unitless" COEFFS 0 1 0 0 0 1 /end COMPU_METHOD
/begin MEASUREMENT VGT_EBPG_ERR "" FLOAT32_IEEE MC_VGT_EBPG_ERR 0 0 0 0 ECU_ADDRESS 0x3FA8AC /end MEASUREMENT
/begin COMPU_METHOD MC_VGT_EBPG_ERR "VGT_EBPG_ERR conversion" RAT_FUNC "%10.5" "Unitless" COEFFS 0 1 0 0 0 1 /end COMPU_METHOD
/begin MEASUREMENT VGT_EBPG_ERR_DER "" FLOAT32_IEEE MC_VGT_EBPG_ERR_DER 0 0 0 0 ECU_ADDRESS 0x3FA8A8 /end MEASUREMENT
/begin COMPU_METHOD MC_VGT_EBPG_ERR_DER "VGT_EBPG_ERR_DER conversion" RAT_FUNC "%10.5" "Unitless" COEFFS 0 1 0 0 0 1 /end COMPU_METHOD
/begin MEASUREMENT VGT_EBPG_ERR_DER_DIFF "" FLOAT32_IEEE MC_VGT_EBPG_ERR_DER_DIFF 0 0 0 0 ECU_ADDRESS 0x3FA8A4 /end MEASUREMENT
/begin COMPU_METHOD MC_VGT_EBPG_ERR_DER_DIFF "VGT_EBPG_ERR_DER_DIFF conversion" RAT_FUNC "%10.5" "Unitless" COEFFS 0 1 0 0 0 1 /end COMPU_METHOD
/begin MEASUREMENT VGT_EBPG_ERR_FILT "" FLOAT32_IEEE MC_VGT_EBPG_ERR_FILT 0 0 0 0 ECU_ADDRESS 0x3FA8A0 /end MEASUREMENT
/begin COMPU_METHOD MC_VGT_EBPG_ERR_FILT "VGT_EBPG_ERR_FILT conversion" RAT_FUNC "%10.5" "Unitless" COEFFS 0 1 0 0 0 1 /end COMPU_METHOD
/begin CHARACTERISTIC VGT_EBPG_ERR_LMN "" VALUE 0x571A8 SD_FLOAT32_IEEE 0 SC_VGT_EBPG_ERR_LMN -350 350 /end CHARACTERISTIC
/begin COMPU_METHOD SC_VGT_EBPG_ERR_LMN "VGT_EBPG_ERR_LMN conversion" RAT_FUNC "%10.5" "unitless" COEFFS 0 1 0 0 0 1 /end COMPU_METHOD
/begin CHARACTERISTIC VGT_EBPG_ERR_LMX "" VALUE 0x571A4 SD_FLOAT32_IEEE 0 SC_VGT_EBPG_ERR_LMX -350 350 /end CHARACTERISTIC
/begin COMPU_METHOD SC_VGT_EBPG_ERR_LMX "VGT_EBPG_ERR_LMX conversion" RAT_FUNC "%10.5" "unitless" COEFFS 0 1 0 0 0 1 /end COMPU_METHOD
/begin MEASUREMENT VGT_EBPG_FF_EGR "" FLOAT32_IEEE MC_VGT_EBPG_FF_EGR 0 0 0 0 ECU_ADDRESS 0x3FA89C /end MEASUREMENT
/begin COMPU_METHOD MC_VGT_EBPG_FF_EGR "VGT_EBPG_FF_EGR conversion" RAT_FUNC "%10.5" "Unitless" COEFFS 0 1 0 0 0 1 /end COMPU_METHOD
/begin MEASUREMENT VGT_EBPG_FF_NEGR "" FLOAT32_IEEE MC_VGT_EBPG_FF_NEGR 0 0 0 0 ECU_ADDRESS 0x3FA898 /end MEASUREMENT
/begin COMPU_METHOD MC_VGT_EBPG_FF_NEGR "VGT_EBPG_FF_NEGR conversion" RAT_FUNC "%10.5" "Unitless" COEFFS 0 1 0 0 0 1 /end COMPU_METHOD
/begin MEASUREMENT VGT_EOT_COLD_MLT "" FLOAT32_IEEE MC_VGT_EOT_COLD_MLT 0 0 0 0 ECU_ADDRESS 0x3FA894 /end MEASUREMENT
/begin COMPU_METHOD MC_VGT_EOT_COLD_MLT "VGT_EOT_COLD_MLT conversion" RAT_FUNC "%10.5" "Unitless" COEFFS 0 1 0 0 0 1 /end COMPU_METHOD
/begin MEASUREMENT VGT_EOT_DUTY_MAX "" FLOAT32_IEEE MC_VGT_EOT_DUTY_MAX 0 0 0 0 ECU_ADDRESS 0x3FA890 /end MEASUREMENT
/begin COMPU_METHOD MC_VGT_EOT_DUTY_MAX "VGT_EOT_DUTY_MAX conversion" RAT_FUNC "%10.5" "Unitless" COEFFS 0 1 0 0 0 1 /end COMPU_METHOD
/begin MEASUREMENT VGT_FF_DUTY "" FLOAT32_IEEE MC_VGT_FF_DUTY 0 0 0 0 ECU_ADDRESS 0x3FA88C /end MEASUREMENT
/begin COMPU_METHOD MC_VGT_FF_DUTY "VGT_FF_DUTY conversion" RAT_FUNC "%10.5" "Unitless" COEFFS 0 1 0 0 0 1 /end COMPU_METHOD
/begin CHARACTERISTIC VGT_FF_SEL "VGT Feed forward option select; 1 = Do VGT FF with EGR" VALUE 0x571DA SD_UBYTE 0 SC_VGT_FF_SEL 0 1 /end CHARACTERISTIC
/begin COMPU_METHOD SC_VGT_FF_SEL "VGT_FF_SEL conversion" RAT_FUNC "%3.0" "unitless" COEFFS 0 1 0 0 0 1 /end COMPU_METHOD
/begin MEASUREMENT VGT_I_DUTY "" FLOAT32_IEEE MC_VGT_I_DUTY 0 0 0 0 ECU_ADDRESS 0x3FA888 /end MEASUREMENT
/begin COMPU_METHOD MC_VGT_I_DUTY "VGT_I_DUTY conversion" RAT_FUNC "%10.5" "Unitless" COEFFS 0 1 0 0 0 1 /end COMPU_METHOD
/begin CHARACTERISTIC VGT_KI_LM_MAX "" VALUE 0x5719C SD_FLOAT32_IEEE 0 SC_VGT_KI_LM_MAX -1 1 /end CHARACTERISTIC
/begin COMPU_METHOD SC_VGT_KI_LM_MAX "VGT_KI_LM_MAX conversion" RAT_FUNC "%10.5" "unitless" COEFFS 0 1 0 0 0 1 /end COMPU_METHOD
/begin CHARACTERISTIC VGT_KI_LM_MIN "" VALUE 0x571A0 SD_FLOAT32_IEEE 0 SC_VGT_KI_LM_MIN -1 1 /end CHARACTERISTIC
/begin COMPU_METHOD SC_VGT_KI_LM_MIN "VGT_KI_LM_MIN conversion" RAT_FUNC "%10.5" "unitless" COEFFS 0 1 0 0 0 1 /end COMPU_METHOD
/begin CHARACTERISTIC VGT_LI_ACTV "" VALUE 0x571D9 SD_UBYTE 0 SC_VGT_LI_ACTV 0 1 /end CHARACTERISTIC
/begin COMPU_METHOD SC_VGT_LI_ACTV "VGT_LI_ACTV conversion" RAT_FUNC "%3.0" "unitless" COEFFS 0 1 0 0 0 1 /end COMPU_METHOD
/begin CHARACTERISTIC VGT_LI_ACTV_TM "" VALUE 0x57194 SD_FLOAT32_IEEE 0 SC_VGT_LI_ACTV_TM 0 300 /end CHARACTERISTIC
/begin COMPU_METHOD SC_VGT_LI_ACTV_TM "VGT_LI_ACTV_TM conversion" RAT_FUNC "%10.5" "unitless" COEFFS 0 1 0 0 0 1 /end COMPU_METHOD
/begin MEASUREMENT VGT_LI_ACTV_TMR "" FLOAT32_IEEE MC_VGT_LI_ACTV_TMR 0 0 0 0 ECU_ADDRESS 0x3FA884 /end MEASUREMENT
/begin COMPU_METHOD MC_VGT_LI_ACTV_TMR "VGT_LI_ACTV_TMR conversion" RAT_FUNC "%10.5" "Unitless" COEFFS 0 1 0 0 0 1 /end COMPU_METHOD
/begin MEASUREMENT VGT_LI_DUTY "" FLOAT32_IEEE MC_VGT_LI_DUTY 0 0 0 0 ECU_ADDRESS 0x3FA880 /end MEASUREMENT
/begin COMPU_METHOD MC_VGT_LI_DUTY "VGT_LI_DUTY conversion" RAT_FUNC "%10.5" "Unitless" COEFFS 0 1 0 0 0 1 /end COMPU_METHOD
/begin CHARACTERISTIC VGT_LI_ERR_BAND "" VALUE 0x57198 SD_FLOAT32_IEEE 0 SC_VGT_LI_ERR_BAND 0 100 /end CHARACTERISTIC
/begin COMPU_METHOD SC_VGT_LI_ERR_BAND "VGT_LI_ERR_BAND conversion" RAT_FUNC "%10.5" "unitless" COEFFS 0 1 0 0 0 1 /end COMPU_METHOD
/begin MEASUREMENT VGT_MAP_CLIP "" FLOAT32_IEEE MC_VGT_MAP_CLIP 0 0 0 0 ECU_ADDRESS 0x3FA87C /end MEASUREMENT
/begin COMPU_METHOD MC_VGT_MAP_CLIP "VGT_MAP_CLIP conversion" RAT_FUNC "%10.5" "Unitless" COEFFS 0 1 0 0 0 1 /end COMPU_METHOD
/begin MEASUREMENT VGT_MAP_MAX "" FLOAT32_IEEE MC_VGT_MAP_MAX 0 0 0 0 ECU_ADDRESS 0x3FA878 /end MEASUREMENT
/begin COMPU_METHOD MC_VGT_MAP_MAX "VGT_MAP_MAX conversion" RAT_FUNC "%10.5" "Unitless" COEFFS 0 1 0 0 0 1 /end COMPU_METHOD
/begin CHARACTERISTIC VGT_MAX_MF_INC "" VALUE 0x57190 SD_FLOAT32_IEEE 0 SC_VGT_MAX_MF_INC -1000 1000 /end CHARACTERISTIC
/begin COMPU_METHOD SC_VGT_MAX_MF_INC "VGT_MAX_MF_INC conversion" RAT_FUNC "%10.5" "unitless" COEFFS 0 1 0 0 0 1 /end COMPU_METHOD
/begin CHARACTERISTIC VGT_MAX_MF_TM "" VALUE 0x5718C SD_FLOAT32_IEEE 0 SC_VGT_MAX_MF_TM 0 10 /end CHARACTERISTIC
/begin COMPU_METHOD SC_VGT_MAX_MF_TM "VGT_MAX_MF_TM conversion" RAT_FUNC "%10.5" "unitless" COEFFS 0 1 0 0 0 1 /end COMPU_METHOD
/begin MEASUREMENT VGT_MFL_DIFF "" FLOAT32_IEEE MC_VGT_MFL_DIFF 0 0 0 0 ECU_ADDRESS 0x3FA868 /end MEASUREMENT
/begin COMPU_METHOD MC_VGT_MFL_DIFF "VGT_MFL_DIFF conversion" RAT_FUNC "%10.5" "Unitless" COEFFS 0 1 0 0 0 1 /end COMPU_METHOD
/begin MEASUREMENT VGT_MFL_DIFF_ABS "" FLOAT32_IEEE MC_VGT_MFL_DIFF_ABS 0 0 0 0 ECU_ADDRESS 0x3FA864 /end MEASUREMENT
/begin COMPU_METHOD MC_VGT_MFL_DIFF_ABS "VGT_MFL_DIFF_ABS conversion" RAT_FUNC "%10.5" "Unitless" COEFFS 0 1 0 0 0 1 /end COMPU_METHOD
/begin MEASUREMENT VGT_MFL_DIFF_SIGN "" FLOAT32_IEEE MC_VGT_MFL_DIFF_SIGN 0 0 0 0 ECU_ADDRESS 0x3FA860 /end MEASUREMENT
/begin COMPU_METHOD MC_VGT_MFL_DIFF_SIGN "VGT_MFL_DIFF_SIGN conversion" RAT_FUNC "%10.5" "Unitless" COEFFS 0 1 0 0 0 1 /end COMPU_METHOD
/begin MEASUREMENT VGT_MFL_MULT "VGT overboost smoke limiter multiplier" FLOAT32_IEEE MC_VGT_MFL_MULT 0 0 0 0 ECU_ADDRESS 0x3FA85C /end MEASUREMENT
/begin COMPU_METHOD MC_VGT_MFL_MULT "VGT_MFL_MULT conversion" RAT_FUNC "%10.5" "Unitless" COEFFS 0 1 0 0 0 1 /end COMPU_METHOD
/begin CHARACTERISTIC VGT_MF_TRNS_KF "" VALUE 0x57188 SD_FLOAT32_IEEE 0 SC_VGT_MF_TRNS_KF 0 10 /end CHARACTERISTIC
/begin COMPU_METHOD SC_VGT_MF_TRNS_KF "VGT_MF_TRNS_KF conversion" RAT_FUNC "%10.5" "unitless" COEFFS 0 1 0 0 0 1 /end COMPU_METHOD
/begin MEASUREMENT VGT_MF_TRNS_MULT "" FLOAT32_IEEE MC_VGT_MF_TRNS_MULT 0 0 0 0 ECU_ADDRESS 0x3FA874 /end MEASUREMENT
/begin COMPU_METHOD MC_VGT_MF_TRNS_MULT "VGT_MF_TRNS_MULT conversion" RAT_FUNC "%10.5" "Unitless" COEFFS 0 1 0 0 0 1 /end COMPU_METHOD
/begin MEASUREMENT VGT_MF_TRNS_TMR "" FLOAT32_IEEE MC_VGT_MF_TRNS_TMR 0 0 0 0 ECU_ADDRESS 0x3FA870 /end MEASUREMENT
/begin COMPU_METHOD MC_VGT_MF_TRNS_TMR "VGT_MF_TRNS_TMR conversion" RAT_FUNC "%10.5" "Unitless" COEFFS 0 1 0 0 0 1 /end COMPU_METHOD
/begin MEASUREMENT VGT_MF_TRNS_VAL "" FLOAT32_IEEE MC_VGT_MF_TRNS_VAL 0 0 0 0 ECU_ADDRESS 0x3FA86C /end MEASUREMENT
/begin COMPU_METHOD MC_VGT_MF_TRNS_VAL "VGT_MF_TRNS_VAL conversion" RAT_FUNC "%10.5" "Unitless" COEFFS 0 1 0 0 0 1 /end COMPU_METHOD
/begin MEASUREMENT VGT_N_DUTY_LMX "" FLOAT32_IEEE MC_VGT_N_DUTY_LMX 0 0 0 0 ECU_ADDRESS 0x3FA858 /end MEASUREMENT
/begin COMPU_METHOD MC_VGT_N_DUTY_LMX "VGT_N_DUTY_LMX conversion" RAT_FUNC "%10.5" "Unitless" COEFFS 0 1 0 0 0 1 /end COMPU_METHOD
/begin CHARACTERISTIC VGT_N_OSP_LR "" VALUE 0x57184 SD_FLOAT32_IEEE 0 SC_VGT_N_OSP_LR 0 5000 /end CHARACTERISTIC
/begin COMPU_METHOD SC_VGT_N_OSP_LR "VGT_N_OSP_LR conversion" RAT_FUNC "%10.5" "unitless" COEFFS 0 1 0 0 0 1 /end COMPU_METHOD
/begin CHARACTERISTIC VGT_N_OSP_UR "" VALUE 0x57180 SD_FLOAT32_IEEE 0 SC_VGT_N_OSP_UR 0 5000 /end CHARACTERISTIC
/begin COMPU_METHOD SC_VGT_N_OSP_UR "VGT_N_OSP_UR conversion" RAT_FUNC "%10.5" "unitless" COEFFS 0 1 0 0 0 1 /end COMPU_METHOD
/begin MEASUREMENT VGT_OBMFL_FLG "" UBYTE MC_VGT_OBMFL_FLG 0 0 0 0 ECU_ADDRESS 0x3FA905 /end MEASUREMENT
/begin COMPU_METHOD MC_VGT_OBMFL_FLG "VGT_OBMFL_FLG conversion" RAT_FUNC "%3.0" "Unitless" COEFFS 0 1 0 0 0 1 /end COMPU_METHOD
/begin MEASUREMENT VGT_OB_CNTR "" SLONG MC_VGT_OB_CNTR 0 0 0 0 ECU_ADDRESS 0x3FA854 /end MEASUREMENT
/begin COMPU_METHOD MC_VGT_OB_CNTR "VGT_OB_CNTR conversion" RAT_FUNC "%10.0" "Unitless" COEFFS 0 1 0 0 0 1 /end COMPU_METHOD
/begin CHARACTERISTIC VGT_OB_DEC "" VALUE 0x5717C SD_SLONG 0 SC_VGT_OB_DEC 0 65535 /end CHARACTERISTIC
/begin COMPU_METHOD SC_VGT_OB_DEC "VGT_OB_DEC conversion" RAT_FUNC "%10.0" "unitless" COEFFS 0 1 0 0 0 1 /end COMPU_METHOD
/begin CHARACTERISTIC VGT_OB_DR "" VALUE 0x57178 SD_FLOAT32_IEEE 0 SC_VGT_OB_DR -100 100 /end CHARACTERISTIC
/begin COMPU_METHOD SC_VGT_OB_DR "VGT_OB_DR conversion" RAT_FUNC "%10.5" "unitless" COEFFS 0 1 0 0 0 1 /end COMPU_METHOD
/begin MEASUREMENT VGT_OB_DUTY_MAX "" FLOAT32_IEEE MC_VGT_OB_DUTY_MAX 0 0 0 0 ECU_ADDRESS 0x3FA850 /end MEASUREMENT
/begin COMPU_METHOD MC_VGT_OB_DUTY_MAX "VGT_OB_DUTY_MAX conversion" RAT_FUNC "%10.5" "Unitless" COEFFS 0 1 0 0 0 1 /end COMPU_METHOD
/begin MEASUREMENT VGT_OB_FLG "" UBYTE MC_VGT_OB_FLG 0 0 0 0 ECU_ADDRESS 0x3FA906 /end MEASUREMENT
/begin COMPU_METHOD MC_VGT_OB_FLG "VGT_OB_FLG conversion" RAT_FUNC "%3.0" "Unitless" COEFFS 0 1 0 0 0 1 /end COMPU_METHOD
/begin CHARACTERISTIC VGT_OB_INC "" VALUE 0x57174 SD_SLONG 0 SC_VGT_OB_INC 0 65535 /end CHARACTERISTIC
/begin COMPU_METHOD SC_VGT_OB_INC "VGT_OB_INC conversion" RAT_FUNC "%10.0" "unitless" COEFFS 0 1 0 0 0 1 /end COMPU_METHOD
/begin MEASUREMENT VGT_OB_KPA "" FLOAT32_IEEE MC_VGT_OB_KPA 0 0 0 0 ECU_ADDRESS 0x3FA84C /end MEASUREMENT
/begin COMPU_METHOD MC_VGT_OB_KPA "VGT_OB_KPA conversion" RAT_FUNC "%10.5" "Unitless" COEFFS 0 1 0 0 0 1 /end COMPU_METHOD
/begin CHARACTERISTIC VGT_OB_LMN "" VALUE 0x57170 SD_FLOAT32_IEEE 0 SC_VGT_OB_LMN 0 350 /end CHARACTERISTIC
/begin COMPU_METHOD SC_VGT_OB_LMN "VGT_OB_LMN conversion" RAT_FUNC "%10.5" "unitless" COEFFS 0 1 0 0 0 1 /end COMPU_METHOD
/begin CHARACTERISTIC VGT_OB_LMX "" VALUE 0x5716C SD_FLOAT32_IEEE 0 SC_VGT_OB_LMX 0 350 /end CHARACTERISTIC
/begin COMPU_METHOD SC_VGT_OB_LMX "VGT_OB_LMX conversion" RAT_FUNC "%10.5" "unitless" COEFFS 0 1 0 0 0 1 /end COMPU_METHOD
/begin CHARACTERISTIC VGT_OB_MFLR "" VALUE 0x57164 SD_FLOAT32_IEEE 0 SC_VGT_OB_MFLR -100 100 /end CHARACTERISTIC
/begin COMPU_METHOD SC_VGT_OB_MFLR "VGT_OB_MFLR conversion" RAT_FUNC "%10.5" "unitless" COEFFS 0 1 0 0 0 1 /end COMPU_METHOD
/begin MEASUREMENT VGT_OB_MFL_PCT "" FLOAT32_IEEE MC_VGT_OB_MFL_PCT 0 0 0 0 ECU_ADDRESS 0x3FA848 /end MEASUREMENT
/begin COMPU_METHOD MC_VGT_OB_MFL_PCT "VGT_OB_MFL_PCT conversion" RAT_FUNC "%10.5" "Unitless" COEFFS 0 1 0 0 0 1 /end COMPU_METHOD
/begin CHARACTERISTIC VGT_OB_MFL_ROC_LMX "" VALUE 0x57168 SD_FLOAT32_IEEE 0 SC_VGT_OB_MFL_ROC_LMX -100 100 /end CHARACTERISTIC
/begin COMPU_METHOD SC_VGT_OB_MFL_ROC_LMX "VGT_OB_MFL_ROC_LMX conversion" RAT_FUNC "%10.5" "unitless" COEFFS 0 1 0 0 0 1 /end COMPU_METHOD
/begin CHARACTERISTIC VGT_OB_TM "" VALUE 0x57160 SD_FLOAT32_IEEE 0 SC_VGT_OB_TM 0 300 /end CHARACTERISTIC
/begin COMPU_METHOD SC_VGT_OB_TM "VGT_OB_TM conversion" RAT_FUNC "%10.5" "unitless" COEFFS 0 1 0 0 0 1 /end COMPU_METHOD
/begin MEASUREMENT VGT_OB_TMR "" FLOAT32_IEEE MC_VGT_OB_TMR 0 0 0 0 ECU_ADDRESS 0x3FA844 /end MEASUREMENT
/begin COMPU_METHOD MC_VGT_OB_TMR "VGT_OB_TMR conversion" RAT_FUNC "%10.5" "Unitless" COEFFS 0 1 0 0 0 1 /end COMPU_METHOD
/begin MEASUREMENT VGT_OSP "" FLOAT32_IEEE MC_VGT_OSP 0 0 0 0 ECU_ADDRESS 0x3FA840 /end MEASUREMENT
/begin COMPU_METHOD MC_VGT_OSP "VGT_OSP conversion" RAT_FUNC "%10.5" "Unitless" COEFFS 0 1 0 0 0 1 /end COMPU_METHOD
/begin MEASUREMENT VGT_OSP_DUTY "" FLOAT32_IEEE MC_VGT_OSP_DUTY 0 0 0 0 ECU_ADDRESS 0x3FA83C /end MEASUREMENT
/begin COMPU_METHOD MC_VGT_OSP_DUTY "VGT_OSP_DUTY conversion" RAT_FUNC "%10.5" "Unitless" COEFFS 0 1 0 0 0 1 /end COMPU_METHOD
/begin MEASUREMENT VGT_OSP_SW "" UBYTE MC_VGT_OSP_SW 0 0 0 0 ECU_ADDRESS 0x3FA904 /end MEASUREMENT
/begin COMPU_METHOD MC_VGT_OSP_SW "VGT_OSP_SW conversion" RAT_FUNC "%3.0" "Unitless" COEFFS 0 1 0 0 0 1 /end COMPU_METHOD
/begin CHARACTERISTIC VGT_OSP_SW_OFF "" VALUE 0x5715C SD_FLOAT32_IEEE 0 SC_VGT_OSP_SW_OFF 0 200000 /end CHARACTERISTIC
/begin COMPU_METHOD SC_VGT_OSP_SW_OFF "VGT_OSP_SW_OFF conversion" RAT_FUNC "%10.5" "unitless" COEFFS 0 1 0 0 0 1 /end COMPU_METHOD
/begin CHARACTERISTIC VGT_OSP_SW_ON "" VALUE 0x57158 SD_FLOAT32_IEEE 0 SC_VGT_OSP_SW_ON 0 200000 /end CHARACTERISTIC
/begin COMPU_METHOD SC_VGT_OSP_SW_ON "VGT_OSP_SW_ON conversion" RAT_FUNC "%10.5" "unitless" COEFFS 0 1 0 0 0 1 /end COMPU_METHOD
/begin MEASUREMENT VGT_PID_DUTY "" FLOAT32_IEEE MC_VGT_PID_DUTY 0 0 0 0 ECU_ADDRESS 0x3FA834 /end MEASUREMENT
/begin COMPU_METHOD MC_VGT_PID_DUTY "VGT_PID_DUTY conversion" RAT_FUNC "%10.5" "Unitless" COEFFS 0 1 0 0 0 1 /end COMPU_METHOD
/begin CHARACTERISTIC VGT_PID_KD "" VALUE 0x57154 SD_FLOAT32_IEEE 0 SC_VGT_PID_KD 0 1 /end CHARACTERISTIC
/begin COMPU_METHOD SC_VGT_PID_KD "VGT_PID_KD conversion" RAT_FUNC "%10.5" "unitless" COEFFS 0 1 0 0 0 1 /end COMPU_METHOD
/begin CHARACTERISTIC VGT_PID_KI "" VALUE 0x57150 SD_FLOAT32_IEEE 0 SC_VGT_PID_KI 0 1 /end CHARACTERISTIC
/begin COMPU_METHOD SC_VGT_PID_KI "VGT_PID_KI conversion" RAT_FUNC "%10.5" "unitless" COEFFS 0 1 0 0 0 1 /end COMPU_METHOD
/begin CHARACTERISTIC VGT_PID_KP "" VALUE 0x5714C SD_FLOAT32_IEEE 0 SC_VGT_PID_KP 0 1 /end CHARACTERISTIC
/begin COMPU_METHOD SC_VGT_PID_KP "VGT_PID_KP conversion" RAT_FUNC "%10.5" "unitless" COEFFS 0 1 0 0 0 1 /end COMPU_METHOD
/begin MEASUREMENT VGT_P_DUTY "" FLOAT32_IEEE MC_VGT_P_DUTY 0 0 0 0 ECU_ADDRESS 0x3FA838 /end MEASUREMENT
/begin COMPU_METHOD MC_VGT_P_DUTY "VGT_P_DUTY conversion" RAT_FUNC "%10.5" "Unitless" COEFFS 0 1 0 0 0 1 /end COMPU_METHOD
/begin CHARACTERISTIC VGT_SEL "VGT select switch units[0-4]; Values: 0=Substitute cal for VGT_DTY, 1=Substitute cal for MAP_des, 2-4=Normal VGT operation" VALUE 0x571D8 SD_UBYTE 0 SC_VGT_SEL 0 4 /end CHARACTERISTIC
/begin COMPU_METHOD SC_VGT_SEL "VGT_SEL conversion" RAT_FUNC "%3.0" "unitless" COEFFS 0 1 0 0 0 1 /end COMPU_METHOD
/begin MEASUREMENT VGT_TOTAL_DUTY "" FLOAT32_IEEE MC_VGT_TOTAL_DUTY 0 0 0 0 ECU_ADDRESS 0x3FA830 /end MEASUREMENT
/begin COMPU_METHOD MC_VGT_TOTAL_DUTY "VGT_TOTAL_DUTY conversion" RAT_FUNC "%10.5" "Unitless" COEFFS 0 1 0 0 0 1 /end COMPU_METHOD
/begin MEASUREMENT VGT_TSP "" FLOAT32_IEEE MC_VGT_TSP 0 0 0 0 ECU_ADDRESS 0x3FA82C /end MEASUREMENT
/begin COMPU_METHOD MC_VGT_TSP "VGT_TSP conversion" RAT_FUNC "%10.5" "Unitless" COEFFS 0 1 0 0 0 1 /end COMPU_METHOD
/begin MEASUREMENT VGT_TSP_HI "" FLOAT32_IEEE MC_VGT_TSP_HI 0 0 0 0 ECU_ADDRESS 0x3FA828 /end MEASUREMENT
/begin COMPU_METHOD MC_VGT_TSP_HI "VGT_TSP_HI conversion" RAT_FUNC "%10.5" "Unitless" COEFFS 0 1 0 0 0 1 /end COMPU_METHOD
/begin MEASUREMENT VGT_TSP_LO "" FLOAT32_IEEE MC_VGT_TSP_LO 0 0 0 0 ECU_ADDRESS 0x3FA820 /end MEASUREMENT
/begin COMPU_METHOD MC_VGT_TSP_LO "VGT_TSP_LO conversion" RAT_FUNC "%10.5" "Unitless" COEFFS 0 1 0 0 0 1 /end COMPU_METHOD
/begin MEASUREMENT VGT_TSP_MID "" FLOAT32_IEEE MC_VGT_TSP_MID 0 0 0 0 ECU_ADDRESS 0x3FA824 /end MEASUREMENT
/begin COMPU_METHOD MC_VGT_TSP_MID "VGT_TSP_MID conversion" RAT_FUNC "%10.5" "Unitless" COEFFS 0 1 0 0 0 1 /end COMPU_METHOD
/begin MEASUREMENT VGT_WARMUP_ADDR "" FLOAT32_IEEE MC_VGT_WARMUP_ADDR 0 0 0 0 ECU_ADDRESS 0x3FA81C /end MEASUREMENT
/begin COMPU_METHOD MC_VGT_WARMUP_ADDR "VGT_WARMUP_ADDR conversion" RAT_FUNC "%10.5" "Unitless" COEFFS 0 1 0 0 0 1 /end COMPU_METHOD
/begin MEASUREMENT VPWR_CNTS "System voltage in Counts" SLONG MC_VPWR_CNTS 0 0 0 0 ECU_ADDRESS 0x3FAAAC /end MEASUREMENT
/begin COMPU_METHOD MC_VPWR_CNTS "VPWR_CNTS conversion" RAT_FUNC "%10.0" "Unitless" COEFFS 0 1 0 0 0 1 /end COMPU_METHOD
/begin MEASUREMENT VPWR_ENG_IOP "System voltage engineering value" FLOAT32_IEEE MC_VPWR_ENG_IOP 0 0 0 0 ECU_ADDRESS 0x3FA248 /end MEASUREMENT
/begin COMPU_METHOD MC_VPWR_ENG_IOP "VPWR_ENG_IOP conversion" RAT_FUNC "%10.5" "Unitless" COEFFS 0 1 0 0 0 1 /end COMPU_METHOD
/begin CHARACTERISTIC VPWR_HI_ER "System voltage out of range high" VALUE 0x57584 SD_FLOAT32_IEEE 0 SC_VPWR_HI_ER 0 25.2 /end CHARACTERISTIC
/begin COMPU_METHOD SC_VPWR_HI_ER "VPWR_HI_ER conversion" RAT_FUNC "%10.5" "V" COEFFS 0 1 0 0 0 1 /end COMPU_METHOD
/begin CHARACTERISTIC VPWR_LO_ER "System voltage out of range low" VALUE 0x57580 SD_FLOAT32_IEEE 0 SC_VPWR_LO_ER 0 25.2 /end CHARACTERISTIC
/begin COMPU_METHOD SC_VPWR_LO_ER "VPWR_LO_ER conversion" RAT_FUNC "%10.5" "V" COEFFS 0 1 0 0 0 1 /end COMPU_METHOD
/begin MEASUREMENT VPWR_RAW "System voltage, Raw value" FLOAT32_IEEE MC_VPWR_RAW 0 0 0 0 ECU_ADDRESS 0x3FAAB0 /end MEASUREMENT
/begin COMPU_METHOD MC_VPWR_RAW "VPWR_RAW conversion" RAT_FUNC "%10.5" "Unitless" COEFFS 0 1 0 0 0 1 /end COMPU_METHOD
/begin MEASUREMENT VPWR_STATUS "System voltage out of range status" UBYTE MC_VPWR_STATUS 0 0 0 0 ECU_ADDRESS 0x3FAAB4 /end MEASUREMENT
/begin COMPU_METHOD MC_VPWR_STATUS "VPWR_STATUS conversion" RAT_FUNC "%3.0" "Unitless" COEFFS 0 1 0 0 0 1 /end COMPU_METHOD
/begin CHARACTERISTIC VRCM_HP "VRCm hardware present switch" VALUE 0x576F4 SD_UBYTE 0 SC_VRCM_HP 0 1 /end CHARACTERISTIC
/begin COMPU_METHOD SC_VRCM_HP "VRCM_HP conversion" RAT_FUNC "%3.0" "UNITLESS" COEFFS 0 1 0 0 0 1 /end COMPU_METHOD
/begin MEASUREMENT VS "INSTANTANEOUS VEHICLE SPEED (unverified)" FLOAT32_IEEE MC_VS 0 0 0 0 ECU_ADDRESS 0x3FA010 /end MEASUREMENT
/begin COMPU_METHOD MC_VS "VS conversion" RAT_FUNC "%10.5" "Unitless" COEFFS 0 1 0 0 0 1 /end COMPU_METHOD
/begin MEASUREMENT VSBAR "Filtered vehicle speed." FLOAT32_IEEE MC_VSBAR 0 0 0 0 ECU_ADDRESS 0x3FAC9C /end MEASUREMENT
/begin COMPU_METHOD MC_VSBAR "VSBAR conversion" RAT_FUNC "%10.5" "Unitless" COEFFS 0 1 0 0 0 1 /end COMPU_METHOD
/begin MEASUREMENT VSBAR_FF "Value of filtered vehicle speed at the time the freeze frame was stored." FLOAT32_IEEE MC_VSBAR_FF 0 0 0 0 ECU_ADDRESS 0x3FAEA4 /end MEASUREMENT
/begin COMPU_METHOD MC_VSBAR_FF "VSBAR_FF conversion" RAT_FUNC "%10.5" "Unitless" COEFFS 0 1 0 0 0 1 /end COMPU_METHOD
/begin MEASUREMENT VSF "Variable speed fan level." FLOAT32_IEEE MC_VSF 0 0 0 0 ECU_ADDRESS 0x3FA930 /end MEASUREMENT
/begin COMPU_METHOD MC_VSF "VSF conversion" RAT_FUNC "%10.5" "Unitless" COEFFS 0 1 0 0 0 1 /end COMPU_METHOD
/begin CHARACTERISTIC VSF_VS_CL "VS to return to normal fan control." VALUE 0x571DC SD_FLOAT32_IEEE 0 SC_VSF_VS_CL 0 127.5 /end CHARACTERISTIC
/begin COMPU_METHOD SC_VSF_VS_CL "VSF_VS_CL conversion" RAT_FUNC "%10.5" "MPH" COEFFS 0 1 0 0 0 1 /end COMPU_METHOD
/begin MEASUREMENT VSPD "Vehicle speed" FLOAT32_IEEE MC_VSPD 0 0 0 0 ECU_ADDRESS 0x3FAC88 /end MEASUREMENT
/begin COMPU_METHOD MC_VSPD "VSPD conversion" RAT_FUNC "%10.5" "Unitless" COEFFS 0 1 0 0 0 1 /end COMPU_METHOD
/begin MEASUREMENT VSPD_PREV "Previous vehicle speed" FLOAT32_IEEE MC_VSPD_PREV 0 0 0 0 ECU_ADDRESS 0x3FAC8C /end MEASUREMENT
/begin COMPU_METHOD MC_VSPD_PREV "VSPD_PREV conversion" RAT_FUNC "%10.5" "Unitless" COEFFS 0 1 0 0 0 1 /end COMPU_METHOD
/begin MEASUREMENT VS_FIL "Intermittent fault filter for the VS sensor." UBYTE MC_VS_FIL 0 0 0 0 ECU_ADDRESS 0x3F9EF5 /end MEASUREMENT
/begin COMPU_METHOD MC_VS_FIL "VS_FIL conversion" RAT_FUNC "%3.0" "Unitless" COEFFS 0 1 0 0 0 1 /end COMPU_METHOD
/begin MEASUREMENT VS_FIL_MAX "HIGHEST VALUE THE FAULT FILTER VS_FIL SEES." UBYTE MC_VS_FIL_MAX 0 0 0 0 ECU_ADDRESS 0x3FAED9 /end MEASUREMENT
/begin COMPU_METHOD MC_VS_FIL_MAX "VS_FIL_MAX conversion" RAT_FUNC "%3.0" "Unitless" COEFFS 0 1 0 0 0 1 /end COMPU_METHOD
/begin CHARACTERISTIC VS_HP "Switch indicating a source of vehicle speed (VSS or SCP) is present; 0 -> all vehicle speed calcs come from OSS, 1 -> VSS or SCP VS" VALUE 0x3FADA2 SD_UWORD 0 SC_VS_HP 0 1 /end CHARACTERISTIC
/begin COMPU_METHOD SC_VS_HP "VS_HP conversion" RAT_FUNC "%5.0" "Unitless" COEFFS 0 1 0 0 0 1 /end COMPU_METHOD
/begin MEASUREMENT VS_INT "Flag set when intermittent is detected on the VS sensor." UBYTE MC_VS_INT 0 0 0 0 ECU_ADDRESS 0x3F9EF4 /end MEASUREMENT
/begin COMPU_METHOD MC_VS_INT "VS_INT conversion" RAT_FUNC "%3.0" "Unitless" COEFFS 0 1 0 0 0 1 /end COMPU_METHOD
/begin CHARACTERISTIC VS_LVL "Fault level for intermittent VS sensor." VALUE 0x563A2 SD_UBYTE 0 SC_VS_LVL 0 255 /end CHARACTERISTIC
/begin COMPU_METHOD SC_VS_LVL "VS_LVL conversion" RAT_FUNC "%3.0" "LEVEL" COEFFS 0 1 0 0 0 1 /end COMPU_METHOD
/begin MEASUREMENT VS_SCP_FMFLG "Vehicle Speed Failure mode (FMEM) flag." UBYTE MC_VS_SCP_FMFLG 0 0 0 0 ECU_ADDRESS 0x3FAA2F /end MEASUREMENT
/begin COMPU_METHOD MC_VS_SCP_FMFLG "VS_SCP_FMFLG conversion" RAT_FUNC "%3.0" "Unitless" COEFFS 0 1 0 0 0 1 /end COMPU_METHOD
/begin MEASUREMENT VS_SCP__A "Vehicle Speed as received over SCP" FLOAT32_IEEE MC_VS_SCP__A 0 0 0 0 ECU_ADDRESS 0x3FAA14 /end MEASUREMENT
/begin COMPU_METHOD MC_VS_SCP__A "VS_SCP__A conversion" RAT_FUNC "%10.5" "Unitless" COEFFS 0 1 0 0 0 1 /end COMPU_METHOD
/begin CHARACTERISTIC V_ISC_HI_DL2 "Time delay to allow RPM to settle after EGR on demand test." VALUE 0x5781C SD_FLOAT32_IEEE 0 SC_V_ISC_HI_DL2 0 31 /end CHARACTERISTIC
/begin COMPU_METHOD SC_V_ISC_HI_DL2 "V_ISC_HI_DL2 conversion" RAT_FUNC "%10.5" "s" COEFFS 0 1 0 0 0 1 /end COMPU_METHOD
/begin CHARACTERISTIC V_ISC_HI_DLY "Time delay to allow RPM to reach minimum value for engine running on-demand test." VALUE 0x57810 SD_FLOAT32_IEEE 0 SC_V_ISC_HI_DLY 0 31 /end CHARACTERISTIC
/begin COMPU_METHOD SC_V_ISC_HI_DLY "V_ISC_HI_DLY conversion" RAT_FUNC "%10.5" "s" COEFFS 0 1 0 0 0 1 /end COMPU_METHOD
/begin CHARACTERISTIC V_ISC_HI_MIN "Minimum RPM to pass High RPM portion of engine running on demand test" VALUE 0x5780C SD_FLOAT32_IEEE 0 SC_V_ISC_HI_MIN 0 2500 /end CHARACTERISTIC
/begin COMPU_METHOD SC_V_ISC_HI_MIN "V_ISC_HI_MIN conversion" RAT_FUNC "%10.5" "RPM" COEFFS 0 1 0 0 0 1 /end COMPU_METHOD
/begin CHARACTERISTIC V_ISC_LO_DLY "Time delay to allow RPM to return to normal idle before testing ISC duty cycle." VALUE 0x57818 SD_FLOAT32_IEEE 0 SC_V_ISC_LO_DLY 0 31 /end CHARACTERISTIC
/begin COMPU_METHOD SC_V_ISC_LO_DLY "V_ISC_LO_DLY conversion" RAT_FUNC "%10.5" "s" COEFFS 0 1 0 0 0 1 /end COMPU_METHOD
/begin CHARACTERISTIC V_ISC_LO_TIM "Time delay to allow ISC to test at low rpm." VALUE 0x57814 SD_FLOAT32_IEEE 0 SC_V_ISC_LO_TIM 0 31 /end CHARACTERISTIC
/begin COMPU_METHOD SC_V_ISC_LO_TIM "V_ISC_LO_TIM conversion" RAT_FUNC "%10.5" "s" COEFFS 0 1 0 0 0 1 /end COMPU_METHOD
/begin MEASUREMENT WIF_F "Water In Fuel failure flag" UBYTE MC_WIF_F 0 0 0 0 ECU_ADDRESS 0x3FADE8 /end MEASUREMENT
/begin COMPU_METHOD MC_WIF_F "WIF_F conversion" RAT_FUNC "%3.0" "Unitless" COEFFS 0 1 0 0 0 1 /end COMPU_METHOD
/begin MEASUREMENT WIF_RAW "" UBYTE MC_WIF_RAW 0 0 0 0 ECU_ADDRESS 0x3FA9A0 /end MEASUREMENT
/begin COMPU_METHOD MC_WIF_RAW "WIF_RAW conversion" RAT_FUNC "%3.0" "Unitless" COEFFS 0 1 0 0 0 1 /end COMPU_METHOD
/begin MEASUREMENT XCPTN_CNT "Copy of exception counter from RTOS Exception logs" ULONG MC_XCPTN_CNT 0 0 0 0 ECU_ADDRESS 0x3FB04C /end MEASUREMENT
/begin COMPU_METHOD MC_XCPTN_CNT "XCPTN_CNT conversion" RAT_FUNC "%10.0" "Unitless" COEFFS 0 1 0 0 0 1 /end COMPU_METHOD
/begin MEASUREMENT XCPTN_TYPE "Copy of excetpion types from RTOS exception log" ULONG MC_XCPTN_TYPE 0 0 0 0 ECU_ADDRESS 0x3FB050 /end MEASUREMENT
/begin COMPU_METHOD MC_XCPTN_TYPE "XCPTN_TYPE conversion" RAT_FUNC "%10.0" "Unitless" COEFFS 0 1 0 0 0 1 /end COMPU_METHOD
/begin CHARACTERISTIC YDIT "Use Calibratable Direct Injection Desired value (DITOFST)" VALUE 0x56B38 SD_FLOAT32_IEEE 0 SC_YDIT 0 1 /end CHARACTERISTIC
/begin COMPU_METHOD SC_YDIT "YDIT conversion" RAT_FUNC "%10.5" "unitless" COEFFS 0 1 0 0 0 1 /end COMPU_METHOD
/begin MEASUREMENT ZERO_FLT "Floating point value of zero to be used as a constant." FLOAT32_IEEE MC_ZERO_FLT 0 0 0 0 ECU_ADDRESS 0x3FAD60 /end MEASUREMENT
/begin COMPU_METHOD MC_ZERO_FLT "ZERO_FLT conversion" RAT_FUNC "%10.5" "Unitless" COEFFS 0 1 0 0 0 1 /end COMPU_METHOD
/begin RECORD_LAYOUT SD_UBYTE FNC_VALUES 1 UBYTE ROW_DIR DIRECT /end RECORD_LAYOUT
/begin RECORD_LAYOUT SD_UWORD FNC_VALUES 1 UWORD ROW_DIR DIRECT /end RECORD_LAYOUT
/begin RECORD_LAYOUT SD_ULONG FNC_VALUES 1 ULONG ROW_DIR DIRECT /end RECORD_LAYOUT
/begin RECORD_LAYOUT SD_SLONG FNC_VALUES 1 SLONG ROW_DIR DIRECT /end RECORD_LAYOUT
/begin RECORD_LAYOUT SD_FLOAT32_IEEE FNC_VALUES 1 FLOAT32_IEEE ROW_DIR DIRECT /end RECORD_LAYOUT
/end MODULE
/end PROJECT
