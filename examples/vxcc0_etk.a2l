/begin PROJECT DPU-2XX "Visteon Diesel"
/begin HEADER " " VERSION "1" PROJECT_NO Global /end HEADER
/begin MODULE ENGINE "International Engine Controller"
/begin MOD_COMMON " " BYTE_ORDER MSB_FIRST /end MOD_COMMON
/begin CHARACTERISTIC P2122SW_NGD "Pedal position sensor  1 out of range low - malf enable switch" VALUE 0x5D549 SD_UBYTE 0 SC_P2122SW_NGD 0 255 /end CHARACTERISTIC
/begin COMPU_METHOD SC_P2122SW_NGD "P2122SW_NGD conversion" RAT_FUNC "%3.0" "unitless" COEFFS 0 1 0 0 0 1 /end COMPU_METHOD
/begin MEASUREMENT P2123MALF "OBDII pedal sensor #1 out of range high malf flag" UBYTE MC_P2123MALF 0 0 0 0 ECU_ADDRESS 0x3FA33B /end MEASUREMENT
/begin COMPU_METHOD MC_P2123MALF "P2123MALF conversion" RAT_FUNC "%3.0" "Unitless" COEFFS 0 1 0 0 0 1 /end COMPU_METHOD
/begin CHARACTERISTIC P2123SW_NGD "Pedal position sensor  1 out of range high - malf enable switch" VALUE 0x5D548 SD_UBYTE 0 SC_P2123SW_NGD 0 255 /end CHARACTERISTIC
/begin COMPU_METHOD SC_P2123SW_NGD "P2123SW_NGD conversion" RAT_FUNC "%3.0" "unitless" COEFFS 0 1 0 0 0 1 /end COMPU_METHOD
/begin MEASUREMENT P2124MALF "OBDII pedal sensor #1 intermittent failure malf flag" UBYTE MC_P2124MALF 0 0 0 0 ECU_ADDRESS 0x3FA33A /end MEASUREMENT
/begin COMPU_METHOD MC_P2124MALF "P2124MALF conversion" RAT_FUNC "%3.0" "Unitless" COEFFS 0 1 0 0 0 1 /end COMPU_METHOD
/begin CHARACTERISTIC P2124SW_NGD "Pedal position sensor  1 intermittent failure - malf enable switch" VALUE 0x5D547 SD_UBYTE 0 SC_P2124SW_NGD 0 255 /end CHARACTERISTIC
/begin COMPU_METHOD SC_P2124SW_NGD "P2124SW_NGD conversion" RAT_FUNC "%3.0" "unitless" COEFFS 0 1 0 0 0 1 /end COMPU_METHOD
/begin MEASUREMENT P2126MALF "OBDII pedal sensor #2 failed malf flag" UBYTE MC_P2126MALF 0 0 0 0 ECU_ADDRESS 0x3FA341 /end MEASUREMENT
/begin COMPU_METHOD MC_P2126MALF "P2126MALF conversion" RAT_FUNC "%3.0" "Unitless" COEFFS 0 1 0 0 0 1 /end COMPU_METHOD
/begin CHARACTERISTIC P2126SW_NGD "Pedal position sensor 2 failed - malf enable switch" VALUE 0x5D54E SD_UBYTE 0 SC_P2126SW_NGD 0 255 /end CHARACTERISTIC
/begin COMPU_METHOD SC_P2126SW_NGD "P2126SW_NGD conversion" RAT_FUNC "%3.0" "unitless" COEFFS 0 1 0 0 0 1 /end COMPU_METHOD
/begin MEASUREMENT P2127MALF "OBDII pedal sensor #2 out of range low malf flag" UBYTE MC_P2127MALF 0 0 0 0 ECU_ADDRESS 0x3FA339 /end MEASUREMENT
/begin COMPU_METHOD MC_P2127MALF "P2127MALF conversion" RAT_FUNC "%3.0" "Unitless" COEFFS 0 1 0 0 0 1 /end COMPU_METHOD
/begin CHARACTERISTIC P2127SW_NGD "Pedal position sensor  2 out of range low - malf enable switch" VALUE 0x5D546 SD_UBYTE 0 SC_P2127SW_NGD 0 255 /end CHARACTERISTIC
/begin COMPU_METHOD SC_P2127SW_NGD "P2127SW_NGD conversion" RAT_FUNC "%3.0" "unitless" COEFFS 0 1 0 0 0 1 /end COMPU_METHOD
/begin MEASUREMENT P2128MALF "OBDII pedal sensor #2 out of range high malf flag" UBYTE MC_P2128MALF 0 0 0 0 ECU_ADDRESS 0x3FA338 /end MEASUREMENT
/begin COMPU_METHOD MC_P2128MALF "P2128MALF conversion" RAT_FUNC "%3.0" "Unitless" COEFFS 0 1 0 0 0 1 /end COMPU_METHOD
/begin CHARACTERISTIC P2128SW_NGD "Pedal position sensor  2 out of range high - malf enable switch" VALUE 0x5D545 SD_UBYTE 0 SC_P2128SW_NGD 0 255 /end CHARACTERISTIC
/begin COMPU_METHOD SC_P2128SW_NGD "P2128SW_NGD conversion" RAT_FUNC "%3.0" "unitless" COEFFS 0 1 0 0 0 1 /end COMPU_METHOD
/begin MEASUREMENT P2129MALF "OBDII pedal sensor #2 intermittent failure malf flag" UBYTE MC_P2129MALF 0 0 0 0 ECU_ADDRESS 0x3FA337 /end MEASUREMENT
/begin COMPU_METHOD MC_P2129MALF "P2129MALF conversion" RAT_FUNC "%3.0" "Unitless" COEFFS 0 1 0 0 0 1 /end COMPU_METHOD
/begin CHARACTERISTIC P2129SW_NGD "Pedal position sensor  2 intermittent failure - malf enable switch" VALUE 0x5D544 SD_UBYTE 0 SC_P2129SW_NGD 0 255 /end CHARACTERISTIC
/begin COMPU_METHOD SC_P2129SW_NGD "P2129SW_NGD conversion" RAT_FUNC "%3.0" "unitless" COEFFS 0 1 0 0 0 1 /end COMPU_METHOD
/begin MEASUREMENT P2131MALF "OBDII pedal sensor #3 failed malf flag" UBYTE MC_P2131MALF 0 0 0 0 ECU_ADDRESS 0x3FA340 /end MEASUREMENT
/begin COMPU_METHOD MC_P2131MALF "P2131MALF conversion" RAT_FUNC "%3.0" "Unitless" COEFFS 0 1 0 0 0 1 /end COMPU_METHOD
/begin CHARACTERISTIC P2131SW_NGD "Pedal position sensor 3 failed - malf enable switch" VALUE 0x5D54D SD_UBYTE 0 SC_P2131SW_NGD 0 255 /end CHARACTERISTIC
/begin COMPU_METHOD SC_P2131SW_NGD "P2131SW_NGD conversion" RAT_FUNC "%3.0" "unitless" COEFFS 0 1 0 0 0 1 /end COMPU_METHOD
/begin MEASUREMENT P2132MALF "OBDII pedal sensor #3 out of range low malf flag" UBYTE MC_P2132MALF 0 0 0 0 ECU_ADDRESS 0x3FA336 /end MEASUREMENT
/begin COMPU_METHOD MC_P2132MALF "P2132MALF conversion" RAT_FUNC "%3.0" "Unitless" COEFFS 0 1 0 0 0 1 /end COMPU_METHOD
/begin CHARACTERISTIC P2132SW_NGD "Pedal position sensor  3 out of range low - malf enable switch" VALUE 0x5D543 SD_UBYTE 0 SC_P2132SW_NGD 0 255 /end CHARACTERISTIC
/begin COMPU_METHOD SC_P2132SW_NGD "P2132SW_NGD conversion" RAT_FUNC "%3.0" "unitless" COEFFS 0 1 0 0 0 1 /end COMPU_METHOD
/begin MEASUREMENT P2133MALF "OBDII pedal sensor #3 out of range high malf flag" UBYTE MC_P2133MALF 0 0 0 0 ECU_ADDRESS 0x3FA335 /end MEASUREMENT
/begin COMPU_METHOD MC_P2133MALF "P2133MALF conversion" RAT_FUNC "%3.0" "Unitless" COEFFS 0 1 0 0 0 1 /end COMPU_METHOD
/begin CHARACTERISTIC P2133SW_NGD "Pedal position sensor  3 out of range high - malf enable switch" VALUE 0x5D542 SD_UBYTE 0 SC_P2133SW_NGD 0 255 /end CHARACTERISTIC
/begin COMPU_METHOD SC_P2133SW_NGD "P2133SW_NGD conversion" RAT_FUNC "%3.0" "unitless" COEFFS 0 1 0 0 0 1 /end COMPU_METHOD
/begin MEASUREMENT P2134MALF "OBDII pedal sensor #3 intermittent failure malf flag" UBYTE MC_P2134MALF 0 0 0 0 ECU_ADDRESS 0x3FA334 /end MEASUREMENT
/begin COMPU_METHOD MC_P2134MALF "P2134MALF conversion" RAT_FUNC "%3.0" "Unitless" COEFFS 0 1 0 0 0 1 /end COMPU_METHOD
/begin CHARACTERISTIC P2134SW_NGD "Pedal position sensor  3 intermittent failure - malf enable switch" VALUE 0x5D541 SD_UBYTE 0 SC_P2134SW_NGD 0 255 /end CHARACTERISTIC
/begin COMPU_METHOD SC_P2134SW_NGD "P2134SW_NGD conversion" RAT_FUNC "%3.0" "unitless" COEFFS 0 1 0 0 0 1 /end COMPU_METHOD
/begin MEASUREMENT P2138MALF "OBDII pedal sensor #1 and #2 disagree" UBYTE MC_P2138MALF 0 0 0 0 ECU_ADDRESS 0x3FA33F /end MEASUREMENT
/begin COMPU_METHOD MC_P2138MALF "P2138MALF conversion" RAT_FUNC "%3.0" "Unitless" COEFFS 0 1 0 0 0 1 /end COMPU_METHOD
/begin CHARACTERISTIC P2138SW_NGD "Pedal position sensor  1 & 2  disagree - malf enable switch" VALUE 0x5D54C SD_UBYTE 0 SC_P2138SW_NGD 0 255 /end CHARACTERISTIC
/begin COMPU_METHOD SC_P2138SW_NGD "P2138SW_NGD conversion" RAT_FUNC "%3.0" "unitless" COEFFS 0 1 0 0 0 1 /end COMPU_METHOD
/begin MEASUREMENT P2139MALF "OBDII pedal sensor #1 and #3 disagree" UBYTE MC_P2139MALF 0 0 0 0 ECU_ADDRESS 0x3FA33E /end MEASUREMENT
/begin COMPU_METHOD MC_P2139MALF "P2139MALF conversion" RAT_FUNC "%3.0" "Unitless" COEFFS 0 1 0 0 0 1 /end COMPU_METHOD
/begin CHARACTERISTIC P2139SW_NGD "Pedal position sensor  1 & 3  disagree - malf enable switch" VALUE 0x5D54B SD_UBYTE 0 SC_P2139SW_NGD 0 255 /end CHARACTERISTIC
/begin COMPU_METHOD SC_P2139SW_NGD "P2139SW_NGD conversion" RAT_FUNC "%3.0" "unitless" COEFFS 0 1 0 0 0 1 /end COMPU_METHOD
/begin MEASUREMENT P2140MALF "OBDII pedal sensor #2 and #3 disagree" UBYTE MC_P2140MALF 0 0 0 0 ECU_ADDRESS 0x3FA33D /end MEASUREMENT
/begin COMPU_METHOD MC_P2140MALF "P2140MALF conversion" RAT_FUNC "%3.0" "Unitless" COEFFS 0 1 0 0 0 1 /end COMPU_METHOD
/begin CHARACTERISTIC P2140SW_NGD "Pedal position sensor  2 & 3  disagree - malf enable switch" VALUE 0x5D54A SD_UBYTE 0 SC_P2140SW_NGD 0 255 /end CHARACTERISTIC
/begin COMPU_METHOD SC_P2140SW_NGD "P2140SW_NGD conversion" RAT_FUNC "%3.0" "unitless" COEFFS 0 1 0 0 0 1 /end COMPU_METHOD
/begin MEASUREMENT P2161MALF "VSS Failure non mil flag" UBYTE MC_P2161MALF 0 0 0 0 ECU_ADDRESS 0x3FA6A0 /end MEASUREMENT
/begin COMPU_METHOD MC_P2161MALF "P2161MALF conversion" RAT_FUNC "%3.0" "Unitless" COEFFS 0 1 0 0 0 1 /end COMPU_METHOD
/begin CHARACTERISTIC P2161SW "Vehicle speed sensor A intermittent / erratic" VALUE 0x5D793 SD_UBYTE 0 SC_P2161SW 0 255 /end CHARACTERISTIC
/begin COMPU_METHOD SC_P2161SW "P2161SW conversion" RAT_FUNC "%3.0" "unitless" COEFFS 0 1 0 0 0 1 /end COMPU_METHOD
/begin MEASUREMENT P2199MALF "EO IAT/MAT raionale test fault flag." UBYTE MC_P2199MALF 0 0 0 0 ECU_ADDRESS 0x3FA53E /end MEASUREMENT
/begin COMPU_METHOD MC_P2199MALF "P2199MALF conversion" RAT_FUNC "%3.0" "Unitless" COEFFS 0 1 0 0 0 1 /end COMPU_METHOD
/begin CHARACTERISTIC P2199SW "Engine off IAT/MAT Rationale test" VALUE 0x5D782 SD_UBYTE 0 SC_P2199SW 0 255 /end CHARACTERISTIC
/begin COMPU_METHOD SC_P2199SW "P2199SW conversion" RAT_FUNC "%3.0" "Unitless" COEFFS 0 1 0 0 0 1 /end COMPU_METHOD
/begin MEASUREMENT P2199UPDATE "EO IAT/MAT rationale test update flag." UBYTE MC_P2199UPDATE 0 0 0 0 ECU_ADDRESS 0x3FA53D /end MEASUREMENT
/begin COMPU_METHOD MC_P2199UPDATE "P2199UPDATE conversion" RAT_FUNC "%3.0" "Unitless" COEFFS 0 1 0 0 0 1 /end COMPU_METHOD
/begin MEASUREMENT P2262MALF "MAP Fail Turbo charger Hose off" UBYTE MC_P2262MALF 0 0 0 0 ECU_ADDRESS 0x3FA1E3 /end MEASUREMENT
/begin COMPU_METHOD MC_P2262MALF "P2262MALF conversion" RAT_FUNC "%3.0" "Unitless" COEFFS 0 1 0 0 0 1 /end COMPU_METHOD
/begin MEASUREMENT P2262MALF_TMR "Turbo charger hose off malf timer" FLOAT32_IEEE MC_P2262MALF_TMR 0 0 0 0 ECU_ADDRESS 0x3FA184 /end MEASUREMENT
/begin COMPU_METHOD MC_P2262MALF_TMR "P2262MALF_TMR conversion" RAT_FUNC "%10.5" "Unitless" COEFFS 0 1 0 0 0 1 /end COMPU_METHOD
/begin CHARACTERISTIC P2262SW "Turbo charger hose off  fault record updation enable switch" VALUE 0x5D78B SD_UBYTE 0 SC_P2262SW 0 255 /end CHARACTERISTIC
/begin COMPU_METHOD SC_P2262SW "P2262SW conversion" RAT_FUNC "%3.0" "unitless" COEFFS 0 1 0 0 0 1 /end COMPU_METHOD
/begin MEASUREMENT P2262UPDATE "p2262 malf update indication flag" UBYTE MC_P2262UPDATE 0 0 0 0 ECU_ADDRESS 0x3FA1E0 /end MEASUREMENT
/begin COMPU_METHOD MC_P2262UPDATE "P2262UPDATE conversion" RAT_FUNC "%3.0" "Unitless" COEFFS 0 1 0 0 0 1 /end COMPU_METHOD
/begin MEASUREMENT P2262UPDATE_TMR "Turbo charger hose off malf update timer" FLOAT32_IEEE MC_P2262UPDATE_TMR 0 0 0 0 ECU_ADDRESS 0x3FA180 /end MEASUREMENT
/begin COMPU_METHOD MC_P2262UPDATE_TMR "P2262UPDATE_TMR conversion" RAT_FUNC "%10.5" "Unitless" COEFFS 0 1 0 0 0 1 /end COMPU_METHOD
/begin MEASUREMENT P2263MALF "MAP Fail connection Hose off" UBYTE MC_P2263MALF 0 0 0 0 ECU_ADDRESS 0x3FA1E2 /end MEASUREMENT
/begin COMPU_METHOD MC_P2263MALF "P2263MALF conversion" RAT_FUNC "%3.0" "Unitless" COEFFS 0 1 0 0 0 1 /end COMPU_METHOD
/begin MEASUREMENT P2263MALF_TMR "Connection hose off malf timer" FLOAT32_IEEE MC_P2263MALF_TMR 0 0 0 0 ECU_ADDRESS 0x3FA17C /end MEASUREMENT
/begin COMPU_METHOD MC_P2263MALF_TMR "P2263MALF_TMR conversion" RAT_FUNC "%10.5" "Unitless" COEFFS 0 1 0 0 0 1 /end COMPU_METHOD
/begin CHARACTERISTIC P2263SW "Turbo charger connection  hose off  fault record updation enable switch" VALUE 0x5D78A SD_UBYTE 0 SC_P2263SW 0 255 /end CHARACTERISTIC
/begin COMPU_METHOD SC_P2263SW "P2263SW conversion" RAT_FUNC "%3.0" "unitless" COEFFS 0 1 0 0 0 1 /end COMPU_METHOD
/begin MEASUREMENT P2263UPDATE "p2263 malf update indication flag" UBYTE MC_P2263UPDATE 0 0 0 0 ECU_ADDRESS 0x3FA1DF /end MEASUREMENT
/begin COMPU_METHOD MC_P2263UPDATE "P2263UPDATE conversion" RAT_FUNC "%3.0" "Unitless" COEFFS 0 1 0 0 0 1 /end COMPU_METHOD
/begin MEASUREMENT P2263UPDATE_TMR "Connection hose off malf update timer" FLOAT32_IEEE MC_P2263UPDATE_TMR 0 0 0 0 ECU_ADDRESS 0x3FA178 /end MEASUREMENT
/begin COMPU_METHOD MC_P2263UPDATE_TMR "P2263UPDATE_TMR conversion" RAT_FUNC "%10.5" "Unitless" COEFFS 0 1 0 0 0 1 /end COMPU_METHOD
/begin CHARACTERISTIC P2269SW "Water in fuel condition P-code switch" VALUE 0x5D45D SD_UBYTE 0 SC_P2269SW 0 255 /end CHARACTERISTIC
/begin COMPU_METHOD SC_P2269SW "P2269SW conversion" RAT_FUNC "%3.0" "unitless" COEFFS 0 1 0 0 0 1 /end COMPU_METHOD
/begin MEASUREMENT P2284MALF "ICP higher/lower than desired malfunction flag" UBYTE MC_P2284MALF 0 0 0 0 ECU_ADDRESS 0x3FA0EB /end MEASUREMENT
/begin COMPU_METHOD MC_P2284MALF "P2284MALF conversion" RAT_FUNC "%3.0" "Unitless" COEFFS 0 1 0 0 0 1 /end COMPU_METHOD
/begin CHARACTERISTIC P2284SW "ICP  higher/lower than desired malf fault record updation enable switch" VALUE 0x5D7AD SD_UBYTE 0 SC_P2284SW 0 255 /end CHARACTERISTIC
/begin COMPU_METHOD SC_P2284SW "P2284SW conversion" RAT_FUNC "%3.0" "unitless" COEFFS 0 1 0 0 0 1 /end COMPU_METHOD
/begin MEASUREMENT P2284UPDATE "ICP higher/lower than desired malf flag" UBYTE MC_P2284UPDATE 0 0 0 0 ECU_ADDRESS 0x3FA0EA /end MEASUREMENT
/begin COMPU_METHOD MC_P2284UPDATE "P2284UPDATE conversion" RAT_FUNC "%3.0" "Unitless" COEFFS 0 1 0 0 0 1 /end COMPU_METHOD
/begin MEASUREMENT P2285MALF "OBDII malfunction flag for icp below min cal value" UBYTE MC_P2285MALF 0 0 0 0 ECU_ADDRESS 0x3FA0F7 /end MEASUREMENT
/begin COMPU_METHOD MC_P2285MALF "P2285MALF conversion" RAT_FUNC "%3.0" "Unitless" COEFFS 0 1 0 0 0 1 /end COMPU_METHOD
/begin CHARACTERISTIC P2285SW "ICP low malf fault record updation enable switch" VALUE 0x5D7B0 SD_UBYTE 0 SC_P2285SW 0 255 /end CHARACTERISTIC
/begin COMPU_METHOD SC_P2285SW "P2285SW conversion" RAT_FUNC "%3.0" "unitless" COEFFS 0 1 0 0 0 1 /end COMPU_METHOD
/begin MEASUREMENT P2285UPDATE "p2285 malfunction update flag" UBYTE MC_P2285UPDATE 0 0 0 0 ECU_ADDRESS 0x3FA0F5 /end MEASUREMENT
/begin COMPU_METHOD MC_P2285UPDATE "P2285UPDATE conversion" RAT_FUNC "%3.0" "Unitless" COEFFS 0 1 0 0 0 1 /end COMPU_METHOD
/begin MEASUREMENT P2286MALF "OBDII malfunction flag for icp above max calibration value" UBYTE MC_P2286MALF 0 0 0 0 ECU_ADDRESS 0x3FA0F6 /end MEASUREMENT
/begin COMPU_METHOD MC_P2286MALF "P2286MALF conversion" RAT_FUNC "%3.0" "Unitless" COEFFS 0 1 0 0 0 1 /end COMPU_METHOD
/begin CHARACTERISTIC P2286SW "ICP high malf fault record updation enable switch" VALUE 0x5D7AF SD_UBYTE 0 SC_P2286SW 0 255 /end CHARACTERISTIC
/begin COMPU_METHOD SC_P2286SW "P2286SW conversion" RAT_FUNC "%3.0" "unitless" COEFFS 0 1 0 0 0 1 /end COMPU_METHOD
/begin MEASUREMENT P2286UPDATE "p2286 mafunction update flag" UBYTE MC_P2286UPDATE 0 0 0 0 ECU_ADDRESS 0x3FA0F4 /end MEASUREMENT
/begin COMPU_METHOD MC_P2286UPDATE "P2286UPDATE conversion" RAT_FUNC "%3.0" "Unitless" COEFFS 0 1 0 0 0 1 /end COMPU_METHOD
/begin MEASUREMENT P2288MALF "In range ICP excessive malfunction fault flag" UBYTE MC_P2288MALF 0 0 0 0 ECU_ADDRESS 0x3FA0F0 /end MEASUREMENT
/begin COMPU_METHOD MC_P2288MALF "P2288MALF conversion" RAT_FUNC "%3.0" "Unitless" COEFFS 0 1 0 0 0 1 /end COMPU_METHOD
/begin CHARACTERISTIC P2288SW "In-range ICP excessive malf fault record updation enable switch" VALUE 0x5D7AB SD_UBYTE 0 SC_P2288SW 0 255 /end CHARACTERISTIC
/begin COMPU_METHOD SC_P2288SW "P2288SW conversion" RAT_FUNC "%3.0" "unitless" COEFFS 0 1 0 0 0 1 /end COMPU_METHOD
/begin MEASUREMENT P2288UPDATE "In range ICP excessive fault update flag" UBYTE MC_P2288UPDATE 0 0 0 0 ECU_ADDRESS 0x3FA0EF /end MEASUREMENT
/begin COMPU_METHOD MC_P2288UPDATE "P2288UPDATE conversion" RAT_FUNC "%3.0" "Unitless" COEFFS 0 1 0 0 0 1 /end COMPU_METHOD
/begin MEASUREMENT P2289MALF "In ranage ICP no-start malfunction flag" UBYTE MC_P2289MALF 0 0 0 0 ECU_ADDRESS 0x3FA0EE /end MEASUREMENT
/begin COMPU_METHOD MC_P2289MALF "P2289MALF conversion" RAT_FUNC "%3.0" "Unitless" COEFFS 0 1 0 0 0 1 /end COMPU_METHOD
/begin CHARACTERISTIC P2289SW "ICP  in-range no start malf fault record updation enable switch" VALUE 0x5D7AE SD_UBYTE 0 SC_P2289SW 0 255 /end CHARACTERISTIC
/begin COMPU_METHOD SC_P2289SW "P2289SW conversion" RAT_FUNC "%3.0" "unitless" COEFFS 0 1 0 0 0 1 /end COMPU_METHOD
/begin MEASUREMENT P2289UPDATE "In-range ICP no-start fault update flag" UBYTE MC_P2289UPDATE 0 0 0 0 ECU_ADDRESS 0x3FA0ED /end MEASUREMENT
/begin COMPU_METHOD MC_P2289UPDATE "P2289UPDATE conversion" RAT_FUNC "%3.0" "Unitless" COEFFS 0 1 0 0 0 1 /end COMPU_METHOD
/begin MEASUREMENT P2290MALF "ICP higher than desired malf flag" UBYTE MC_P2290MALF 0 0 0 0 ECU_ADDRESS 0x3FA0E9 /end MEASUREMENT
/begin COMPU_METHOD MC_P2290MALF "P2290MALF conversion" RAT_FUNC "%3.0" "Unitless" COEFFS 0 1 0 0 0 1 /end COMPU_METHOD
/begin CHARACTERISTIC P2290SW "ICP higher than desired malf fault record updation enable switch" VALUE 0x5D7AA SD_UBYTE 0 SC_P2290SW 0 255 /end CHARACTERISTIC
/begin COMPU_METHOD SC_P2290SW "P2290SW conversion" RAT_FUNC "%3.0" "unitless" COEFFS 0 1 0 0 0 1 /end COMPU_METHOD
/begin MEASUREMENT P2290UPDATE "ICP higher than desired malfunction update flag" UBYTE MC_P2290UPDATE 0 0 0 0 ECU_ADDRESS 0x3FA0E8 /end MEASUREMENT
/begin COMPU_METHOD MC_P2290UPDATE "P2290UPDATE conversion" RAT_FUNC "%3.0" "Unitless" COEFFS 0 1 0 0 0 1 /end COMPU_METHOD
/begin MEASUREMENT P2291MALF "p2291 malfunction flag" UBYTE MC_P2291MALF 0 0 0 0 ECU_ADDRESS 0x3FA0E5 /end MEASUREMENT
/begin COMPU_METHOD MC_P2291MALF "P2291MALF conversion" RAT_FUNC "%3.0" "Unitless" COEFFS 0 1 0 0 0 1 /end COMPU_METHOD
/begin CHARACTERISTIC P2291SW "ICP  lower than desired at crank/run malf fault record updation enable switch" VALUE 0x5D7AC SD_UBYTE 0 SC_P2291SW 0 255 /end CHARACTERISTIC
/begin COMPU_METHOD SC_P2291SW "P2291SW conversion" RAT_FUNC "%3.0" "unitless" COEFFS 0 1 0 0 0 1 /end COMPU_METHOD
/begin MEASUREMENT P2291UPDATE "p2291malf update flag" UBYTE MC_P2291UPDATE 0 0 0 0 ECU_ADDRESS 0x3FA0E4 /end MEASUREMENT
/begin COMPU_METHOD MC_P2291UPDATE "P2291UPDATE conversion" RAT_FUNC "%3.0" "Unitless" COEFFS 0 1 0 0 0 1 /end COMPU_METHOD
/begin CHARACTERISTIC P2292SW "Injector control pressure erratic" VALUE 0x5CB2A SD_UBYTE 0 SC_P2292SW 0 255 /end CHARACTERISTIC
/begin COMPU_METHOD SC_P2292SW "P2292SW conversion" RAT_FUNC "%3.0" "unitless" COEFFS 0 1 0 0 0 1 /end COMPU_METHOD
/begin MEASUREMENT P2552MALF "FICM PCM input driver diagnostics fault flag." UBYTE MC_P2552MALF 0 0 0 0 ECU_ADDRESS 0x3FA518 /end MEASUREMENT
/begin COMPU_METHOD MC_P2552MALF "P2552MALF conversion" RAT_FUNC "%3.0" "Unitless" COEFFS 0 1 0 0 0 1 /end COMPU_METHOD
/begin CHARACTERISTIC P2552SW "0=cal_out; 1=non_mil; 2=mil" VALUE 0x5D784 SD_UBYTE 0 SC_P2552SW 0 255 /end CHARACTERISTIC
/begin COMPU_METHOD SC_P2552SW "P2552SW conversion" RAT_FUNC "%3.0" "Unitless" COEFFS 0 1 0 0 0 1 /end COMPU_METHOD
/begin MEASUREMENT P2552UPDATE "FICM PCM input driver diagnostics update flag." UBYTE MC_P2552UPDATE 0 0 0 0 ECU_ADDRESS 0x3FA517 /end MEASUREMENT
/begin COMPU_METHOD MC_P2552UPDATE "P2552UPDATE conversion" RAT_FUNC "%3.0" "Unitless" COEFFS 0 1 0 0 0 1 /end COMPU_METHOD
/begin MEASUREMENT P2614MALF "Cam position output circuit malf" UBYTE MC_P2614MALF 0 0 0 0 ECU_ADDRESS 0x3FA643 /end MEASUREMENT
/begin COMPU_METHOD MC_P2614MALF "P2614MALF conversion" RAT_FUNC "%3.0" "Unitless" COEFFS 0 1 0 0 0 1 /end COMPU_METHOD
/begin CHARACTERISTIC P2614SW "CAM position o/p circuit  malf fault record updation enable switch" VALUE 0x5D7A9 SD_UBYTE 0 SC_P2614SW 0 255 /end CHARACTERISTIC
/begin COMPU_METHOD SC_P2614SW "P2614SW conversion" RAT_FUNC "%3.0" "unitless" COEFFS 0 1 0 0 0 1 /end COMPU_METHOD
/begin MEASUREMENT P2614UPDATE "Cam   position output circuit malf update  flag" UBYTE MC_P2614UPDATE 0 0 0 0 ECU_ADDRESS 0x3FA641 /end MEASUREMENT
/begin COMPU_METHOD MC_P2614UPDATE "P2614UPDATE conversion" RAT_FUNC "%3.0" "Unitless" COEFFS 0 1 0 0 0 1 /end COMPU_METHOD
/begin MEASUREMENT P2614UPDCNTR "Cam position output circuit malf update counter" SLONG MC_P2614UPDCNTR 0 0 0 0 ECU_ADDRESS 0x3FA63C /end MEASUREMENT
/begin COMPU_METHOD MC_P2614UPDCNTR "P2614UPDCNTR conversion" RAT_FUNC "%10.0" "Unitless" COEFFS 0 1 0 0 0 1 /end COMPU_METHOD
/begin MEASUREMENT P2617MALF "Crank  position output circuit malf" UBYTE MC_P2617MALF 0 0 0 0 ECU_ADDRESS 0x3FA642 /end MEASUREMENT
/begin COMPU_METHOD MC_P2617MALF "P2617MALF conversion" RAT_FUNC "%3.0" "Unitless" COEFFS 0 1 0 0 0 1 /end COMPU_METHOD
/begin CHARACTERISTIC P2617SW "Crank  position o/p circuit  malf fault record updation enable switch" VALUE 0x5D7A8 SD_UBYTE 0 SC_P2617SW 0 255 /end CHARACTERISTIC
/begin COMPU_METHOD SC_P2617SW "P2617SW conversion" RAT_FUNC "%3.0" "unitless" COEFFS 0 1 0 0 0 1 /end COMPU_METHOD
/begin MEASUREMENT P2617UPDATE "Crank   position output circuit malf update  flag" UBYTE MC_P2617UPDATE 0 0 0 0 ECU_ADDRESS 0x3FA640 /end MEASUREMENT
/begin COMPU_METHOD MC_P2617UPDATE "P2617UPDATE conversion" RAT_FUNC "%3.0" "Unitless" COEFFS 0 1 0 0 0 1 /end COMPU_METHOD
/begin MEASUREMENT P2617UPDCNTR "Crank  position output circuit malf update counter" SLONG MC_P2617UPDCNTR 0 0 0 0 ECU_ADDRESS 0x3FA638 /end MEASUREMENT
/begin COMPU_METHOD MC_P2617UPDCNTR "P2617UPDCNTR conversion" RAT_FUNC "%10.0" "Unitless" COEFFS 0 1 0 0 0 1 /end COMPU_METHOD
/begin CHARACTERISTIC P2623SW "0=cal_out; 1=non_mil; 2=mil; 3 = instant mil" VALUE 0x5D7C6 SD_UBYTE 0 SC_P2623SW 0 255 /end CHARACTERISTIC
/begin COMPU_METHOD SC_P2623SW "P2623SW conversion" RAT_FUNC "%3.0" "Unitless" COEFFS 0 1 0 0 0 1 /end COMPU_METHOD
/begin MEASUREMENT P2P3FMFLG "PPS SENSOR COMPARISON TEST FAILURE" UBYTE MC_P2P3FMFLG 0 0 0 0 ECU_ADDRESS 0x3FA326 /end MEASUREMENT
/begin COMPU_METHOD MC_P2P3FMFLG "P2P3FMFLG conversion" RAT_FUNC "%3.0" "Unitless" COEFFS 0 1 0 0 0 1 /end COMPU_METHOD
/begin MEASUREMENT P2P3SCFMFLG "PPS SENSOR COMPARISON TEST FAILURE for short circuit between sensors 2 and 3" UBYTE MC_P2P3SCFMFLG 0 0 0 0 ECU_ADDRESS 0x3FA325 /end MEASUREMENT
/begin COMPU_METHOD MC_P2P3SCFMFLG "P2P3SCFMFLG conversion" RAT_FUNC "%3.0" "Unitless" COEFFS 0 1 0 0 0 1 /end COMPU_METHOD
/begin MEASUREMENT P2P3_CNT "PEDAL COMPARISON FAILURE COUNTER" UBYTE MC_P2P3_CNT 0 0 0 0 ECU_ADDRESS 0x3FA32D /end MEASUREMENT
/begin COMPU_METHOD MC_P2P3_CNT "P2P3_CNT conversion" RAT_FUNC "%3.0" "Unitless" COEFFS 0 1 0 0 0 1 /end COMPU_METHOD
/begin MEASUREMENT P2P3_SCCNT "PEDAL COMPARISON FAILURE COUNTER for short circuit between sensors 2-3" UBYTE MC_P2P3_SCCNT 0 0 0 0 ECU_ADDRESS 0x3FA32C /end MEASUREMENT
/begin COMPU_METHOD MC_P2P3_SCCNT "P2P3_SCCNT conversion" RAT_FUNC "%3.0" "Unitless" COEFFS 0 1 0 0 0 1 /end COMPU_METHOD
/begin CHARACTERISTIC PAPMAX_VLTS[0] "High limits for eletronic throttle accelerator pedal inputs, voltage" VALUE 0x40FF8 SD_FLOAT32_IEEE 0 SC_PAPMAX_VLTS 0 5 /end CHARACTERISTIC
/begin COMPU_METHOD SC_PAPMAX_VLTS "PAPMAX_VLTS conversion" RAT_FUNC "%10.5" "V" COEFFS 0 1 0 0 0 1 /end COMPU_METHOD
/begin CHARACTERISTIC PAPMAX_VLTS[1] "High limits for eletronic throttle accelerator pedal inputs, voltage" VALUE 0x40FFC SD_FLOAT32_IEEE 0 SC_PAPMAX_VLTS 0 5 /end CHARACTERISTIC
/begin CHARACTERISTIC PAPMAX_VLTS[2] "High limits for eletronic throttle accelerator pedal inputs, voltage" VALUE 0x41000 SD_FLOAT32_IEEE 0 SC_PAPMAX_VLTS 0 5 /end CHARACTERISTIC
/begin CHARACTERISTIC PAPMIN_VLTS[0] "Low limits for eletronic throttle accelerator pedal inputs, voltage" VALUE 0x40FEC SD_FLOAT32_IEEE 0 SC_PAPMIN_VLTS 0 5 /end CHARACTERISTIC
/begin COMPU_METHOD SC_PAPMIN_VLTS "PAPMIN_VLTS conversion" RAT_FUNC "%10.5" "V" COEFFS 0 1 0 0 0 1 /end COMPU_METHOD
/begin CHARACTERISTIC PAPMIN_VLTS[1] "Low limits for eletronic throttle accelerator pedal inputs, voltage" VALUE 0x40FF0 SD_FLOAT32_IEEE 0 SC_PAPMIN_VLTS 0 5 /end CHARACTERISTIC
/begin CHARACTERISTIC PAPMIN_VLTS[2] "Low limits for eletronic throttle accelerator pedal inputs, voltage" VALUE 0x40FF4 SD_FLOAT32_IEEE 0 SC_PAPMIN_VLTS 0 5 /end CHARACTERISTIC
/begin MEASUREMENT PATS_ACC "Secure access method for ANTI-THEFT.  0 -> coded, 1 -> timed." UBYTE MC_PATS_ACC 0 0 0 0 ECU_ADDRESS 0x3F9DEC /end MEASUREMENT
/begin COMPU_METHOD MC_PATS_ACC "PATS_ACC conversion" RAT_FUNC "%3.0" "Unitless" COEFFS 0 1 0 0 0 1 /end COMPU_METHOD
/begin CHARACTERISTIC PATS_ACCESS "Secure access method for ANTI-THEFT. 0 -> coded, 1 -> timed." VALUE 0x5CD70 SD_UBYTE 0 SC_PATS_ACCESS 0 1 /end CHARACTERISTIC
/begin COMPU_METHOD SC_PATS_ACCESS "PATS_ACCESS conversion" RAT_FUNC "%3.0" "Unitless" COEFFS 0 1 0 0 0 1 /end COMPU_METHOD
/begin MEASUREMENT PATS_ACTIVE "PATS Operation Status, 1- PATS S/W Running, 0 - PATS  S/W Not Running" UBYTE MC_PATS_ACTIVE 0 0 0 0 ECU_ADDRESS 0x3F9DF9 /end MEASUREMENT
/begin COMPU_METHOD MC_PATS_ACTIVE "PATS_ACTIVE conversion" RAT_FUNC "%3.0" "Unitless" COEFFS 0 1 0 0 0 1 /end COMPU_METHOD
/begin MEASUREMENT PATS_BLK_NUM "Vehicle Security PCM ID Block Number." SBYTE MC_PATS_BLK_NUM 0 0 0 0 ECU_ADDRESS 0x3F9E04 /end MEASUREMENT
/begin COMPU_METHOD MC_PATS_BLK_NUM "PATS_BLK_NUM conversion" RAT_FUNC "%3.0" "Unitless" COEFFS 0 1 0 0 0 1 /end COMPU_METHOD
/begin MEASUREMENT PATS_CHL_CD1 "PATS challenge code query byte #1." UBYTE MC_PATS_CHL_CD1 0 0 0 0 ECU_ADDRESS 0x3F9DF4 /end MEASUREMENT
/begin COMPU_METHOD MC_PATS_CHL_CD1 "PATS_CHL_CD1 conversion" RAT_FUNC "%3.0" "Unitless" COEFFS 0 1 0 0 0 1 /end COMPU_METHOD
/begin MEASUREMENT PATS_CHL_CD2 "PATS challenge code query byte #2." UBYTE MC_PATS_CHL_CD2 0 0 0 0 ECU_ADDRESS 0x3F9DF3 /end MEASUREMENT
/begin COMPU_METHOD MC_PATS_CHL_CD2 "PATS_CHL_CD2 conversion" RAT_FUNC "%3.0" "Unitless" COEFFS 0 1 0 0 0 1 /end COMPU_METHOD
/begin MEASUREMENT PATS_CHL_CD3 "PATS challenge code query byte #3." UBYTE MC_PATS_CHL_CD3 0 0 0 0 ECU_ADDRESS 0x3F9DF2 /end MEASUREMENT
/begin COMPU_METHOD MC_PATS_CHL_CD3 "PATS_CHL_CD3 conversion" RAT_FUNC "%3.0" "Unitless" COEFFS 0 1 0 0 0 1 /end COMPU_METHOD
/begin MEASUREMENT PATS_CHL_CD4 "PATS challenge code query byte #4." UBYTE MC_PATS_CHL_CD4 0 0 0 0 ECU_ADDRESS 0x3F9DF1 /end MEASUREMENT
/begin COMPU_METHOD MC_PATS_CHL_CD4 "PATS_CHL_CD4 conversion" RAT_FUNC "%3.0" "Unitless" COEFFS 0 1 0 0 0 1 /end COMPU_METHOD
/begin MEASUREMENT PATS_CHL_REQ "PATS challenge query status enable flag.  (Controlled by Anti-Theft strategy)." UBYTE MC_PATS_CHL_REQ 0 0 0 0 ECU_ADDRESS 0x3F9DF5 /end MEASUREMENT
/begin COMPU_METHOD MC_PATS_CHL_REQ "PATS_CHL_REQ conversion" RAT_FUNC "%3.0" "Unitless" COEFFS 0 1 0 0 0 1 /end COMPU_METHOD
/begin MEASUREMENT PATS_CONFG "" UBYTE MC_PATS_CONFG 0 0 0 0 ECU_ADDRESS 0x3F9DED /end MEASUREMENT
/begin COMPU_METHOD MC_PATS_CONFG "PATS_CONFG conversion" RAT_FUNC "%3.0" "Unitless" COEFFS 0 1 0 0 0 1 /end COMPU_METHOD
/begin CHARACTERISTIC PATS_CONFIG "Auto send PCMID without secure access" VALUE 0x5CD71 SD_UBYTE 0 SC_PATS_CONFIG 0 255 /end CHARACTERISTIC
/begin COMPU_METHOD SC_PATS_CONFIG "PATS_CONFIG conversion" RAT_FUNC "%3.0" "unitless" COEFFS 0 1 0 0 0 1 /end COMPU_METHOD
/begin CHARACTERISTIC PATS_DISABLE "Enable / disable the Integrated PATS strategy.  0 -> PATS strategy enabled." VALUE 0x5C87C SD_UBYTE 0 SC_PATS_DISABLE 0 1 /end CHARACTERISTIC
/begin COMPU_METHOD SC_PATS_DISABLE "PATS_DISABLE conversion" RAT_FUNC "%3.0" "Unitless" COEFFS 0 1 0 0 0 1 /end COMPU_METHOD
/begin MEASUREMENT PATS_ENCR_ST "Encrypted PATS state as determined by the Anti-Theft PCM strategy.  (Used for transmittal over SCP)." UBYTE MC_PATS_ENCR_ST 0 0 0 0 ECU_ADDRESS 0x3F9DF6 /end MEASUREMENT
/begin COMPU_METHOD MC_PATS_ENCR_ST "PATS_ENCR_ST conversion" RAT_FUNC "%3.0" "Unitless" COEFFS 0 1 0 0 0 1 /end COMPU_METHOD
/begin MEASUREMENT PATS_ID_TMR "Timer counting down time since ANTI-THEFT strategy transmitted PCM_ID to PATS module, seconds." FLOAT32_IEEE MC_PATS_ID_TMR 0 0 0 0 ECU_ADDRESS 0x3F9DFC /end MEASUREMENT
/begin COMPU_METHOD MC_PATS_ID_TMR "PATS_ID_TMR conversion" RAT_FUNC "%10.5" "Unitless" COEFFS 0 1 0 0 0 1 /end COMPU_METHOD
/begin MEASUREMENT PATS_PCM_ID1 "Vehicle Security PCM ID Block Response Byte #1." UBYTE MC_PATS_PCM_ID1 0 0 0 0 ECU_ADDRESS 0x3F9E0A /end MEASUREMENT
/begin COMPU_METHOD MC_PATS_PCM_ID1 "PATS_PCM_ID1 conversion" RAT_FUNC "%3.0" "Unitless" COEFFS 0 1 0 0 0 1 /end COMPU_METHOD
/begin MEASUREMENT PATS_PCM_ID2 "Vehicle Security PCM ID Block Response Byte #2." UBYTE MC_PATS_PCM_ID2 0 0 0 0 ECU_ADDRESS 0x3F9E09 /end MEASUREMENT
/begin COMPU_METHOD MC_PATS_PCM_ID2 "PATS_PCM_ID2 conversion" RAT_FUNC "%3.0" "Unitless" COEFFS 0 1 0 0 0 1 /end COMPU_METHOD
/begin MEASUREMENT PATS_PCM_ID3 "Vehicle Security PCM ID Block Response Byte #3." UBYTE MC_PATS_PCM_ID3 0 0 0 0 ECU_ADDRESS 0x3F9E08 /end MEASUREMENT
/begin COMPU_METHOD MC_PATS_PCM_ID3 "PATS_PCM_ID3 conversion" RAT_FUNC "%3.0" "Unitless" COEFFS 0 1 0 0 0 1 /end COMPU_METHOD
/begin MEASUREMENT PATS_PCM_ID4 "Vehicle Security PCM ID Block Response Byte #4." UBYTE MC_PATS_PCM_ID4 0 0 0 0 ECU_ADDRESS 0x3F9E07 /end MEASUREMENT
/begin COMPU_METHOD MC_PATS_PCM_ID4 "PATS_PCM_ID4 conversion" RAT_FUNC "%3.0" "Unitless" COEFFS 0 1 0 0 0 1 /end COMPU_METHOD
/begin MEASUREMENT PATS_PCM_ID5 "Vehicle Security PCM ID Block Response Byte #5." UBYTE MC_PATS_PCM_ID5 0 0 0 0 ECU_ADDRESS 0x3F9E06 /end MEASUREMENT
/begin COMPU_METHOD MC_PATS_PCM_ID5 "PATS_PCM_ID5 conversion" RAT_FUNC "%3.0" "Unitless" COEFFS 0 1 0 0 0 1 /end COMPU_METHOD
/begin MEASUREMENT PATS_RAND[0] "Array containing four random bytes, used in ANTI_THEFT strategy" UBYTE MC_PATS_RAND 0 0 0 255 ECU_ADDRESS 0x3F9DE4 /end MEASUREMENT
/begin COMPU_METHOD MC_PATS_RAND "PATS_RAND conversion" RAT_FUNC "%3.0" "unitless" COEFFS 0 1 0 0 0 1 /end COMPU_METHOD
/begin MEASUREMENT PATS_RAND[1] "Array containing four random bytes, used in ANTI_THEFT strategy" UBYTE MC_PATS_RAND 0 0 0 255 ECU_ADDRESS 0x3F9DE5 /end MEASUREMENT
/begin MEASUREMENT PATS_RAND[2] "Array containing four random bytes, used in ANTI_THEFT strategy" UBYTE MC_PATS_RAND 0 0 0 255 ECU_ADDRESS 0x3F9DE6 /end MEASUREMENT
/begin MEASUREMENT PATS_RAND[3] "Array containing four random bytes, used in ANTI_THEFT strategy" UBYTE MC_PATS_RAND 0 0 0 255 ECU_ADDRESS 0x3F9DE7 /end MEASUREMENT
/begin MEASUREMENT PATS_RSP_REQ "PATS response message enable flag. (Controlled by Anti - Theft strategy)." UBYTE MC_PATS_RSP_REQ 0 0 0 0 ECU_ADDRESS 0x3F9E05 /end MEASUREMENT
/begin COMPU_METHOD MC_PATS_RSP_REQ "PATS_RSP_REQ conversion" RAT_FUNC "%3.0" "Unitless" COEFFS 0 1 0 0 0 1 /end COMPU_METHOD
/begin MEASUREMENT PAT_CHL_RSP1 "Security response message sent by the PCM over SCP. Byte #1" UBYTE MC_PAT_CHL_RSP1 0 0 0 0 ECU_ADDRESS 0x3F9E0E /end MEASUREMENT
/begin COMPU_METHOD MC_PAT_CHL_RSP1 "PAT_CHL_RSP1 conversion" RAT_FUNC "%3.0" "Unitless" COEFFS 0 1 0 0 0 1 /end COMPU_METHOD
/begin MEASUREMENT PAT_CHL_RSP2 "Security response message sent by the PCM over SCP. Byte #2" UBYTE MC_PAT_CHL_RSP2 0 0 0 0 ECU_ADDRESS 0x3F9E0D /end MEASUREMENT
/begin COMPU_METHOD MC_PAT_CHL_RSP2 "PAT_CHL_RSP2 conversion" RAT_FUNC "%3.0" "Unitless" COEFFS 0 1 0 0 0 1 /end COMPU_METHOD
/begin MEASUREMENT PAT_CHL_RSP3 "Security response message sent by the PCM over SCP. Byte #3" UBYTE MC_PAT_CHL_RSP3 0 0 0 0 ECU_ADDRESS 0x3F9E0C /end MEASUREMENT
/begin COMPU_METHOD MC_PAT_CHL_RSP3 "PAT_CHL_RSP3 conversion" RAT_FUNC "%3.0" "Unitless" COEFFS 0 1 0 0 0 1 /end COMPU_METHOD
/begin MEASUREMENT PAT_CHL_RSP4 "Security response message sent by the PCM over SCP. Byte #4" UBYTE MC_PAT_CHL_RSP4 0 0 0 0 ECU_ADDRESS 0x3F9E0B /end MEASUREMENT
/begin COMPU_METHOD MC_PAT_CHL_RSP4 "PAT_CHL_RSP4 conversion" RAT_FUNC "%3.0" "Unitless" COEFFS 0 1 0 0 0 1 /end COMPU_METHOD
/begin MEASUREMENT PAT_PARM_RST "Flag indicating to ANTI-THEFT to reset state machine to allow PCM ID request." UBYTE MC_PAT_PARM_RST 0 0 0 0 ECU_ADDRESS 0x3FB4AE /end MEASUREMENT
/begin COMPU_METHOD MC_PAT_PARM_RST "PAT_PARM_RST conversion" RAT_FUNC "%3.0" "Unitless" COEFFS 0 1 0 0 0 1 /end COMPU_METHOD
/begin MEASUREMENT PBA "parking brake applied indicator flag, 1 - brake applied" UBYTE MC_PBA 0 0 0 0 ECU_ADDRESS 0x3F98FF /end MEASUREMENT
/begin COMPU_METHOD MC_PBA "PBA conversion" RAT_FUNC "%3.0" "Unitless" COEFFS 0 1 0 0 0 1 /end COMPU_METHOD
/begin MEASUREMENT PCF_AC "Filtered ROC of pedal for A/C control finctions." FLOAT32_IEEE MC_PCF_AC 0 0 0 0 ECU_ADDRESS 0x3F9D3C /end MEASUREMENT
/begin COMPU_METHOD MC_PCF_AC "PCF_AC conversion" RAT_FUNC "%10.5" "Unitless" COEFFS 0 1 0 0 0 1 /end COMPU_METHOD
/begin CHARACTERISTIC PCLCH_AC "Time constant for pcf_ac" VALUE 0x5CBD8 SD_FLOAT32_IEEE 0 SC_PCLCH_AC 0 63.999 /end CHARACTERISTIC
/begin COMPU_METHOD SC_PCLCH_AC "PCLCH_AC conversion" RAT_FUNC "%10.5" "unitless" COEFFS 0 1 0 0 0 1 /end COMPU_METHOD
/begin MEASUREMENT PCM_ID_STAT "Flag indicating whether PCM_ID has been shared with the PATS module. 1 -> shared." UBYTE MC_PCM_ID_STAT 0 0 0 0 ECU_ADDRESS 0x3FCC9E /end MEASUREMENT
/begin COMPU_METHOD MC_PCM_ID_STAT "PCM_ID_STAT conversion" RAT_FUNC "%3.0" "Unitless" COEFFS 0 1 0 0 0 1 /end COMPU_METHOD
/begin CHARACTERISTIC PCM_INJ_ID_HI "PCM injector type upper byte compate calibration." VALUE 0x5D741 SD_UBYTE 0 SC_PCM_INJ_ID_HI 0 255 /end CHARACTERISTIC
/begin COMPU_METHOD SC_PCM_INJ_ID_HI "PCM_INJ_ID_HI conversion" RAT_FUNC "%3.0" "unitless" COEFFS 0 1 0 0 0 1 /end COMPU_METHOD
/begin CHARACTERISTIC PCM_INJ_ID_LO "PCM injector type lower byte compate calibration." VALUE 0x5D740 SD_UBYTE 0 SC_PCM_INJ_ID_LO 0 255 /end CHARACTERISTIC
/begin COMPU_METHOD SC_PCM_INJ_ID_LO "PCM_INJ_ID_LO conversion" RAT_FUNC "%3.0" "unitless" COEFFS 0 1 0 0 0 1 /end COMPU_METHOD
/begin MEASUREMENT PCM_INJ_ID_MIS_CNTR "PCM injector type mismatch failure counter" SLONG MC_PCM_INJ_ID_MIS_CNTR 0 0 0 0 ECU_ADDRESS 0x3FA440 /end MEASUREMENT
/begin COMPU_METHOD MC_PCM_INJ_ID_MIS_CNTR "PCM_INJ_ID_MIS_CNTR conversion" RAT_FUNC "%10.0" "Unitless" COEFFS 0 1 0 0 0 1 /end COMPU_METHOD
/begin CHARACTERISTIC PCM_INJ_ID_MIS_DEC "PCM injector type mismatch failure counter decrement value" VALUE 0x5D648 SD_SLONG 0 SC_PCM_INJ_ID_MIS_DEC 0 65535 /end CHARACTERISTIC
/begin COMPU_METHOD SC_PCM_INJ_ID_MIS_DEC "PCM_INJ_ID_MIS_DEC conversion" RAT_FUNC "%10.0" "unitless" COEFFS 0 1 0 0 0 1 /end COMPU_METHOD
/begin CHARACTERISTIC PCM_INJ_ID_MIS_INC "PCM injector type mismatch failure counter increment value" VALUE 0x5D64C SD_SLONG 0 SC_PCM_INJ_ID_MIS_INC 0 65535 /end CHARACTERISTIC
/begin COMPU_METHOD SC_PCM_INJ_ID_MIS_INC "PCM_INJ_ID_MIS_INC conversion" RAT_FUNC "%10.0" "unitless" COEFFS 0 1 0 0 0 1 /end COMPU_METHOD
/begin MEASUREMENT PCM_INJ_TYPE_STATUS "PCM injection type mismatch failure status" UBYTE MC_PCM_INJ_TYPE_STATUS 0 0 0 0 ECU_ADDRESS 0x3FA514 /end MEASUREMENT
/begin COMPU_METHOD MC_PCM_INJ_TYPE_STATUS "PCM_INJ_TYPE_STATUS conversion" RAT_FUNC "%3.0" "Unitless" COEFFS 0 1 0 0 0 1 /end COMPU_METHOD
/begin MEASUREMENT PCM_RST_CNT "Counter used to delay a diagnostic tester's request for PCM Reset to allow respnse message to be sent." UBYTE MC_PCM_RST_CNT 0 0 0 0 ECU_ADDRESS 0x3FB4AA /end MEASUREMENT
/begin COMPU_METHOD MC_PCM_RST_CNT "PCM_RST_CNT conversion" RAT_FUNC "%3.0" "Unitless" COEFFS 0 1 0 0 0 1 /end COMPU_METHOD
/begin MEASUREMENT PCT_LOAD "Percent inferred load based on mapped engine behavior at ESTP" FLOAT32_IEEE MC_PCT_LOAD 0 0 0 0 ECU_ADDRESS 0x3F9B2C /end MEASUREMENT
/begin COMPU_METHOD MC_PCT_LOAD "PCT_LOAD conversion" RAT_FUNC "%10.5" "Unitless" COEFFS 0 1 0 0 0 1 /end COMPU_METHOD
/begin MEASUREMENT PDIF_ALT_BARO "Altitude offset for reference" FLOAT32_IEEE MC_PDIF_ALT_BARO 0 0 0 0 ECU_ADDRESS 0x3FA4D4 /end MEASUREMENT
/begin COMPU_METHOD MC_PDIF_ALT_BARO "PDIF_ALT_BARO conversion" RAT_FUNC "%10.5" "Unitless" COEFFS 0 1 0 0 0 1 /end COMPU_METHOD
/begin MEASUREMENT PDIF_ARA_C "1-> Indicates reference value captured this keyon" UBYTE MC_PDIF_ARA_C 0 0 0 0 ECU_ADDRESS 0x3FA4E7 /end MEASUREMENT
/begin COMPU_METHOD MC_PDIF_ARA_C "PDIF_ARA_C conversion" RAT_FUNC "%3.0" "Unitless" COEFFS 0 1 0 0 0 1 /end COMPU_METHOD
/begin MEASUREMENT PDIF_BP_REF_ADD "BP offset value" FLOAT32_IEEE MC_PDIF_BP_REF_ADD 0 0 0 0 ECU_ADDRESS 0x3FA4C8 /end MEASUREMENT
/begin COMPU_METHOD MC_PDIF_BP_REF_ADD "PDIF_BP_REF_ADD conversion" RAT_FUNC "%10.5" "Unitless" COEFFS 0 1 0 0 0 1 /end COMPU_METHOD
/begin CHARACTERISTIC PDIF_BP_WGT "Weighing facture for BP" VALUE 0x5D6C8 SD_FLOAT32_IEEE 0 SC_PDIF_BP_WGT 0 10 /end CHARACTERISTIC
/begin COMPU_METHOD SC_PDIF_BP_WGT "PDIF_BP_WGT conversion" RAT_FUNC "%10.5" "unitless" COEFFS 0 1 0 0 0 1 /end COMPU_METHOD
/begin MEASUREMENT PDIF_EBP_REF_ADD "Altitude reference adder term for EBP" FLOAT32_IEEE MC_PDIF_EBP_REF_ADD 0 0 0 0 ECU_ADDRESS 0x3FA4D0 /end MEASUREMENT
/begin COMPU_METHOD MC_PDIF_EBP_REF_ADD "PDIF_EBP_REF_ADD conversion" RAT_FUNC "%10.5" "Unitless" COEFFS 0 1 0 0 0 1 /end COMPU_METHOD
/begin CHARACTERISTIC PDIF_EBP_THLD "EBP/BP differential equate threshold (kPa)" VALUE 0x5D6D4 SD_FLOAT32_IEEE 0 SC_PDIF_EBP_THLD 0 100 /end CHARACTERISTIC
/begin COMPU_METHOD SC_PDIF_EBP_THLD "PDIF_EBP_THLD conversion" RAT_FUNC "%10.5" "kPa" COEFFS 0 1 0 0 0 1 /end COMPU_METHOD
/begin CHARACTERISTIC PDIF_EGRPMAX "EGRP min. limit value for ARA" VALUE 0x5D6BC SD_FLOAT32_IEEE 0 SC_PDIF_EGRPMAX 0 2 /end CHARACTERISTIC
/begin COMPU_METHOD SC_PDIF_EGRPMAX "PDIF_EGRPMAX conversion" RAT_FUNC "%10.5" "%" COEFFS 0 1 0 0 0 1 /end COMPU_METHOD
/begin CHARACTERISTIC PDIF_IDLE_TM "Input conditions  Stabilisation timer value" VALUE 0x5D6B0 SD_FLOAT32_IEEE 0 SC_PDIF_IDLE_TM 0 1000 /end CHARACTERISTIC
/begin COMPU_METHOD SC_PDIF_IDLE_TM "PDIF_IDLE_TM conversion" RAT_FUNC "%10.5" "s" COEFFS 0 1 0 0 0 1 /end COMPU_METHOD
/begin MEASUREMENT PDIF_IDLE_TMR "Engine conditions stable timer" FLOAT32_IEEE MC_PDIF_IDLE_TMR 0 0 0 0 ECU_ADDRESS 0x3FA4C0 /end MEASUREMENT
/begin COMPU_METHOD MC_PDIF_IDLE_TMR "PDIF_IDLE_TMR conversion" RAT_FUNC "%10.5" "Unitless" COEFFS 0 1 0 0 0 1 /end COMPU_METHOD
/begin CHARACTERISTIC PDIF_MAPEBP_THLD "MAP/EBP differential equate threshold (kPa)" VALUE 0x5D6D0 SD_FLOAT32_IEEE 0 SC_PDIF_MAPEBP_THLD 0 100 /end CHARACTERISTIC
/begin COMPU_METHOD SC_PDIF_MAPEBP_THLD "PDIF_MAPEBP_THLD conversion" RAT_FUNC "%10.5" "kPa" COEFFS 0 1 0 0 0 1 /end COMPU_METHOD
/begin MEASUREMENT PDIF_MAP_REF_ADD "Differential MAP reference term" FLOAT32_IEEE MC_PDIF_MAP_REF_ADD 0 0 0 0 ECU_ADDRESS 0x3FA4CC /end MEASUREMENT
/begin COMPU_METHOD MC_PDIF_MAP_REF_ADD "PDIF_MAP_REF_ADD conversion" RAT_FUNC "%10.5" "Unitless" COEFFS 0 1 0 0 0 1 /end COMPU_METHOD
/begin CHARACTERISTIC PDIF_MAP_THLD "MAP/BP differential equate threshold (kPa)" VALUE 0x5D6D8 SD_FLOAT32_IEEE 0 SC_PDIF_MAP_THLD 0 100 /end CHARACTERISTIC
/begin COMPU_METHOD SC_PDIF_MAP_THLD "PDIF_MAP_THLD conversion" RAT_FUNC "%10.5" "kPa" COEFFS 0 1 0 0 0 1 /end COMPU_METHOD
/begin CHARACTERISTIC PDIF_MFDES_MAX "Desired fuel threshold for ARA calc" VALUE 0x5D6DC SD_FLOAT32_IEEE 0 SC_PDIF_MFDES_MAX 0 200 /end CHARACTERISTIC
/begin COMPU_METHOD SC_PDIF_MFDES_MAX "PDIF_MFDES_MAX conversion" RAT_FUNC "%10.5" "unitless" COEFFS 0 1 0 0 0 1 /end COMPU_METHOD
/begin CHARACTERISTIC PDIF_MFDES_TOLMAX "mfdes min. limit value for ARA" VALUE 0x5D6C0 SD_FLOAT32_IEEE 0 SC_PDIF_MFDES_TOLMAX -2048 2048 /end CHARACTERISTIC
/begin COMPU_METHOD SC_PDIF_MFDES_TOLMAX "PDIF_MFDES_TOLMAX conversion" RAT_FUNC "%10.5" "unitless" COEFFS 0 1 0 0 0 1 /end COMPU_METHOD
/begin MEASUREMENT PDIF_MODE "1-> Indicates which sensor is okay for altitude reading" UBYTE MC_PDIF_MODE 0 0 0 0 ECU_ADDRESS 0x3FA4E1 /end MEASUREMENT
/begin COMPU_METHOD MC_PDIF_MODE "PDIF_MODE conversion" RAT_FUNC "%3.0" "Unitless" COEFFS 0 1 0 0 0 1 /end COMPU_METHOD
/begin CHARACTERISTIC PDIF_N_MAX "Speed threshold for ARA calc" VALUE 0x5D6E0 SD_FLOAT32_IEEE 0 SC_PDIF_N_MAX 0 1000 /end CHARACTERISTIC
/begin COMPU_METHOD SC_PDIF_N_MAX "PDIF_N_MAX conversion" RAT_FUNC "%10.5" "RPM" COEFFS 0 1 0 0 0 1 /end COMPU_METHOD
/begin CHARACTERISTIC PDIF_N_TOLMAX "RPM limit value for altitude reference calc." VALUE 0x5D6C4 SD_FLOAT32_IEEE 0 SC_PDIF_N_TOLMAX 0 8000 /end CHARACTERISTIC
/begin COMPU_METHOD SC_PDIF_N_TOLMAX "PDIF_N_TOLMAX conversion" RAT_FUNC "%10.5" "RPM" COEFFS 0 1 0 0 0 1 /end COMPU_METHOD
/begin MEASUREMENT PDIF_SAMPLE "1-> Indicates capture altitude reference values" UBYTE MC_PDIF_SAMPLE 0 0 0 0 ECU_ADDRESS 0x3FA4E8 /end MEASUREMENT
/begin COMPU_METHOD MC_PDIF_SAMPLE "PDIF_SAMPLE conversion" RAT_FUNC "%3.0" "Unitless" COEFFS 0 1 0 0 0 1 /end COMPU_METHOD
/begin CHARACTERISTIC PDIF_STL_TM "ARA Stabilisation timer value" VALUE 0x5D6CC SD_FLOAT32_IEEE 0 SC_PDIF_STL_TM 0 1000 /end CHARACTERISTIC
/begin COMPU_METHOD SC_PDIF_STL_TM "PDIF_STL_TM conversion" RAT_FUNC "%10.5" "s" COEFFS 0 1 0 0 0 1 /end COMPU_METHOD
/begin MEASUREMENT PDIF_STL_TMR "ARA input conditions stable timer" FLOAT32_IEEE MC_PDIF_STL_TMR 0 0 0 0 ECU_ADDRESS 0x3FA4C4 /end MEASUREMENT
/begin COMPU_METHOD MC_PDIF_STL_TMR "PDIF_STL_TMR conversion" RAT_FUNC "%10.5" "Unitless" COEFFS 0 1 0 0 0 1 /end COMPU_METHOD
/begin MEASUREMENT PDIF_STL_TMR_FLG "1-> Indicates engine conditions stable for ARA" UBYTE MC_PDIF_STL_TMR_FLG 0 0 0 0 ECU_ADDRESS 0x3FA4E6 /end MEASUREMENT
/begin COMPU_METHOD MC_PDIF_STL_TMR_FLG "PDIF_STL_TMR_FLG conversion" RAT_FUNC "%3.0" "Unitless" COEFFS 0 1 0 0 0 1 /end COMPU_METHOD
/begin CHARACTERISTIC PDIF_VGT_MAX "VGT min. limit value for ARA" VALUE 0x5D6B8 SD_FLOAT32_IEEE 0 SC_PDIF_VGT_MAX 0 2 /end CHARACTERISTIC
/begin COMPU_METHOD SC_PDIF_VGT_MAX "PDIF_VGT_MAX conversion" RAT_FUNC "%10.5" "unitless" COEFFS 0 1 0 0 0 1 /end COMPU_METHOD
/begin MEASUREMENT PDL "PRNDL Position - from A to D conversion" UBYTE MC_PDL 0 0 0 0 ECU_ADDRESS 0x3FB743 /end MEASUREMENT
/begin COMPU_METHOD MC_PDL "PDL conversion" RAT_FUNC "%3.0" "Unitless" COEFFS 0 1 0 0 0 1 /end COMPU_METHOD
/begin MEASUREMENT PDL_ERROR "Flag indicating PRNDL Position Error (1 = Failed)" UBYTE MC_PDL_ERROR 0 0 0 0 ECU_ADDRESS 0x3F9D0A /end MEASUREMENT
/begin COMPU_METHOD MC_PDL_ERROR "PDL_ERROR conversion" RAT_FUNC "%3.0" "Unitless" COEFFS 0 1 0 0 0 1 /end COMPU_METHOD
/begin MEASUREMENT PEAK_FUEL_FLOW "Peak fuel flow at WOT and STP as a function of RPM" FLOAT32_IEEE MC_PEAK_FUEL_FLOW 0 0 0 0 ECU_ADDRESS 0x3FA898 /end MEASUREMENT
/begin COMPU_METHOD MC_PEAK_FUEL_FLOW "PEAK_FUEL_FLOW conversion" RAT_FUNC "%10.5" "Unitless" COEFFS 0 1 0 0 0 1 /end COMPU_METHOD
/begin CHARACTERISTIC PFEHP__A "SWITCH TO SELECT EGR STRATEGY 2 = DO NOT USE ANY EGR 1 = USE DPFE STRATEGY 0 = USE STEPPER POSITION STRATEGY" VALUE 0x5CB30 SD_UBYTE 0 SC_PFEHP__A 0 2 /end CHARACTERISTIC
/begin COMPU_METHOD SC_PFEHP__A "PFEHP__A conversion" RAT_FUNC "%3.0" "ENUMERATED" COEFFS 0 1 0 0 0 1 /end COMPU_METHOD
/begin MEASUREMENT PFMFLG "PPS SENSORS HAVE ALL FAILED" UBYTE MC_PFMFLG 0 0 0 0 ECU_ADDRESS 0x3FA324 /end MEASUREMENT
/begin COMPU_METHOD MC_PFMFLG "PFMFLG conversion" RAT_FUNC "%3.0" "Unitless" COEFFS 0 1 0 0 0 1 /end COMPU_METHOD
/begin MEASUREMENT PGM_DONE "PURGE MONITOR TEST IS DONE FLAG; 1 -> TEST IS DONE." UBYTE MC_PGM_DONE 0 0 0 0 ECU_ADDRESS 0x3F9CF3 /end MEASUREMENT
/begin COMPU_METHOD MC_PGM_DONE "PGM_DONE conversion" RAT_FUNC "%3.0" "Unitless" COEFFS 0 1 0 0 0 1 /end COMPU_METHOD
/begin MEASUREMENT PGM_FLI_DLT "Absolute value of difference between instantaneous and filtered fuel level." FLOAT32_IEEE MC_PGM_FLI_DLT 0 0 0 0 ECU_ADDRESS 0x3F9FDC /end MEASUREMENT
/begin COMPU_METHOD MC_PGM_FLI_DLT "PGM_FLI_DLT conversion" RAT_FUNC "%10.5" "Unitless" COEFFS 0 1 0 0 0 1 /end COMPU_METHOD
/begin MEASUREMENT PGM_FLI_FM "Fuel level sensor FMEM failure flag; 1 -> FLI sensor failed." UBYTE MC_PGM_FLI_FM 0 0 0 0 ECU_ADDRESS 0x3FA008 /end MEASUREMENT
/begin COMPU_METHOD MC_PGM_FLI_FM "PGM_FLI_FM conversion" RAT_FUNC "%3.0" "Unitless" COEFFS 0 1 0 0 0 1 /end COMPU_METHOD
/begin CHARACTERISTIC PGM_FLI_FMEM "FMEM value for filtered fuel level input, % fill" VALUE 0x5D108 SD_FLOAT32_IEEE 0 SC_PGM_FLI_FMEM 0 1.99 /end CHARACTERISTIC
/begin COMPU_METHOD SC_PGM_FLI_FMEM "PGM_FLI_FMEM conversion" RAT_FUNC "%10.5" "%" COEFFS 0 1 0 0 0 1 /end COMPU_METHOD
/begin MEASUREMENT PGM_FUEL_LVL "Filtered fuel level, % fill" FLOAT32_IEEE MC_PGM_FUEL_LVL 0 0 0 0 ECU_ADDRESS 0x3F9FD8 /end MEASUREMENT
/begin COMPU_METHOD MC_PGM_FUEL_LVL "PGM_FUEL_LVL conversion" RAT_FUNC "%10.5" "Unitless" COEFFS 0 1 0 0 0 1 /end COMPU_METHOD
/begin MEASUREMENT PGM_TEMP_BYP "Purge Monitor temperature bypass flag; 1 -> bypass monitor." UBYTE MC_PGM_TEMP_BYP 0 0 0 0 ECU_ADDRESS 0x3F9CC9 /end MEASUREMENT
/begin COMPU_METHOD MC_PGM_TEMP_BYP "PGM_TEMP_BYP conversion" RAT_FUNC "%3.0" "Unitless" COEFFS 0 1 0 0 0 1 /end COMPU_METHOD
/begin MEASUREMENT PHFMFLG_A[0] "ARRAY OF PEDAL POSITION HIGH FAILURE FLAGS" UBYTE MC_PHFMFLG_A 0 0 0 1 ECU_ADDRESS 0x3FA31C /end MEASUREMENT
/begin COMPU_METHOD MC_PHFMFLG_A "PHFMFLG_A conversion" RAT_FUNC "%3.0" "Unitless" COEFFS 0 1 0 0 0 1 /end COMPU_METHOD
/begin MEASUREMENT PHFMFLG_A[1] "ARRAY OF PEDAL POSITION HIGH FAILURE FLAGS" UBYTE MC_PHFMFLG_A 0 0 0 1 ECU_ADDRESS 0x3FA31D /end MEASUREMENT
/begin MEASUREMENT PHFMFLG_A[2] "ARRAY OF PEDAL POSITION HIGH FAILURE FLAGS" UBYTE MC_PHFMFLG_A 0 0 0 1 ECU_ADDRESS 0x3FA31E /end MEASUREMENT
/begin MEASUREMENT PHFM_CNT_A[0] "COUNTER OF PEDAL POSITION HIGH FAILURES" UBYTE MC_PHFM_CNT_A 0 0 0 255 ECU_ADDRESS 0x3FA319 /end MEASUREMENT
/begin COMPU_METHOD MC_PHFM_CNT_A "PHFM_CNT_A conversion" RAT_FUNC "%3.0" "Unitless" COEFFS 0 1 0 0 0 1 /end COMPU_METHOD
/begin MEASUREMENT PHFM_CNT_A[1] "COUNTER OF PEDAL POSITION HIGH FAILURES" UBYTE MC_PHFM_CNT_A 0 0 0 255 ECU_ADDRESS 0x3FA31A /end MEASUREMENT
/begin MEASUREMENT PHFM_CNT_A[2] "COUNTER OF PEDAL POSITION HIGH FAILURES" UBYTE MC_PHFM_CNT_A 0 0 0 255 ECU_ADDRESS 0x3FA31B /end MEASUREMENT
/begin CHARACTERISTIC PHFM_INC "VARIABLE  TO INCREMENT THE  PEDAL HIGH FAILURE COUNTER BY" VALUE 0x5D52A SD_UBYTE 0 SC_PHFM_INC 8 255 /end CHARACTERISTIC
/begin COMPU_METHOD SC_PHFM_INC "PHFM_INC conversion" RAT_FUNC "%3.0" "Unitless" COEFFS 0 1 0 0 0 1 /end COMPU_METHOD
/begin CHARACTERISTIC PHFM_LVL "NUMBER OF PEDAL HIGH FAILURE COUNTS FOR FLAG TO SET" VALUE 0x5D529 SD_UBYTE 0 SC_PHFM_LVL 0 254 /end CHARACTERISTIC
/begin COMPU_METHOD SC_PHFM_LVL "PHFM_LVL conversion" RAT_FUNC "%3.0" "Unitless" COEFFS 0 1 0 0 0 1 /end COMPU_METHOD
/begin CHARACTERISTIC PIDMAP_1 "J1979 map of supported PIDs for numbers $01-$16." VALUE 0x5CDE6 SD_UWORD 0 SC_PIDMAP_1 0 65535 /end CHARACTERISTIC
/begin COMPU_METHOD SC_PIDMAP_1 "PIDMAP_1 conversion" RAT_FUNC "%5.0" "NONE" COEFFS 0 1 0 0 0 1 /end COMPU_METHOD
/begin CHARACTERISTIC PIDMAP_2 "J1979 map of supported PIDs for numbers $17-$20." VALUE 0x5CDE4 SD_UWORD 0 SC_PIDMAP_2 0 65535 /end CHARACTERISTIC
/begin COMPU_METHOD SC_PIDMAP_2 "PIDMAP_2 conversion" RAT_FUNC "%5.0" "NONE" COEFFS 0 1 0 0 0 1 /end COMPU_METHOD
/begin CHARACTERISTIC PIDMAP_3 "J1979 map of supported PIDs for mode 01 PIDs 01-16." VALUE 0x5CDE2 SD_UWORD 0 SC_PIDMAP_3 0 65535 /end CHARACTERISTIC
/begin COMPU_METHOD SC_PIDMAP_3 "PIDMAP_3 conversion" RAT_FUNC "%5.0" "UNITLESS" COEFFS 0 1 0 0 0 1 /end COMPU_METHOD
/begin CHARACTERISTIC PIDMAP_4 "J1979 map of supported PIDs for mode 01, PIDs 17-20" VALUE 0x5CDE0 SD_UWORD 0 SC_PIDMAP_4 0 65535 /end CHARACTERISTIC
/begin COMPU_METHOD SC_PIDMAP_4 "PIDMAP_4 conversion" RAT_FUNC "%5.0" "UNITLESS" COEFFS 0 1 0 0 0 1 /end COMPU_METHOD
/begin MEASUREMENT PID_10020_D "Data for J1979 Mode $01 PID $20" ULONG MC_PID_10020_D 0 0 0 0 ECU_ADDRESS 0x3F9E7C /end MEASUREMENT
/begin COMPU_METHOD MC_PID_10020_D "PID_10020_D conversion" RAT_FUNC "%10.0" "Unitless" COEFFS 0 1 0 0 0 1 /end COMPU_METHOD
/begin MEASUREMENT PID_2000A_D "J1979 Mode$02 PID number ^0A, Fuel pressure as indicated by the fuel pressure sensor at the time the freeze frame data was collecte" UBYTE MC_PID_2000A_D 0 0 0 0 ECU_ADDRESS 0x3F9CC8 /end MEASUREMENT
/begin COMPU_METHOD MC_PID_2000A_D "PID_2000A_D conversion" RAT_FUNC "%3.0" "Unitless" COEFFS 0 1 0 0 0 1 /end COMPU_METHOD
/begin CHARACTERISTIC PID_30921_D "This is a J2190 PID assignment for ^0921, it contains the address of alc_strt_kam. (4 byte address)" VALUE 0x5CB18 SD_UWORD 0 SC_PID_30921_D 0 -256 /end CHARACTERISTIC
/begin COMPU_METHOD SC_PID_30921_D "PID_30921_D conversion" RAT_FUNC "%5.0" "pointer" COEFFS 0 1 0 0 0 1 /end COMPU_METHOD
/begin CHARACTERISTIC PID_30922_D "Starting address of adaptive fuel table 1" VALUE 0x5CB10 SD_ULONG 0 SC_PID_30922_D 0 1e+09 /end CHARACTERISTIC
/begin COMPU_METHOD SC_PID_30922_D "PID_30922_D conversion" RAT_FUNC "%10.0" "unitless" COEFFS 0 1 0 0 0 1 /end COMPU_METHOD
/begin MEASUREMENT PID_30923_D "PID parameter loaded with cell ct, row ct and idle cell switch info on ADPT table 1" UWORD MC_PID_30923_D 0 0 0 0 ECU_ADDRESS 0x3F9CB4 /end MEASUREMENT
/begin COMPU_METHOD MC_PID_30923_D "PID_30923_D conversion" RAT_FUNC "%5.0" "Unitless" COEFFS 0 1 0 0 0 1 /end COMPU_METHOD
/begin CHARACTERISTIC PID_30924_D "Starting Address of Adaptive Fuel Table Bank 2" VALUE 0x5CB0C SD_ULONG 0 SC_PID_30924_D 0 1e+09 /end CHARACTERISTIC
/begin COMPU_METHOD SC_PID_30924_D "PID_30924_D conversion" RAT_FUNC "%10.0" "unitless" COEFFS 0 1 0 0 0 1 /end COMPU_METHOD
/begin MEASUREMENT PID_30925_D "PID Parameter loaded with cell ct, row ct and idle cell switch info for ADPT table 2" UWORD MC_PID_30925_D 0 0 0 0 ECU_ADDRESS 0x3F9CB2 /end MEASUREMENT
/begin COMPU_METHOD MC_PID_30925_D "PID_30925_D conversion" RAT_FUNC "%5.0" "Unitless" COEFFS 0 1 0 0 0 1 /end COMPU_METHOD
/begin MEASUREMENT PID_30944_D "Address of start of PCM generated vehicle speed VID block ranges." ULONG MC_PID_30944_D 0 0 0 0 ECU_ADDRESS 0x3F9AF4 /end MEASUREMENT
/begin COMPU_METHOD MC_PID_30944_D "PID_30944_D conversion" RAT_FUNC "%10.0" "Unitless" COEFFS 0 1 0 0 0 1 /end COMPU_METHOD
/begin MEASUREMENT PID_31100_D "4 bytes of data for double word SCP J2190 PID number 1100. Contains location (3 bytes)  and format (1 byte)  of Software ID block." ULONG MC_PID_31100_D 0 0 0 0 ECU_ADDRESS 0x3FB3FC /end MEASUREMENT
/begin COMPU_METHOD MC_PID_31100_D "PID_31100_D conversion" RAT_FUNC "%10.0" "Unitless" COEFFS 0 1 0 0 0 1 /end COMPU_METHOD
/begin MEASUREMENT PID_316FC_D "Freeze Frame value of  VBATT." FLOAT32_IEEE MC_PID_316FC_D 0 0 0 0 ECU_ADDRESS 0x3FCCB4 /end MEASUREMENT
/begin COMPU_METHOD MC_PID_316FC_D "PID_316FC_D conversion" RAT_FUNC "%10.5" "Unitless" COEFFS 0 1 0 0 0 1 /end COMPU_METHOD
/begin MEASUREMENT PID_3C115_D "Data for single byte SCP J2190 PID number C115, Security Access Status for  PATS (Passive Anti-Theft System)." UBYTE MC_PID_3C115_D 0 0 0 0 ECU_ADDRESS 0x3F9DF0 /end MEASUREMENT
/begin COMPU_METHOD MC_PID_3C115_D "PID_3C115_D conversion" RAT_FUNC "%3.0" "Unitless" COEFFS 0 1 0 0 0 1 /end COMPU_METHOD
/begin MEASUREMENT PID_3C116_D "4 bytes of data for double word SCP J2190 PID number C116, Request Outcode for PATS (Passive Anti-Theft System)." ULONG MC_PID_3C116_D 0 0 0 0 ECU_ADDRESS 0x3F9DE0 /end MEASUREMENT
/begin COMPU_METHOD MC_PID_3C116_D "PID_3C116_D conversion" RAT_FUNC "%10.0" "Unitless" COEFFS 0 1 0 0 0 1 /end COMPU_METHOD
/begin MEASUREMENT PID_3C117_D "4 bytes of data for double word SCP J2190 PID number C117, Parameter Status for PATS (Passive Anti-Theft System)." ULONG MC_PID_3C117_D 0 0 0 0 ECU_ADDRESS 0x3F9DDC /end MEASUREMENT
/begin COMPU_METHOD MC_PID_3C117_D "PID_3C117_D conversion" RAT_FUNC "%10.0" "Unitless" COEFFS 0 1 0 0 0 1 /end COMPU_METHOD
/begin MEASUREMENT PID_3C124_D "Data for single byte SCP J2190 PID number C124, Passive Anti-Theft System (PATS) Status." UBYTE MC_PID_3C124_D 0 0 0 0 ECU_ADDRESS 0x3F9DEF /end MEASUREMENT
/begin COMPU_METHOD MC_PID_3C124_D "PID_3C124_D conversion" RAT_FUNC "%3.0" "Unitless" COEFFS 0 1 0 0 0 1 /end COMPU_METHOD
/begin MEASUREMENT PID_3D100_D "Data for SCP J2190 PID number D100 ECU Operating States (State Encoded. The description of PID D100 is controlled by EESE.)" UBYTE MC_PID_3D100_D 0 0 0 0 ECU_ADDRESS 0x3FB4B0 /end MEASUREMENT
/begin COMPU_METHOD MC_PID_3D100_D "PID_3D100_D conversion" RAT_FUNC "%3.0" "Unitless" COEFFS 0 1 0 0 0 1 /end COMPU_METHOD
/begin MEASUREMENT PID_SYNC_CTR "Sequence counter incremented every PIP falling edge, used to indentify the cycle and position." UBYTE MC_PID_SYNC_CTR 0 0 0 0 ECU_ADDRESS 0x3F9AC4 /end MEASUREMENT
/begin COMPU_METHOD MC_PID_SYNC_CTR "PID_SYNC_CTR conversion" RAT_FUNC "%3.0" "Unitless" COEFFS 0 1 0 0 0 1 /end COMPU_METHOD
/begin CHARACTERISTIC PILOT_CLOSE "" VALUE 0x5D43C SD_FLOAT32_IEEE 0 SC_PILOT_CLOSE 0 65535 /end CHARACTERISTIC
/begin COMPU_METHOD SC_PILOT_CLOSE "PILOT_CLOSE conversion" RAT_FUNC "%10.5" "unitless" COEFFS 0 1 0 0 0 1 /end COMPU_METHOD
/begin CHARACTERISTIC PILOT_DURATION "" VALUE 0x5D440 SD_FLOAT32_IEEE 0 SC_PILOT_DURATION 0 65535 /end CHARACTERISTIC
/begin COMPU_METHOD SC_PILOT_DURATION "PILOT_DURATION conversion" RAT_FUNC "%10.5" "unitless" COEFFS 0 1 0 0 0 1 /end COMPU_METHOD
/begin CHARACTERISTIC PILOT_OPEN "" VALUE 0x5D444 SD_FLOAT32_IEEE 0 SC_PILOT_OPEN 0 65535 /end CHARACTERISTIC
/begin COMPU_METHOD SC_PILOT_OPEN "PILOT_OPEN conversion" RAT_FUNC "%10.5" "unitless" COEFFS 0 1 0 0 0 1 /end COMPU_METHOD
/begin CHARACTERISTIC PIPERR "PIP ERROR LEVEL TO SET PIP FAULT UNITLESS RATIO OF CLOCK TICKS" VALUE 0x5ECC0 SD_FLOAT32_IEEE 0 SC_PIPERR 0 0.99 /end CHARACTERISTIC
/begin COMPU_METHOD SC_PIPERR "PIPERR conversion" RAT_FUNC "%10.5" "EVENTS" COEFFS 0 1 0 0 0 1 /end COMPU_METHOD
/begin CHARACTERISTIC PIPLVLEXP "PIP failure fault filter threshold for export use" VALUE 0x5ECFF SD_UBYTE 0 SC_PIPLVLEXP 0 255 /end CHARACTERISTIC
/begin COMPU_METHOD SC_PIPLVLEXP "PIPLVLEXP conversion" RAT_FUNC "%3.0" "COUNTS" COEFFS 0 1 0 0 0 1 /end COMPU_METHOD
/begin MEASUREMENT PIPTSTFIL "PIP circuit failure fault filter" UBYTE MC_PIPTSTFIL 0 0 0 0 ECU_ADDRESS 0x3FB295 /end MEASUREMENT
/begin COMPU_METHOD MC_PIPTSTFIL "PIPTSTFIL conversion" RAT_FUNC "%3.0" "Unitless" COEFFS 0 1 0 0 0 1 /end COMPU_METHOD
/begin CHARACTERISTIC PIPTSTLVL1 "PIP failure fault filter threshold" VALUE 0x5ECFB SD_UBYTE 0 SC_PIPTSTLVL1 0 255 /end CHARACTERISTIC
/begin COMPU_METHOD SC_PIPTSTLVL1 "PIPTSTLVL1 conversion" RAT_FUNC "%3.0" "COUNTS" COEFFS 0 1 0 0 0 1 /end COMPU_METHOD
/begin CHARACTERISTIC PIPTSTLVL2 "PIP failure fault filter threshold" VALUE 0x5ECFA SD_UBYTE 0 SC_PIPTSTLVL2 0 255 /end CHARACTERISTIC
/begin COMPU_METHOD SC_PIPTSTLVL2 "PIPTSTLVL2 conversion" RAT_FUNC "%3.0" "COUNTS" COEFFS 0 1 0 0 0 1 /end COMPU_METHOD
/begin CHARACTERISTIC PIPUP1 "intermittent pip fault filter increment crank" VALUE 0x5ECF3 SD_UBYTE 0 SC_PIPUP1 0 255 /end CHARACTERISTIC
/begin COMPU_METHOD SC_PIPUP1 "PIPUP1 conversion" RAT_FUNC "%3.0" "unitless" COEFFS 0 1 0 0 0 1 /end COMPU_METHOD
/begin CHARACTERISTIC PIPUP2 "intermittent pip fault filter increment run" VALUE 0x5ECF2 SD_UBYTE 0 SC_PIPUP2 0 255 /end CHARACTERISTIC
/begin COMPU_METHOD SC_PIPUP2 "PIPUP2 conversion" RAT_FUNC "%3.0" "unitless" COEFFS 0 1 0 0 0 1 /end COMPU_METHOD
/begin MEASUREMENT PIP_EVNT_CTR "Incremented every PIP event.  It is reset to zero if DFSO mode is off." UWORD MC_PIP_EVNT_CTR 0 0 0 0 ECU_ADDRESS 0x3FB334 /end MEASUREMENT
/begin COMPU_METHOD MC_PIP_EVNT_CTR "PIP_EVNT_CTR conversion" RAT_FUNC "%5.0" "Unitless" COEFFS 0 1 0 0 0 1 /end COMPU_METHOD
/begin CHARACTERISTIC PIP_EVNT_MAX "When in DFSO, number of PIP events to wait before learning CFs" VALUE 0x5EF00 SD_UWORD 0 SC_PIP_EVNT_MAX 0 65535 /end CHARACTERISTIC
/begin COMPU_METHOD SC_PIP_EVNT_MAX "PIP_EVNT_MAX conversion" RAT_FUNC "%5.0" "EVENTS" COEFFS 0 1 0 0 0 1 /end COMPU_METHOD
/begin MEASUREMENT PIP_HIGH "PIP INPUT LEVEL" UBYTE MC_PIP_HIGH 0 0 0 0 ECU_ADDRESS 0x3F9CE9 /end MEASUREMENT
/begin COMPU_METHOD MC_PIP_HIGH "PIP_HIGH conversion" RAT_FUNC "%3.0" "Unitless" COEFFS 0 1 0 0 0 1 /end COMPU_METHOD
/begin MEASUREMENT PIP_HIGH_TIME "last PIP period time seen when PIP is HIGH" FLOAT32_IEEE MC_PIP_HIGH_TIME 0 0 0 0 ECU_ADDRESS 0x3F9AB8 /end MEASUREMENT
/begin COMPU_METHOD MC_PIP_HIGH_TIME "PIP_HIGH_TIME conversion" RAT_FUNC "%10.5" "Unitless" COEFFS 0 1 0 0 0 1 /end COMPU_METHOD
/begin MEASUREMENT PLFMFLG_A[0] "ARRAY OF PEDAL POSITION  LOW FAILURE FLAGS" UBYTE MC_PLFMFLG_A 0 0 0 1 ECU_ADDRESS 0x3FA316 /end MEASUREMENT
/begin COMPU_METHOD MC_PLFMFLG_A "PLFMFLG_A conversion" RAT_FUNC "%3.0" "Unitless" COEFFS 0 1 0 0 0 1 /end COMPU_METHOD
/begin MEASUREMENT PLFMFLG_A[1] "ARRAY OF PEDAL POSITION  LOW FAILURE FLAGS" UBYTE MC_PLFMFLG_A 0 0 0 1 ECU_ADDRESS 0x3FA317 /end MEASUREMENT
/begin MEASUREMENT PLFMFLG_A[2] "ARRAY OF PEDAL POSITION  LOW FAILURE FLAGS" UBYTE MC_PLFMFLG_A 0 0 0 1 ECU_ADDRESS 0x3FA318 /end MEASUREMENT
/begin MEASUREMENT PLFM_CNT_A[0] "COUNTER OF PEDAL POSITION LOW FAILURES" UBYTE MC_PLFM_CNT_A 0 0 0 255 ECU_ADDRESS 0x3FA313 /end MEASUREMENT
/begin COMPU_METHOD MC_PLFM_CNT_A "PLFM_CNT_A conversion" RAT_FUNC "%3.0" "Unitless" COEFFS 0 1 0 0 0 1 /end COMPU_METHOD
/begin MEASUREMENT PLFM_CNT_A[1] "COUNTER OF PEDAL POSITION LOW FAILURES" UBYTE MC_PLFM_CNT_A 0 0 0 255 ECU_ADDRESS 0x3FA314 /end MEASUREMENT
/begin MEASUREMENT PLFM_CNT_A[2] "COUNTER OF PEDAL POSITION LOW FAILURES" UBYTE MC_PLFM_CNT_A 0 0 0 255 ECU_ADDRESS 0x3FA315 /end MEASUREMENT
/begin CHARACTERISTIC PLFM_INC "VARIABLE  TO INCREMENT THE  PEDAL LOW FAILURE COUNTER BY" VALUE 0x5D528 SD_UBYTE 0 SC_PLFM_INC 8 255 /end CHARACTERISTIC
/begin COMPU_METHOD SC_PLFM_INC "PLFM_INC conversion" RAT_FUNC "%3.0" "Unitless" COEFFS 0 1 0 0 0 1 /end COMPU_METHOD
/begin CHARACTERISTIC PLFM_LVL "NUMBER OF PEDAL LOW FAILURE COUNTS FOR FLAG TO SET" VALUE 0x5D527 SD_UBYTE 0 SC_PLFM_LVL 0 254 /end CHARACTERISTIC
/begin COMPU_METHOD SC_PLFM_LVL "PLFM_LVL conversion" RAT_FUNC "%3.0" "Unitless" COEFFS 0 1 0 0 0 1 /end COMPU_METHOD
/begin CHARACTERISTIC PNPM_INC "VARIABLE  TO INCREMENT THE  PEDAL COMPARE FAILURE COUNTER BY" VALUE 0x5D526 SD_UBYTE 0 SC_PNPM_INC 0 255 /end CHARACTERISTIC
/begin COMPU_METHOD SC_PNPM_INC "PNPM_INC conversion" RAT_FUNC "%3.0" "Unitless" COEFFS 0 1 0 0 0 1 /end COMPU_METHOD
/begin CHARACTERISTIC PNPM_LVL "NUMBER OF PEDAL COMPARE FAILURE COUNTS FOR FLAG TO SET" VALUE 0x5D525 SD_UBYTE 0 SC_PNPM_LVL 1 254 /end CHARACTERISTIC
/begin COMPU_METHOD SC_PNPM_LVL "PNPM_LVL conversion" RAT_FUNC "%3.0" "Unitless" COEFFS 0 1 0 0 0 1 /end COMPU_METHOD
/begin MEASUREMENT POKE_CNT "Number of poke attempts to ram" UBYTE MC_POKE_CNT 0 0 0 0 ECU_ADDRESS 0x3FB5F8 /end MEASUREMENT
/begin COMPU_METHOD MC_POKE_CNT "POKE_CNT conversion" RAT_FUNC "%3.0" "Unitless" COEFFS 0 1 0 0 0 1 /end COMPU_METHOD
/begin CHARACTERISTIC POKE_ENA "RAM poke enable flag for PTEC" VALUE 0x5F29B SD_UBYTE 0 SC_POKE_ENA 0 1 /end CHARACTERISTIC
/begin COMPU_METHOD SC_POKE_ENA "POKE_ENA conversion" RAT_FUNC "%3.0" "Unitless" COEFFS 0 1 0 0 0 1 /end COMPU_METHOD
/begin CHARACTERISTIC POKE_F "Floating point value to poke for PTEC RAM" VALUE 0x5F294 SD_FLOAT32_IEEE 0 SC_POKE_F -32000 64000 /end CHARACTERISTIC
/begin COMPU_METHOD SC_POKE_F "POKE_F conversion" RAT_FUNC "%10.5" "Unitless" COEFFS 0 1 0 0 0 1 /end COMPU_METHOD
/begin CHARACTERISTIC POKE_I "Interger value to poke for PTEC RAM" VALUE 0x5F290 SD_SLONG 0 SC_POKE_I -2.14748e+09 2.14748e+09 /end CHARACTERISTIC
/begin COMPU_METHOD SC_POKE_I "POKE_I conversion" RAT_FUNC "%10.0" "Unitless" COEFFS 0 1 0 0 0 1 /end COMPU_METHOD
/begin CHARACTERISTIC POKE_OFF "Offset into RAM for parpoke" VALUE 0x5F298 SD_UWORD 0 SC_POKE_OFF 0 28671 /end CHARACTERISTIC
/begin COMPU_METHOD SC_POKE_OFF "POKE_OFF conversion" RAT_FUNC "%5.0" "Unitless" COEFFS 0 1 0 0 0 1 /end COMPU_METHOD
/begin MEASUREMENT POKE_STATUS "Status of last RAM poke; 0= success, 1= bad address, 2=bad type, 3=bad alignment, 4=Illegal float value" UBYTE MC_POKE_STATUS 0 0 0 0 ECU_ADDRESS 0x3FB5F9 /end MEASUREMENT
/begin COMPU_METHOD MC_POKE_STATUS "POKE_STATUS conversion" RAT_FUNC "%3.0" "Unitless" COEFFS 0 1 0 0 0 1 /end COMPU_METHOD
/begin CHARACTERISTIC POKE_TYPE "Type of ram to be poked; 0=float,1=int byte, 2= int hword, 4 = int word" VALUE 0x5F29A SD_UBYTE 0 SC_POKE_TYPE 0 4 /end CHARACTERISTIC
/begin COMPU_METHOD SC_POKE_TYPE "POKE_TYPE conversion" RAT_FUNC "%3.0" "Unitless" COEFFS 0 1 0 0 0 1 /end COMPU_METHOD
/begin MEASUREMENT POST2_CNCLD "" UBYTE MC_POST2_CNCLD 0 0 0 0 ECU_ADDRESS 0x3FB6B5 /end MEASUREMENT
/begin COMPU_METHOD MC_POST2_CNCLD "POST2_CNCLD conversion" RAT_FUNC "%3.0" "Unitless" COEFFS 0 1 0 0 0 1 /end COMPU_METHOD
/begin MEASUREMENT POTN_FAIL "Array of 32 bits, which buffer misfire detections for up to 32 PIP events to allow noise filtering" ULONG MC_POTN_FAIL 0 0 0 0 ECU_ADDRESS 0x3FB348 /end MEASUREMENT
/begin COMPU_METHOD MC_POTN_FAIL "POTN_FAIL conversion" RAT_FUNC "%10.0" "Unitless" COEFFS 0 1 0 0 0 1 /end COMPU_METHOD
/begin MEASUREMENT POTN_FL_MSK "Bit mask which sets the most significant bit in the potn array if a misfire is detected" ULONG MC_POTN_FL_MSK 0 0 0 0 ECU_ADDRESS 0x3FB34C /end MEASUREMENT
/begin COMPU_METHOD MC_POTN_FL_MSK "POTN_FL_MSK conversion" RAT_FUNC "%10.0" "Unitless" COEFFS 0 1 0 0 0 1 /end COMPU_METHOD
/begin MEASUREMENT POTN_HFAIL "Array of 32 bits which buffers non-pc misfire detections to up to 32 PIPs to stay aligned with pc channel" ULONG MC_POTN_HFAIL 0 0 0 0 ECU_ADDRESS 0x3FB344 /end MEASUREMENT
/begin COMPU_METHOD MC_POTN_HFAIL "POTN_HFAIL conversion" RAT_FUNC "%10.0" "Unitless" COEFFS 0 1 0 0 0 1 /end COMPU_METHOD
/begin CHARACTERISTIC PP23_SCDELT "DIFFERENCE THRESHOLD BETWEEN ipps2-3 COMPARISONS FOR short circuit" VALUE 0x5D4FC SD_FLOAT32_IEEE 0 SC_PP23_SCDELT 0 1023 /end CHARACTERISTIC
/begin COMPU_METHOD SC_PP23_SCDELT "PP23_SCDELT conversion" RAT_FUNC "%10.5" "unitless" COEFFS 0 1 0 0 0 1 /end COMPU_METHOD
/begin CHARACTERISTIC PPC_CALINFO[0] "" VALUE 0x101E0 SD_UBYTE 0 SC_PPC_CALINFO 0 255 /end CHARACTERISTIC
/begin COMPU_METHOD SC_PPC_CALINFO "PPC_CALINFO conversion" RAT_FUNC "%3.0" "unitless" COEFFS 0 1 0 0 0 1 /end COMPU_METHOD
/begin CHARACTERISTIC PPC_CALINFO[10] "" VALUE 0x101EA SD_UBYTE 0 SC_PPC_CALINFO 0 255 /end CHARACTERISTIC
/begin CHARACTERISTIC PPC_CALINFO[11] "" VALUE 0x101EB SD_UBYTE 0 SC_PPC_CALINFO 0 255 /end CHARACTERISTIC
/begin CHARACTERISTIC PPC_CALINFO[12] "" VALUE 0x101EC SD_UBYTE 0 SC_PPC_CALINFO 0 255 /end CHARACTERISTIC
/begin CHARACTERISTIC PPC_CALINFO[13] "" VALUE 0x101ED SD_UBYTE 0 SC_PPC_CALINFO 0 255 /end CHARACTERISTIC
/begin CHARACTERISTIC PPC_CALINFO[14] "" VALUE 0x101EE SD_UBYTE 0 SC_PPC_CALINFO 0 255 /end CHARACTERISTIC
/begin CHARACTERISTIC PPC_CALINFO[15] "" VALUE 0x101EF SD_UBYTE 0 SC_PPC_CALINFO 0 255 /end CHARACTERISTIC
/begin CHARACTERISTIC PPC_CALINFO[16] "" VALUE 0x101F0 SD_UBYTE 0 SC_PPC_CALINFO 0 255 /end CHARACTERISTIC
/begin CHARACTERISTIC PPC_CALINFO[17] "" VALUE 0x101F1 SD_UBYTE 0 SC_PPC_CALINFO 0 255 /end CHARACTERISTIC
/begin CHARACTERISTIC PPC_CALINFO[18] "" VALUE 0x101F2 SD_UBYTE 0 SC_PPC_CALINFO 0 255 /end CHARACTERISTIC
/begin CHARACTERISTIC PPC_CALINFO[19] "" VALUE 0x101F3 SD_UBYTE 0 SC_PPC_CALINFO 0 255 /end CHARACTERISTIC
/begin CHARACTERISTIC PPC_CALINFO[1] "" VALUE 0x101E1 SD_UBYTE 0 SC_PPC_CALINFO 0 255 /end CHARACTERISTIC
/begin CHARACTERISTIC PPC_CALINFO[20] "" VALUE 0x101F4 SD_UBYTE 0 SC_PPC_CALINFO 0 255 /end CHARACTERISTIC
/begin CHARACTERISTIC PPC_CALINFO[21] "" VALUE 0x101F5 SD_UBYTE 0 SC_PPC_CALINFO 0 255 /end CHARACTERISTIC
/begin CHARACTERISTIC PPC_CALINFO[22] "" VALUE 0x101F6 SD_UBYTE 0 SC_PPC_CALINFO 0 255 /end CHARACTERISTIC
/begin CHARACTERISTIC PPC_CALINFO[23] "" VALUE 0x101F7 SD_UBYTE 0 SC_PPC_CALINFO 0 255 /end CHARACTERISTIC
/begin CHARACTERISTIC PPC_CALINFO[24] "" VALUE 0x101F8 SD_UBYTE 0 SC_PPC_CALINFO 0 255 /end CHARACTERISTIC
/begin CHARACTERISTIC PPC_CALINFO[25] "" VALUE 0x101F9 SD_UBYTE 0 SC_PPC_CALINFO 0 255 /end CHARACTERISTIC
/begin CHARACTERISTIC PPC_CALINFO[26] "" VALUE 0x101FA SD_UBYTE 0 SC_PPC_CALINFO 0 255 /end CHARACTERISTIC
/begin CHARACTERISTIC PPC_CALINFO[27] "" VALUE 0x101FB SD_UBYTE 0 SC_PPC_CALINFO 0 255 /end CHARACTERISTIC
/begin CHARACTERISTIC PPC_CALINFO[28] "" VALUE 0x101FC SD_UBYTE 0 SC_PPC_CALINFO 0 255 /end CHARACTERISTIC
/begin CHARACTERISTIC PPC_CALINFO[29] "" VALUE 0x101FD SD_UBYTE 0 SC_PPC_CALINFO 0 255 /end CHARACTERISTIC
/begin CHARACTERISTIC PPC_CALINFO[2] "" VALUE 0x101E2 SD_UBYTE 0 SC_PPC_CALINFO 0 255 /end CHARACTERISTIC
/begin CHARACTERISTIC PPC_CALINFO[30] "" VALUE 0x101FE SD_UBYTE 0 SC_PPC_CALINFO 0 255 /end CHARACTERISTIC
/begin CHARACTERISTIC PPC_CALINFO[31] "" VALUE 0x101FF SD_UBYTE 0 SC_PPC_CALINFO 0 255 /end CHARACTERISTIC
/begin CHARACTERISTIC PPC_CALINFO[32] "" VALUE 0x10200 SD_UBYTE 0 SC_PPC_CALINFO 0 255 /end CHARACTERISTIC
/begin CHARACTERISTIC PPC_CALINFO[33] "" VALUE 0x10201 SD_UBYTE 0 SC_PPC_CALINFO 0 255 /end CHARACTERISTIC
/begin CHARACTERISTIC PPC_CALINFO[34] "" VALUE 0x10202 SD_UBYTE 0 SC_PPC_CALINFO 0 255 /end CHARACTERISTIC
/begin CHARACTERISTIC PPC_CALINFO[35] "" VALUE 0x10203 SD_UBYTE 0 SC_PPC_CALINFO 0 255 /end CHARACTERISTIC
/begin CHARACTERISTIC PPC_CALINFO[36] "" VALUE 0x10204 SD_UBYTE 0 SC_PPC_CALINFO 0 255 /end CHARACTERISTIC
/begin CHARACTERISTIC PPC_CALINFO[37] "" VALUE 0x10205 SD_UBYTE 0 SC_PPC_CALINFO 0 255 /end CHARACTERISTIC
/begin CHARACTERISTIC PPC_CALINFO[38] "" VALUE 0x10206 SD_UBYTE 0 SC_PPC_CALINFO 0 255 /end CHARACTERISTIC
/begin CHARACTERISTIC PPC_CALINFO[39] "" VALUE 0x10207 SD_UBYTE 0 SC_PPC_CALINFO 0 255 /end CHARACTERISTIC
/begin CHARACTERISTIC PPC_CALINFO[3] "" VALUE 0x101E3 SD_UBYTE 0 SC_PPC_CALINFO 0 255 /end CHARACTERISTIC
/begin CHARACTERISTIC PPC_CALINFO[40] "" VALUE 0x10208 SD_UBYTE 0 SC_PPC_CALINFO 0 255 /end CHARACTERISTIC
/begin CHARACTERISTIC PPC_CALINFO[41] "" VALUE 0x10209 SD_UBYTE 0 SC_PPC_CALINFO 0 255 /end CHARACTERISTIC
/begin CHARACTERISTIC PPC_CALINFO[42] "" VALUE 0x1020A SD_UBYTE 0 SC_PPC_CALINFO 0 255 /end CHARACTERISTIC
/begin CHARACTERISTIC PPC_CALINFO[43] "" VALUE 0x1020B SD_UBYTE 0 SC_PPC_CALINFO 0 255 /end CHARACTERISTIC
/begin CHARACTERISTIC PPC_CALINFO[44] "" VALUE 0x1020C SD_UBYTE 0 SC_PPC_CALINFO 0 255 /end CHARACTERISTIC
/begin CHARACTERISTIC PPC_CALINFO[45] "" VALUE 0x1020D SD_UBYTE 0 SC_PPC_CALINFO 0 255 /end CHARACTERISTIC
/begin CHARACTERISTIC PPC_CALINFO[46] "" VALUE 0x1020E SD_UBYTE 0 SC_PPC_CALINFO 0 255 /end CHARACTERISTIC
/begin CHARACTERISTIC PPC_CALINFO[47] "" VALUE 0x1020F SD_UBYTE 0 SC_PPC_CALINFO 0 255 /end CHARACTERISTIC
/begin CHARACTERISTIC PPC_CALINFO[48] "" VALUE 0x10210 SD_UBYTE 0 SC_PPC_CALINFO 0 255 /end CHARACTERISTIC
/begin CHARACTERISTIC PPC_CALINFO[49] "" VALUE 0x10211 SD_UBYTE 0 SC_PPC_CALINFO 0 255 /end CHARACTERISTIC
/begin CHARACTERISTIC PPC_CALINFO[4] "" VALUE 0x101E4 SD_UBYTE 0 SC_PPC_CALINFO 0 255 /end CHARACTERISTIC
/begin CHARACTERISTIC PPC_CALINFO[50] "" VALUE 0x10212 SD_UBYTE 0 SC_PPC_CALINFO 0 255 /end CHARACTERISTIC
/begin CHARACTERISTIC PPC_CALINFO[51] "" VALUE 0x10213 SD_UBYTE 0 SC_PPC_CALINFO 0 255 /end CHARACTERISTIC
/begin CHARACTERISTIC PPC_CALINFO[52] "" VALUE 0x10214 SD_UBYTE 0 SC_PPC_CALINFO 0 255 /end CHARACTERISTIC
/begin CHARACTERISTIC PPC_CALINFO[53] "" VALUE 0x10215 SD_UBYTE 0 SC_PPC_CALINFO 0 255 /end CHARACTERISTIC
/begin CHARACTERISTIC PPC_CALINFO[54] "" VALUE 0x10216 SD_UBYTE 0 SC_PPC_CALINFO 0 255 /end CHARACTERISTIC
/begin CHARACTERISTIC PPC_CALINFO[55] "" VALUE 0x10217 SD_UBYTE 0 SC_PPC_CALINFO 0 255 /end CHARACTERISTIC
/begin CHARACTERISTIC PPC_CALINFO[56] "" VALUE 0x10218 SD_UBYTE 0 SC_PPC_CALINFO 0 255 /end CHARACTERISTIC
/begin CHARACTERISTIC PPC_CALINFO[57] "" VALUE 0x10219 SD_UBYTE 0 SC_PPC_CALINFO 0 255 /end CHARACTERISTIC
/begin CHARACTERISTIC PPC_CALINFO[58] "" VALUE 0x1021A SD_UBYTE 0 SC_PPC_CALINFO 0 255 /end CHARACTERISTIC
/begin CHARACTERISTIC PPC_CALINFO[59] "" VALUE 0x1021B SD_UBYTE 0 SC_PPC_CALINFO 0 255 /end CHARACTERISTIC
/begin CHARACTERISTIC PPC_CALINFO[5] "" VALUE 0x101E5 SD_UBYTE 0 SC_PPC_CALINFO 0 255 /end CHARACTERISTIC
/begin CHARACTERISTIC PPC_CALINFO[6] "" VALUE 0x101E6 SD_UBYTE 0 SC_PPC_CALINFO 0 255 /end CHARACTERISTIC
/begin CHARACTERISTIC PPC_CALINFO[7] "" VALUE 0x101E7 SD_UBYTE 0 SC_PPC_CALINFO 0 255 /end CHARACTERISTIC
/begin CHARACTERISTIC PPC_CALINFO[8] "" VALUE 0x101E8 SD_UBYTE 0 SC_PPC_CALINFO 0 255 /end CHARACTERISTIC
/begin CHARACTERISTIC PPC_CALINFO[9] "" VALUE 0x101E9 SD_UBYTE 0 SC_PPC_CALINFO 0 255 /end CHARACTERISTIC
/begin CHARACTERISTIC PPC_CAL_END1 "End addr of 1st Strategy Cal ROM Type region" VALUE 0x5F380 SD_ULONG 0 SC_PPC_CAL_END1 0 1e+07 /end CHARACTERISTIC
/begin COMPU_METHOD SC_PPC_CAL_END1 "PPC_CAL_END1 conversion" RAT_FUNC "%10.0" "unitless" COEFFS 0 1 0 0 0 1 /end COMPU_METHOD
/begin CHARACTERISTIC PPC_CAL_START1 "Start addr of 1st Strategy Cal ROM Type region" VALUE 0x5F384 SD_ULONG 0 SC_PPC_CAL_START1 0 1e+07 /end CHARACTERISTIC
/begin COMPU_METHOD SC_PPC_CAL_START1 "PPC_CAL_START1 conversion" RAT_FUNC "%10.0" "unitless" COEFFS 0 1 0 0 0 1 /end COMPU_METHOD
/begin CHARACTERISTIC PPC_CHECKSUM "ROM Checksum for PPC Applications" VALUE 0x10220 SD_UWORD 0 SC_PPC_CHECKSUM 0 65535 /end CHARACTERISTIC
/begin COMPU_METHOD SC_PPC_CHECKSUM "PPC_CHECKSUM conversion" RAT_FUNC "%5.0" "unitless" COEFFS 0 1 0 0 0 1 /end COMPU_METHOD
/begin CHARACTERISTIC PPC_CHIPID "Chip ID" VALUE 0x10222 SD_UWORD 0 SC_PPC_CHIPID 0 65535 /end CHARACTERISTIC
/begin COMPU_METHOD SC_PPC_CHIPID "PPC_CHIPID conversion" RAT_FUNC "%5.0" "unitless" COEFFS 0 1 0 0 0 1 /end COMPU_METHOD
/begin CHARACTERISTIC PPC_KAM_END1 "End addr of 1st KAM Type region" VALUE 0x5F390 SD_ULONG 0 SC_PPC_KAM_END1 0 1e+07 /end CHARACTERISTIC
/begin COMPU_METHOD SC_PPC_KAM_END1 "PPC_KAM_END1 conversion" RAT_FUNC "%10.0" "unitless" COEFFS 0 1 0 0 0 1 /end COMPU_METHOD
/begin CHARACTERISTIC PPC_KAM_END2 "End addr of 2nd KAM Type region" VALUE 0x5F388 SD_ULONG 0 SC_PPC_KAM_END2 0 1e+07 /end CHARACTERISTIC
/begin COMPU_METHOD SC_PPC_KAM_END2 "PPC_KAM_END2 conversion" RAT_FUNC "%10.0" "unitless" COEFFS 0 1 0 0 0 1 /end COMPU_METHOD
/begin CHARACTERISTIC PPC_KAM_START1 "Start addr of 1st KAM Type region" VALUE 0x5F394 SD_ULONG 0 SC_PPC_KAM_START1 0 1e+07 /end CHARACTERISTIC
/begin COMPU_METHOD SC_PPC_KAM_START1 "PPC_KAM_START1 conversion" RAT_FUNC "%10.0" "unitless" COEFFS 0 1 0 0 0 1 /end COMPU_METHOD
/begin CHARACTERISTIC PPC_KAM_START2 "Start addr of 2nd KAM Type region" VALUE 0x5F38C SD_ULONG 0 SC_PPC_KAM_START2 0 1e+07 /end CHARACTERISTIC
/begin COMPU_METHOD SC_PPC_KAM_START2 "PPC_KAM_START2 conversion" RAT_FUNC "%10.0" "unitless" COEFFS 0 1 0 0 0 1 /end COMPU_METHOD
/begin CHARACTERISTIC PPC_RAM_END1 "End addr of 1st Strategy RAM Type region" VALUE 0x5F398 SD_ULONG 0 SC_PPC_RAM_END1 0 1e+07 /end CHARACTERISTIC
/begin COMPU_METHOD SC_PPC_RAM_END1 "PPC_RAM_END1 conversion" RAT_FUNC "%10.0" "unitless" COEFFS 0 1 0 0 0 1 /end COMPU_METHOD
/begin CHARACTERISTIC PPC_RAM_START1 "Start addr of 1st Strategy RAM Type region" VALUE 0x5F39C SD_ULONG 0 SC_PPC_RAM_START1 0 1e+07 /end CHARACTERISTIC
/begin COMPU_METHOD SC_PPC_RAM_START1 "PPC_RAM_START1 conversion" RAT_FUNC "%10.0" "unitless" COEFFS 0 1 0 0 0 1 /end COMPU_METHOD
/begin CHARACTERISTIC PPC_ROM_END1 "End addr of 1st Non-Cal Strategy ROM Type region" VALUE 0x5F3A0 SD_ULONG 0 SC_PPC_ROM_END1 0 1e+07 /end CHARACTERISTIC
/begin COMPU_METHOD SC_PPC_ROM_END1 "PPC_ROM_END1 conversion" RAT_FUNC "%10.0" "unitless" COEFFS 0 1 0 0 0 1 /end COMPU_METHOD
/begin CHARACTERISTIC PPC_ROM_START1 "Start addr of 1st Non-Cal Strategy ROM Type region" VALUE 0x5F3A4 SD_ULONG 0 SC_PPC_ROM_START1 0 1e+07 /end CHARACTERISTIC
/begin COMPU_METHOD SC_PPC_ROM_START1 "PPC_ROM_START1 conversion" RAT_FUNC "%10.0" "unitless" COEFFS 0 1 0 0 0 1 /end COMPU_METHOD
/begin CHARACTERISTIC PPC_RTOS_END1 "End addr of 1st RTOS Non-Cal ROM Type region" VALUE 0x5F3B0 SD_ULONG 0 SC_PPC_RTOS_END1 0 1e+07 /end CHARACTERISTIC
/begin COMPU_METHOD SC_PPC_RTOS_END1 "PPC_RTOS_END1 conversion" RAT_FUNC "%10.0" "unitless" COEFFS 0 1 0 0 0 1 /end COMPU_METHOD
/begin CHARACTERISTIC PPC_RTOS_END2 "End addr of 2nd RTOS Non-Cal ROM Type region" VALUE 0x5F3A8 SD_ULONG 0 SC_PPC_RTOS_END2 0 1e+07 /end CHARACTERISTIC
/begin COMPU_METHOD SC_PPC_RTOS_END2 "PPC_RTOS_END2 conversion" RAT_FUNC "%10.0" "unitless" COEFFS 0 1 0 0 0 1 /end COMPU_METHOD
/begin CHARACTERISTIC PPC_RTOS_START1 "Start addr of 1st RTOS Non-Cal ROM Type region" VALUE 0x5F3B4 SD_ULONG 0 SC_PPC_RTOS_START1 0 1e+07 /end CHARACTERISTIC
/begin COMPU_METHOD SC_PPC_RTOS_START1 "PPC_RTOS_START1 conversion" RAT_FUNC "%10.0" "unitless" COEFFS 0 1 0 0 0 1 /end COMPU_METHOD
/begin CHARACTERISTIC PPC_RTOS_START2 "Start addr of 2nd RTOS Non-Cal ROM Type region" VALUE 0x5F3AC SD_ULONG 0 SC_PPC_RTOS_START2 0 1e+07 /end CHARACTERISTIC
/begin COMPU_METHOD SC_PPC_RTOS_START2 "PPC_RTOS_START2 conversion" RAT_FUNC "%10.0" "unitless" COEFFS 0 1 0 0 0 1 /end COMPU_METHOD
/begin CHARACTERISTIC PPC_STRATID[0] "" VALUE 0x101C0 SD_UBYTE 0 SC_PPC_STRATID 0 255 /end CHARACTERISTIC
/begin COMPU_METHOD SC_PPC_STRATID "PPC_STRATID conversion" RAT_FUNC "%3.0" "unitless" COEFFS 0 1 0 0 0 1 /end COMPU_METHOD
/begin CHARACTERISTIC PPC_STRATID[10] "" VALUE 0x101CA SD_UBYTE 0 SC_PPC_STRATID 0 255 /end CHARACTERISTIC
/begin CHARACTERISTIC PPC_STRATID[11] "" VALUE 0x101CB SD_UBYTE 0 SC_PPC_STRATID 0 255 /end CHARACTERISTIC
/begin CHARACTERISTIC PPC_STRATID[12] "" VALUE 0x101CC SD_UBYTE 0 SC_PPC_STRATID 0 255 /end CHARACTERISTIC
/begin CHARACTERISTIC PPC_STRATID[13] "" VALUE 0x101CD SD_UBYTE 0 SC_PPC_STRATID 0 255 /end CHARACTERISTIC
/begin CHARACTERISTIC PPC_STRATID[14] "" VALUE 0x101CE SD_UBYTE 0 SC_PPC_STRATID 0 255 /end CHARACTERISTIC
/begin CHARACTERISTIC PPC_STRATID[15] "" VALUE 0x101CF SD_UBYTE 0 SC_PPC_STRATID 0 255 /end CHARACTERISTIC
/begin CHARACTERISTIC PPC_STRATID[1] "" VALUE 0x101C1 SD_UBYTE 0 SC_PPC_STRATID 0 255 /end CHARACTERISTIC
/begin CHARACTERISTIC PPC_STRATID[2] "" VALUE 0x101C2 SD_UBYTE 0 SC_PPC_STRATID 0 255 /end CHARACTERISTIC
/begin CHARACTERISTIC PPC_STRATID[3] "" VALUE 0x101C3 SD_UBYTE 0 SC_PPC_STRATID 0 255 /end CHARACTERISTIC
/begin CHARACTERISTIC PPC_STRATID[4] "" VALUE 0x101C4 SD_UBYTE 0 SC_PPC_STRATID 0 255 /end CHARACTERISTIC
/begin CHARACTERISTIC PPC_STRATID[5] "" VALUE 0x101C5 SD_UBYTE 0 SC_PPC_STRATID 0 255 /end CHARACTERISTIC
/begin CHARACTERISTIC PPC_STRATID[6] "" VALUE 0x101C6 SD_UBYTE 0 SC_PPC_STRATID 0 255 /end CHARACTERISTIC
/begin CHARACTERISTIC PPC_STRATID[7] "" VALUE 0x101C7 SD_UBYTE 0 SC_PPC_STRATID 0 255 /end CHARACTERISTIC
/begin CHARACTERISTIC PPC_STRATID[8] "" VALUE 0x101C8 SD_UBYTE 0 SC_PPC_STRATID 0 255 /end CHARACTERISTIC
/begin CHARACTERISTIC PPC_STRATID[9] "" VALUE 0x101C9 SD_UBYTE 0 SC_PPC_STRATID 0 255 /end CHARACTERISTIC
/begin CHARACTERISTIC PPC_SUM_END1 "End of 1st region used to calculate checksum" VALUE 0x10228 SD_ULONG 0 SC_PPC_SUM_END1 0 1e+07 /end CHARACTERISTIC
/begin COMPU_METHOD SC_PPC_SUM_END1 "PPC_SUM_END1 conversion" RAT_FUNC "%10.0" "unitless" COEFFS 0 1 0 0 0 1 /end COMPU_METHOD
/begin CHARACTERISTIC PPC_SUM_END2 "End addr of 2nd region for checksum calculation" VALUE 0x10230 SD_ULONG 0 SC_PPC_SUM_END2 0 1e+07 /end CHARACTERISTIC
/begin COMPU_METHOD SC_PPC_SUM_END2 "PPC_SUM_END2 conversion" RAT_FUNC "%10.0" "unitless" COEFFS 0 1 0 0 0 1 /end COMPU_METHOD
/begin CHARACTERISTIC PPC_SUM_START1 "Start addr of 1st region for checksum calculation" VALUE 0x10224 SD_ULONG 0 SC_PPC_SUM_START1 0 1e+07 /end CHARACTERISTIC
/begin COMPU_METHOD SC_PPC_SUM_START1 "PPC_SUM_START1 conversion" RAT_FUNC "%10.0" "unitless" COEFFS 0 1 0 0 0 1 /end COMPU_METHOD
/begin CHARACTERISTIC PPC_SUM_START2 "Start addr of 2nd region for checksum calculation" VALUE 0x1022C SD_ULONG 0 SC_PPC_SUM_START2 0 1e+07 /end CHARACTERISTIC
/begin COMPU_METHOD SC_PPC_SUM_START2 "PPC_SUM_START2 conversion" RAT_FUNC "%10.0" "unitless" COEFFS 0 1 0 0 0 1 /end COMPU_METHOD
/begin CHARACTERISTIC PPC_USERID[0] "" VALUE 0x101D0 SD_UBYTE 0 SC_PPC_USERID 0 255 /end CHARACTERISTIC
/begin COMPU_METHOD SC_PPC_USERID "PPC_USERID conversion" RAT_FUNC "%3.0" "unitless" COEFFS 0 1 0 0 0 1 /end COMPU_METHOD
/begin CHARACTERISTIC PPC_USERID[1] "" VALUE 0x101D1 SD_UBYTE 0 SC_PPC_USERID 0 255 /end CHARACTERISTIC
/begin CHARACTERISTIC PPC_USERID[2] "" VALUE 0x101D2 SD_UBYTE 0 SC_PPC_USERID 0 255 /end CHARACTERISTIC
/begin CHARACTERISTIC PPC_USERID[3] "" VALUE 0x101D3 SD_UBYTE 0 SC_PPC_USERID 0 255 /end CHARACTERISTIC
/begin CHARACTERISTIC PPC_USERID[4] "" VALUE 0x101D4 SD_UBYTE 0 SC_PPC_USERID 0 255 /end CHARACTERISTIC
/begin CHARACTERISTIC PPC_USERID[5] "" VALUE 0x101D5 SD_UBYTE 0 SC_PPC_USERID 0 255 /end CHARACTERISTIC
/begin CHARACTERISTIC PPC_USERID[6] "" VALUE 0x101D6 SD_UBYTE 0 SC_PPC_USERID 0 255 /end CHARACTERISTIC
/begin CHARACTERISTIC PPC_USERID[7] "" VALUE 0x101D7 SD_UBYTE 0 SC_PPC_USERID 0 255 /end CHARACTERISTIC
/begin CHARACTERISTIC PPC_USERID[8] "" VALUE 0x101D8 SD_UBYTE 0 SC_PPC_USERID 0 255 /end CHARACTERISTIC
/begin MEASUREMENT PPFMFLG_A[0] "ARRAY OF PEDAL POSITION  FAILURE FLAGS" UBYTE MC_PPFMFLG_A 0 0 0 1 ECU_ADDRESS 0x3FA310 /end MEASUREMENT
/begin COMPU_METHOD MC_PPFMFLG_A "PPFMFLG_A conversion" RAT_FUNC "%3.0" "Unitless" COEFFS 0 1 0 0 0 1 /end COMPU_METHOD
/begin MEASUREMENT PPFMFLG_A[1] "ARRAY OF PEDAL POSITION  FAILURE FLAGS" UBYTE MC_PPFMFLG_A 0 0 0 1 ECU_ADDRESS 0x3FA311 /end MEASUREMENT
/begin MEASUREMENT PPFMFLG_A[2] "ARRAY OF PEDAL POSITION  FAILURE FLAGS" UBYTE MC_PPFMFLG_A 0 0 0 1 ECU_ADDRESS 0x3FA312 /end MEASUREMENT
/begin MEASUREMENT PPS "Accelerator pedal position sensor value." FLOAT32_IEEE MC_PPS 0 0 0 0 ECU_ADDRESS 0x3FA304 /end MEASUREMENT
/begin COMPU_METHOD MC_PPS "PPS conversion" RAT_FUNC "%10.5" "Unitless" COEFFS 0 1 0 0 0 1 /end COMPU_METHOD
/begin MEASUREMENT PPSBAR_A[0] "ARRAY OF PPS_BAR VALUES FOR PPS SENSORS" FLOAT32_IEEE MC_PPSBAR_A 0 0 0 1023 ECU_ADDRESS 0x3FBCB4 /end MEASUREMENT
/begin COMPU_METHOD MC_PPSBAR_A "PPSBAR_A conversion" RAT_FUNC "%10.5" "unitless" COEFFS 0 1 0 0 0 1 /end COMPU_METHOD
/begin MEASUREMENT PPSBAR_A[1] "ARRAY OF PPS_BAR VALUES FOR PPS SENSORS" FLOAT32_IEEE MC_PPSBAR_A 0 0 0 1023 ECU_ADDRESS 0x3FBCB8 /end MEASUREMENT
/begin MEASUREMENT PPSBAR_A[2] "ARRAY OF PPS_BAR VALUES FOR PPS SENSORS" FLOAT32_IEEE MC_PPSBAR_A 0 0 0 1023 ECU_ADDRESS 0x3FBCBC /end MEASUREMENT
/begin CHARACTERISTIC PPS_ACRATE_OFF "Instantaneous pedal position delta change above which launch cutout logic is active" VALUE 0x5CBD0 SD_FLOAT32_IEEE 0 SC_PPS_ACRATE_OFF 0 1023.98 /end CHARACTERISTIC
/begin COMPU_METHOD SC_PPS_ACRATE_OFF "PPS_ACRATE_OFF conversion" RAT_FUNC "%10.5" "ADct" COEFFS 0 1 0 0 0 1 /end COMPU_METHOD
/begin CHARACTERISTIC PPS_AC_ON "Pedal position below which A/C launch cutout is deactivated" VALUE 0x5CBC0 SD_FLOAT32_IEEE 0 SC_PPS_AC_ON 0 1023.98 /end CHARACTERISTIC
/begin COMPU_METHOD SC_PPS_AC_ON "PPS_AC_ON conversion" RAT_FUNC "%10.5" "ADct" COEFFS 0 1 0 0 0 1 /end COMPU_METHOD
/begin MEASUREMENT PPS_A[0] "ARRAY OF PPS VALUES FOR PPS SENSORS" FLOAT32_IEEE MC_PPS_A 0 0 0 1023 ECU_ADDRESS 0x3FBCC0 /end MEASUREMENT
/begin COMPU_METHOD MC_PPS_A "PPS_A conversion" RAT_FUNC "%10.5" "ADct/V" COEFFS 0 1 0 0 0 1 /end COMPU_METHOD
/begin MEASUREMENT PPS_A[1] "ARRAY OF PPS VALUES FOR PPS SENSORS" FLOAT32_IEEE MC_PPS_A 0 0 0 1023 ECU_ADDRESS 0x3FBCC4 /end MEASUREMENT
/begin MEASUREMENT PPS_A[2] "ARRAY OF PPS VALUES FOR PPS SENSORS" FLOAT32_IEEE MC_PPS_A 0 0 0 1023 ECU_ADDRESS 0x3FBCC8 /end MEASUREMENT
/begin CHARACTERISTIC PPS_DELTA "Accelerator pedal position A/D counts, CT/PT delta value." VALUE 0x5D53E SD_UWORD 0 SC_PPS_DELTA 0 1023 /end CHARACTERISTIC
/begin COMPU_METHOD SC_PPS_DELTA "PPS_DELTA conversion" RAT_FUNC "%5.0" "ADct" COEFFS 0 1 0 0 0 1 /end COMPU_METHOD
/begin CHARACTERISTIC PPS_DELTA_CH "Accelerator pedal position A/D counts, PPS_DELTA plus hysteresis value." VALUE 0x5D53C SD_UWORD 0 SC_PPS_DELTA_CH 0 1023 /end CHARACTERISTIC
/begin COMPU_METHOD SC_PPS_DELTA_CH "PPS_DELTA_CH conversion" RAT_FUNC "%5.0" "ADct" COEFFS 0 1 0 0 0 1 /end COMPU_METHOD
/begin CHARACTERISTIC PPS_IDLE_MAX "Idle window maximum pedal position value" VALUE 0x5D4E4 SD_FLOAT32_IEEE 0 SC_PPS_IDLE_MAX 0 1023 /end CHARACTERISTIC
/begin COMPU_METHOD SC_PPS_IDLE_MAX "PPS_IDLE_MAX conversion" RAT_FUNC "%10.5" "ADct" COEFFS 0 1 0 0 0 1 /end COMPU_METHOD
/begin CHARACTERISTIC PPS_IDLE_MIN "Idle window minimum pedal position value" VALUE 0x5D4E8 SD_FLOAT32_IEEE 0 SC_PPS_IDLE_MIN 0 1023 /end CHARACTERISTIC
/begin COMPU_METHOD SC_PPS_IDLE_MIN "PPS_IDLE_MIN conversion" RAT_FUNC "%10.5" "ADct" COEFFS 0 1 0 0 0 1 /end COMPU_METHOD
/begin CHARACTERISTIC PPS_IDLE_TR_DEF "" VALUE 0x5D4F8 SD_FLOAT32_IEEE 0 SC_PPS_IDLE_TR_DEF 0 1023 /end CHARACTERISTIC
/begin COMPU_METHOD SC_PPS_IDLE_TR_DEF "PPS_IDLE_TR_DEF conversion" RAT_FUNC "%10.5" "unitless" COEFFS 0 1 0 0 0 1 /end COMPU_METHOD
/begin MEASUREMENT PPS_IDLE_TR_PT "" FLOAT32_IEEE MC_PPS_IDLE_TR_PT 0 0 0 0 ECU_ADDRESS 0x3FA2F4 /end MEASUREMENT
/begin COMPU_METHOD MC_PPS_IDLE_TR_PT "PPS_IDLE_TR_PT conversion" RAT_FUNC "%10.5" "Unitless" COEFFS 0 1 0 0 0 1 /end COMPU_METHOD
/begin CHARACTERISTIC PPS_INT_LVL "NUMBER OF PEDAL HIGH  OR LOW COUNTS TO SET INTERMITTENT FLAG" VALUE 0x5D540 SD_UBYTE 0 SC_PPS_INT_LVL 0 254 /end CHARACTERISTIC
/begin COMPU_METHOD SC_PPS_INT_LVL "PPS_INT_LVL conversion" RAT_FUNC "%3.0" "Unitless" COEFFS 0 1 0 0 0 1 /end COMPU_METHOD
/begin CHARACTERISTIC PPS_LAUNCH_SW "Flag to switch PPS launch in A/C" VALUE 0x5CC0C SD_UBYTE 0 SC_PPS_LAUNCH_SW 0 1 /end CHARACTERISTIC
/begin COMPU_METHOD SC_PPS_LAUNCH_SW "PPS_LAUNCH_SW conversion" RAT_FUNC "%3.0" "flag" COEFFS 0 1 0 0 0 1 /end COMPU_METHOD
/begin CHARACTERISTIC PPS_LCH_CUT "Pedal position above which launch cutout is active" VALUE 0x5CBD4 SD_FLOAT32_IEEE 0 SC_PPS_LCH_CUT 0 1023.98 /end CHARACTERISTIC
/begin COMPU_METHOD SC_PPS_LCH_CUT "PPS_LCH_CUT conversion" RAT_FUNC "%10.5" "ADct" COEFFS 0 1 0 0 0 1 /end COMPU_METHOD
/begin MEASUREMENT PPS_RATCH_A[0] "ARRAY OF PPS_RATCH VALUES FOR PPS SENSORS" FLOAT32_IEEE MC_PPS_RATCH_A 0 0 0 1023 ECU_ADDRESS 0x3FBCCC /end MEASUREMENT
/begin COMPU_METHOD MC_PPS_RATCH_A "PPS_RATCH_A conversion" RAT_FUNC "%10.5" "unitless" COEFFS 0 1 0 0 0 1 /end COMPU_METHOD
/begin MEASUREMENT PPS_RATCH_A[1] "ARRAY OF PPS_RATCH VALUES FOR PPS SENSORS" FLOAT32_IEEE MC_PPS_RATCH_A 0 0 0 1023 ECU_ADDRESS 0x3FBCD0 /end MEASUREMENT
/begin MEASUREMENT PPS_RATCH_A[2] "ARRAY OF PPS_RATCH VALUES FOR PPS SENSORS" FLOAT32_IEEE MC_PPS_RATCH_A 0 0 0 1023 ECU_ADDRESS 0x3FBCD4 /end MEASUREMENT
/begin CHARACTERISTIC PPS_RATCH_A_DEF[0] "" VALUE 0x43FDC SD_FLOAT32_IEEE 0 SC_PPS_RATCH_A_DEF 0 1023 /end CHARACTERISTIC
/begin COMPU_METHOD SC_PPS_RATCH_A_DEF "PPS_RATCH_A_DEF conversion" RAT_FUNC "%10.5" "unitless" COEFFS 0 1 0 0 0 1 /end COMPU_METHOD
/begin CHARACTERISTIC PPS_RATCH_A_DEF[1] "" VALUE 0x43FE0 SD_FLOAT32_IEEE 0 SC_PPS_RATCH_A_DEF 0 1023 /end CHARACTERISTIC
/begin CHARACTERISTIC PPS_RATCH_A_DEF[2] "" VALUE 0x43FE4 SD_FLOAT32_IEEE 0 SC_PPS_RATCH_A_DEF 0 1023 /end CHARACTERISTIC
/begin CHARACTERISTIC PPS_RATCH_A_MIN[0] "" VALUE 0x43FD0 SD_FLOAT32_IEEE 0 SC_PPS_RATCH_A_MIN 0 1023 /end CHARACTERISTIC
/begin COMPU_METHOD SC_PPS_RATCH_A_MIN "PPS_RATCH_A_MIN conversion" RAT_FUNC "%10.5" "unitless" COEFFS 0 1 0 0 0 1 /end COMPU_METHOD
/begin CHARACTERISTIC PPS_RATCH_A_MIN[1] "" VALUE 0x43FD4 SD_FLOAT32_IEEE 0 SC_PPS_RATCH_A_MIN 0 1023 /end CHARACTERISTIC
/begin CHARACTERISTIC PPS_RATCH_A_MIN[2] "" VALUE 0x43FD8 SD_FLOAT32_IEEE 0 SC_PPS_RATCH_A_MIN 0 1023 /end CHARACTERISTIC
/begin CHARACTERISTIC PPS_RATIV_A[0] "INITIAL VALUE OF  PEDAL  RATCH  UNITS ARE COUNTS" VALUE 0x43FC4 SD_FLOAT32_IEEE 0 SC_PPS_RATIV_A 0 1023 /end CHARACTERISTIC
/begin COMPU_METHOD SC_PPS_RATIV_A "PPS_RATIV_A conversion" RAT_FUNC "%10.5" "ADCT" COEFFS 0 1 0 0 0 1 /end COMPU_METHOD
/begin CHARACTERISTIC PPS_RATIV_A[1] "INITIAL VALUE OF  PEDAL  RATCH  UNITS ARE COUNTS" VALUE 0x43FC8 SD_FLOAT32_IEEE 0 SC_PPS_RATIV_A 0 1023 /end CHARACTERISTIC
/begin CHARACTERISTIC PPS_RATIV_A[2] "INITIAL VALUE OF  PEDAL  RATCH  UNITS ARE COUNTS" VALUE 0x43FCC SD_FLOAT32_IEEE 0 SC_PPS_RATIV_A 0 1023 /end CHARACTERISTIC
/begin MEASUREMENT PPS_REL "Minimum relative accelerator pedal position." FLOAT32_IEEE MC_PPS_REL 0 0 0 0 ECU_ADDRESS 0x3FA30C /end MEASUREMENT
/begin COMPU_METHOD MC_PPS_REL "PPS_REL conversion" RAT_FUNC "%10.5" "Unitless" COEFFS 0 1 0 0 0 1 /end COMPU_METHOD
/begin MEASUREMENT PPS_REL_A[0] "ARRAY OF PPS VALUES FOR PPS SENSORS" FLOAT32_IEEE MC_PPS_REL_A 0 0 0 1023 ECU_ADDRESS 0x3FBCD8 /end MEASUREMENT
/begin COMPU_METHOD MC_PPS_REL_A "PPS_REL_A conversion" RAT_FUNC "%10.5" "unitless" COEFFS 0 1 0 0 0 1 /end COMPU_METHOD
/begin MEASUREMENT PPS_REL_A[1] "ARRAY OF PPS VALUES FOR PPS SENSORS" FLOAT32_IEEE MC_PPS_REL_A 0 0 0 1023 ECU_ADDRESS 0x3FBCDC /end MEASUREMENT
/begin MEASUREMENT PPS_REL_A[2] "ARRAY OF PPS VALUES FOR PPS SENSORS" FLOAT32_IEEE MC_PPS_REL_A 0 0 0 1023 ECU_ADDRESS 0x3FBCE0 /end MEASUREMENT
/begin MEASUREMENT PPS_REL_FIL "Filtered minimum relative accelerator pedal position." FLOAT32_IEEE MC_PPS_REL_FIL 0 0 0 0 ECU_ADDRESS 0x3FA308 /end MEASUREMENT
/begin COMPU_METHOD MC_PPS_REL_FIL "PPS_REL_FIL conversion" RAT_FUNC "%10.5" "Unitless" COEFFS 0 1 0 0 0 1 /end COMPU_METHOD
/begin CHARACTERISTIC PPS_REL_MAX_DEF "" VALUE 0x5D4F4 SD_FLOAT32_IEEE 0 SC_PPS_REL_MAX_DEF 0 1023 /end CHARACTERISTIC
/begin COMPU_METHOD SC_PPS_REL_MAX_DEF "PPS_REL_MAX_DEF conversion" RAT_FUNC "%10.5" "unitless" COEFFS 0 1 0 0 0 1 /end COMPU_METHOD
/begin MEASUREMENT PPS_REL_MAX_VAR "" FLOAT32_IEEE MC_PPS_REL_MAX_VAR 0 0 0 0 ECU_ADDRESS 0x3FA2F0 /end MEASUREMENT
/begin COMPU_METHOD MC_PPS_REL_MAX_VAR "PPS_REL_MAX_VAR conversion" RAT_FUNC "%10.5" "Unitless" COEFFS 0 1 0 0 0 1 /end COMPU_METHOD
/begin CHARACTERISTIC PPS_SCALE1 "MULTIPLIER FOR PPS_REL ON SENSOR 1" VALUE 0x5D50C SD_FLOAT32_IEEE 0 SC_PPS_SCALE1 0 2 /end CHARACTERISTIC
/begin COMPU_METHOD SC_PPS_SCALE1 "PPS_SCALE1 conversion" RAT_FUNC "%10.5" "Unitless" COEFFS 0 1 0 0 0 1 /end COMPU_METHOD
/begin CHARACTERISTIC PPS_SCALE2 "MULTIPLIER FOR PPS_REL ON SENSOR 2" VALUE 0x5D508 SD_FLOAT32_IEEE 0 SC_PPS_SCALE2 0 2 /end CHARACTERISTIC
/begin COMPU_METHOD SC_PPS_SCALE2 "PPS_SCALE2 conversion" RAT_FUNC "%10.5" "Unitless" COEFFS 0 1 0 0 0 1 /end COMPU_METHOD
/begin CHARACTERISTIC PPS_SCALE3 "MULTIPLIER FOR PPS_REL ON SENSOR 3" VALUE 0x5D504 SD_FLOAT32_IEEE 0 SC_PPS_SCALE3 0 2 /end CHARACTERISTIC
/begin COMPU_METHOD SC_PPS_SCALE3 "PPS_SCALE3 conversion" RAT_FUNC "%10.5" "Unitless" COEFFS 0 1 0 0 0 1 /end COMPU_METHOD
/begin MEASUREMENT PPS_STATE "PPS SENSOR FAILURE INDICATOR" UBYTE MC_PPS_STATE 0 0 0 0 ECU_ADDRESS 0x3FA329 /end MEASUREMENT
/begin COMPU_METHOD MC_PPS_STATE "PPS_STATE conversion" RAT_FUNC "%3.0" "Unitless" COEFFS 0 1 0 0 0 1 /end COMPU_METHOD
/begin MEASUREMENT PPS_TC_VAR "Accelerator pedal position filter time constant" FLOAT32_IEEE MC_PPS_TC_VAR 0 0 0 0 ECU_ADDRESS 0x3FA2F8 /end MEASUREMENT
/begin COMPU_METHOD MC_PPS_TC_VAR "PPS_TC_VAR conversion" RAT_FUNC "%10.5" "Unitless" COEFFS 0 1 0 0 0 1 /end COMPU_METHOD
/begin CHARACTERISTIC PPS_THBP2 "Accelerator pedal position PT/WOT breakpoint." VALUE 0x5D53A SD_UWORD 0 SC_PPS_THBP2 0 1023 /end CHARACTERISTIC
/begin COMPU_METHOD SC_PPS_THBP2 "PPS_THBP2 conversion" RAT_FUNC "%5.0" "ADct" COEFFS 0 1 0 0 0 1 /end COMPU_METHOD
/begin CHARACTERISTIC PPS_THBP2_SH "Accelerator pedal position  A/D counts, PPS_THBP2 plus hysteresis." VALUE 0x5D538 SD_UWORD 0 SC_PPS_THBP2_SH 0 1023 /end CHARACTERISTIC
/begin COMPU_METHOD SC_PPS_THBP2_SH "PPS_THBP2_SH conversion" RAT_FUNC "%5.0" "ADct" COEFFS 0 1 0 0 0 1 /end COMPU_METHOD
/begin CHARACTERISTIC PP_DELTA "DIFFERENCE THRESHOLD BETWEEN PPS_REL COMPARISONS FOR FAILURE" VALUE 0x5D500 SD_FLOAT32_IEEE 0 SC_PP_DELTA 0 1023 /end CHARACTERISTIC
/begin COMPU_METHOD SC_PP_DELTA "PP_DELTA conversion" RAT_FUNC "%10.5" "unitless" COEFFS 0 1 0 0 0 1 /end COMPU_METHOD
/begin CHARACTERISTIC PP_NUM "INDICATOR OF WHICH PPS SENSOR IS INVERTED SLOPE" VALUE 0x5D524 SD_UBYTE 0 SC_PP_NUM 0 2 /end CHARACTERISTIC
/begin COMPU_METHOD SC_PP_NUM "PP_NUM conversion" RAT_FUNC "%3.0" "Unitless" COEFFS 0 1 0 0 0 1 /end COMPU_METHOD
/begin MEASUREMENT PREPURG_RDY "Purge pre-test ready flag; 1 -> all pre-test ready conditions have been met." UBYTE MC_PREPURG_RDY 0 0 0 0 ECU_ADDRESS 0x3F9CF2 /end MEASUREMENT
/begin COMPU_METHOD MC_PREPURG_RDY "PREPURG_RDY conversion" RAT_FUNC "%3.0" "Unitless" COEFFS 0 1 0 0 0 1 /end COMPU_METHOD
/begin MEASUREMENT PREV_BP_MALF_STATUS_FLG "Indicates malf failure during previous cycle" UBYTE MC_PREV_BP_MALF_STATUS_FLG 0 0 0 0 ECU_ADDRESS 0x3F9EC9 /end MEASUREMENT
/begin COMPU_METHOD MC_PREV_BP_MALF_STATUS_FLG "PREV_BP_MALF_STATUS_FLG conversion" RAT_FUNC "%3.0" "Unitless" COEFFS 0 1 0 0 0 1 /end COMPU_METHOD
/begin MEASUREMENT PREV_EBP_MALF_STATUS_FLG "Indicate malf failure during previouse cycle" UBYTE MC_PREV_EBP_MALF_STATUS_FLG 0 0 0 0 ECU_ADDRESS 0x3FA3BF /end MEASUREMENT
/begin COMPU_METHOD MC_PREV_EBP_MALF_STATUS_FLG "PREV_EBP_MALF_STATUS_FLG conversion" RAT_FUNC "%3.0" "Unitless" COEFFS 0 1 0 0 0 1 /end COMPU_METHOD
/begin MEASUREMENT PREV_ECT_MALF_STATUS_FLG "indicates malf failure during previous cycle" UBYTE MC_PREV_ECT_MALF_STATUS_FLG 0 0 0 0 ECU_ADDRESS 0x3F9F93 /end MEASUREMENT
/begin COMPU_METHOD MC_PREV_ECT_MALF_STATUS_FLG "PREV_ECT_MALF_STATUS_FLG conversion" RAT_FUNC "%3.0" "Unitless" COEFFS 0 1 0 0 0 1 /end COMPU_METHOD
/begin MEASUREMENT PREV_EGRP_MALF_STATUS_FLG "Indicates egrp malf failure during previous cycle" UBYTE MC_PREV_EGRP_MALF_STATUS_FLG 0 0 0 0 ECU_ADDRESS 0x3F9FC9 /end MEASUREMENT
/begin COMPU_METHOD MC_PREV_EGRP_MALF_STATUS_FLG "PREV_EGRP_MALF_STATUS_FLG conversion" RAT_FUNC "%3.0" "Unitless" COEFFS 0 1 0 0 0 1 /end COMPU_METHOD
/begin MEASUREMENT PREV_EOT_MALF_STATUS_FLG "indicates malf failure during previous cycle" UBYTE MC_PREV_EOT_MALF_STATUS_FLG 0 0 0 0 ECU_ADDRESS 0x3F9F36 /end MEASUREMENT
/begin COMPU_METHOD MC_PREV_EOT_MALF_STATUS_FLG "PREV_EOT_MALF_STATUS_FLG conversion" RAT_FUNC "%3.0" "Unitless" COEFFS 0 1 0 0 0 1 /end COMPU_METHOD
/begin MEASUREMENT PREV_IAT_MALF_STATUS_FLG "Indicates malf failure during previous cycle" UBYTE MC_PREV_IAT_MALF_STATUS_FLG 0 0 0 0 ECU_ADDRESS 0x3FA36A /end MEASUREMENT
/begin COMPU_METHOD MC_PREV_IAT_MALF_STATUS_FLG "PREV_IAT_MALF_STATUS_FLG conversion" RAT_FUNC "%3.0" "Unitless" COEFFS 0 1 0 0 0 1 /end COMPU_METHOD
/begin MEASUREMENT PREV_ICP_MALF_STATUS_FLG "indicates malf failure during previous cycle" UBYTE MC_PREV_ICP_MALF_STATUS_FLG 0 0 0 0 ECU_ADDRESS 0x3FA0F2 /end MEASUREMENT
/begin COMPU_METHOD MC_PREV_ICP_MALF_STATUS_FLG "PREV_ICP_MALF_STATUS_FLG conversion" RAT_FUNC "%3.0" "Unitless" COEFFS 0 1 0 0 0 1 /end COMPU_METHOD
/begin MEASUREMENT PREV_ITHP_MALF_STATUS_FLG "Indicates malf failure during previous cycle" UBYTE MC_PREV_ITHP_MALF_STATUS_FLG 0 0 0 0 ECU_ADDRESS 0x3FA3FE /end MEASUREMENT
/begin COMPU_METHOD MC_PREV_ITHP_MALF_STATUS_FLG "PREV_ITHP_MALF_STATUS_FLG conversion" RAT_FUNC "%3.0" "Unitless" COEFFS 0 1 0 0 0 1 /end COMPU_METHOD
/begin MEASUREMENT PREV_IVPWR_MALF_STATUS_FLG "Indicates malf failure during previous cycle" UBYTE MC_PREV_IVPWR_MALF_STATUS_FLG 0 0 0 0 ECU_ADDRESS 0x3FA431 /end MEASUREMENT
/begin COMPU_METHOD MC_PREV_IVPWR_MALF_STATUS_FLG "PREV_IVPWR_MALF_STATUS_FLG conversion" RAT_FUNC "%3.0" "Unitless" COEFFS 0 1 0 0 0 1 /end COMPU_METHOD
/begin MEASUREMENT PREV_MAF_MALF_STATUS_FLG "Indicates malf failure during previous cycle" UBYTE MC_PREV_MAF_MALF_STATUS_FLG 0 0 0 0 ECU_ADDRESS 0x3FA159 /end MEASUREMENT
/begin COMPU_METHOD MC_PREV_MAF_MALF_STATUS_FLG "PREV_MAF_MALF_STATUS_FLG conversion" RAT_FUNC "%3.0" "Unitless" COEFFS 0 1 0 0 0 1 /end COMPU_METHOD
/begin MEASUREMENT PREV_MAP_MALF_STATUS_FLG "Indicates malf failure during previous cycle" UBYTE MC_PREV_MAP_MALF_STATUS_FLG 0 0 0 0 ECU_ADDRESS 0x3FA1E6 /end MEASUREMENT
/begin COMPU_METHOD MC_PREV_MAP_MALF_STATUS_FLG "PREV_MAP_MALF_STATUS_FLG conversion" RAT_FUNC "%3.0" "Unitless" COEFFS 0 1 0 0 0 1 /end COMPU_METHOD
/begin MEASUREMENT PREV_MAT_MALF_STATUS_FLG "Indicates mat malf failure during previous cycle" UBYTE MC_PREV_MAT_MALF_STATUS_FLG 0 0 0 0 ECU_ADDRESS 0x3FA215 /end MEASUREMENT
/begin COMPU_METHOD MC_PREV_MAT_MALF_STATUS_FLG "PREV_MAT_MALF_STATUS_FLG conversion" RAT_FUNC "%3.0" "Unitless" COEFFS 0 1 0 0 0 1 /end COMPU_METHOD
/begin MEASUREMENT PREV_PDIF_STL_TMR_FLG "Previous timing loop, timer flag status" UBYTE MC_PREV_PDIF_STL_TMR_FLG 0 0 0 0 ECU_ADDRESS 0x3FA4E5 /end MEASUREMENT
/begin COMPU_METHOD MC_PREV_PDIF_STL_TMR_FLG "PREV_PDIF_STL_TMR_FLG conversion" RAT_FUNC "%3.0" "Unitless" COEFFS 0 1 0 0 0 1 /end COMPU_METHOD
/begin MEASUREMENT PROCESSING_GPD "Glow plug diagnostic semphore (1=gpd buffer is being emptied)" UBYTE MC_PROCESSING_GPD 0 0 0 0 ECU_ADDRESS 0x3FABC0 /end MEASUREMENT
/begin COMPU_METHOD MC_PROCESSING_GPD "PROCESSING_GPD conversion" RAT_FUNC "%3.0" "Unitless" COEFFS 0 1 0 0 0 1 /end COMPU_METHOD
/begin MEASUREMENT PTOST_LGL_FLG "Powertrain Takeoff (PTO) Legal flag" UBYTE MC_PTOST_LGL_FLG 0 0 0 0 ECU_ADDRESS 0x3FB186 /end MEASUREMENT
/begin COMPU_METHOD MC_PTOST_LGL_FLG "PTOST_LGL_FLG conversion" RAT_FUNC "%3.0" "Unitless" COEFFS 0 1 0 0 0 1 /end COMPU_METHOD
/begin MEASUREMENT PTO_ACTIVE "Signal which is used to disable monitors affected by PTO." UBYTE MC_PTO_ACTIVE 0 0 0 0 ECU_ADDRESS 0x3F9E34 /end MEASUREMENT
/begin COMPU_METHOD MC_PTO_ACTIVE "PTO_ACTIVE conversion" RAT_FUNC "%3.0" "Unitless" COEFFS 0 1 0 0 0 1 /end COMPU_METHOD
/begin MEASUREMENT PTO_ENGAGED "Signal from PTO hardware indicating PTO is engaged; 1=engaged, 0=not engaged." UBYTE MC_PTO_ENGAGED 0 0 0 0 ECU_ADDRESS 0x3F9A62 /end MEASUREMENT
/begin COMPU_METHOD MC_PTO_ENGAGED "PTO_ENGAGED conversion" RAT_FUNC "%3.0" "Unitless" COEFFS 0 1 0 0 0 1 /end COMPU_METHOD
/begin CHARACTERISTIC PTO_LEG_TM "Lockout time for PTO" VALUE 0x5EA6C SD_FLOAT32_IEEE 0 SC_PTO_LEG_TM 0 100 /end CHARACTERISTIC
/begin COMPU_METHOD SC_PTO_LEG_TM "PTO_LEG_TM conversion" RAT_FUNC "%10.5" "s" COEFFS 0 1 0 0 0 1 /end COMPU_METHOD
/begin MEASUREMENT PTO_LEG_TMR "Lockout timer for PTO" FLOAT32_IEEE MC_PTO_LEG_TMR 0 0 0 0 ECU_ADDRESS 0x3FB168 /end MEASUREMENT
/begin COMPU_METHOD MC_PTO_LEG_TMR "PTO_LEG_TMR conversion" RAT_FUNC "%10.5" "Unitless" COEFFS 0 1 0 0 0 1 /end COMPU_METHOD
/begin CHARACTERISTIC PTO_TST_SW "Mapped byte of sys_PTO_SW flag bits in the order(0..7): {cat,ccm,purg,sair,fuel,ego,egr,mis}." VALUE 0x5CE33 SD_UBYTE 0 SC_PTO_TST_SW 0 255 /end CHARACTERISTIC
/begin COMPU_METHOD SC_PTO_TST_SW "PTO_TST_SW conversion" RAT_FUNC "%3.0" "MAPPED_BYTE" COEFFS 0 1 0 0 0 1 /end COMPU_METHOD
/begin MEASUREMENT PTR_TABLE_0 "Special RCON Shadow Table 0" ULONG MC_PTR_TABLE_0 0 0 0 0 ECU_ADDRESS 0x3F9C80 /end MEASUREMENT
/begin COMPU_METHOD MC_PTR_TABLE_0 "PTR_TABLE_0 conversion" RAT_FUNC "%10.0" "Unitless" COEFFS 0 1 0 0 0 1 /end COMPU_METHOD
/begin MEASUREMENT PTR_TABLE_1 "Special RCON Shadow Table 1" ULONG MC_PTR_TABLE_1 0 0 0 0 ECU_ADDRESS 0x3F9C7C /end MEASUREMENT
/begin COMPU_METHOD MC_PTR_TABLE_1 "PTR_TABLE_1 conversion" RAT_FUNC "%10.0" "Unitless" COEFFS 0 1 0 0 0 1 /end COMPU_METHOD
/begin MEASUREMENT PTR_TABLE_2 "Special RCON Shadow Table 2" ULONG MC_PTR_TABLE_2 0 0 0 0 ECU_ADDRESS 0x3F9C78 /end MEASUREMENT
/begin COMPU_METHOD MC_PTR_TABLE_2 "PTR_TABLE_2 conversion" RAT_FUNC "%10.0" "Unitless" COEFFS 0 1 0 0 0 1 /end COMPU_METHOD
/begin MEASUREMENT PTR_TABLE_3 "Special RCON Shadow Table 3" ULONG MC_PTR_TABLE_3 0 0 0 0 ECU_ADDRESS 0x3F9C74 /end MEASUREMENT
/begin COMPU_METHOD MC_PTR_TABLE_3 "PTR_TABLE_3 conversion" RAT_FUNC "%10.0" "Unitless" COEFFS 0 1 0 0 0 1 /end COMPU_METHOD
/begin MEASUREMENT PUMP "FUEL PUMP MODE FIT FLAG; 1->ENABLE" UBYTE MC_PUMP 0 0 0 0 ECU_ADDRESS 0x3F9832 /end MEASUREMENT
/begin COMPU_METHOD MC_PUMP "PUMP conversion" RAT_FUNC "%3.0" "Unitless" COEFFS 0 1 0 0 0 1 /end COMPU_METHOD
/begin MEASUREMENT PURG_COUNT "Count of the number of complete purge tests since KAM reset." UBYTE MC_PURG_COUNT 0 0 0 0 ECU_ADDRESS 0x3FCD0D /end MEASUREMENT
/begin COMPU_METHOD MC_PURG_COUNT "PURG_COUNT conversion" RAT_FUNC "%3.0" "Unitless" COEFFS 0 1 0 0 0 1 /end COMPU_METHOD
/begin CHARACTERISTIC PURG_DEL_TM "Time delay between succesive runs of the PURG monitor." VALUE 0x5CE2E SD_UBYTE 0 SC_PURG_DEL_TM 0 127 /end CHARACTERISTIC
/begin COMPU_METHOD SC_PURG_DEL_TM "PURG_DEL_TM conversion" RAT_FUNC "%3.0" "s" COEFFS 0 1 0 0 0 1 /end COMPU_METHOD
/begin MEASUREMENT PURG_DEL_TMR "Time since abort of the PURG monitor." FLOAT32_IEEE MC_PURG_DEL_TMR 0 0 0 0 ECU_ADDRESS 0x3F9E64 /end MEASUREMENT
/begin COMPU_METHOD MC_PURG_DEL_TMR "PURG_DEL_TMR conversion" RAT_FUNC "%10.5" "Unitless" COEFFS 0 1 0 0 0 1 /end COMPU_METHOD
/begin MEASUREMENT PURG_FMEM "PURG system FMEM flag.  1 -> don't run PURG monitor due to FMEM." UBYTE MC_PURG_FMEM 0 0 0 0 ECU_ADDRESS 0x3F9E5D /end MEASUREMENT
/begin COMPU_METHOD MC_PURG_FMEM "PURG_FMEM conversion" RAT_FUNC "%3.0" "Unitless" COEFFS 0 1 0 0 0 1 /end COMPU_METHOD
/begin MEASUREMENT PURG_MON "OBDII monitor flag for evaporative purge; 1=>all purge faults been monitored since power-up" UBYTE MC_PURG_MON 0 0 0 0 ECU_ADDRESS 0x3F9CDC /end MEASUREMENT
/begin COMPU_METHOD MC_PURG_MON "PURG_MON conversion" RAT_FUNC "%3.0" "Unitless" COEFFS 0 1 0 0 0 1 /end COMPU_METHOD
/begin MEASUREMENT PURG_TST_ENA "OBD-II Purge Test enable flag. (1 => test enabled)" UBYTE MC_PURG_TST_ENA 0 0 0 0 ECU_ADDRESS 0x3F9E3D /end MEASUREMENT
/begin COMPU_METHOD MC_PURG_TST_ENA "PURG_TST_ENA conversion" RAT_FUNC "%3.0" "Unitless" COEFFS 0 1 0 0 0 1 /end COMPU_METHOD
/begin MEASUREMENT PURG_TST_RDY "PURGE TEST READY FLAG; 1 -> ALL LOCAL CONDITIONS HAVE BEEN MET; READY TO RUN PURGE TEST." UBYTE MC_PURG_TST_RDY 0 0 0 0 ECU_ADDRESS 0x3F9CD4 /end MEASUREMENT
/begin COMPU_METHOD MC_PURG_TST_RDY "PURG_TST_RDY conversion" RAT_FUNC "%3.0" "Unitless" COEFFS 0 1 0 0 0 1 /end COMPU_METHOD
/begin MEASUREMENT PUTMR "Time after CPU power-up." FLOAT32_IEEE MC_PUTMR 0 0 0 0 ECU_ADDRESS 0x3FB5D4 /end MEASUREMENT
/begin COMPU_METHOD MC_PUTMR "PUTMR conversion" RAT_FUNC "%10.5" "Unitless" COEFFS 0 1 0 0 0 1 /end COMPU_METHOD
/begin MEASUREMENT PWR_RESET_FLG "Indicates the master clock time has reset" UBYTE MC_PWR_RESET_FLG 0 0 0 0 ECU_ADDRESS 0x3FB608 /end MEASUREMENT
/begin COMPU_METHOD MC_PWR_RESET_FLG "PWR_RESET_FLG conversion" RAT_FUNC "%3.0" "Unitless" COEFFS 0 1 0 0 0 1 /end COMPU_METHOD
/begin MEASUREMENT P_ADV "Pilot Advance selected (degrees)" FLOAT32_IEEE MC_P_ADV 0 0 0 0 ECU_ADDRESS 0x3FA938 /end MEASUREMENT
/begin COMPU_METHOD MC_P_ADV "P_ADV conversion" RAT_FUNC "%10.5" "Unitless" COEFFS 0 1 0 0 0 1 /end COMPU_METHOD
/begin CHARACTERISTIC P_ADV_CAL "Pilot advance calibration constant" VALUE 0x5DE3C SD_FLOAT32_IEEE 0 SC_P_ADV_CAL -50 50 /end CHARACTERISTIC
/begin COMPU_METHOD SC_P_ADV_CAL "P_ADV_CAL conversion" RAT_FUNC "%10.5" "deg" COEFFS 0 1 0 0 0 1 /end COMPU_METHOD
/begin CHARACTERISTIC P_ADV_MN "Pilot Advance Timing Minimum (degrees)" VALUE 0x5DE38 SD_FLOAT32_IEEE 0 SC_P_ADV_MN -50 5 /end CHARACTERISTIC
/begin COMPU_METHOD SC_P_ADV_MN "P_ADV_MN conversion" RAT_FUNC "%10.5" "deg" COEFFS 0 1 0 0 0 1 /end COMPU_METHOD
/begin CHARACTERISTIC P_ADV_MX "Pilot Advance Timing Maximum (degrees)" VALUE 0x5DE34 SD_FLOAT32_IEEE 0 SC_P_ADV_MX 0 50 /end CHARACTERISTIC
/begin COMPU_METHOD SC_P_ADV_MX "P_ADV_MX conversion" RAT_FUNC "%10.5" "deg" COEFFS 0 1 0 0 0 1 /end COMPU_METHOD
/begin CHARACTERISTIC P_ADV_SEL "Pilot advance sel (0 = p_adv_tbl, 1 = p_adv_cal)" VALUE 0x5DE44 SD_UBYTE 0 SC_P_ADV_SEL 0 255 /end CHARACTERISTIC
/begin COMPU_METHOD SC_P_ADV_SEL "P_ADV_SEL conversion" RAT_FUNC "%3.0" "unitless" COEFFS 0 1 0 0 0 1 /end COMPU_METHOD
/begin MEASUREMENT P_ADV_TBL "Pilot Advance from Table (degrees)" FLOAT32_IEEE MC_P_ADV_TBL 0 0 0 0 ECU_ADDRESS 0x3FA934 /end MEASUREMENT
/begin COMPU_METHOD MC_P_ADV_TBL "P_ADV_TBL conversion" RAT_FUNC "%10.5" "Unitless" COEFFS 0 1 0 0 0 1 /end COMPU_METHOD
/begin MEASUREMENT P_CNCLD "" UBYTE MC_P_CNCLD 0 0 0 0 ECU_ADDRESS 0x3FB6B6 /end MEASUREMENT
/begin COMPU_METHOD MC_P_CNCLD "P_CNCLD conversion" RAT_FUNC "%3.0" "Unitless" COEFFS 0 1 0 0 0 1 /end COMPU_METHOD
/begin MEASUREMENT P_TO_N "Pilot to no pilot transition flag" UBYTE MC_P_TO_N 0 0 0 0 ECU_ADDRESS 0x3FA8C9 /end MEASUREMENT
/begin COMPU_METHOD MC_P_TO_N "P_TO_N conversion" RAT_FUNC "%3.0" "Unitless" COEFFS 0 1 0 0 0 1 /end COMPU_METHOD
/begin MEASUREMENT P_TRNS_MLT "Pilot transition multiplier" FLOAT32_IEEE MC_P_TRNS_MLT 0 0 0 0 ECU_ADDRESS 0x3FA930 /end MEASUREMENT
/begin COMPU_METHOD MC_P_TRNS_MLT "P_TRNS_MLT conversion" RAT_FUNC "%10.5" "Unitless" COEFFS 0 1 0 0 0 1 /end COMPU_METHOD
/begin CHARACTERISTIC R "" VALUE 0x5E4A8 SD_FLOAT32_IEEE 0 SC_R 0 1 /end CHARACTERISTIC
/begin COMPU_METHOD SC_R "R conversion" RAT_FUNC "%10.5" "unitless" COEFFS 0 1 0 0 0 1 /end COMPU_METHOD
/begin MEASUREMENT RATDIFF_MALF_TMR "EO iat/mat rationale test fault timer" FLOAT32_IEEE MC_RATDIFF_MALF_TMR 0 0 0 0 ECU_ADDRESS 0x3FA530 /end MEASUREMENT
/begin COMPU_METHOD MC_RATDIFF_MALF_TMR "RATDIFF_MALF_TMR conversion" RAT_FUNC "%10.5" "Unitless" COEFFS 0 1 0 0 0 1 /end COMPU_METHOD
/begin MEASUREMENT RATDIFF_UPD_TMR "EO iat/mat rationale test update timer" FLOAT32_IEEE MC_RATDIFF_UPD_TMR 0 0 0 0 ECU_ADDRESS 0x3FA534 /end MEASUREMENT
/begin COMPU_METHOD MC_RATDIFF_UPD_TMR "RATDIFF_UPD_TMR conversion" RAT_FUNC "%10.5" "Unitless" COEFFS 0 1 0 0 0 1 /end COMPU_METHOD
/begin MEASUREMENT RAW_PEDAL_3TRACK[0] "Previous loop A/D value" FLOAT32_IEEE MC_RAW_PEDAL_3TRACK 0 0 0 1023 ECU_ADDRESS 0x3FA2E8 /end MEASUREMENT
/begin COMPU_METHOD MC_RAW_PEDAL_3TRACK "RAW_PEDAL_3TRACK conversion" RAT_FUNC "%10.5" "ADct" COEFFS 0 1 0 0 0 1 /end COMPU_METHOD
/begin MEASUREMENT RAW_PEDAL_3TRACK[1] "Previous loop A/D value" FLOAT32_IEEE MC_RAW_PEDAL_3TRACK 0 0 0 1023 ECU_ADDRESS 0x3FA2EC /end MEASUREMENT
/begin MEASUREMENT RAW_SIG_F_MODE "Indicates which sensor is failed for altitude reading" UBYTE MC_RAW_SIG_F_MODE 0 0 0 0 ECU_ADDRESS 0x3FA4E0 /end MEASUREMENT
/begin COMPU_METHOD MC_RAW_SIG_F_MODE "RAW_SIG_F_MODE conversion" RAT_FUNC "%3.0" "Unitless" COEFFS 0 1 0 0 0 1 /end COMPU_METHOD
/begin MEASUREMENT RCT_ENABLE "Relative Compresstion Test mode flag" UBYTE MC_RCT_ENABLE 0 0 0 0 ECU_ADDRESS 0x3F9D0B /end MEASUREMENT
/begin COMPU_METHOD MC_RCT_ENABLE "RCT_ENABLE conversion" RAT_FUNC "%3.0" "Unitless" COEFFS 0 1 0 0 0 1 /end COMPU_METHOD
/begin CHARACTERISTIC RCT_GPC_EOT "Relative compression test EOT (Glow Plug) cal" VALUE 0x5E1FC SD_FLOAT32_IEEE 0 SC_RCT_GPC_EOT -40 150 /end CHARACTERISTIC
/begin COMPU_METHOD SC_RCT_GPC_EOT "RCT_GPC_EOT conversion" RAT_FUNC "%10.5" "degC" COEFFS 0 1 0 0 0 1 /end COMPU_METHOD
/begin CHARACTERISTIC RDSP_DEFAULT_MULT "Default road speed limiting multiplier" VALUE 0x5DD4C SD_FLOAT32_IEEE 0 SC_RDSP_DEFAULT_MULT 0 1 /end CHARACTERISTIC
/begin COMPU_METHOD SC_RDSP_DEFAULT_MULT "RDSP_DEFAULT_MULT conversion" RAT_FUNC "%10.5" "unitless" COEFFS 0 1 0 0 0 1 /end COMPU_METHOD
/begin CHARACTERISTIC RDSP_EN "Road speed limiting enabled" VALUE 0x5DD60 SD_UBYTE 0 SC_RDSP_EN 0 1 /end CHARACTERISTIC
/begin COMPU_METHOD SC_RDSP_EN "RDSP_EN conversion" RAT_FUNC "%3.0" "unitless" COEFFS 0 1 0 0 0 1 /end COMPU_METHOD
/begin MEASUREMENT RDSP_FILT "Filtered road speed (km/hr)" FLOAT32_IEEE MC_RDSP_FILT 0 0 0 0 ECU_ADDRESS 0x3FA034 /end MEASUREMENT
/begin COMPU_METHOD MC_RDSP_FILT "RDSP_FILT conversion" RAT_FUNC "%10.5" "Unitless" COEFFS 0 1 0 0 0 1 /end COMPU_METHOD
/begin CHARACTERISTIC RDSP_GOV_SEL "Road speed option enable switch" VALUE 0x5DD61 SD_UBYTE 0 SC_RDSP_GOV_SEL 0 1 /end CHARACTERISTIC
/begin COMPU_METHOD SC_RDSP_GOV_SEL "RDSP_GOV_SEL conversion" RAT_FUNC "%3.0" "unitless" COEFFS 0 1 0 0 0 1 /end COMPU_METHOD
/begin CHARACTERISTIC RDSP_LMX "maximum road speed  value" VALUE 0x5D984 SD_FLOAT32_IEEE 0 SC_RDSP_LMX 0 5000 /end CHARACTERISTIC
/begin COMPU_METHOD SC_RDSP_LMX "RDSP_LMX conversion" RAT_FUNC "%10.5" "unitless" COEFFS 0 1 0 0 0 1 /end COMPU_METHOD
/begin MEASUREMENT RDSP_MULT "Road speed multiplier" FLOAT32_IEEE MC_RDSP_MULT 0 0 0 0 ECU_ADDRESS 0x3FA7FC /end MEASUREMENT
/begin COMPU_METHOD MC_RDSP_MULT "RDSP_MULT conversion" RAT_FUNC "%10.5" "Unitless" COEFFS 0 1 0 0 0 1 /end COMPU_METHOD
/begin MEASUREMENT RDSP_OSS_MULT "Road speed multiplier based on OSS" FLOAT32_IEEE MC_RDSP_OSS_MULT 0 0 0 0 ECU_ADDRESS 0x3FA804 /end MEASUREMENT
/begin COMPU_METHOD MC_RDSP_OSS_MULT "RDSP_OSS_MULT conversion" RAT_FUNC "%10.5" "Unitless" COEFFS 0 1 0 0 0 1 /end COMPU_METHOD
/begin MEASUREMENT RDSP_VSS_MULT "Road speed multiplier based on VSS" FLOAT32_IEEE MC_RDSP_VSS_MULT 0 0 0 0 ECU_ADDRESS 0x3FA800 /end MEASUREMENT
/begin COMPU_METHOD MC_RDSP_VSS_MULT "RDSP_VSS_MULT conversion" RAT_FUNC "%10.5" "Unitless" COEFFS 0 1 0 0 0 1 /end COMPU_METHOD
/begin MEASUREMENT READY_FLAGS "Bitmapped register containing OBDII ready flags & MIL_ON flag." UBYTE MC_READY_FLAGS 0 0 0 0 ECU_ADDRESS 0x3FCD09 /end MEASUREMENT
/begin COMPU_METHOD MC_READY_FLAGS "READY_FLAGS conversion" RAT_FUNC "%3.0" "Unitless" COEFFS 0 1 0 0 0 1 /end COMPU_METHOD
/begin MEASUREMENT RENUM_PKT "Diagnostic tool has requested renumbering of Rapid Data packets to include group information." UBYTE MC_RENUM_PKT 0 0 0 0 ECU_ADDRESS 0x3FB435 /end MEASUREMENT
/begin COMPU_METHOD MC_RENUM_PKT "RENUM_PKT conversion" RAT_FUNC "%3.0" "Unitless" COEFFS 0 1 0 0 0 1 /end COMPU_METHOD
/begin MEASUREMENT REQ_NORMAL_MODE_OFF "Diagnostics CAN communications enable/disable flag" UBYTE MC_REQ_NORMAL_MODE_OFF 0 0 0 0 ECU_ADDRESS 0x3FB4A8 /end MEASUREMENT
/begin COMPU_METHOD MC_REQ_NORMAL_MODE_OFF "REQ_NORMAL_MODE_OFF conversion" RAT_FUNC "%3.0" "Unitless" COEFFS 0 1 0 0 0 1 /end COMPU_METHOD
/begin MEASUREMENT RESEED_CON1 "" UBYTE MC_RESEED_CON1 0 0 0 0 ECU_ADDRESS 0x3FA7B7 /end MEASUREMENT
/begin COMPU_METHOD MC_RESEED_CON1 "RESEED_CON1 conversion" RAT_FUNC "%3.0" "Unitless" COEFFS 0 1 0 0 0 1 /end COMPU_METHOD
/begin MEASUREMENT RESEED_CON2 "" UBYTE MC_RESEED_CON2 0 0 0 0 ECU_ADDRESS 0x3FA7B6 /end MEASUREMENT
/begin COMPU_METHOD MC_RESEED_CON2 "RESEED_CON2 conversion" RAT_FUNC "%3.0" "Unitless" COEFFS 0 1 0 0 0 1 /end COMPU_METHOD
/begin MEASUREMENT RESEED_I "0=Allow reseed of  governor 'I' term" UBYTE MC_RESEED_I 0 0 0 0 ECU_ADDRESS 0x3FA7BB /end MEASUREMENT
/begin COMPU_METHOD MC_RESEED_I "RESEED_I conversion" RAT_FUNC "%3.0" "Unitless" COEFFS 0 1 0 0 0 1 /end COMPU_METHOD
/begin MEASUREMENT RESET_DONE "OBDII reset occurred last loop." UBYTE MC_RESET_DONE 0 0 0 0 ECU_ADDRESS 0x3F9E11 /end MEASUREMENT
/begin COMPU_METHOD MC_RESET_DONE "RESET_DONE conversion" RAT_FUNC "%3.0" "Unitless" COEFFS 0 1 0 0 0 1 /end COMPU_METHOD
/begin CHARACTERISTIC RESET_KAM "Calibration switch to reset KAM, 1 - resets and initializes KAM parameters" VALUE 0x5EAD9 SD_UBYTE 0 SC_RESET_KAM 0 1 /end CHARACTERISTIC
/begin COMPU_METHOD SC_RESET_KAM "RESET_KAM conversion" RAT_FUNC "%3.0" "unitless" COEFFS 0 1 0 0 0 1 /end COMPU_METHOD
/begin MEASUREMENT RESET_TRIPS_FLG "1 = An OBD-II trip reset is requested internal to the diagnostic executive" UBYTE MC_RESET_TRIPS_FLG 0 0 0 0 ECU_ADDRESS 0x3F9E71 /end MEASUREMENT
/begin COMPU_METHOD MC_RESET_TRIPS_FLG "RESET_TRIPS_FLG conversion" RAT_FUNC "%3.0" "Unitless" COEFFS 0 1 0 0 0 1 /end COMPU_METHOD
/begin MEASUREMENT RESP_CTR "Count of the number of starts without an authenticated OK msg. from the PATS module." UBYTE MC_RESP_CTR 0 0 0 0 ECU_ADDRESS 0x3FCC9D /end MEASUREMENT
/begin COMPU_METHOD MC_RESP_CTR "RESP_CTR conversion" RAT_FUNC "%3.0" "Unitless" COEFFS 0 1 0 0 0 1 /end COMPU_METHOD
/begin MEASUREMENT RESULTS "Flag indicating self-test results are available. 1->results available." UBYTE MC_RESULTS 0 0 0 0 ECU_ADDRESS 0x3F9E31 /end MEASUREMENT
/begin COMPU_METHOD MC_RESULTS "RESULTS conversion" RAT_FUNC "%3.0" "Unitless" COEFFS 0 1 0 0 0 1 /end COMPU_METHOD
/begin MEASUREMENT RISE_EDGE_TOOTH "" UBYTE MC_RISE_EDGE_TOOTH 0 0 0 0 ECU_ADDRESS 0x3FB6E8 /end MEASUREMENT
/begin COMPU_METHOD MC_RISE_EDGE_TOOTH "RISE_EDGE_TOOTH conversion" RAT_FUNC "%3.0" "Unitless" COEFFS 0 1 0 0 0 1 /end COMPU_METHOD
/begin MEASUREMENT RMFGOV_PI "Raw PI value, unclamped (mg/stroke)" FLOAT32_IEEE MC_RMFGOV_PI 0 0 0 0 ECU_ADDRESS 0x3FA770 /end MEASUREMENT
/begin COMPU_METHOD MC_RMFGOV_PI "RMFGOV_PI conversion" RAT_FUNC "%10.5" "Unitless" COEFFS 0 1 0 0 0 1 /end COMPU_METHOD
/begin MEASUREMENT ROLL_ODO "Distance travelled during background loops; 1/8000 mile. Rolls over, no max clip." FLOAT32_IEEE MC_ROLL_ODO 0 0 0 0 ECU_ADDRESS 0x3FA028 /end MEASUREMENT
/begin COMPU_METHOD MC_ROLL_ODO "ROLL_ODO conversion" RAT_FUNC "%10.5" "Unitless" COEFFS 0 1 0 0 0 1 /end COMPU_METHOD
/begin MEASUREMENT ROL_ODO_ACC "Rolling odometer used to accumulate frational kilometers." FLOAT32_IEEE MC_ROL_ODO_ACC 0 0 0 0 ECU_ADDRESS 0x3FCD10 /end MEASUREMENT
/begin COMPU_METHOD MC_ROL_ODO_ACC "ROL_ODO_ACC conversion" RAT_FUNC "%10.5" "Unitless" COEFFS 0 1 0 0 0 1 /end COMPU_METHOD
/begin CHARACTERISTIC ROM_ENCRYPTION_KEYS[0] "Encryption keys for encrypted checksum" VALUE 0x5A8FC SD_ULONG 0 SC_ROM_ENCRYPTION_KEYS 0 1e+07 /end CHARACTERISTIC
/begin COMPU_METHOD SC_ROM_ENCRYPTION_KEYS "ROM_ENCRYPTION_KEYS conversion" RAT_FUNC "%10.0" "unitless" COEFFS 0 1 0 0 0 1 /end COMPU_METHOD
/begin CHARACTERISTIC ROM_ENCRYPTION_KEYS[1] "Encryption keys for encrypted checksum" VALUE 0x5A900 SD_ULONG 0 SC_ROM_ENCRYPTION_KEYS 0 1e+07 /end CHARACTERISTIC
/begin CHARACTERISTIC ROM_ENCRYPTION_KEYS[2] "Encryption keys for encrypted checksum" VALUE 0x5A904 SD_ULONG 0 SC_ROM_ENCRYPTION_KEYS 0 1e+07 /end CHARACTERISTIC
/begin CHARACTERISTIC ROM_ENCRYPTION_KEYS[3] "Encryption keys for encrypted checksum" VALUE 0x5A908 SD_ULONG 0 SC_ROM_ENCRYPTION_KEYS 0 1e+07 /end CHARACTERISTIC
/begin CHARACTERISTIC ROM_ENCRYPTION_KEYS[4] "Encryption keys for encrypted checksum" VALUE 0x5A90C SD_ULONG 0 SC_ROM_ENCRYPTION_KEYS 0 1e+07 /end CHARACTERISTIC
/begin CHARACTERISTIC ROM_ENCRYPTION_KEYS[5] "Encryption keys for encrypted checksum" VALUE 0x5A910 SD_ULONG 0 SC_ROM_ENCRYPTION_KEYS 0 1e+07 /end CHARACTERISTIC
/begin CHARACTERISTIC ROM_ENCRYPTION_KEYS[6] "Encryption keys for encrypted checksum" VALUE 0x5A914 SD_ULONG 0 SC_ROM_ENCRYPTION_KEYS 0 1e+07 /end CHARACTERISTIC
/begin CHARACTERISTIC ROM_ENCRYPTION_KEYS[7] "Encryption keys for encrypted checksum" VALUE 0x5A918 SD_ULONG 0 SC_ROM_ENCRYPTION_KEYS 0 1e+07 /end CHARACTERISTIC
/begin MEASUREMENT RPD_PKT_EN[0] "Enable bits for Rapid Packets.  (1=Packet Enable, 0 = Packet Disabled.)" UBYTE MC_RPD_PKT_EN 0 0 0 1 ECU_ADDRESS 0x3FC1BC /end MEASUREMENT
/begin COMPU_METHOD MC_RPD_PKT_EN "RPD_PKT_EN conversion" RAT_FUNC "%3.0" "unitless" COEFFS 0 1 0 0 0 1 /end COMPU_METHOD
/begin MEASUREMENT RPD_PKT_EN[10] "Enable bits for Rapid Packets.  (1=Packet Enable, 0 = Packet Disabled.)" UBYTE MC_RPD_PKT_EN 0 0 0 1 ECU_ADDRESS 0x3FC1C6 /end MEASUREMENT
/begin MEASUREMENT RPD_PKT_EN[11] "Enable bits for Rapid Packets.  (1=Packet Enable, 0 = Packet Disabled.)" UBYTE MC_RPD_PKT_EN 0 0 0 1 ECU_ADDRESS 0x3FC1C7 /end MEASUREMENT
/begin MEASUREMENT RPD_PKT_EN[12] "Enable bits for Rapid Packets.  (1=Packet Enable, 0 = Packet Disabled.)" UBYTE MC_RPD_PKT_EN 0 0 0 1 ECU_ADDRESS 0x3FC1C8 /end MEASUREMENT
/begin MEASUREMENT RPD_PKT_EN[13] "Enable bits for Rapid Packets.  (1=Packet Enable, 0 = Packet Disabled.)" UBYTE MC_RPD_PKT_EN 0 0 0 1 ECU_ADDRESS 0x3FC1C9 /end MEASUREMENT
/begin MEASUREMENT RPD_PKT_EN[14] "Enable bits for Rapid Packets.  (1=Packet Enable, 0 = Packet Disabled.)" UBYTE MC_RPD_PKT_EN 0 0 0 1 ECU_ADDRESS 0x3FC1CA /end MEASUREMENT
/begin MEASUREMENT RPD_PKT_EN[1] "Enable bits for Rapid Packets.  (1=Packet Enable, 0 = Packet Disabled.)" UBYTE MC_RPD_PKT_EN 0 0 0 1 ECU_ADDRESS 0x3FC1BD /end MEASUREMENT
/begin MEASUREMENT RPD_PKT_EN[2] "Enable bits for Rapid Packets.  (1=Packet Enable, 0 = Packet Disabled.)" UBYTE MC_RPD_PKT_EN 0 0 0 1 ECU_ADDRESS 0x3FC1BE /end MEASUREMENT
/begin MEASUREMENT RPD_PKT_EN[3] "Enable bits for Rapid Packets.  (1=Packet Enable, 0 = Packet Disabled.)" UBYTE MC_RPD_PKT_EN 0 0 0 1 ECU_ADDRESS 0x3FC1BF /end MEASUREMENT
/begin MEASUREMENT RPD_PKT_EN[4] "Enable bits for Rapid Packets.  (1=Packet Enable, 0 = Packet Disabled.)" UBYTE MC_RPD_PKT_EN 0 0 0 1 ECU_ADDRESS 0x3FC1C0 /end MEASUREMENT
/begin MEASUREMENT RPD_PKT_EN[5] "Enable bits for Rapid Packets.  (1=Packet Enable, 0 = Packet Disabled.)" UBYTE MC_RPD_PKT_EN 0 0 0 1 ECU_ADDRESS 0x3FC1C1 /end MEASUREMENT
/begin MEASUREMENT RPD_PKT_EN[6] "Enable bits for Rapid Packets.  (1=Packet Enable, 0 = Packet Disabled.)" UBYTE MC_RPD_PKT_EN 0 0 0 1 ECU_ADDRESS 0x3FC1C2 /end MEASUREMENT
/begin MEASUREMENT RPD_PKT_EN[7] "Enable bits for Rapid Packets.  (1=Packet Enable, 0 = Packet Disabled.)" UBYTE MC_RPD_PKT_EN 0 0 0 1 ECU_ADDRESS 0x3FC1C3 /end MEASUREMENT
/begin MEASUREMENT RPD_PKT_EN[8] "Enable bits for Rapid Packets.  (1=Packet Enable, 0 = Packet Disabled.)" UBYTE MC_RPD_PKT_EN 0 0 0 1 ECU_ADDRESS 0x3FC1C4 /end MEASUREMENT
/begin MEASUREMENT RPD_PKT_EN[9] "Enable bits for Rapid Packets.  (1=Packet Enable, 0 = Packet Disabled.)" UBYTE MC_RPD_PKT_EN 0 0 0 1 ECU_ADDRESS 0x3FC1C5 /end MEASUREMENT
/begin MEASUREMENT RPD_PKT_PTR "Index pointer indicating  Rapid Data Packet that will be checked next." UBYTE MC_RPD_PKT_PTR 0 0 0 0 ECU_ADDRESS 0x3FB4B4 /end MEASUREMENT
/begin COMPU_METHOD MC_RPD_PKT_PTR "RPD_PKT_PTR conversion" RAT_FUNC "%3.0" "Unitless" COEFFS 0 1 0 0 0 1 /end COMPU_METHOD
/begin MEASUREMENT RQST_4X4L "Driver requested 4x4L" UBYTE MC_RQST_4X4L 0 0 0 0 ECU_ADDRESS 0x3FA2A9 /end MEASUREMENT
/begin COMPU_METHOD MC_RQST_4X4L "RQST_4X4L conversion" RAT_FUNC "%3.0" "Unitless" COEFFS 0 1 0 0 0 1 /end COMPU_METHOD
/begin CHARACTERISTIC RT_AXLE "Axle ratio; used in conjunction with TIRE_REV to compute OSS/VSS ratio." VALUE 0x5D18C SD_FLOAT32_IEEE 0 SC_RT_AXLE 1 6 /end CHARACTERISTIC
/begin COMPU_METHOD SC_RT_AXLE "RT_AXLE conversion" RAT_FUNC "%10.5" "unitless" COEFFS 0 1 0 0 0 1 /end COMPU_METHOD
/begin CHARACTERISTIC RT_AXLE_MN "Minimum allowable axle ratio to be emission compliant; used in conjunction with TIRE_REV to compute OSS/VSS ratio." VALUE 0x5EF74 SD_FLOAT32_IEEE 0 SC_RT_AXLE_MN 1 63.999 /end CHARACTERISTIC
/begin COMPU_METHOD SC_RT_AXLE_MN "RT_AXLE_MN conversion" RAT_FUNC "%10.5" "unitless" COEFFS 0 1 0 0 0 1 /end COMPU_METHOD
/begin CHARACTERISTIC RT_AXLE_MX "Maximum allowable axle ratio to be emission compliant; used in conjunction with TIRE_REV to compute OSS/VSS ratio." VALUE 0x5EF70 SD_FLOAT32_IEEE 0 SC_RT_AXLE_MX 1 63.999 /end CHARACTERISTIC
/begin COMPU_METHOD SC_RT_AXLE_MX "RT_AXLE_MX conversion" RAT_FUNC "%10.5" "unitless" COEFFS 0 1 0 0 0 1 /end COMPU_METHOD
/begin MEASUREMENT RUN_LATCH_FLG "engine in run mode" UBYTE MC_RUN_LATCH_FLG 0 0 0 0 ECU_ADDRESS 0x3FA8B3 /end MEASUREMENT
/begin COMPU_METHOD MC_RUN_LATCH_FLG "RUN_LATCH_FLG conversion" RAT_FUNC "%3.0" "Unitless" COEFFS 0 1 0 0 0 1 /end COMPU_METHOD
/begin MEASUREMENT RUN_MODE_OTM "OTM MODE: 1-> ENABLE, 0->DISABLE" UBYTE MC_RUN_MODE_OTM 0 0 0 0 ECU_ADDRESS 0x3FB51A /end MEASUREMENT
/begin COMPU_METHOD MC_RUN_MODE_OTM "RUN_MODE_OTM conversion" RAT_FUNC "%3.0" "Unitless" COEFFS 0 1 0 0 0 1 /end COMPU_METHOD
/begin MEASUREMENT RUN_TMR "TIME IN RUN MODE" FLOAT32_IEEE MC_RUN_TMR 0 0 0 0 ECU_ADDRESS 0x3FB5D0 /end MEASUREMENT
/begin COMPU_METHOD MC_RUN_TMR "RUN_TMR conversion" RAT_FUNC "%10.5" "Unitless" COEFFS 0 1 0 0 0 1 /end COMPU_METHOD
/begin MEASUREMENT RX_INCODE1 "First byte of incode data received over SCP network for ANTI-THEFT coded access." UBYTE MC_RX_INCODE1 0 0 0 0 ECU_ADDRESS 0x3FB4A6 /end MEASUREMENT
/begin COMPU_METHOD MC_RX_INCODE1 "RX_INCODE1 conversion" RAT_FUNC "%3.0" "Unitless" COEFFS 0 1 0 0 0 1 /end COMPU_METHOD
/begin MEASUREMENT RX_INCODE2 "Second byte of incode data received over SCP network for ANTI-THEFT coded access." UBYTE MC_RX_INCODE2 0 0 0 0 ECU_ADDRESS 0x3FB4A5 /end MEASUREMENT
/begin COMPU_METHOD MC_RX_INCODE2 "RX_INCODE2 conversion" RAT_FUNC "%3.0" "Unitless" COEFFS 0 1 0 0 0 1 /end COMPU_METHOD
/begin MEASUREMENT SAFTOT "TOTAL SPARK ADVANCE" FLOAT32_IEEE MC_SAFTOT 0 0 0 0 ECU_ADDRESS 0x3F9C58 /end MEASUREMENT
/begin COMPU_METHOD MC_SAFTOT "SAFTOT conversion" RAT_FUNC "%10.5" "Unitless" COEFFS 0 1 0 0 0 1 /end COMPU_METHOD
/begin MEASUREMENT SAIR_COUNT "Count of the number of complete sair tests since KAM reset." UBYTE MC_SAIR_COUNT 0 0 0 0 ECU_ADDRESS 0x3FCD0C /end MEASUREMENT
/begin COMPU_METHOD MC_SAIR_COUNT "SAIR_COUNT conversion" RAT_FUNC "%3.0" "Unitless" COEFFS 0 1 0 0 0 1 /end COMPU_METHOD
/begin CHARACTERISTIC SAIR_DEL_TM "Time delay between succesive runs of the SAIR monitor." VALUE 0x5CE2D SD_UBYTE 0 SC_SAIR_DEL_TM 0 127 /end CHARACTERISTIC
/begin COMPU_METHOD SC_SAIR_DEL_TM "SAIR_DEL_TM conversion" RAT_FUNC "%3.0" "s" COEFFS 0 1 0 0 0 1 /end COMPU_METHOD
/begin MEASUREMENT SAIR_DEL_TMR "Time since abort of the SAIR monitor." FLOAT32_IEEE MC_SAIR_DEL_TMR 0 0 0 0 ECU_ADDRESS 0x3F9E68 /end MEASUREMENT
/begin COMPU_METHOD MC_SAIR_DEL_TMR "SAIR_DEL_TMR conversion" RAT_FUNC "%10.5" "Unitless" COEFFS 0 1 0 0 0 1 /end COMPU_METHOD
/begin MEASUREMENT SAIR_FMEM "SAIR system FMEM flag.  1 -> don't run SAIR monitor due to FMEM." UBYTE MC_SAIR_FMEM 0 0 0 0 ECU_ADDRESS 0x3F9E5C /end MEASUREMENT
/begin COMPU_METHOD MC_SAIR_FMEM "SAIR_FMEM conversion" RAT_FUNC "%3.0" "Unitless" COEFFS 0 1 0 0 0 1 /end COMPU_METHOD
/begin MEASUREMENT SAIR_MON "Secomdary air has been monitored for OBD-II trip" UBYTE MC_SAIR_MON 0 0 0 0 ECU_ADDRESS 0x3F9CDB /end MEASUREMENT
/begin COMPU_METHOD MC_SAIR_MON "SAIR_MON conversion" RAT_FUNC "%3.0" "Unitless" COEFFS 0 1 0 0 0 1 /end COMPU_METHOD
/begin MEASUREMENT SAIR_TST_ENA "OBD-II Secondary Air Test enable flag. (1 => test enabled)" UBYTE MC_SAIR_TST_ENA 0 0 0 0 ECU_ADDRESS 0x3F9E3C /end MEASUREMENT
/begin COMPU_METHOD MC_SAIR_TST_ENA "SAIR_TST_ENA conversion" RAT_FUNC "%3.0" "Unitless" COEFFS 0 1 0 0 0 1 /end COMPU_METHOD
/begin MEASUREMENT SAIR_TST_RDY "SAIR test ready flag; 1-> all local conditoins have been met; ready to run test." UBYTE MC_SAIR_TST_RDY 0 0 0 0 ECU_ADDRESS 0x3F9CD5 /end MEASUREMENT
/begin COMPU_METHOD MC_SAIR_TST_RDY "SAIR_TST_RDY conversion" RAT_FUNC "%3.0" "Unitless" COEFFS 0 1 0 0 0 1 /end COMPU_METHOD
/begin MEASUREMENT SCCS_ACCU_ARY[0] "" UWORD MC_SCCS_ACCU_ARY 0 0 0 65535 ECU_ADDRESS 0x3FBE34 /end MEASUREMENT
/begin COMPU_METHOD MC_SCCS_ACCU_ARY "SCCS_ACCU_ARY conversion" RAT_FUNC "%5.0" "unitless" COEFFS 0 1 0 0 0 1 /end COMPU_METHOD
/begin MEASUREMENT SCCS_ACCU_ARY[1] "" UWORD MC_SCCS_ACCU_ARY 0 0 0 65535 ECU_ADDRESS 0x3FBE36 /end MEASUREMENT
/begin MEASUREMENT SCCS_ACCU_ARY[2] "" UWORD MC_SCCS_ACCU_ARY 0 0 0 65535 ECU_ADDRESS 0x3FBE38 /end MEASUREMENT
/begin MEASUREMENT SCCS_ACCU_ARY[3] "" UWORD MC_SCCS_ACCU_ARY 0 0 0 65535 ECU_ADDRESS 0x3FBE3A /end MEASUREMENT
/begin MEASUREMENT SCCS_ACCU_ARY[4] "" UWORD MC_SCCS_ACCU_ARY 0 0 0 65535 ECU_ADDRESS 0x3FBE3C /end MEASUREMENT
/begin MEASUREMENT SCCS_ACCU_ARY[5] "" UWORD MC_SCCS_ACCU_ARY 0 0 0 65535 ECU_ADDRESS 0x3FBE3E /end MEASUREMENT
/begin CHARACTERISTIC SCCS_ACCU_DSTEP "Accumulator decrement step size in counts." VALUE 0x5D734 SD_UBYTE 0 SC_SCCS_ACCU_DSTEP 0 255 /end CHARACTERISTIC
/begin COMPU_METHOD SC_SCCS_ACCU_DSTEP "SCCS_ACCU_DSTEP conversion" RAT_FUNC "%3.0" "unitless" COEFFS 0 1 0 0 0 1 /end COMPU_METHOD
/begin CHARACTERISTIC SCCS_ACCU_ISTEP "Accumulator increment step size in counts." VALUE 0x5D735 SD_UBYTE 0 SC_SCCS_ACCU_ISTEP 0 255 /end CHARACTERISTIC
/begin COMPU_METHOD SC_SCCS_ACCU_ISTEP "SCCS_ACCU_ISTEP conversion" RAT_FUNC "%3.0" "unitless" COEFFS 0 1 0 0 0 1 /end COMPU_METHOD
/begin MEASUREMENT SCCS_AD_COUNT "" FLOAT32_IEEE MC_SCCS_AD_COUNT 0 0 0 0 ECU_ADDRESS 0x3FA4FC /end MEASUREMENT
/begin COMPU_METHOD MC_SCCS_AD_COUNT "SCCS_AD_COUNT conversion" RAT_FUNC "%10.5" "Unitless" COEFFS 0 1 0 0 0 1 /end COMPU_METHOD
/begin CHARACTERISTIC SCCS_AD_TC "" VALUE 0x5D720 SD_FLOAT32_IEEE 0 SC_SCCS_AD_TC 0 1000 /end CHARACTERISTIC
/begin COMPU_METHOD SC_SCCS_AD_TC "SCCS_AD_TC conversion" RAT_FUNC "%10.5" "unitless" COEFFS 0 1 0 0 0 1 /end COMPU_METHOD
/begin MEASUREMENT SCCS_ATOD "Speed Control Command Value from analog input, urd 22626" UWORD MC_SCCS_ATOD 0 0 0 0 ECU_ADDRESS 0x3F9A60 /end MEASUREMENT
/begin COMPU_METHOD MC_SCCS_ATOD "SCCS_ATOD conversion" RAT_FUNC "%5.0" "Unitless" COEFFS 0 1 0 0 0 1 /end COMPU_METHOD
/begin CHARACTERISTIC SCCS_CNT_DEF "" VALUE 0x5D72C SD_SLONG 0 SC_SCCS_CNT_DEF 0 1023 /end CHARACTERISTIC
/begin COMPU_METHOD SC_SCCS_CNT_DEF "SCCS_CNT_DEF conversion" RAT_FUNC "%10.0" "unitless" COEFFS 0 1 0 0 0 1 /end COMPU_METHOD
/begin MEASUREMENT SCCS_CNT_STATUS "" UBYTE MC_SCCS_CNT_STATUS 0 0 0 0 ECU_ADDRESS 0x3FB768 /end MEASUREMENT
/begin COMPU_METHOD MC_SCCS_CNT_STATUS "SCCS_CNT_STATUS conversion" RAT_FUNC "%3.0" "Unitless" COEFFS 0 1 0 0 0 1 /end COMPU_METHOD
/begin MEASUREMENT SCCS_COUNTER "" UBYTE MC_SCCS_COUNTER 0 0 0 0 ECU_ADDRESS 0x3FA506 /end MEASUREMENT
/begin COMPU_METHOD MC_SCCS_COUNTER "SCCS_COUNTER conversion" RAT_FUNC "%3.0" "Unitless" COEFFS 0 1 0 0 0 1 /end COMPU_METHOD
/begin MEASUREMENT SCCS_EVENT_TIME "Time stamp of speed control command input" ULONG MC_SCCS_EVENT_TIME 0 0 0 0 ECU_ADDRESS 0x3F9A5C /end MEASUREMENT
/begin COMPU_METHOD MC_SCCS_EVENT_TIME "SCCS_EVENT_TIME conversion" RAT_FUNC "%10.0" "Unitless" COEFFS 0 1 0 0 0 1 /end COMPU_METHOD
/begin MEASUREMENT SCCS_FLG_ST "" UBYTE MC_SCCS_FLG_ST 0 0 0 0 ECU_ADDRESS 0x3FA507 /end MEASUREMENT
/begin COMPU_METHOD MC_SCCS_FLG_ST "SCCS_FLG_ST conversion" RAT_FUNC "%3.0" "Unitless" COEFFS 0 1 0 0 0 1 /end COMPU_METHOD
/begin CHARACTERISTIC SCCS_F_INC "" VALUE 0x5D728 SD_SLONG 0 SC_SCCS_F_INC 0 65535 /end CHARACTERISTIC
/begin COMPU_METHOD SC_SCCS_F_INC "SCCS_F_INC conversion" RAT_FUNC "%10.0" "unitless" COEFFS 0 1 0 0 0 1 /end COMPU_METHOD
/begin CHARACTERISTIC SCCS_MAX_ARY[0] "" VALUE 0x4445C SD_UWORD 0 SC_SCCS_MAX_ARY 0 1023 /end CHARACTERISTIC
/begin COMPU_METHOD SC_SCCS_MAX_ARY "SCCS_MAX_ARY conversion" RAT_FUNC "%5.0" "unitless" COEFFS 0 1 0 0 0 1 /end COMPU_METHOD
/begin CHARACTERISTIC SCCS_MAX_ARY[1] "" VALUE 0x4445E SD_UWORD 0 SC_SCCS_MAX_ARY 0 1023 /end CHARACTERISTIC
/begin CHARACTERISTIC SCCS_MAX_ARY[2] "" VALUE 0x44460 SD_UWORD 0 SC_SCCS_MAX_ARY 0 1023 /end CHARACTERISTIC
/begin CHARACTERISTIC SCCS_MAX_ARY[3] "" VALUE 0x44462 SD_UWORD 0 SC_SCCS_MAX_ARY 0 1023 /end CHARACTERISTIC
/begin CHARACTERISTIC SCCS_MAX_ARY[4] "" VALUE 0x44464 SD_UWORD 0 SC_SCCS_MAX_ARY 0 1023 /end CHARACTERISTIC
/begin CHARACTERISTIC SCCS_MAX_ARY[5] "" VALUE 0x44466 SD_UWORD 0 SC_SCCS_MAX_ARY 0 1023 /end CHARACTERISTIC
/begin MEASUREMENT SCCS_OFF_PID "The speed control OFF switch position ( 1 = switch activation detected)" UBYTE MC_SCCS_OFF_PID 0 0 0 0 ECU_ADDRESS 0x3F9CC7 /end MEASUREMENT
/begin COMPU_METHOD MC_SCCS_OFF_PID "SCCS_OFF_PID conversion" RAT_FUNC "%3.0" "Unitless" COEFFS 0 1 0 0 0 1 /end COMPU_METHOD
/begin MEASUREMENT SCCS_ON_PID "The speed control ON switch position ( 1 = switch activation detected)" UBYTE MC_SCCS_ON_PID 0 0 0 0 ECU_ADDRESS 0x3F9CC6 /end MEASUREMENT
/begin COMPU_METHOD MC_SCCS_ON_PID "SCCS_ON_PID conversion" RAT_FUNC "%3.0" "Unitless" COEFFS 0 1 0 0 0 1 /end COMPU_METHOD
/begin MEASUREMENT SCCS_ORH_CNTR "" SLONG MC_SCCS_ORH_CNTR 0 0 0 0 ECU_ADDRESS 0x3FA4F8 /end MEASUREMENT
/begin COMPU_METHOD MC_SCCS_ORH_CNTR "SCCS_ORH_CNTR conversion" RAT_FUNC "%10.0" "Unitless" COEFFS 0 1 0 0 0 1 /end COMPU_METHOD
/begin CHARACTERISTIC SCCS_ORH_LIM "High count limit for ORH error." VALUE 0x5D730 SD_UWORD 0 SC_SCCS_ORH_LIM 0 1023 /end CHARACTERISTIC
/begin COMPU_METHOD SC_SCCS_ORH_LIM "SCCS_ORH_LIM conversion" RAT_FUNC "%5.0" "unitless" COEFFS 0 1 0 0 0 1 /end COMPU_METHOD
/begin MEASUREMENT SCCS_ORL_CNTR "" SLONG MC_SCCS_ORL_CNTR 0 0 0 0 ECU_ADDRESS 0x3FA4F4 /end MEASUREMENT
/begin COMPU_METHOD MC_SCCS_ORL_CNTR "SCCS_ORL_CNTR conversion" RAT_FUNC "%10.0" "Unitless" COEFFS 0 1 0 0 0 1 /end COMPU_METHOD
/begin CHARACTERISTIC SCCS_ORL_LIM "Low count limit for ORL error." VALUE 0x5D732 SD_UWORD 0 SC_SCCS_ORL_LIM 0 1023 /end CHARACTERISTIC
/begin COMPU_METHOD SC_SCCS_ORL_LIM "SCCS_ORL_LIM conversion" RAT_FUNC "%5.0" "unitless" COEFFS 0 1 0 0 0 1 /end COMPU_METHOD
/begin CHARACTERISTIC SCCS_R_DEC "" VALUE 0x5D724 SD_SLONG 0 SC_SCCS_R_DEC 0 65535 /end CHARACTERISTIC
/begin COMPU_METHOD SC_SCCS_R_DEC "SCCS_R_DEC conversion" RAT_FUNC "%10.0" "unitless" COEFFS 0 1 0 0 0 1 /end COMPU_METHOD
/begin MEASUREMENT SCCS_STATE "" UBYTE MC_SCCS_STATE 0 0 0 0 ECU_ADDRESS 0x3FA509 /end MEASUREMENT
/begin COMPU_METHOD MC_SCCS_STATE "SCCS_STATE conversion" RAT_FUNC "%3.0" "Unitless" COEFFS 0 1 0 0 0 1 /end COMPU_METHOD
/begin MEASUREMENT SCCS_STATE_TMP "" UBYTE MC_SCCS_STATE_TMP 0 0 0 0 ECU_ADDRESS 0x3FA508 /end MEASUREMENT
/begin COMPU_METHOD MC_SCCS_STATE_TMP "SCCS_STATE_TMP conversion" RAT_FUNC "%3.0" "Unitless" COEFFS 0 1 0 0 0 1 /end COMPU_METHOD
/begin CHARACTERISTIC SCCS_THR_ARY[0] "" VALUE 0x44468 SD_UWORD 0 SC_SCCS_THR_ARY 0 65535 /end CHARACTERISTIC
/begin COMPU_METHOD SC_SCCS_THR_ARY "SCCS_THR_ARY conversion" RAT_FUNC "%5.0" "unitless" COEFFS 0 1 0 0 0 1 /end COMPU_METHOD
/begin CHARACTERISTIC SCCS_THR_ARY[1] "" VALUE 0x4446A SD_UWORD 0 SC_SCCS_THR_ARY 0 65535 /end CHARACTERISTIC
/begin CHARACTERISTIC SCCS_THR_ARY[2] "" VALUE 0x4446C SD_UWORD 0 SC_SCCS_THR_ARY 0 65535 /end CHARACTERISTIC
/begin CHARACTERISTIC SCCS_THR_ARY[3] "" VALUE 0x4446E SD_UWORD 0 SC_SCCS_THR_ARY 0 65535 /end CHARACTERISTIC
/begin CHARACTERISTIC SCCS_THR_ARY[4] "" VALUE 0x44470 SD_UWORD 0 SC_SCCS_THR_ARY 0 65535 /end CHARACTERISTIC
/begin CHARACTERISTIC SCCS_THR_ARY[5] "" VALUE 0x44472 SD_UWORD 0 SC_SCCS_THR_ARY 0 65535 /end CHARACTERISTIC
/begin CHARACTERISTIC SCCS_TRNF_PRD "" VALUE 0x5D71C SD_ULONG 0 SC_SCCS_TRNF_PRD 0 100000 /end CHARACTERISTIC
/begin COMPU_METHOD SC_SCCS_TRNF_PRD "SCCS_TRNF_PRD conversion" RAT_FUNC "%10.0" "ms" COEFFS 0 1 0 0 0 1 /end COMPU_METHOD
/begin MEASUREMENT SCCS_TRNF_TMR "" ULONG MC_SCCS_TRNF_TMR 0 0 0 0 ECU_ADDRESS 0x3FA4F0 /end MEASUREMENT
/begin COMPU_METHOD MC_SCCS_TRNF_TMR "SCCS_TRNF_TMR conversion" RAT_FUNC "%10.0" "Unitless" COEFFS 0 1 0 0 0 1 /end COMPU_METHOD
/begin CHARACTERISTIC SCCS_TRNR_PRD "" VALUE 0x5D718 SD_ULONG 0 SC_SCCS_TRNR_PRD 0 100000 /end CHARACTERISTIC
/begin COMPU_METHOD SC_SCCS_TRNR_PRD "SCCS_TRNR_PRD conversion" RAT_FUNC "%10.0" "ms" COEFFS 0 1 0 0 0 1 /end COMPU_METHOD
/begin MEASUREMENT SCCS_TRNR_TMR "" ULONG MC_SCCS_TRNR_TMR 0 0 0 0 ECU_ADDRESS 0x3FA4EC /end MEASUREMENT
/begin COMPU_METHOD MC_SCCS_TRNR_TMR "SCCS_TRNR_TMR conversion" RAT_FUNC "%10.0" "Unitless" COEFFS 0 1 0 0 0 1 /end COMPU_METHOD
/begin MEASUREMENT SCPEO_BUZZ_ACTIVE "Buzz test active flag" UBYTE MC_SCPEO_BUZZ_ACTIVE 0 0 0 0 ECU_ADDRESS 0x3FB483 /end MEASUREMENT
/begin COMPU_METHOD MC_SCPEO_BUZZ_ACTIVE "SCPEO_BUZZ_ACTIVE conversion" RAT_FUNC "%3.0" "Unitless" COEFFS 0 1 0 0 0 1 /end COMPU_METHOD
/begin MEASUREMENT SCPEO_EXIT "Siganl to abort the engine off self test." UBYTE MC_SCPEO_EXIT 0 0 0 0 ECU_ADDRESS 0x3F9E42 /end MEASUREMENT
/begin COMPU_METHOD MC_SCPEO_EXIT "SCPEO_EXIT conversion" RAT_FUNC "%3.0" "Unitless" COEFFS 0 1 0 0 0 1 /end COMPU_METHOD
/begin MEASUREMENT SCPEO_START "Siganl to start the engine off self test." UBYTE MC_SCPEO_START 0 0 0 0 ECU_ADDRESS 0x3F9E45 /end MEASUREMENT
/begin COMPU_METHOD MC_SCPEO_START "SCPEO_START conversion" RAT_FUNC "%3.0" "Unitless" COEFFS 0 1 0 0 0 1 /end COMPU_METHOD
/begin MEASUREMENT SCPER_EXIT "Signal to abort the engine running self test." UBYTE MC_SCPER_EXIT 0 0 0 0 ECU_ADDRESS 0x3F9E41 /end MEASUREMENT
/begin COMPU_METHOD MC_SCPER_EXIT "SCPER_EXIT conversion" RAT_FUNC "%3.0" "Unitless" COEFFS 0 1 0 0 0 1 /end COMPU_METHOD
/begin MEASUREMENT SCPER_GPC_REQ "KOER glow plug test requested" UBYTE MC_SCPER_GPC_REQ 0 0 0 0 ECU_ADDRESS 0x3FB482 /end MEASUREMENT
/begin COMPU_METHOD MC_SCPER_GPC_REQ "SCPER_GPC_REQ conversion" RAT_FUNC "%3.0" "Unitless" COEFFS 0 1 0 0 0 1 /end COMPU_METHOD
/begin MEASUREMENT SCPER_START "Signal to start the engine running self test." UBYTE MC_SCPER_START 0 0 0 0 ECU_ADDRESS 0x3F9E44 /end MEASUREMENT
/begin COMPU_METHOD MC_SCPER_START "SCPER_START conversion" RAT_FUNC "%3.0" "Unitless" COEFFS 0 1 0 0 0 1 /end COMPU_METHOD
/begin MEASUREMENT SCPOTM_EXIT "Signal to abort the output test mode diagnostic procedure." UBYTE MC_SCPOTM_EXIT 0 0 0 0 ECU_ADDRESS 0x3F9E40 /end MEASUREMENT
/begin COMPU_METHOD MC_SCPOTM_EXIT "SCPOTM_EXIT conversion" RAT_FUNC "%3.0" "Unitless" COEFFS 0 1 0 0 0 1 /end COMPU_METHOD
/begin MEASUREMENT SCPOTM_START "Siganl to start output test mode diagnostic procedure." UBYTE MC_SCPOTM_START 0 0 0 0 ECU_ADDRESS 0x3F9E43 /end MEASUREMENT
/begin COMPU_METHOD MC_SCPOTM_START "SCPOTM_START conversion" RAT_FUNC "%3.0" "Unitless" COEFFS 0 1 0 0 0 1 /end COMPU_METHOD
/begin MEASUREMENT SCPPAT_FMFLG "Failure Mode Flag for PATS Key Status input over SCP.  1 = SCP Input failure." UBYTE MC_SCPPAT_FMFLG 0 0 0 0 ECU_ADDRESS 0x3F9D0C /end MEASUREMENT
/begin COMPU_METHOD MC_SCPPAT_FMFLG "SCPPAT_FMFLG conversion" RAT_FUNC "%3.0" "Unitless" COEFFS 0 1 0 0 0 1 /end COMPU_METHOD
/begin MEASUREMENT SCP_ACC_TIM "New Time delay for Timed Secure Access to be stored into EEPROM" UWORD MC_SCP_ACC_TIM 0 0 0 0 ECU_ADDRESS 0x3FB478 /end MEASUREMENT
/begin COMPU_METHOD MC_SCP_ACC_TIM "SCP_ACC_TIM conversion" RAT_FUNC "%5.0" "Unitless" COEFFS 0 1 0 0 0 1 /end COMPU_METHOD
/begin MEASUREMENT SCP_B0_TMR "Indicates time elapsed since the last receipt of 'Request No Stored Codes' message.  Message Mode ID = B0 hex." FLOAT32_IEEE MC_SCP_B0_TMR 0 0 0 0 ECU_ADDRESS 0x3FB428 /end MEASUREMENT
/begin COMPU_METHOD MC_SCP_B0_TMR "SCP_B0_TMR conversion" RAT_FUNC "%10.5" "Unitless" COEFFS 0 1 0 0 0 1 /end COMPU_METHOD
/begin MEASUREMENT SCP_CHL_RSP1 "Security challenge response received from the PATS module over SCP, byte #1." UBYTE MC_SCP_CHL_RSP1 0 0 0 0 ECU_ADDRESS 0x3F9D11 /end MEASUREMENT
/begin COMPU_METHOD MC_SCP_CHL_RSP1 "SCP_CHL_RSP1 conversion" RAT_FUNC "%3.0" "Unitless" COEFFS 0 1 0 0 0 1 /end COMPU_METHOD
/begin MEASUREMENT SCP_CHL_RSP2 "Security challenge response received from the PATS module over SCP, byte #2." UBYTE MC_SCP_CHL_RSP2 0 0 0 0 ECU_ADDRESS 0x3F9D10 /end MEASUREMENT
/begin COMPU_METHOD MC_SCP_CHL_RSP2 "SCP_CHL_RSP2 conversion" RAT_FUNC "%3.0" "Unitless" COEFFS 0 1 0 0 0 1 /end COMPU_METHOD
/begin MEASUREMENT SCP_CHL_RSP3 "Security challenge response received from the PATS module over SCP, byte #3." UBYTE MC_SCP_CHL_RSP3 0 0 0 0 ECU_ADDRESS 0x3F9D0F /end MEASUREMENT
/begin COMPU_METHOD MC_SCP_CHL_RSP3 "SCP_CHL_RSP3 conversion" RAT_FUNC "%3.0" "Unitless" COEFFS 0 1 0 0 0 1 /end COMPU_METHOD
/begin MEASUREMENT SCP_CHL_RSP4 "Security challenge response received from the PATS module over SCP, byte #4." UBYTE MC_SCP_CHL_RSP4 0 0 0 0 ECU_ADDRESS 0x3F9D0E /end MEASUREMENT
/begin COMPU_METHOD MC_SCP_CHL_RSP4 "SCP_CHL_RSP4 conversion" RAT_FUNC "%3.0" "Unitless" COEFFS 0 1 0 0 0 1 /end COMPU_METHOD
/begin MEASUREMENT SCP_COD_ACC "Flag indicating SCP has requested ANTI-THEFT to change to coded access mode." UBYTE MC_SCP_COD_ACC 0 0 0 0 ECU_ADDRESS 0x3FB4A4 /end MEASUREMENT
/begin COMPU_METHOD MC_SCP_COD_ACC "SCP_COD_ACC conversion" RAT_FUNC "%3.0" "Unitless" COEFFS 0 1 0 0 0 1 /end COMPU_METHOD
/begin MEASUREMENT SCP_CONS_TOTAL "Total number of consecutive frames used for diagnostic code reporting" UBYTE MC_SCP_CONS_TOTAL 0 0 0 0 ECU_ADDRESS 0x3F9847 /end MEASUREMENT
/begin COMPU_METHOD MC_SCP_CONS_TOTAL "SCP_CONS_TOTAL conversion" RAT_FUNC "%3.0" "Unitless" COEFFS 0 1 0 0 0 1 /end COMPU_METHOD
/begin MEASUREMENT SCP_DFSO_ENA "Flag set to 1 to activate alternate branches of profile correction and DFSO logic for learning profile at EOL." UBYTE MC_SCP_DFSO_ENA 0 0 0 0 ECU_ADDRESS 0x3FB3BA /end MEASUREMENT
/begin COMPU_METHOD MC_SCP_DFSO_ENA "SCP_DFSO_ENA conversion" RAT_FUNC "%3.0" "Unitless" COEFFS 0 1 0 0 0 1 /end COMPU_METHOD
/begin MEASUREMENT SCP_DIAG_ST "Current level of On-Demand State Machine" UBYTE MC_SCP_DIAG_ST 0 0 0 0 ECU_ADDRESS 0x3FB434 /end MEASUREMENT
/begin COMPU_METHOD MC_SCP_DIAG_ST "SCP_DIAG_ST conversion" RAT_FUNC "%3.0" "Unitless" COEFFS 0 1 0 0 0 1 /end COMPU_METHOD
/begin CHARACTERISTIC SCP_DT1 "Time delay to begin transmitting SCP network initialization message set." VALUE 0x5C306 SD_UWORD 0 SC_SCP_DT1 0 65535 /end CHARACTERISTIC
/begin COMPU_METHOD SC_SCP_DT1 "SCP_DT1 conversion" RAT_FUNC "%5.0" "ms" COEFFS 0 1 0 0 0 1 /end COMPU_METHOD
/begin CHARACTERISTIC SCP_DT2 "Time delay to begin transmitting SCP status request messages." VALUE 0x5C304 SD_UWORD 0 SC_SCP_DT2 0 65535 /end CHARACTERISTIC
/begin COMPU_METHOD SC_SCP_DT2 "SCP_DT2 conversion" RAT_FUNC "%5.0" "ms" COEFFS 0 1 0 0 0 1 /end COMPU_METHOD
/begin MEASUREMENT SCP_DWNLD_ST "Current level of Download & Execute State Machine." UBYTE MC_SCP_DWNLD_ST 0 0 0 0 ECU_ADDRESS 0x3FB4AC /end MEASUREMENT
/begin COMPU_METHOD MC_SCP_DWNLD_ST "SCP_DWNLD_ST conversion" RAT_FUNC "%3.0" "Unitless" COEFFS 0 1 0 0 0 1 /end COMPU_METHOD
/begin MEASUREMENT SCP_ERA_KEYS "Flag indicating SCP has requested that all keys stored be erased by the ANTI-THEFT feature." UBYTE MC_SCP_ERA_KEYS 0 0 0 0 ECU_ADDRESS 0x3FB4A3 /end MEASUREMENT
/begin COMPU_METHOD MC_SCP_ERA_KEYS "SCP_ERA_KEYS conversion" RAT_FUNC "%3.0" "Unitless" COEFFS 0 1 0 0 0 1 /end COMPU_METHOD
/begin MEASUREMENT SCP_FLI_COUNTS "" UWORD MC_SCP_FLI_COUNTS 0 0 0 0 ECU_ADDRESS 0x3F9940 /end MEASUREMENT
/begin COMPU_METHOD MC_SCP_FLI_COUNTS "SCP_FLI_COUNTS conversion" RAT_FUNC "%5.0" "Unitless" COEFFS 0 1 0 0 0 1 /end COMPU_METHOD
/begin MEASUREMENT SCP_FLI_LVL "Encoded fuel level information supplied over SCP." UBYTE MC_SCP_FLI_LVL 0 0 0 0 ECU_ADDRESS 0x3F9949 /end MEASUREMENT
/begin COMPU_METHOD MC_SCP_FLI_LVL "SCP_FLI_LVL conversion" RAT_FUNC "%3.0" "Unitless" COEFFS 0 1 0 0 0 1 /end COMPU_METHOD
/begin MEASUREMENT SCP_FLI_SENSOR "" UBYTE MC_SCP_FLI_SENSOR 0 0 0 0 ECU_ADDRESS 0x3F9947 /end MEASUREMENT
/begin COMPU_METHOD MC_SCP_FLI_SENSOR "SCP_FLI_SENSOR conversion" RAT_FUNC "%3.0" "Unitless" COEFFS 0 1 0 0 0 1 /end COMPU_METHOD
/begin MEASUREMENT SCP_INCD1 "First byte of incode to be stored in EEPROM.  Request to store comes via SCP_IOCD_WRT." UBYTE MC_SCP_INCD1 0 0 0 0 ECU_ADDRESS 0x3FB4A2 /end MEASUREMENT
/begin COMPU_METHOD MC_SCP_INCD1 "SCP_INCD1 conversion" RAT_FUNC "%3.0" "Unitless" COEFFS 0 1 0 0 0 1 /end COMPU_METHOD
/begin MEASUREMENT SCP_INCD2 "Second byte of Incode to be stored in EEPROM.  Request comes via SCP_IOCD_WRT." UBYTE MC_SCP_INCD2 0 0 0 0 ECU_ADDRESS 0x3FB4A1 /end MEASUREMENT
/begin COMPU_METHOD MC_SCP_INCD2 "SCP_INCD2 conversion" RAT_FUNC "%3.0" "Unitless" COEFFS 0 1 0 0 0 1 /end COMPU_METHOD
/begin MEASUREMENT SCP_INCD_ARR "Flag used to indicate to ANTI-THEFT logic when SCP has recieved an incode for coded access." UBYTE MC_SCP_INCD_ARR 0 0 0 0 ECU_ADDRESS 0x3FB487 /end MEASUREMENT
/begin COMPU_METHOD MC_SCP_INCD_ARR "SCP_INCD_ARR conversion" RAT_FUNC "%3.0" "Unitless" COEFFS 0 1 0 0 0 1 /end COMPU_METHOD
/begin MEASUREMENT SCP_IOCD_WRT "Flag indicating to ANTI-THEFT that a Incode/Outcode write has been requested over SCP." UBYTE MC_SCP_IOCD_WRT 0 0 0 0 ECU_ADDRESS 0x3FB4A0 /end MEASUREMENT
/begin COMPU_METHOD MC_SCP_IOCD_WRT "SCP_IOCD_WRT conversion" RAT_FUNC "%3.0" "Unitless" COEFFS 0 1 0 0 0 1 /end COMPU_METHOD
/begin MEASUREMENT SCP_KAM_RST "Flag requesting a complete KAM reset do to SCP diagnostic request message." UBYTE MC_SCP_KAM_RST 0 0 0 0 ECU_ADDRESS 0x3FB4A7 /end MEASUREMENT
/begin COMPU_METHOD MC_SCP_KAM_RST "SCP_KAM_RST conversion" RAT_FUNC "%3.0" "Unitless" COEFFS 0 1 0 0 0 1 /end COMPU_METHOD
/begin MEASUREMENT SCP_KEYS_REQ "Minimum number of keys required to be stored before PATS is enabled." UBYTE MC_SCP_KEYS_REQ 0 0 0 0 ECU_ADDRESS 0x3FB49F /end MEASUREMENT
/begin COMPU_METHOD MC_SCP_KEYS_REQ "SCP_KEYS_REQ conversion" RAT_FUNC "%3.0" "Unitless" COEFFS 0 1 0 0 0 1 /end COMPU_METHOD
/begin MEASUREMENT SCP_LED_OFF "Flag indicating SCP has requested that the Anti-Theft indicator be turned off." UBYTE MC_SCP_LED_OFF 0 0 0 0 ECU_ADDRESS 0x3FB49E /end MEASUREMENT
/begin COMPU_METHOD MC_SCP_LED_OFF "SCP_LED_OFF conversion" RAT_FUNC "%3.0" "Unitless" COEFFS 0 1 0 0 0 1 /end COMPU_METHOD
/begin MEASUREMENT SCP_LED_ON "Flag indicating SCP has requested that the Anti-Theft indicator be turned on." UBYTE MC_SCP_LED_ON 0 0 0 0 ECU_ADDRESS 0x3FB49D /end MEASUREMENT
/begin COMPU_METHOD MC_SCP_LED_ON "SCP_LED_ON conversion" RAT_FUNC "%3.0" "Unitless" COEFFS 0 1 0 0 0 1 /end COMPU_METHOD
/begin MEASUREMENT SCP_LRN_DIS "Flag indicating SCP has requested the ANTI-THEFT feature to disable any spare key learning." UBYTE MC_SCP_LRN_DIS 0 0 0 0 ECU_ADDRESS 0x3FB49C /end MEASUREMENT
/begin COMPU_METHOD MC_SCP_LRN_DIS "SCP_LRN_DIS conversion" RAT_FUNC "%3.0" "Unitless" COEFFS 0 1 0 0 0 1 /end COMPU_METHOD
/begin MEASUREMENT SCP_LRN_ENA "Flag indicating SCP has requested the ANTI-THEFT feature to enable spare key learning." UBYTE MC_SCP_LRN_ENA 0 0 0 0 ECU_ADDRESS 0x3FB49B /end MEASUREMENT
/begin COMPU_METHOD MC_SCP_LRN_ENA "SCP_LRN_ENA conversion" RAT_FUNC "%3.0" "Unitless" COEFFS 0 1 0 0 0 1 /end COMPU_METHOD
/begin MEASUREMENT SCP_LRN_KEY "Flag indicating SCP requests ANTI-THEFT to learn a new key." UBYTE MC_SCP_LRN_KEY 0 0 0 0 ECU_ADDRESS 0x3FB49A /end MEASUREMENT
/begin COMPU_METHOD MC_SCP_LRN_KEY "SCP_LRN_KEY conversion" RAT_FUNC "%3.0" "Unitless" COEFFS 0 1 0 0 0 1 /end COMPU_METHOD
/begin MEASUREMENT SCP_MIL_ON "MIL light control state encoded register. 0=OFF, 1=ON, 2=FLASHING. (parameter to scp output)" UBYTE MC_SCP_MIL_ON 0 0 0 0 ECU_ADDRESS 0x3FA2A2 /end MEASUREMENT
/begin COMPU_METHOD MC_SCP_MIL_ON "SCP_MIL_ON conversion" RAT_FUNC "%3.0" "Unitless" COEFFS 0 1 0 0 0 1 /end COMPU_METHOD
/begin MEASUREMENT SCP_NO_DTCS "When set, indicates that the No DTCs should be stored." UBYTE MC_SCP_NO_DTCS 0 0 0 0 ECU_ADDRESS 0x3FB4A9 /end MEASUREMENT
/begin COMPU_METHOD MC_SCP_NO_DTCS "SCP_NO_DTCS conversion" RAT_FUNC "%3.0" "Unitless" COEFFS 0 1 0 0 0 1 /end COMPU_METHOD
/begin MEASUREMENT SCP_NO_STRTS "Number of starts enabled by B&A enable, before PATS will be disabled if the minimum keys have not been stored." UBYTE MC_SCP_NO_STRTS 0 0 0 0 ECU_ADDRESS 0x3FB499 /end MEASUREMENT
/begin COMPU_METHOD MC_SCP_NO_STRTS "SCP_NO_STRTS conversion" RAT_FUNC "%3.0" "Unitless" COEFFS 0 1 0 0 0 1 /end COMPU_METHOD
/begin MEASUREMENT SCP_OUTCD1 "First byte of Outcode to be stored in EEPROM.  Requested via SCP_IOCS_WRT." UBYTE MC_SCP_OUTCD1 0 0 0 0 ECU_ADDRESS 0x3FB498 /end MEASUREMENT
/begin COMPU_METHOD MC_SCP_OUTCD1 "SCP_OUTCD1 conversion" RAT_FUNC "%3.0" "Unitless" COEFFS 0 1 0 0 0 1 /end COMPU_METHOD
/begin MEASUREMENT SCP_OUTCD2 "Second byte of Outcode to be stored in EEPROM.  Requested via SCP_IOCD_WRT." UBYTE MC_SCP_OUTCD2 0 0 0 0 ECU_ADDRESS 0x3FB497 /end MEASUREMENT
/begin COMPU_METHOD MC_SCP_OUTCD2 "SCP_OUTCD2 conversion" RAT_FUNC "%3.0" "Unitless" COEFFS 0 1 0 0 0 1 /end COMPU_METHOD
/begin MEASUREMENT SCP_OUT_REQ "Request for outcode." UBYTE MC_SCP_OUT_REQ 0 0 0 0 ECU_ADDRESS 0x3FB486 /end MEASUREMENT
/begin COMPU_METHOD MC_SCP_OUT_REQ "SCP_OUT_REQ conversion" RAT_FUNC "%3.0" "Unitless" COEFFS 0 1 0 0 0 1 /end COMPU_METHOD
/begin MEASUREMENT SCP_PACKET[0][0] "Rapid Packet information, can be either an address or PID number depending how [packet][position] was defined." ULONG MC_SCP_PACKET 0 0 0 1e+07 ECU_ADDRESS 0x3FC090 /end MEASUREMENT
/begin COMPU_METHOD MC_SCP_PACKET "SCP_PACKET conversion" RAT_FUNC "%10.0" "unitless" COEFFS 0 1 0 0 0 1 /end COMPU_METHOD
/begin MEASUREMENT SCP_PACKET[0][10] "Rapid Packet information, can be either an address or PID number depending how [packet][position] was defined." ULONG MC_SCP_PACKET 0 0 0 1e+07 ECU_ADDRESS 0x3FC0B8 /end MEASUREMENT
/begin MEASUREMENT SCP_PACKET[0][11] "Rapid Packet information, can be either an address or PID number depending how [packet][position] was defined." ULONG MC_SCP_PACKET 0 0 0 1e+07 ECU_ADDRESS 0x3FC0BC /end MEASUREMENT
/begin MEASUREMENT SCP_PACKET[0][12] "Rapid Packet information, can be either an address or PID number depending how [packet][position] was defined." ULONG MC_SCP_PACKET 0 0 0 1e+07 ECU_ADDRESS 0x3FC0C0 /end MEASUREMENT
/begin MEASUREMENT SCP_PACKET[0][13] "Rapid Packet information, can be either an address or PID number depending how [packet][position] was defined." ULONG MC_SCP_PACKET 0 0 0 1e+07 ECU_ADDRESS 0x3FC0C4 /end MEASUREMENT
/begin MEASUREMENT SCP_PACKET[0][14] "Rapid Packet information, can be either an address or PID number depending how [packet][position] was defined." ULONG MC_SCP_PACKET 0 0 0 1e+07 ECU_ADDRESS 0x3FC0C8 /end MEASUREMENT
/begin MEASUREMENT SCP_PACKET[0][1] "Rapid Packet information, can be either an address or PID number depending how [packet][position] was defined." ULONG MC_SCP_PACKET 0 0 0 1e+07 ECU_ADDRESS 0x3FC094 /end MEASUREMENT
/begin MEASUREMENT SCP_PACKET[0][2] "Rapid Packet information, can be either an address or PID number depending how [packet][position] was defined." ULONG MC_SCP_PACKET 0 0 0 1e+07 ECU_ADDRESS 0x3FC098 /end MEASUREMENT
/begin MEASUREMENT SCP_PACKET[0][3] "Rapid Packet information, can be either an address or PID number depending how [packet][position] was defined." ULONG MC_SCP_PACKET 0 0 0 1e+07 ECU_ADDRESS 0x3FC09C /end MEASUREMENT
/begin MEASUREMENT SCP_PACKET[0][4] "Rapid Packet information, can be either an address or PID number depending how [packet][position] was defined." ULONG MC_SCP_PACKET 0 0 0 1e+07 ECU_ADDRESS 0x3FC0A0 /end MEASUREMENT
/begin MEASUREMENT SCP_PACKET[0][5] "Rapid Packet information, can be either an address or PID number depending how [packet][position] was defined." ULONG MC_SCP_PACKET 0 0 0 1e+07 ECU_ADDRESS 0x3FC0A4 /end MEASUREMENT
/begin MEASUREMENT SCP_PACKET[0][6] "Rapid Packet information, can be either an address or PID number depending how [packet][position] was defined." ULONG MC_SCP_PACKET 0 0 0 1e+07 ECU_ADDRESS 0x3FC0A8 /end MEASUREMENT
/begin MEASUREMENT SCP_PACKET[0][7] "Rapid Packet information, can be either an address or PID number depending how [packet][position] was defined." ULONG MC_SCP_PACKET 0 0 0 1e+07 ECU_ADDRESS 0x3FC0AC /end MEASUREMENT
/begin MEASUREMENT SCP_PACKET[0][8] "Rapid Packet information, can be either an address or PID number depending how [packet][position] was defined." ULONG MC_SCP_PACKET 0 0 0 1e+07 ECU_ADDRESS 0x3FC0B0 /end MEASUREMENT
/begin MEASUREMENT SCP_PACKET[0][9] "Rapid Packet information, can be either an address or PID number depending how [packet][position] was defined." ULONG MC_SCP_PACKET 0 0 0 1e+07 ECU_ADDRESS 0x3FC0B4 /end MEASUREMENT
/begin MEASUREMENT SCP_PACKET[1][0] "Rapid Packet information, can be either an address or PID number depending how [packet][position] was defined." ULONG MC_SCP_PACKET 0 0 0 1e+07 ECU_ADDRESS 0x3FC0CC /end MEASUREMENT
/begin MEASUREMENT SCP_PACKET[1][10] "Rapid Packet information, can be either an address or PID number depending how [packet][position] was defined." ULONG MC_SCP_PACKET 0 0 0 1e+07 ECU_ADDRESS 0x3FC0F4 /end MEASUREMENT
/begin MEASUREMENT SCP_PACKET[1][11] "Rapid Packet information, can be either an address or PID number depending how [packet][position] was defined." ULONG MC_SCP_PACKET 0 0 0 1e+07 ECU_ADDRESS 0x3FC0F8 /end MEASUREMENT
/begin MEASUREMENT SCP_PACKET[1][12] "Rapid Packet information, can be either an address or PID number depending how [packet][position] was defined." ULONG MC_SCP_PACKET 0 0 0 1e+07 ECU_ADDRESS 0x3FC0FC /end MEASUREMENT
/begin MEASUREMENT SCP_PACKET[1][13] "Rapid Packet information, can be either an address or PID number depending how [packet][position] was defined." ULONG MC_SCP_PACKET 0 0 0 1e+07 ECU_ADDRESS 0x3FC100 /end MEASUREMENT
/begin MEASUREMENT SCP_PACKET[1][14] "Rapid Packet information, can be either an address or PID number depending how [packet][position] was defined." ULONG MC_SCP_PACKET 0 0 0 1e+07 ECU_ADDRESS 0x3FC104 /end MEASUREMENT
/begin MEASUREMENT SCP_PACKET[1][1] "Rapid Packet information, can be either an address or PID number depending how [packet][position] was defined." ULONG MC_SCP_PACKET 0 0 0 1e+07 ECU_ADDRESS 0x3FC0D0 /end MEASUREMENT
/begin MEASUREMENT SCP_PACKET[1][2] "Rapid Packet information, can be either an address or PID number depending how [packet][position] was defined." ULONG MC_SCP_PACKET 0 0 0 1e+07 ECU_ADDRESS 0x3FC0D4 /end MEASUREMENT
/begin MEASUREMENT SCP_PACKET[1][3] "Rapid Packet information, can be either an address or PID number depending how [packet][position] was defined." ULONG MC_SCP_PACKET 0 0 0 1e+07 ECU_ADDRESS 0x3FC0D8 /end MEASUREMENT
/begin MEASUREMENT SCP_PACKET[1][4] "Rapid Packet information, can be either an address or PID number depending how [packet][position] was defined." ULONG MC_SCP_PACKET 0 0 0 1e+07 ECU_ADDRESS 0x3FC0DC /end MEASUREMENT
/begin MEASUREMENT SCP_PACKET[1][5] "Rapid Packet information, can be either an address or PID number depending how [packet][position] was defined." ULONG MC_SCP_PACKET 0 0 0 1e+07 ECU_ADDRESS 0x3FC0E0 /end MEASUREMENT
/begin MEASUREMENT SCP_PACKET[1][6] "Rapid Packet information, can be either an address or PID number depending how [packet][position] was defined." ULONG MC_SCP_PACKET 0 0 0 1e+07 ECU_ADDRESS 0x3FC0E4 /end MEASUREMENT
/begin MEASUREMENT SCP_PACKET[1][7] "Rapid Packet information, can be either an address or PID number depending how [packet][position] was defined." ULONG MC_SCP_PACKET 0 0 0 1e+07 ECU_ADDRESS 0x3FC0E8 /end MEASUREMENT
/begin MEASUREMENT SCP_PACKET[1][8] "Rapid Packet information, can be either an address or PID number depending how [packet][position] was defined." ULONG MC_SCP_PACKET 0 0 0 1e+07 ECU_ADDRESS 0x3FC0EC /end MEASUREMENT
/begin MEASUREMENT SCP_PACKET[1][9] "Rapid Packet information, can be either an address or PID number depending how [packet][position] was defined." ULONG MC_SCP_PACKET 0 0 0 1e+07 ECU_ADDRESS 0x3FC0F0 /end MEASUREMENT
/begin MEASUREMENT SCP_PACKET[2][0] "Rapid Packet information, can be either an address or PID number depending how [packet][position] was defined." ULONG MC_SCP_PACKET 0 0 0 1e+07 ECU_ADDRESS 0x3FC108 /end MEASUREMENT
/begin MEASUREMENT SCP_PACKET[2][10] "Rapid Packet information, can be either an address or PID number depending how [packet][position] was defined." ULONG MC_SCP_PACKET 0 0 0 1e+07 ECU_ADDRESS 0x3FC130 /end MEASUREMENT
/begin MEASUREMENT SCP_PACKET[2][11] "Rapid Packet information, can be either an address or PID number depending how [packet][position] was defined." ULONG MC_SCP_PACKET 0 0 0 1e+07 ECU_ADDRESS 0x3FC134 /end MEASUREMENT
/begin MEASUREMENT SCP_PACKET[2][12] "Rapid Packet information, can be either an address or PID number depending how [packet][position] was defined." ULONG MC_SCP_PACKET 0 0 0 1e+07 ECU_ADDRESS 0x3FC138 /end MEASUREMENT
/begin MEASUREMENT SCP_PACKET[2][13] "Rapid Packet information, can be either an address or PID number depending how [packet][position] was defined." ULONG MC_SCP_PACKET 0 0 0 1e+07 ECU_ADDRESS 0x3FC13C /end MEASUREMENT
/begin MEASUREMENT SCP_PACKET[2][14] "Rapid Packet information, can be either an address or PID number depending how [packet][position] was defined." ULONG MC_SCP_PACKET 0 0 0 1e+07 ECU_ADDRESS 0x3FC140 /end MEASUREMENT
/begin MEASUREMENT SCP_PACKET[2][1] "Rapid Packet information, can be either an address or PID number depending how [packet][position] was defined." ULONG MC_SCP_PACKET 0 0 0 1e+07 ECU_ADDRESS 0x3FC10C /end MEASUREMENT
/begin MEASUREMENT SCP_PACKET[2][2] "Rapid Packet information, can be either an address or PID number depending how [packet][position] was defined." ULONG MC_SCP_PACKET 0 0 0 1e+07 ECU_ADDRESS 0x3FC110 /end MEASUREMENT
/begin MEASUREMENT SCP_PACKET[2][3] "Rapid Packet information, can be either an address or PID number depending how [packet][position] was defined." ULONG MC_SCP_PACKET 0 0 0 1e+07 ECU_ADDRESS 0x3FC114 /end MEASUREMENT
/begin MEASUREMENT SCP_PACKET[2][4] "Rapid Packet information, can be either an address or PID number depending how [packet][position] was defined." ULONG MC_SCP_PACKET 0 0 0 1e+07 ECU_ADDRESS 0x3FC118 /end MEASUREMENT
/begin MEASUREMENT SCP_PACKET[2][5] "Rapid Packet information, can be either an address or PID number depending how [packet][position] was defined." ULONG MC_SCP_PACKET 0 0 0 1e+07 ECU_ADDRESS 0x3FC11C /end MEASUREMENT
/begin MEASUREMENT SCP_PACKET[2][6] "Rapid Packet information, can be either an address or PID number depending how [packet][position] was defined." ULONG MC_SCP_PACKET 0 0 0 1e+07 ECU_ADDRESS 0x3FC120 /end MEASUREMENT
/begin MEASUREMENT SCP_PACKET[2][7] "Rapid Packet information, can be either an address or PID number depending how [packet][position] was defined." ULONG MC_SCP_PACKET 0 0 0 1e+07 ECU_ADDRESS 0x3FC124 /end MEASUREMENT
/begin MEASUREMENT SCP_PACKET[2][8] "Rapid Packet information, can be either an address or PID number depending how [packet][position] was defined." ULONG MC_SCP_PACKET 0 0 0 1e+07 ECU_ADDRESS 0x3FC128 /end MEASUREMENT
/begin MEASUREMENT SCP_PACKET[2][9] "Rapid Packet information, can be either an address or PID number depending how [packet][position] was defined." ULONG MC_SCP_PACKET 0 0 0 1e+07 ECU_ADDRESS 0x3FC12C /end MEASUREMENT
/begin MEASUREMENT SCP_PACKET[3][0] "Rapid Packet information, can be either an address or PID number depending how [packet][position] was defined." ULONG MC_SCP_PACKET 0 0 0 1e+07 ECU_ADDRESS 0x3FC144 /end MEASUREMENT
/begin MEASUREMENT SCP_PACKET[3][10] "Rapid Packet information, can be either an address or PID number depending how [packet][position] was defined." ULONG MC_SCP_PACKET 0 0 0 1e+07 ECU_ADDRESS 0x3FC16C /end MEASUREMENT
/begin MEASUREMENT SCP_PACKET[3][11] "Rapid Packet information, can be either an address or PID number depending how [packet][position] was defined." ULONG MC_SCP_PACKET 0 0 0 1e+07 ECU_ADDRESS 0x3FC170 /end MEASUREMENT
/begin MEASUREMENT SCP_PACKET[3][12] "Rapid Packet information, can be either an address or PID number depending how [packet][position] was defined." ULONG MC_SCP_PACKET 0 0 0 1e+07 ECU_ADDRESS 0x3FC174 /end MEASUREMENT
/begin MEASUREMENT SCP_PACKET[3][13] "Rapid Packet information, can be either an address or PID number depending how [packet][position] was defined." ULONG MC_SCP_PACKET 0 0 0 1e+07 ECU_ADDRESS 0x3FC178 /end MEASUREMENT
/begin MEASUREMENT SCP_PACKET[3][14] "Rapid Packet information, can be either an address or PID number depending how [packet][position] was defined." ULONG MC_SCP_PACKET 0 0 0 1e+07 ECU_ADDRESS 0x3FC17C /end MEASUREMENT
/begin MEASUREMENT SCP_PACKET[3][1] "Rapid Packet information, can be either an address or PID number depending how [packet][position] was defined." ULONG MC_SCP_PACKET 0 0 0 1e+07 ECU_ADDRESS 0x3FC148 /end MEASUREMENT
/begin MEASUREMENT SCP_PACKET[3][2] "Rapid Packet information, can be either an address or PID number depending how [packet][position] was defined." ULONG MC_SCP_PACKET 0 0 0 1e+07 ECU_ADDRESS 0x3FC14C /end MEASUREMENT
/begin MEASUREMENT SCP_PACKET[3][3] "Rapid Packet information, can be either an address or PID number depending how [packet][position] was defined." ULONG MC_SCP_PACKET 0 0 0 1e+07 ECU_ADDRESS 0x3FC150 /end MEASUREMENT
/begin MEASUREMENT SCP_PACKET[3][4] "Rapid Packet information, can be either an address or PID number depending how [packet][position] was defined." ULONG MC_SCP_PACKET 0 0 0 1e+07 ECU_ADDRESS 0x3FC154 /end MEASUREMENT
/begin MEASUREMENT SCP_PACKET[3][5] "Rapid Packet information, can be either an address or PID number depending how [packet][position] was defined." ULONG MC_SCP_PACKET 0 0 0 1e+07 ECU_ADDRESS 0x3FC158 /end MEASUREMENT
/begin MEASUREMENT SCP_PACKET[3][6] "Rapid Packet information, can be either an address or PID number depending how [packet][position] was defined." ULONG MC_SCP_PACKET 0 0 0 1e+07 ECU_ADDRESS 0x3FC15C /end MEASUREMENT
/begin MEASUREMENT SCP_PACKET[3][7] "Rapid Packet information, can be either an address or PID number depending how [packet][position] was defined." ULONG MC_SCP_PACKET 0 0 0 1e+07 ECU_ADDRESS 0x3FC160 /end MEASUREMENT
/begin MEASUREMENT SCP_PACKET[3][8] "Rapid Packet information, can be either an address or PID number depending how [packet][position] was defined." ULONG MC_SCP_PACKET 0 0 0 1e+07 ECU_ADDRESS 0x3FC164 /end MEASUREMENT
/begin MEASUREMENT SCP_PACKET[3][9] "Rapid Packet information, can be either an address or PID number depending how [packet][position] was defined." ULONG MC_SCP_PACKET 0 0 0 1e+07 ECU_ADDRESS 0x3FC168 /end MEASUREMENT
/begin MEASUREMENT SCP_PACKET[4][0] "Rapid Packet information, can be either an address or PID number depending how [packet][position] was defined." ULONG MC_SCP_PACKET 0 0 0 1e+07 ECU_ADDRESS 0x3FC180 /end MEASUREMENT
/begin MEASUREMENT SCP_PACKET[4][10] "Rapid Packet information, can be either an address or PID number depending how [packet][position] was defined." ULONG MC_SCP_PACKET 0 0 0 1e+07 ECU_ADDRESS 0x3FC1A8 /end MEASUREMENT
/begin MEASUREMENT SCP_PACKET[4][11] "Rapid Packet information, can be either an address or PID number depending how [packet][position] was defined." ULONG MC_SCP_PACKET 0 0 0 1e+07 ECU_ADDRESS 0x3FC1AC /end MEASUREMENT
/begin MEASUREMENT SCP_PACKET[4][12] "Rapid Packet information, can be either an address or PID number depending how [packet][position] was defined." ULONG MC_SCP_PACKET 0 0 0 1e+07 ECU_ADDRESS 0x3FC1B0 /end MEASUREMENT
/begin MEASUREMENT SCP_PACKET[4][13] "Rapid Packet information, can be either an address or PID number depending how [packet][position] was defined." ULONG MC_SCP_PACKET 0 0 0 1e+07 ECU_ADDRESS 0x3FC1B4 /end MEASUREMENT
/begin MEASUREMENT SCP_PACKET[4][14] "Rapid Packet information, can be either an address or PID number depending how [packet][position] was defined." ULONG MC_SCP_PACKET 0 0 0 1e+07 ECU_ADDRESS 0x3FC1B8 /end MEASUREMENT
/begin MEASUREMENT SCP_PACKET[4][1] "Rapid Packet information, can be either an address or PID number depending how [packet][position] was defined." ULONG MC_SCP_PACKET 0 0 0 1e+07 ECU_ADDRESS 0x3FC184 /end MEASUREMENT
/begin MEASUREMENT SCP_PACKET[4][2] "Rapid Packet information, can be either an address or PID number depending how [packet][position] was defined." ULONG MC_SCP_PACKET 0 0 0 1e+07 ECU_ADDRESS 0x3FC188 /end MEASUREMENT
/begin MEASUREMENT SCP_PACKET[4][3] "Rapid Packet information, can be either an address or PID number depending how [packet][position] was defined." ULONG MC_SCP_PACKET 0 0 0 1e+07 ECU_ADDRESS 0x3FC18C /end MEASUREMENT
/begin MEASUREMENT SCP_PACKET[4][4] "Rapid Packet information, can be either an address or PID number depending how [packet][position] was defined." ULONG MC_SCP_PACKET 0 0 0 1e+07 ECU_ADDRESS 0x3FC190 /end MEASUREMENT
/begin MEASUREMENT SCP_PACKET[4][5] "Rapid Packet information, can be either an address or PID number depending how [packet][position] was defined." ULONG MC_SCP_PACKET 0 0 0 1e+07 ECU_ADDRESS 0x3FC194 /end MEASUREMENT
/begin MEASUREMENT SCP_PACKET[4][6] "Rapid Packet information, can be either an address or PID number depending how [packet][position] was defined." ULONG MC_SCP_PACKET 0 0 0 1e+07 ECU_ADDRESS 0x3FC198 /end MEASUREMENT
/begin MEASUREMENT SCP_PACKET[4][7] "Rapid Packet information, can be either an address or PID number depending how [packet][position] was defined." ULONG MC_SCP_PACKET 0 0 0 1e+07 ECU_ADDRESS 0x3FC19C /end MEASUREMENT
/begin MEASUREMENT SCP_PACKET[4][8] "Rapid Packet information, can be either an address or PID number depending how [packet][position] was defined." ULONG MC_SCP_PACKET 0 0 0 1e+07 ECU_ADDRESS 0x3FC1A0 /end MEASUREMENT
/begin MEASUREMENT SCP_PACKET[4][9] "Rapid Packet information, can be either an address or PID number depending how [packet][position] was defined." ULONG MC_SCP_PACKET 0 0 0 1e+07 ECU_ADDRESS 0x3FC1A4 /end MEASUREMENT
/begin MEASUREMENT SCP_PATS_ACC "Vehicle security challenge, security access method.  (The data received over SCP)" FLOAT32_IEEE MC_SCP_PATS_ACC 0 0 0 0 ECU_ADDRESS 0x3F9CA4 /end MEASUREMENT
/begin COMPU_METHOD MC_SCP_PATS_ACC "SCP_PATS_ACC conversion" RAT_FUNC "%10.5" "Unitless" COEFFS 0 1 0 0 0 1 /end COMPU_METHOD
/begin MEASUREMENT SCP_PATS_ST "Key read status.  (The data received over SCP.)" UBYTE MC_SCP_PATS_ST 0 0 0 0 ECU_ADDRESS 0x3F9D12 /end MEASUREMENT
/begin COMPU_METHOD MC_SCP_PATS_ST "SCP_PATS_ST conversion" RAT_FUNC "%3.0" "Unitless" COEFFS 0 1 0 0 0 1 /end COMPU_METHOD
/begin MEASUREMENT SCP_PCMID_RQ "The Vehicle Security PCM ID request has been received over SCP. 1 = PCM ID requested." UBYTE MC_SCP_PCMID_RQ 0 0 0 0 ECU_ADDRESS 0x3F9D0D /end MEASUREMENT
/begin COMPU_METHOD MC_SCP_PCMID_RQ "SCP_PCMID_RQ conversion" RAT_FUNC "%3.0" "Unitless" COEFFS 0 1 0 0 0 1 /end COMPU_METHOD
/begin MEASUREMENT SCP_RD_DSIZE "Counter indicating the number of Rapid Data messages loaded to be transmitted." UBYTE MC_SCP_RD_DSIZE 0 0 0 0 ECU_ADDRESS 0x3FB4B5 /end MEASUREMENT
/begin COMPU_METHOD MC_SCP_RD_DSIZE "SCP_RD_DSIZE conversion" RAT_FUNC "%3.0" "Unitless" COEFFS 0 1 0 0 0 1 /end COMPU_METHOD
/begin MEASUREMENT SCP_RX_DSIZE "Number of diagnostic SCP messages received by the PCM" UBYTE MC_SCP_RX_DSIZE 0 0 0 0 ECU_ADDRESS 0x3F9930 /end MEASUREMENT
/begin COMPU_METHOD MC_SCP_RX_DSIZE "SCP_RX_DSIZE conversion" RAT_FUNC "%3.0" "Unitless" COEFFS 0 1 0 0 0 1 /end COMPU_METHOD
/begin MEASUREMENT SCP_SETACTIM "Flag indicating ANTI-THEFT should change the secure access time delay." UBYTE MC_SCP_SETACTIM 0 0 0 0 ECU_ADDRESS 0x3FB496 /end MEASUREMENT
/begin COMPU_METHOD MC_SCP_SETACTIM "SCP_SETACTIM conversion" RAT_FUNC "%3.0" "Unitless" COEFFS 0 1 0 0 0 1 /end COMPU_METHOD
/begin MEASUREMENT SCP_SET_BAEN "Flag requesting ANTI-THEFT Update the number of starts available with less than minimum number of keys have been stored." UBYTE MC_SCP_SET_BAEN 0 0 0 0 ECU_ADDRESS 0x3FB495 /end MEASUREMENT
/begin COMPU_METHOD MC_SCP_SET_BAEN "SCP_SET_BAEN conversion" RAT_FUNC "%3.0" "Unitless" COEFFS 0 1 0 0 0 1 /end COMPU_METHOD
/begin MEASUREMENT SCP_SET_KEYS "Flag indicating ANTI-THEFT should set the minimum keys required to enable PATS." UBYTE MC_SCP_SET_KEYS 0 0 0 0 ECU_ADDRESS 0x3FB494 /end MEASUREMENT
/begin COMPU_METHOD MC_SCP_SET_KEYS "SCP_SET_KEYS conversion" RAT_FUNC "%3.0" "Unitless" COEFFS 0 1 0 0 0 1 /end COMPU_METHOD
/begin MEASUREMENT SCP_STRT_TIM "Flag indicating ANTI-THEFT should begin security time access." UBYTE MC_SCP_STRT_TIM 0 0 0 0 ECU_ADDRESS 0x3FB485 /end MEASUREMENT
/begin COMPU_METHOD MC_SCP_STRT_TIM "SCP_STRT_TIM conversion" RAT_FUNC "%3.0" "Unitless" COEFFS 0 1 0 0 0 1 /end COMPU_METHOD
/begin MEASUREMENT SCP_SVMD_DIS "Disable PATS service mode capability." UBYTE MC_SCP_SVMD_DIS 0 0 0 0 ECU_ADDRESS 0x3FB493 /end MEASUREMENT
/begin COMPU_METHOD MC_SCP_SVMD_DIS "SCP_SVMD_DIS conversion" RAT_FUNC "%3.0" "Unitless" COEFFS 0 1 0 0 0 1 /end COMPU_METHOD
/begin MEASUREMENT SCP_SVMD_ENA "Enable PATS service mode capability." UBYTE MC_SCP_SVMD_ENA 0 0 0 0 ECU_ADDRESS 0x3FB492 /end MEASUREMENT
/begin COMPU_METHOD MC_SCP_SVMD_ENA "SCP_SVMD_ENA conversion" RAT_FUNC "%3.0" "Unitless" COEFFS 0 1 0 0 0 1 /end COMPU_METHOD
/begin MEASUREMENT SCP_TIM_ACC "Flag indicating SCP has requested ANTI-THEFT to change to timed access mode." UBYTE MC_SCP_TIM_ACC 0 0 0 0 ECU_ADDRESS 0x3FB491 /end MEASUREMENT
/begin COMPU_METHOD MC_SCP_TIM_ACC "SCP_TIM_ACC conversion" RAT_FUNC "%3.0" "Unitless" COEFFS 0 1 0 0 0 1 /end COMPU_METHOD
/begin MEASUREMENT SCP_TMR "SCP network initialization timer." UWORD MC_SCP_TMR 0 0 0 0 ECU_ADDRESS 0x3F9844 /end MEASUREMENT
/begin COMPU_METHOD MC_SCP_TMR "SCP_TMR conversion" RAT_FUNC "%5.0" "Unitless" COEFFS 0 1 0 0 0 1 /end COMPU_METHOD
/begin MEASUREMENT SCP_TRX_OFF "Flag indicating ANTI-THEFT should switch pats transceiver OFF.." UBYTE MC_SCP_TRX_OFF 0 0 0 0 ECU_ADDRESS 0x3FB490 /end MEASUREMENT
/begin COMPU_METHOD MC_SCP_TRX_OFF "SCP_TRX_OFF conversion" RAT_FUNC "%3.0" "Unitless" COEFFS 0 1 0 0 0 1 /end COMPU_METHOD
/begin MEASUREMENT SCP_TRX_ON "Flag indicating ANTI-THEFT should continously transmit enable." UBYTE MC_SCP_TRX_ON 0 0 0 0 ECU_ADDRESS 0x3FB48F /end MEASUREMENT
/begin COMPU_METHOD MC_SCP_TRX_ON "SCP_TRX_ON conversion" RAT_FUNC "%3.0" "Unitless" COEFFS 0 1 0 0 0 1 /end COMPU_METHOD
/begin MEASUREMENT SCP_TST_REQ "Last On-Demand test which was requested by Offboard Unit (this powerup)" UBYTE MC_SCP_TST_REQ 0 0 0 0 ECU_ADDRESS 0x3FB484 /end MEASUREMENT
/begin COMPU_METHOD MC_SCP_TST_REQ "SCP_TST_REQ conversion" RAT_FUNC "%3.0" "Unitless" COEFFS 0 1 0 0 0 1 /end COMPU_METHOD
/begin MEASUREMENT SCP_TX_DSIZE "Number of PCM SCP_DIAGNOSTIC messages to be transmitted." UBYTE MC_SCP_TX_DSIZE 0 0 0 0 ECU_ADDRESS 0x3F984B /end MEASUREMENT
/begin COMPU_METHOD MC_SCP_TX_DSIZE "SCP_TX_DSIZE conversion" RAT_FUNC "%3.0" "Unitless" COEFFS 0 1 0 0 0 1 /end COMPU_METHOD
/begin MEASUREMENT SCP_TX_READY "Flag set when the PCM is ready to start regular transmission of periodic and event driven messages." UBYTE MC_SCP_TX_READY 0 0 0 0 ECU_ADDRESS 0x3F9846 /end MEASUREMENT
/begin COMPU_METHOD MC_SCP_TX_READY "SCP_TX_READY conversion" RAT_FUNC "%3.0" "Unitless" COEFFS 0 1 0 0 0 1 /end COMPU_METHOD
/begin MEASUREMENT SCP_UP "Flag to indicate that the EBC chip has been successfully initialized." UBYTE MC_SCP_UP 0 0 0 0 ECU_ADDRESS 0x3FB40C /end MEASUREMENT
/begin COMPU_METHOD MC_SCP_UP "SCP_UP conversion" RAT_FUNC "%3.0" "Unitless" COEFFS 0 1 0 0 0 1 /end COMPU_METHOD
/begin MEASUREMENT SCP_UTKEY_0 "Least significant byte of unlimited transponder security key." UBYTE MC_SCP_UTKEY_0 0 0 0 0 ECU_ADDRESS 0x3FB48E /end MEASUREMENT
/begin COMPU_METHOD MC_SCP_UTKEY_0 "SCP_UTKEY_0 conversion" RAT_FUNC "%3.0" "Unitless" COEFFS 0 1 0 0 0 1 /end COMPU_METHOD
/begin MEASUREMENT SCP_UTKEY_1 "2nd LSByte of unlimited transponder security key." UBYTE MC_SCP_UTKEY_1 0 0 0 0 ECU_ADDRESS 0x3FB48D /end MEASUREMENT
/begin COMPU_METHOD MC_SCP_UTKEY_1 "SCP_UTKEY_1 conversion" RAT_FUNC "%3.0" "Unitless" COEFFS 0 1 0 0 0 1 /end COMPU_METHOD
/begin MEASUREMENT SCP_UTKEY_2 "2nd MSByte of unlimited transponder security key." UBYTE MC_SCP_UTKEY_2 0 0 0 0 ECU_ADDRESS 0x3FB48C /end MEASUREMENT
/begin COMPU_METHOD MC_SCP_UTKEY_2 "SCP_UTKEY_2 conversion" RAT_FUNC "%3.0" "Unitless" COEFFS 0 1 0 0 0 1 /end COMPU_METHOD
/begin MEASUREMENT SCP_UTKEY_3 "MSByte of unlimited transponder security key." UBYTE MC_SCP_UTKEY_3 0 0 0 0 ECU_ADDRESS 0x3FB48B /end MEASUREMENT
/begin COMPU_METHOD MC_SCP_UTKEY_3 "SCP_UTKEY_3 conversion" RAT_FUNC "%3.0" "Unitless" COEFFS 0 1 0 0 0 1 /end COMPU_METHOD
/begin MEASUREMENT SCP_UTKEY_AR "Flag indicating SCP has received UT security key data, and it is ready to be processed by the ANTI-THEFT feature." UBYTE MC_SCP_UTKEY_AR 0 0 0 0 ECU_ADDRESS 0x3FB48A /end MEASUREMENT
/begin COMPU_METHOD MC_SCP_UTKEY_AR "SCP_UTKEY_AR conversion" RAT_FUNC "%3.0" "Unitless" COEFFS 0 1 0 0 0 1 /end COMPU_METHOD
/begin MEASUREMENT SCP_UTMD_OFF "Flag indicating SCP has requested the ANTI-THEFT feature to switch off unlimited transponder mode." UBYTE MC_SCP_UTMD_OFF 0 0 0 0 ECU_ADDRESS 0x3FB489 /end MEASUREMENT
/begin COMPU_METHOD MC_SCP_UTMD_OFF "SCP_UTMD_OFF conversion" RAT_FUNC "%3.0" "Unitless" COEFFS 0 1 0 0 0 1 /end COMPU_METHOD
/begin MEASUREMENT SCP_UTMD_ON "Flag indicating SCP has requested the ANTI-THEFT feature to switch on unlimited transponder mode." UBYTE MC_SCP_UTMD_ON 0 0 0 0 ECU_ADDRESS 0x3FB488 /end MEASUREMENT
/begin COMPU_METHOD MC_SCP_UTMD_ON "SCP_UTMD_ON conversion" RAT_FUNC "%3.0" "Unitless" COEFFS 0 1 0 0 0 1 /end COMPU_METHOD
/begin MEASUREMENT SC_CST "speed control coast switch active" UBYTE MC_SC_CST 0 0 0 0 ECU_ADDRESS 0x3FA504 /end MEASUREMENT
/begin COMPU_METHOD MC_SC_CST "SC_CST conversion" RAT_FUNC "%3.0" "Unitless" COEFFS 0 1 0 0 0 1 /end COMPU_METHOD
/begin MEASUREMENT SC_NULL "No speed control  button pushed" UBYTE MC_SC_NULL 0 0 0 0 ECU_ADDRESS 0x3FA501 /end MEASUREMENT
/begin COMPU_METHOD MC_SC_NULL "SC_NULL conversion" RAT_FUNC "%3.0" "Unitless" COEFFS 0 1 0 0 0 1 /end COMPU_METHOD
/begin MEASUREMENT SC_OFF "speed control OFF switch active" UBYTE MC_SC_OFF 0 0 0 0 ECU_ADDRESS 0x3FA505 /end MEASUREMENT
/begin COMPU_METHOD MC_SC_OFF "SC_OFF conversion" RAT_FUNC "%3.0" "Unitless" COEFFS 0 1 0 0 0 1 /end COMPU_METHOD
/begin MEASUREMENT SC_ON "Speed control ON active" UBYTE MC_SC_ON 0 0 0 0 ECU_ADDRESS 0x3FA500 /end MEASUREMENT
/begin COMPU_METHOD MC_SC_ON "SC_ON conversion" RAT_FUNC "%3.0" "Unitless" COEFFS 0 1 0 0 0 1 /end COMPU_METHOD
/begin MEASUREMENT SC_RSUM "speed control resume switch active" UBYTE MC_SC_RSUM 0 0 0 0 ECU_ADDRESS 0x3FA502 /end MEASUREMENT
/begin COMPU_METHOD MC_SC_RSUM "SC_RSUM conversion" RAT_FUNC "%3.0" "Unitless" COEFFS 0 1 0 0 0 1 /end COMPU_METHOD
/begin MEASUREMENT SC_SET "speed control set/accel switch active" UBYTE MC_SC_SET 0 0 0 0 ECU_ADDRESS 0x3FA503 /end MEASUREMENT
/begin COMPU_METHOD MC_SC_SET "SC_SET conversion" RAT_FUNC "%3.0" "Unitless" COEFFS 0 1 0 0 0 1 /end COMPU_METHOD
/begin CHARACTERISTIC SEA_LEVEL "Atmospheric pressure at sea level (kpa)" VALUE 0x5D374 SD_FLOAT32_IEEE 0 SC_SEA_LEVEL 0 500 /end CHARACTERISTIC
/begin COMPU_METHOD SC_SEA_LEVEL "SEA_LEVEL conversion" RAT_FUNC "%10.5" "kPa" COEFFS 0 1 0 0 0 1 /end COMPU_METHOD
/begin MEASUREMENT SECACCTMR_UP "Control flag for sec_acc_tmr." UBYTE MC_SECACCTMR_UP 0 0 0 0 ECU_ADDRESS 0x3F9DA6 /end MEASUREMENT
/begin COMPU_METHOD MC_SECACCTMR_UP "SECACCTMR_UP conversion" RAT_FUNC "%3.0" "Unitless" COEFFS 0 1 0 0 0 1 /end COMPU_METHOD
/begin CHARACTERISTIC SEC_ACC_DELY "Secure Access Time Delay." VALUE 0x5CC88 SD_UWORD 0 SC_SEC_ACC_DELY 480 3780 /end CHARACTERISTIC
/begin COMPU_METHOD SC_SEC_ACC_DELY "SEC_ACC_DELY conversion" RAT_FUNC "%5.0" "Unitless" COEFFS 0 1 0 0 0 1 /end COMPU_METHOD
/begin MEASUREMENT SEC_ACC_STAT "Secure Access Status, can be 'not requested' 00h,'granted' AAh,'in_prog' 55h or 'denied' FFh." UBYTE MC_SEC_ACC_STAT 0 0 0 0 ECU_ADDRESS 0x3F9DB4 /end MEASUREMENT
/begin COMPU_METHOD MC_SEC_ACC_STAT "SEC_ACC_STAT conversion" RAT_FUNC "%3.0" "Unitless" COEFFS 0 1 0 0 0 1 /end COMPU_METHOD
/begin MEASUREMENT SEC_ACC_ST_K "KAM Version of SEC_ACC_STAT, takes values AAh 'granted', 55h 'in_prog' or 33h 'denied'" UBYTE MC_SEC_ACC_ST_K 0 0 0 0 ECU_ADDRESS 0x3FB754 /end MEASUREMENT
/begin COMPU_METHOD MC_SEC_ACC_ST_K "SEC_ACC_ST_K conversion" RAT_FUNC "%3.0" "Unitless" COEFFS 0 1 0 0 0 1 /end COMPU_METHOD
/begin MEASUREMENT SEC_ACC_TMR "Timed Secure Access timer. Controlled by secacctmr_up." FLOAT32_IEEE MC_SEC_ACC_TMR 0 0 0 0 ECU_ADDRESS 0x3F9D9C /end MEASUREMENT
/begin COMPU_METHOD MC_SEC_ACC_TMR "SEC_ACC_TMR conversion" RAT_FUNC "%10.5" "Unitless" COEFFS 0 1 0 0 0 1 /end COMPU_METHOD
/begin MEASUREMENT SEQ_NUM "Upper nibble of Rapid Packet identifier used to indicate group number to improve sequencing." UBYTE MC_SEQ_NUM 0 0 0 0 ECU_ADDRESS 0x3FB4B6 /end MEASUREMENT
/begin COMPU_METHOD MC_SEQ_NUM "SEQ_NUM conversion" RAT_FUNC "%3.0" "Unitless" COEFFS 0 1 0 0 0 1 /end COMPU_METHOD
/begin MEASUREMENT SFT_STATE "Pressure ctl state;0 -> no shft;10 -> pre sft;20 -> start sft;30 -> rt chng;40->end sft;50->post sft;60->finish sft;70->chng mnd" UBYTE MC_SFT_STATE 0 0 0 0 ECU_ADDRESS 0x3FB728 /end MEASUREMENT
/begin COMPU_METHOD MC_SFT_STATE "SFT_STATE conversion" RAT_FUNC "%3.0" "Unitless" COEFFS 0 1 0 0 0 1 /end COMPU_METHOD
/begin MEASUREMENT SHADOW_TABLE_INFO "Special RCON Shadow Table Structure" ULONG MC_SHADOW_TABLE_INFO 0 0 0 0 ECU_ADDRESS 0x3F9C84 /end MEASUREMENT
/begin COMPU_METHOD MC_SHADOW_TABLE_INFO "SHADOW_TABLE_INFO conversion" RAT_FUNC "%10.0" "Unitless" COEFFS 0 1 0 0 0 1 /end COMPU_METHOD
/begin MEASUREMENT SHPCA_SRC "Shift point calculation source sent to transmission for shift scheduling" UBYTE MC_SHPCA_SRC 0 0 0 0 ECU_ADDRESS 0x3FA2A5 /end MEASUREMENT
/begin COMPU_METHOD MC_SHPCA_SRC "SHPCA_SRC conversion" RAT_FUNC "%3.0" "Unitless" COEFFS 0 1 0 0 0 1 /end COMPU_METHOD
/begin CHARACTERISTIC SKSF "System voltage multiplication factor" VALUE 0x5D620 SD_FLOAT32_IEEE 0 SC_SKSF 5.6 5.6 /end CHARACTERISTIC
/begin COMPU_METHOD SC_SKSF "SKSF conversion" RAT_FUNC "%10.5" "V" COEFFS 0 1 0 0 0 1 /end COMPU_METHOD
/begin MEASUREMENT SMS_FLAGS "" UBYTE MC_SMS_FLAGS 0 0 0 0 ECU_ADDRESS 0x3FB6D3 /end MEASUREMENT
/begin COMPU_METHOD MC_SMS_FLAGS "SMS_FLAGS conversion" RAT_FUNC "%3.0" "Unitless" COEFFS 0 1 0 0 0 1 /end COMPU_METHOD
/begin MEASUREMENT SOAK_TIME "Soak time duration in minutes." FLOAT32_IEEE MC_SOAK_TIME 0 0 0 0 ECU_ADDRESS 0x3F9C60 /end MEASUREMENT
/begin COMPU_METHOD MC_SOAK_TIME "SOAK_TIME conversion" RAT_FUNC "%10.5" "Unitless" COEFFS 0 1 0 0 0 1 /end COMPU_METHOD
/begin MEASUREMENT SOC_ADDR "Start of Combustion Adder (crnk deg BTDC)" FLOAT32_IEEE MC_SOC_ADDR 0 0 0 0 ECU_ADDRESS 0x3FA92C /end MEASUREMENT
/begin COMPU_METHOD MC_SOC_ADDR "SOC_ADDR conversion" RAT_FUNC "%10.5" "Unitless" COEFFS 0 1 0 0 0 1 /end COMPU_METHOD
/begin MEASUREMENT SOIDES_M "Main Desired timing (crnk deg BTDC)" FLOAT32_IEEE MC_SOIDES_M 0 0 0 0 ECU_ADDRESS 0x3FA9B4 /end MEASUREMENT
/begin COMPU_METHOD MC_SOIDES_M "SOIDES_M conversion" RAT_FUNC "%10.5" "Unitless" COEFFS 0 1 0 0 0 1 /end COMPU_METHOD
/begin CHARACTERISTIC SOIDES_M_MN "Main fuel pulse Start of Injection Desired Minimum" VALUE 0x5DE30 SD_FLOAT32_IEEE 0 SC_SOIDES_M_MN -128 5 /end CHARACTERISTIC
/begin COMPU_METHOD SC_SOIDES_M_MN "SOIDES_M_MN conversion" RAT_FUNC "%10.5" "deg" COEFFS 0 1 0 0 0 1 /end COMPU_METHOD
/begin CHARACTERISTIC SOIDES_M_MX "Main fuel pulse Start of Injection Desired Maximum" VALUE 0x5DE2C SD_FLOAT32_IEEE 0 SC_SOIDES_M_MX -128 135 /end CHARACTERISTIC
/begin COMPU_METHOD SC_SOIDES_M_MX "SOIDES_M_MX conversion" RAT_FUNC "%10.5" "deg" COEFFS 0 1 0 0 0 1 /end COMPU_METHOD
/begin MEASUREMENT SOIDES_P "Pilot Desired timing (crnk deg BTDC)" FLOAT32_IEEE MC_SOIDES_P 0 0 0 0 ECU_ADDRESS 0x3FA9B0 /end MEASUREMENT
/begin COMPU_METHOD MC_SOIDES_P "SOIDES_P conversion" RAT_FUNC "%10.5" "Unitless" COEFFS 0 1 0 0 0 1 /end COMPU_METHOD
/begin MEASUREMENT SOIDES_POST2 "Post Desired inj timing (crnk deg BTDC)" FLOAT32_IEEE MC_SOIDES_POST2 0 0 0 0 ECU_ADDRESS 0x3F9C94 /end MEASUREMENT
/begin COMPU_METHOD MC_SOIDES_POST2 "SOIDES_POST2 conversion" RAT_FUNC "%10.5" "Unitless" COEFFS 0 1 0 0 0 1 /end COMPU_METHOD
/begin CHARACTERISTIC SOI_M_CAL "Calibratable Start of Injection Desired for Main fuel pulse" VALUE 0x5DE28 SD_FLOAT32_IEEE 0 SC_SOI_M_CAL -128 135 /end CHARACTERISTIC
/begin COMPU_METHOD SC_SOI_M_CAL "SOI_M_CAL conversion" RAT_FUNC "%10.5" "deg" COEFFS 0 1 0 0 0 1 /end COMPU_METHOD
/begin CHARACTERISTIC SOI_M_SEL "Select SOI_M_CAL scalar for SOIDES_M" VALUE 0x5DE24 SD_FLOAT32_IEEE 0 SC_SOI_M_SEL 0 1 /end CHARACTERISTIC
/begin COMPU_METHOD SC_SOI_M_SEL "SOI_M_SEL conversion" RAT_FUNC "%10.5" "unitless" COEFFS 0 1 0 0 0 1 /end COMPU_METHOD
/begin MEASUREMENT SPD_CTL_ON_REQ "Speed control lamp on request" UBYTE MC_SPD_CTL_ON_REQ 0 0 0 0 ECU_ADDRESS 0x3FA2B6 /end MEASUREMENT
/begin COMPU_METHOD MC_SPD_CTL_ON_REQ "SPD_CTL_ON_REQ conversion" RAT_FUNC "%3.0" "Unitless" COEFFS 0 1 0 0 0 1 /end COMPU_METHOD
/begin MEASUREMENT SPD_ERR_MODE "Vehicle Speed Control system failure mode flag." UBYTE MC_SPD_ERR_MODE 0 0 0 0 ECU_ADDRESS 0x3F9CBC /end MEASUREMENT
/begin COMPU_METHOD MC_SPD_ERR_MODE "SPD_ERR_MODE conversion" RAT_FUNC "%3.0" "Unitless" COEFFS 0 1 0 0 0 1 /end COMPU_METHOD
/begin CHARACTERISTIC SPD_HP "Hardware present switch for Vehicle Speed Control system (Cruise Control)" VALUE 0x5CB20 SD_UBYTE 0 SC_SPD_HP 0 1 /end CHARACTERISTIC
/begin COMPU_METHOD SC_SPD_HP "SPD_HP conversion" RAT_FUNC "%3.0" "unitless" COEFFS 0 1 0 0 0 1 /end COMPU_METHOD
/begin MEASUREMENT SPD_VID_HP "Flag indicating whether speed control hardware is present." UBYTE MC_SPD_VID_HP 0 0 0 0 ECU_ADDRESS 0x3FB408 /end MEASUREMENT
/begin COMPU_METHOD MC_SPD_VID_HP "SPD_VID_HP conversion" RAT_FUNC "%3.0" "Unitless" COEFFS 0 1 0 0 0 1 /end COMPU_METHOD
/begin MEASUREMENT SPIP_INIT "" FLOAT32_IEEE MC_SPIP_INIT 0 0 0 0 ECU_ADDRESS 0x3F9AC0 /end MEASUREMENT
/begin COMPU_METHOD MC_SPIP_INIT "SPIP_INIT conversion" RAT_FUNC "%10.5" "Unitless" COEFFS 0 1 0 0 0 1 /end COMPU_METHOD
/begin CHARACTERISTIC SPIP_INIT_CAL "" VALUE 0x5C8A8 SD_FLOAT32_IEEE 0 SC_SPIP_INIT_CAL 0 512 /end CHARACTERISTIC
/begin COMPU_METHOD SC_SPIP_INIT_CAL "SPIP_INIT_CAL conversion" RAT_FUNC "%10.5" "unitless" COEFFS 0 1 0 0 0 1 /end COMPU_METHOD
/begin CHARACTERISTIC SPIP_TOOTH_CAL "" VALUE 0x5C8A4 SD_FLOAT32_IEEE 0 SC_SPIP_TOOTH_CAL 0 1200 /end CHARACTERISTIC
/begin COMPU_METHOD SC_SPIP_TOOTH_CAL "SPIP_TOOTH_CAL conversion" RAT_FUNC "%10.5" "unitless" COEFFS 0 1 0 0 0 1 /end COMPU_METHOD
/begin MEASUREMENT SPIP_TOOTH_INIT "" FLOAT32_IEEE MC_SPIP_TOOTH_INIT 0 0 0 0 ECU_ADDRESS 0x3F9ABC /end MEASUREMENT
/begin COMPU_METHOD MC_SPIP_TOOTH_INIT "SPIP_TOOTH_INIT conversion" RAT_FUNC "%10.5" "Unitless" COEFFS 0 1 0 0 0 1 /end COMPU_METHOD
/begin MEASUREMENT SPK_M_B_T "Spark advance required to achieve Maximum Brake Torque." FLOAT32_IEEE MC_SPK_M_B_T 0 0 0 0 ECU_ADDRESS 0x3F9C5C /end MEASUREMENT
/begin COMPU_METHOD MC_SPK_M_B_T "SPK_M_B_T conversion" RAT_FUNC "%10.5" "Unitless" COEFFS 0 1 0 0 0 1 /end COMPU_METHOD
/begin MEASUREMENT SPK_OCT_ADJ "Flag to request addition of borderline octane adjustment.  1 -> add adjustment." UBYTE MC_SPK_OCT_ADJ 0 0 0 0 ECU_ADDRESS 0x3FB409 /end MEASUREMENT
/begin COMPU_METHOD MC_SPK_OCT_ADJ "SPK_OCT_ADJ conversion" RAT_FUNC "%3.0" "Unitless" COEFFS 0 1 0 0 0 1 /end COMPU_METHOD
/begin CHARACTERISTIC SP_BP "Pilot mode mass fuel desired threshhold" VALUE 0x5DDE8 SD_FLOAT32_IEEE 0 SC_SP_BP 0 300 /end CHARACTERISTIC
/begin COMPU_METHOD SC_SP_BP "SP_BP conversion" RAT_FUNC "%10.5" "unitless" COEFFS 0 1 0 0 0 1 /end COMPU_METHOD
/begin CHARACTERISTIC SP_BP_HYS "Pilot mode barometric pressure hysteresis adder" VALUE 0x5DDE4 SD_FLOAT32_IEEE 0 SC_SP_BP_HYS 0 30 /end CHARACTERISTIC
/begin COMPU_METHOD SC_SP_BP_HYS "SP_BP_HYS conversion" RAT_FUNC "%10.5" "kPa" COEFFS 0 1 0 0 0 1 /end COMPU_METHOD
/begin CHARACTERISTIC SP_ENBL_TM "Time delay after startup to allow pilot mode" VALUE 0x5DDB8 SD_ULONG 0 SC_SP_ENBL_TM 0 300000 /end CHARACTERISTIC
/begin COMPU_METHOD SC_SP_ENBL_TM "SP_ENBL_TM conversion" RAT_FUNC "%10.0" "ms" COEFFS 0 1 0 0 0 1 /end COMPU_METHOD
/begin MEASUREMENT SP_ENBL_TMR "SP mode enable timer" ULONG MC_SP_ENBL_TMR 0 0 0 0 ECU_ADDRESS 0x3FA8E8 /end MEASUREMENT
/begin COMPU_METHOD MC_SP_ENBL_TMR "SP_ENBL_TMR conversion" RAT_FUNC "%10.0" "Unitless" COEFFS 0 1 0 0 0 1 /end COMPU_METHOD
/begin CHARACTERISTIC SP_EOT "Pilot mode EOT threshhold" VALUE 0x5DDD4 SD_FLOAT32_IEEE 0 SC_SP_EOT 0 300 /end CHARACTERISTIC
/begin COMPU_METHOD SC_SP_EOT "SP_EOT conversion" RAT_FUNC "%10.5" "degC" COEFFS 0 1 0 0 0 1 /end COMPU_METHOD
/begin CHARACTERISTIC SP_EOT_HYS "Pilot mode EOT hysteresis adder" VALUE 0x5DDD0 SD_FLOAT32_IEEE 0 SC_SP_EOT_HYS 0 100 /end CHARACTERISTIC
/begin COMPU_METHOD SC_SP_EOT_HYS "SP_EOT_HYS conversion" RAT_FUNC "%10.5" "degC" COEFFS 0 1 0 0 0 1 /end COMPU_METHOD
/begin CHARACTERISTIC SP_FMEM_EN "Single pilot fmem enable disable switch" VALUE 0x5DDEC SD_UBYTE 0 SC_SP_FMEM_EN 0 1 /end CHARACTERISTIC
/begin COMPU_METHOD SC_SP_FMEM_EN "SP_FMEM_EN conversion" RAT_FUNC "%3.0" "unitless" COEFFS 0 1 0 0 0 1 /end COMPU_METHOD
/begin MEASUREMENT SP_FMEM_FLG "SP FMEM enable /disable flag" UBYTE MC_SP_FMEM_FLG 0 0 0 0 ECU_ADDRESS 0x3FA8CB /end MEASUREMENT
/begin COMPU_METHOD MC_SP_FMEM_FLG "SP_FMEM_FLG conversion" RAT_FUNC "%3.0" "Unitless" COEFFS 0 1 0 0 0 1 /end COMPU_METHOD
/begin CHARACTERISTIC SP_HOT_EOT_HYS_MAX "Pilot mode eot maximum hysterisis threshold" VALUE 0x5DDC8 SD_FLOAT32_IEEE 0 SC_SP_HOT_EOT_HYS_MAX 0 500 /end CHARACTERISTIC
/begin COMPU_METHOD SC_SP_HOT_EOT_HYS_MAX "SP_HOT_EOT_HYS_MAX conversion" RAT_FUNC "%10.5" "degC" COEFFS 0 1 0 0 0 1 /end COMPU_METHOD
/begin CHARACTERISTIC SP_HOT_EOT_MAX "Pilot mode eot maximum threshold" VALUE 0x5DDCC SD_FLOAT32_IEEE 0 SC_SP_HOT_EOT_MAX 0 500 /end CHARACTERISTIC
/begin COMPU_METHOD SC_SP_HOT_EOT_MAX "SP_HOT_EOT_MAX conversion" RAT_FUNC "%10.5" "degC" COEFFS 0 1 0 0 0 1 /end COMPU_METHOD
/begin CHARACTERISTIC SP_IDLE_N "SP idle holdoff engine speed (RPM) limit." VALUE 0x5DDA8 SD_FLOAT32_IEEE 0 SC_SP_IDLE_N 0 16383.8 /end CHARACTERISTIC
/begin COMPU_METHOD SC_SP_IDLE_N "SP_IDLE_N conversion" RAT_FUNC "%10.5" "RPM" COEFFS 0 1 0 0 0 1 /end COMPU_METHOD
/begin CHARACTERISTIC SP_IDLE_PPS "SP idle holdoff accelerator pedal position limit value." VALUE 0x5DDAC SD_FLOAT32_IEEE 0 SC_SP_IDLE_PPS 0 1023 /end CHARACTERISTIC
/begin COMPU_METHOD SC_SP_IDLE_PPS "SP_IDLE_PPS conversion" RAT_FUNC "%10.5" "ADct" COEFFS 0 1 0 0 0 1 /end COMPU_METHOD
/begin CHARACTERISTIC SP_MFDES "Pilot mode mass fuel desired threshhold" VALUE 0x5DDDC SD_FLOAT32_IEEE 0 SC_SP_MFDES 0 150 /end CHARACTERISTIC
/begin COMPU_METHOD SC_SP_MFDES "SP_MFDES conversion" RAT_FUNC "%10.5" "unitless" COEFFS 0 1 0 0 0 1 /end COMPU_METHOD
/begin CHARACTERISTIC SP_MFDES_HYS "Pilot mode mass fuel desired hysteresis adder" VALUE 0x5DDD8 SD_FLOAT32_IEEE 0 SC_SP_MFDES_HYS 0 30 /end CHARACTERISTIC
/begin COMPU_METHOD SC_SP_MFDES_HYS "SP_MFDES_HYS conversion" RAT_FUNC "%10.5" "unitless" COEFFS 0 1 0 0 0 1 /end COMPU_METHOD
/begin MEASUREMENT SP_MNMF "Pilot mode min mass fuel threshold (mg/stroke)" FLOAT32_IEEE MC_SP_MNMF 0 0 0 0 ECU_ADDRESS 0x3FA8C0 /end MEASUREMENT
/begin COMPU_METHOD MC_SP_MNMF "SP_MNMF conversion" RAT_FUNC "%10.5" "Unitless" COEFFS 0 1 0 0 0 1 /end COMPU_METHOD
/begin CHARACTERISTIC SP_MNMF_HYS "Pilot mode maximum mass fuel hysteresis adder" VALUE 0x5DDC4 SD_FLOAT32_IEEE 0 SC_SP_MNMF_HYS 0 30 /end CHARACTERISTIC
/begin COMPU_METHOD SC_SP_MNMF_HYS "SP_MNMF_HYS conversion" RAT_FUNC "%10.5" "unitless" COEFFS 0 1 0 0 0 1 /end COMPU_METHOD
/begin MEASUREMENT SP_MODE_SEL "single pilot mode select" UBYTE MC_SP_MODE_SEL 0 0 0 0 ECU_ADDRESS 0x3FA8CC /end MEASUREMENT
/begin COMPU_METHOD MC_SP_MODE_SEL "SP_MODE_SEL conversion" RAT_FUNC "%3.0" "Unitless" COEFFS 0 1 0 0 0 1 /end COMPU_METHOD
/begin MEASUREMENT SP_MODE_TMR "SP mode latch timer" ULONG MC_SP_MODE_TMR 0 0 0 0 ECU_ADDRESS 0x3FA8E4 /end MEASUREMENT
/begin COMPU_METHOD MC_SP_MODE_TMR "SP_MODE_TMR conversion" RAT_FUNC "%10.0" "Unitless" COEFFS 0 1 0 0 0 1 /end COMPU_METHOD
/begin MEASUREMENT SP_MXMF "Pilot mode max mass fuel threshold (mg/stroke)" FLOAT32_IEEE MC_SP_MXMF 0 0 0 0 ECU_ADDRESS 0x3FA8BC /end MEASUREMENT
/begin COMPU_METHOD MC_SP_MXMF "SP_MXMF conversion" RAT_FUNC "%10.5" "Unitless" COEFFS 0 1 0 0 0 1 /end COMPU_METHOD
/begin CHARACTERISTIC SP_MXMF_HYS "Pilot mode maximum mass fuel hysteresis adder" VALUE 0x5DDC0 SD_FLOAT32_IEEE 0 SC_SP_MXMF_HYS 0 30 /end CHARACTERISTIC
/begin COMPU_METHOD SC_SP_MXMF_HYS "SP_MXMF_HYS conversion" RAT_FUNC "%10.5" "unitless" COEFFS 0 1 0 0 0 1 /end COMPU_METHOD
/begin CHARACTERISTIC SP_NOPLT_TM "Time delay after startup to allow pilot mode" VALUE 0x5DDB4 SD_ULONG 0 SC_SP_NOPLT_TM 0 300000 /end CHARACTERISTIC
/begin COMPU_METHOD SC_SP_NOPLT_TM "SP_NOPLT_TM conversion" RAT_FUNC "%10.0" "ms" COEFFS 0 1 0 0 0 1 /end COMPU_METHOD
/begin CHARACTERISTIC SP_N_HYS "Pilot mode engine speed hysteresis adder" VALUE 0x5DDE0 SD_FLOAT32_IEEE 0 SC_SP_N_HYS 0 1000 /end CHARACTERISTIC
/begin COMPU_METHOD SC_SP_N_HYS "SP_N_HYS conversion" RAT_FUNC "%10.5" "RPM" COEFFS 0 1 0 0 0 1 /end COMPU_METHOD
/begin CHARACTERISTIC SP_PPS "Maximum pedal position for pilot mode" VALUE 0x5DDBC SD_FLOAT32_IEEE 0 SC_SP_PPS 0 1023 /end CHARACTERISTIC
/begin COMPU_METHOD SC_SP_PPS "SP_PPS conversion" RAT_FUNC "%10.5" "unitless" COEFFS 0 1 0 0 0 1 /end COMPU_METHOD
/begin CHARACTERISTIC SP_RUN_TM "Time in run mode limit" VALUE 0x5DDB0 SD_FLOAT32_IEEE 0 SC_SP_RUN_TM 0 65535 /end CHARACTERISTIC
/begin COMPU_METHOD SC_SP_RUN_TM "SP_RUN_TM conversion" RAT_FUNC "%10.5" "s" COEFFS 0 1 0 0 0 1 /end COMPU_METHOD
/begin MEASUREMENT SRC_CONTROLLING "" UBYTE MC_SRC_CONTROLLING 0 0 0 0 ECU_ADDRESS 0x3FB18A /end MEASUREMENT
/begin COMPU_METHOD MC_SRC_CONTROLLING "SRC_CONTROLLING conversion" RAT_FUNC "%3.0" "Unitless" COEFFS 0 1 0 0 0 1 /end COMPU_METHOD
/begin MEASUREMENT SRC_LGL_FLG "Selectable RPM Control (SRC) Legal flag" UBYTE MC_SRC_LGL_FLG 0 0 0 0 ECU_ADDRESS 0x3FB189 /end MEASUREMENT
/begin COMPU_METHOD MC_SRC_LGL_FLG "SRC_LGL_FLG conversion" RAT_FUNC "%3.0" "Unitless" COEFFS 0 1 0 0 0 1 /end COMPU_METHOD
/begin MEASUREMENT SRC_STATE "Selectable RPM Control (SRC) State ( 1 = ON )" UBYTE MC_SRC_STATE 0 0 0 0 ECU_ADDRESS 0x3FB190 /end MEASUREMENT
/begin COMPU_METHOD MC_SRC_STATE "SRC_STATE conversion" RAT_FUNC "%3.0" "Unitless" COEFFS 0 1 0 0 0 1 /end COMPU_METHOD
/begin MEASUREMENT START_FLG "Flag set when engine has been cranked > 30RPM" UBYTE MC_START_FLG 0 0 0 0 ECU_ADDRESS 0x3FA07C /end MEASUREMENT
/begin COMPU_METHOD MC_START_FLG "START_FLG conversion" RAT_FUNC "%3.0" "Unitless" COEFFS 0 1 0 0 0 1 /end COMPU_METHOD
/begin MEASUREMENT START_INJOFF_TEST "Indicates injector off test in progress" UBYTE MC_START_INJOFF_TEST 0 0 0 0 ECU_ADDRESS 0x3F9E93 /end MEASUREMENT
/begin COMPU_METHOD MC_START_INJOFF_TEST "START_INJOFF_TEST conversion" RAT_FUNC "%3.0" "Unitless" COEFFS 0 1 0 0 0 1 /end COMPU_METHOD
/begin MEASUREMENT START_MOTOR_FLAG "" UBYTE MC_START_MOTOR_FLAG 0 0 0 0 ECU_ADDRESS 0x3FA2B5 /end MEASUREMENT
/begin COMPU_METHOD MC_START_MOTOR_FLAG "START_MOTOR_FLAG conversion" RAT_FUNC "%3.0" "Unitless" COEFFS 0 1 0 0 0 1 /end COMPU_METHOD
/begin MEASUREMENT START_TEST "Flag set when any on demand test is active" UBYTE MC_START_TEST 0 0 0 0 ECU_ADDRESS 0x3FB4E8 /end MEASUREMENT
/begin COMPU_METHOD MC_START_TEST "START_TEST conversion" RAT_FUNC "%3.0" "Unitless" COEFFS 0 1 0 0 0 1 /end COMPU_METHOD
/begin MEASUREMENT STATUS_MSG_CLOSE_COIL_OPEN "" UBYTE MC_STATUS_MSG_CLOSE_COIL_OPEN 0 0 0 0 ECU_ADDRESS 0x3FB67E /end MEASUREMENT
/begin COMPU_METHOD MC_STATUS_MSG_CLOSE_COIL_OPEN "STATUS_MSG_CLOSE_COIL_OPEN conversion" RAT_FUNC "%3.0" "Unitless" COEFFS 0 1 0 0 0 1 /end COMPU_METHOD
/begin MEASUREMENT STATUS_MSG_CLOSE_COIL_SHORT "" UBYTE MC_STATUS_MSG_CLOSE_COIL_SHORT 0 0 0 0 ECU_ADDRESS 0x3FB67F /end MEASUREMENT
/begin COMPU_METHOD MC_STATUS_MSG_CLOSE_COIL_SHORT "STATUS_MSG_CLOSE_COIL_SHORT conversion" RAT_FUNC "%3.0" "Unitless" COEFFS 0 1 0 0 0 1 /end COMPU_METHOD
/begin MEASUREMENT STATUS_MSG_OPEN_COIL_OPEN "" UBYTE MC_STATUS_MSG_OPEN_COIL_OPEN 0 0 0 0 ECU_ADDRESS 0x3FB67C /end MEASUREMENT
/begin COMPU_METHOD MC_STATUS_MSG_OPEN_COIL_OPEN "STATUS_MSG_OPEN_COIL_OPEN conversion" RAT_FUNC "%3.0" "Unitless" COEFFS 0 1 0 0 0 1 /end COMPU_METHOD
/begin MEASUREMENT STATUS_MSG_OPEN_COIL_SHORT "" UBYTE MC_STATUS_MSG_OPEN_COIL_SHORT 0 0 0 0 ECU_ADDRESS 0x3FB67D /end MEASUREMENT
/begin COMPU_METHOD MC_STATUS_MSG_OPEN_COIL_SHORT "STATUS_MSG_OPEN_COIL_SHORT conversion" RAT_FUNC "%3.0" "Unitless" COEFFS 0 1 0 0 0 1 /end COMPU_METHOD
/begin MEASUREMENT STATUS_MSG_OPEN_COIL_SIDE_SHORT "" UBYTE COMPU_METHOD_1 0 0 0 0 ECU_ADDRESS 0x3FB680 /end MEASUREMENT
/begin COMPU_METHOD COMPU_METHOD_1 "STATUS_MSG_OPEN_COIL_SIDE_SHORT conversion" RAT_FUNC "%3.0" "Unitless" COEFFS 0 1 0 0 0 1 /end COMPU_METHOD
/begin MEASUREMENT STD_ENG_OFF_TMR "Stored elapsed time of the most recent EEC module key-off powered-down period." FLOAT32_IEEE MC_STD_ENG_OFF_TMR 0 0 0 0 ECU_ADDRESS 0x3F9AA8 /end MEASUREMENT
/begin COMPU_METHOD MC_STD_ENG_OFF_TMR "STD_ENG_OFF_TMR conversion" RAT_FUNC "%10.5" "Unitless" COEFFS 0 1 0 0 0 1 /end COMPU_METHOD
/begin MEASUREMENT STRT_DISABLE "Flag indicating that the STARTER MOTOR CONTROL strategy is disabling the starter motor.  1 = Starter motor disabled" UBYTE MC_STRT_DISABLE 0 0 0 0 ECU_ADDRESS 0x3FA2B4 /end MEASUREMENT
/begin COMPU_METHOD MC_STRT_DISABLE "STRT_DISABLE conversion" RAT_FUNC "%3.0" "Unitless" COEFFS 0 1 0 0 0 1 /end COMPU_METHOD
/begin CHARACTERISTIC STRT_DISABLE_MTX_DEF "" VALUE 0x5D44F SD_UBYTE 0 SC_STRT_DISABLE_MTX_DEF 0 1 /end CHARACTERISTIC
/begin COMPU_METHOD SC_STRT_DISABLE_MTX_DEF "STRT_DISABLE_MTX_DEF conversion" RAT_FUNC "%3.0" "unitless" COEFFS 0 1 0 0 0 1 /end COMPU_METHOD
/begin MEASUREMENT STRT_DISABLE_PID "Indicates starter motor relay enabled" UBYTE MC_STRT_DISABLE_PID 0 0 0 0 ECU_ADDRESS 0x3FA2AB /end MEASUREMENT
/begin COMPU_METHOD MC_STRT_DISABLE_PID "STRT_DISABLE_PID conversion" RAT_FUNC "%3.0" "Unitless" COEFFS 0 1 0 0 0 1 /end COMPU_METHOD
/begin MEASUREMENT STRT_DISABLE_STATUS "Starter enable circuit fault  status byte" UBYTE MC_STRT_DISABLE_STATUS 0 0 0 0 ECU_ADDRESS 0x3F985C /end MEASUREMENT
/begin COMPU_METHOD MC_STRT_DISABLE_STATUS "STRT_DISABLE_STATUS conversion" RAT_FUNC "%3.0" "Unitless" COEFFS 0 1 0 0 0 1 /end COMPU_METHOD
/begin CHARACTERISTIC STRT_EN_PATS_DEF "" VALUE 0x5D44E SD_UBYTE 0 SC_STRT_EN_PATS_DEF 0 1 /end CHARACTERISTIC
/begin COMPU_METHOD SC_STRT_EN_PATS_DEF "STRT_EN_PATS_DEF conversion" RAT_FUNC "%3.0" "unitless" COEFFS 0 1 0 0 0 1 /end COMPU_METHOD
/begin MEASUREMENT SYNC_CTR_0 "Sequence counter incremented every PIP rising edge, used to indentify the cycle and position." UBYTE MC_SYNC_CTR_0 0 0 0 0 ECU_ADDRESS 0x3F9CE8 /end MEASUREMENT
/begin COMPU_METHOD MC_SYNC_CTR_0 "SYNC_CTR_0 conversion" RAT_FUNC "%3.0" "Unitless" COEFFS 0 1 0 0 0 1 /end COMPU_METHOD
/begin MEASUREMENT SYNC_LOC_FLG "Camshaft sync located flag" UBYTE MC_SYNC_LOC_FLG 0 0 0 0 ECU_ADDRESS 0x3FA11A /end MEASUREMENT
/begin COMPU_METHOD MC_SYNC_LOC_FLG "SYNC_LOC_FLG conversion" RAT_FUNC "%3.0" "Unitless" COEFFS 0 1 0 0 0 1 /end COMPU_METHOD
/begin MEASUREMENT SYNC_LOSS_CKP_CNTR "Crank sync. loss fault counter" UBYTE MC_SYNC_LOSS_CKP_CNTR 0 0 0 0 ECU_ADDRESS 0x3FB6E7 /end MEASUREMENT
/begin COMPU_METHOD MC_SYNC_LOSS_CKP_CNTR "SYNC_LOSS_CKP_CNTR conversion" RAT_FUNC "%3.0" "Unitless" COEFFS 0 1 0 0 0 1 /end COMPU_METHOD
/begin MEASUREMENT SYNC_LOSS_CKP_CNTR_IN_NORUN "Crank  sync loss  fault counter when eng. is not running" UBYTE MC_SYNC_LOSS_CKP_CNTR_IN_NORUN 0 0 0 0 ECU_ADDRESS 0x3FA64C /end MEASUREMENT
/begin COMPU_METHOD MC_SYNC_LOSS_CKP_CNTR_IN_NORUN "SYNC_LOSS_CKP_CNTR_IN_NORUN conversion" RAT_FUNC "%3.0" "Unitless" COEFFS 0 1 0 0 0 1 /end COMPU_METHOD
/begin CHARACTERISTIC SYNC_LOSS_CKP_CNT_CRANK "Crank sync. loss  during crank, fault decl. limit value" VALUE 0x5D8A4 SD_UBYTE 0 SC_SYNC_LOSS_CKP_CNT_CRANK 0 255 /end CHARACTERISTIC
/begin COMPU_METHOD SC_SYNC_LOSS_CKP_CNT_CRANK "SYNC_LOSS_CKP_CNT_CRANK conversion" RAT_FUNC "%3.0" "unitless" COEFFS 0 1 0 0 0 1 /end COMPU_METHOD
/begin RECORD_LAYOUT SD_UBYTE FNC_VALUES 1 UBYTE ROW_DIR DIRECT /end RECORD_LAYOUT
/begin RECORD_LAYOUT SD_UWORD FNC_VALUES 1 UWORD ROW_DIR DIRECT /end RECORD_LAYOUT
/begin RECORD_LAYOUT SD_ULONG FNC_VALUES 1 ULONG ROW_DIR DIRECT /end RECORD_LAYOUT
/begin RECORD_LAYOUT SD_SLONG FNC_VALUES 1 SLONG ROW_DIR DIRECT /end RECORD_LAYOUT
/begin RECORD_LAYOUT SD_FLOAT32_IEEE FNC_VALUES 1 FLOAT32_IEEE ROW_DIR DIRECT /end RECORD_LAYOUT
/end MODULE
/end PROJECT
