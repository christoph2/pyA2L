/begin PROJECT DPU-2XX "Visteon Diesel"
/begin HEADER " " VERSION "1" PROJECT_NO Global /end HEADER
/begin MODULE ENGINE "International Engine Controller"
/begin MOD_COMMON " " BYTE_ORDER MSB_FIRST /end MOD_COMMON
/begin CHARACTERISTIC FN090_AFR_A "Engine speed normalization for VGT control" CURVE 0x464CC FD_FLOAT32_IEEE 0 FCY_FN090_AFR_A 0 11 /begin AXIS_DESCR STD_AXIS N FCX_FN090_AFR_A 8 0 5000 /end AXIS_DESCR /end CHARACTERISTIC
/begin COMPU_METHOD FCX_FN090_AFR_A "FN090_AFR_A X-axis conversion" RAT_FUNC "%10.5" "RPM" COEFFS 0 1 0 0 0 1 /end COMPU_METHOD
/begin COMPU_METHOD FCY_FN090_AFR_A "FN090_AFR_A Y-axis conversion" RAT_FUNC "%10.5" "unitless" COEFFS 0 1 0 0 0 1 /end COMPU_METHOD
/begin CHARACTERISTIC FN090_ICPA "Normalise engine speed for table fn_icpa" CURVE 0x4681C FD_FLOAT32_IEEE 0 FCY_FN090_ICPA 0 13 /begin AXIS_DESCR STD_AXIS N FCX_FN090_ICPA 14 0 5000 /end AXIS_DESCR /end CHARACTERISTIC
/begin COMPU_METHOD FCX_FN090_ICPA "FN090_ICPA X-axis conversion" RAT_FUNC "%10.5" "RPM" COEFFS 0 1 0 0 0 1 /end COMPU_METHOD
/begin COMPU_METHOD FCY_FN090_ICPA "FN090_ICPA Y-axis conversion" RAT_FUNC "%10.5" "unitless" COEFFS 0 1 0 0 0 1 /end COMPU_METHOD
/begin CHARACTERISTIC FN090_ICP_A "" CURVE 0x4B554 FD_FLOAT32_IEEE 0 FCY_FN090_ICP_A 0 8 /begin AXIS_DESCR STD_AXIS N FCX_FN090_ICP_A 9 0 5500 /end AXIS_DESCR /end CHARACTERISTIC
/begin COMPU_METHOD FCX_FN090_ICP_A "FN090_ICP_A X-axis conversion" RAT_FUNC "%10.5" "RPM" COEFFS 0 1 0 0 0 1 /end COMPU_METHOD
/begin COMPU_METHOD FCY_FN090_ICP_A "FN090_ICP_A Y-axis conversion" RAT_FUNC "%10.5" "Unitless" COEFFS 0 1 0 0 0 1 /end COMPU_METHOD
/begin CHARACTERISTIC FN090_VGT "" CURVE 0x574BC FD_FLOAT32_IEEE 0 FCY_FN090_VGT 0 15 /begin AXIS_DESCR STD_AXIS N FCX_FN090_VGT 14 0 6000 /end AXIS_DESCR /end CHARACTERISTIC
/begin COMPU_METHOD FCX_FN090_VGT "FN090_VGT X-axis conversion" RAT_FUNC "%10.5" "unitless" COEFFS 0 1 0 0 0 1 /end COMPU_METHOD
/begin COMPU_METHOD FCY_FN090_VGT "FN090_VGT Y-axis conversion" RAT_FUNC "%10.5" "unitless" COEFFS 0 1 0 0 0 1 /end COMPU_METHOD
/begin CHARACTERISTIC FN091DS_EGR "" CURVE 0x5314C FD_FLOAT32_IEEE 0 FCY_FN091DS_EGR 0 100 /begin AXIS_DESCR STD_AXIS MFDES FCX_FN091DS_EGR 14 0 500 /end AXIS_DESCR /end CHARACTERISTIC
/begin COMPU_METHOD FCX_FN091DS_EGR "FN091DS_EGR X-axis conversion" RAT_FUNC "%10.5" "unitless" COEFFS 0 1 0 0 0 1 /end COMPU_METHOD
/begin COMPU_METHOD FCY_FN091DS_EGR "FN091DS_EGR Y-axis conversion" RAT_FUNC "%10.5" "unitless" COEFFS 0 1 0 0 0 1 /end COMPU_METHOD
/begin CHARACTERISTIC FN091DS_ITH "" CURVE 0x561CC FD_FLOAT32_IEEE 0 FCY_FN091DS_ITH 0 15 /begin AXIS_DESCR STD_AXIS MFDES FCX_FN091DS_ITH 14 0 100 /end AXIS_DESCR /end CHARACTERISTIC
/begin COMPU_METHOD FCX_FN091DS_ITH "FN091DS_ITH X-axis conversion" RAT_FUNC "%10.5" "unitless" COEFFS 0 1 0 0 0 1 /end COMPU_METHOD
/begin COMPU_METHOD FCY_FN091DS_ITH "FN091DS_ITH Y-axis conversion" RAT_FUNC "%10.5" "unitless" COEFFS 0 1 0 0 0 1 /end COMPU_METHOD
/begin CHARACTERISTIC FN091DS_TQ "" CURVE 0x4D48C FD_FLOAT32_IEEE 0 FCY_FN091DS_TQ 0 14 /begin AXIS_DESCR STD_AXIS MFDES FCX_FN091DS_TQ 14 -2048 2048 /end AXIS_DESCR /end CHARACTERISTIC
/begin COMPU_METHOD FCX_FN091DS_TQ "FN091DS_TQ X-axis conversion" RAT_FUNC "%10.5" "unitless" COEFFS 0 1 0 0 0 1 /end COMPU_METHOD
/begin COMPU_METHOD FCY_FN091DS_TQ "FN091DS_TQ Y-axis conversion" RAT_FUNC "%10.5" "unitless" COEFFS 0 1 0 0 0 1 /end COMPU_METHOD
/begin CHARACTERISTIC FN091P_AFR_A "" CURVE 0x4658C FD_FLOAT32_IEEE 0 FCY_FN091P_AFR_A 0 10 /begin AXIS_DESCR STD_AXIS MAF_GMS FCX_FN091P_AFR_A 8 0 1000 /end AXIS_DESCR /end CHARACTERISTIC
/begin COMPU_METHOD FCX_FN091P_AFR_A "FN091P_AFR_A X-axis conversion" RAT_FUNC "%10.5" "g/s" COEFFS 0 1 0 0 0 1 /end COMPU_METHOD
/begin COMPU_METHOD FCY_FN091P_AFR_A "FN091P_AFR_A Y-axis conversion" RAT_FUNC "%10.5" "unitless" COEFFS 0 1 0 0 0 1 /end COMPU_METHOD
/begin CHARACTERISTIC FN091_AFR_A "Mass air flow normalization for air/fuel ratio" CURVE 0x4654C FD_FLOAT32_IEEE 0 FCY_FN091_AFR_A 0 10 /begin AXIS_DESCR STD_AXIS MAF_GMS FCX_FN091_AFR_A 8 0 1000 /end AXIS_DESCR /end CHARACTERISTIC
/begin COMPU_METHOD FCX_FN091_AFR_A "FN091_AFR_A X-axis conversion" RAT_FUNC "%10.5" "g/s" COEFFS 0 1 0 0 0 1 /end COMPU_METHOD
/begin COMPU_METHOD FCY_FN091_AFR_A "FN091_AFR_A Y-axis conversion" RAT_FUNC "%10.5" "unitless" COEFFS 0 1 0 0 0 1 /end COMPU_METHOD
/begin CHARACTERISTIC FN091_ICPA "Normalise ICP for table fn_icpa" CURVE 0x4688C FD_FLOAT32_IEEE 0 FCY_FN091_ICPA 0 13 /begin AXIS_DESCR STD_AXIS ICP_MPA FCX_FN091_ICPA 14 0 255 /end AXIS_DESCR /end CHARACTERISTIC
/begin COMPU_METHOD FCX_FN091_ICPA "FN091_ICPA X-axis conversion" RAT_FUNC "%10.5" "MPa" COEFFS 0 1 0 0 0 1 /end COMPU_METHOD
/begin COMPU_METHOD FCY_FN091_ICPA "FN091_ICPA Y-axis conversion" RAT_FUNC "%10.5" "unitless" COEFFS 0 1 0 0 0 1 /end COMPU_METHOD
/begin CHARACTERISTIC FN091_ICP_A "" CURVE 0x4B59C FD_FLOAT32_IEEE 0 FCY_FN091_ICP_A 0 8 /begin AXIS_DESCR STD_AXIS MFDES FCX_FN091_ICP_A 9 -40 350 /end AXIS_DESCR /end CHARACTERISTIC
/begin COMPU_METHOD FCX_FN091_ICP_A "FN091_ICP_A X-axis conversion" RAT_FUNC "%10.5" "unitless" COEFFS 0 1 0 0 0 1 /end COMPU_METHOD
/begin COMPU_METHOD FCY_FN091_ICP_A "FN091_ICP_A Y-axis conversion" RAT_FUNC "%10.5" "Unitless" COEFFS 0 1 0 0 0 1 /end COMPU_METHOD
/begin CHARACTERISTIC FN091_VGT "" CURVE 0x5752C FD_FLOAT32_IEEE 0 FCY_FN091_VGT 0 15 /begin AXIS_DESCR STD_AXIS MFDES FCX_FN091_VGT 14 0 100 /end AXIS_DESCR /end CHARACTERISTIC
/begin COMPU_METHOD FCX_FN091_VGT "FN091_VGT X-axis conversion" RAT_FUNC "%10.5" "unitless" COEFFS 0 1 0 0 0 1 /end COMPU_METHOD
/begin COMPU_METHOD FCY_FN091_VGT "FN091_VGT Y-axis conversion" RAT_FUNC "%10.5" "unitless" COEFFS 0 1 0 0 0 1 /end COMPU_METHOD
/begin CHARACTERISTIC FN100DS_HI "Crank fuel function" CURVE 0x4512C FD_FLOAT32_IEEE 0 FCY_FN100DS_HI 0 160 /begin AXIS_DESCR STD_AXIS EOT_C FCX_FN100DS_HI 8 -40 150 /end AXIS_DESCR /end CHARACTERISTIC
/begin COMPU_METHOD FCX_FN100DS_HI "FN100DS_HI X-axis conversion" RAT_FUNC "%10.5" "degC" COEFFS 0 1 0 0 0 1 /end COMPU_METHOD
/begin COMPU_METHOD FCY_FN100DS_HI "FN100DS_HI Y-axis conversion" RAT_FUNC "%10.5" "unitless" COEFFS 0 1 0 0 0 1 /end COMPU_METHOD
/begin CHARACTERISTIC FN100DS_LO "Crank fuel function" CURVE 0x4516C FD_FLOAT32_IEEE 0 FCY_FN100DS_LO 0 160 /begin AXIS_DESCR STD_AXIS EOT_C FCX_FN100DS_LO 8 -40 150 /end AXIS_DESCR /end CHARACTERISTIC
/begin COMPU_METHOD FCX_FN100DS_LO "FN100DS_LO X-axis conversion" RAT_FUNC "%10.5" "degC" COEFFS 0 1 0 0 0 1 /end COMPU_METHOD
/begin COMPU_METHOD FCY_FN100DS_LO "FN100DS_LO Y-axis conversion" RAT_FUNC "%10.5" "unitless" COEFFS 0 1 0 0 0 1 /end COMPU_METHOD
/begin CHARACTERISTIC FN101DS_HI "Crank fuel adder function" CURVE 0x450AC FD_FLOAT32_IEEE 0 FCY_FN101DS_HI 0 160 /begin AXIS_DESCR STD_AXIS CRANK_TMR FCX_FN101DS_HI 8 0 255 /end AXIS_DESCR /end CHARACTERISTIC
/begin COMPU_METHOD FCX_FN101DS_HI "FN101DS_HI X-axis conversion" RAT_FUNC "%10.5" "s" COEFFS 0 1 0 0 0 1 /end COMPU_METHOD
/begin COMPU_METHOD FCY_FN101DS_HI "FN101DS_HI Y-axis conversion" RAT_FUNC "%10.5" "unitless" COEFFS 0 1 0 0 0 1 /end COMPU_METHOD
/begin CHARACTERISTIC FN101DS_LO "Crank fuel adder function" CURVE 0x450EC FD_FLOAT32_IEEE 0 FCY_FN101DS_LO 0 160 /begin AXIS_DESCR STD_AXIS CRANK_TMR FCX_FN101DS_LO 8 0 255 /end AXIS_DESCR /end CHARACTERISTIC
/begin COMPU_METHOD FCX_FN101DS_LO "FN101DS_LO X-axis conversion" RAT_FUNC "%10.5" "s" COEFFS 0 1 0 0 0 1 /end COMPU_METHOD
/begin COMPU_METHOD FCY_FN101DS_LO "FN101DS_LO Y-axis conversion" RAT_FUNC "%10.5" "unitless" COEFFS 0 1 0 0 0 1 /end COMPU_METHOD
/begin CHARACTERISTIC FN1020HI_COPY "X Norm=FN_TQ122DS_ECT, Y Norm=FN_TQ116, Copy of fh1020h_a from fuel limiter." MAP 0x51ACC TD_FLOAT32_IEEE 0 TCZ_FN1020HI_COPY 0 200
 /begin AXIS_DESCR FIX_AXIS NO_INPUT_QUANTITY TCX_FN1020HI_COPY 14 0 13 FIX_AXIS_PAR 0 0 14 /end AXIS_DESCR
 /begin AXIS_DESCR FIX_AXIS NO_INPUT_QUANTITY TCY_FN1020HI_COPY 14 0 13 FIX_AXIS_PAR 0 0 14 /end AXIS_DESCR
/end CHARACTERISTIC
/begin COMPU_METHOD TCZ_FN1020HI_COPY "FN1020HI_COPY Z-axis conversion" RAT_FUNC "%10.5" "unitless" COEFFS 0 1 0 0 0 1 /end COMPU_METHOD
/begin COMPU_METHOD TCX_FN1020HI_COPY "FN1020HI_COPY X-axis conversion" RAT_FUNC "%10.5" "degC" COEFFS 0 1 0 0 0 1 /end COMPU_METHOD
/begin COMPU_METHOD TCY_FN1020HI_COPY "FN1020HI_COPY Y-axis conversion" RAT_FUNC "%10.5" "unitless" COEFFS 0 1 0 0 0 1 /end COMPU_METHOD
/begin CHARACTERISTIC FN1020H_A "X Norm=FN014DS, Y Norm=unknown" MAP 0x468FC TD_FLOAT32_IEEE 0 TCZ_FN1020H_A 0 200
 /begin AXIS_DESCR FIX_AXIS NO_INPUT_QUANTITY TCX_FN1020H_A 14 0 13 FIX_AXIS_PAR 0 0 14 /end AXIS_DESCR
 /begin AXIS_DESCR FIX_AXIS NO_INPUT_QUANTITY TCY_FN1020H_A 14 0 13 FIX_AXIS_PAR 0 0 14 /end AXIS_DESCR
/end CHARACTERISTIC
/begin COMPU_METHOD TCZ_FN1020H_A "FN1020H_A Z-axis conversion" RAT_FUNC "%10.5" "unitless" COEFFS 0 1 0 0 0 1 /end COMPU_METHOD
/begin COMPU_METHOD TCX_FN1020H_A "FN1020H_A X-axis conversion" RAT_FUNC "%10.5" "RPM" COEFFS 0 1 0 0 0 1 /end COMPU_METHOD
/begin COMPU_METHOD TCY_FN1020H_A "FN1020H_A Y-axis conversion" RAT_FUNC "%10.5" "Unitless" COEFFS 0 1 0 0 0 1 /end COMPU_METHOD
/begin CHARACTERISTIC FN1020LO_COPY "X Norm=FN_TQ122DS_ECT, Y Norm=FN_TQ116, Copy of fn1020l_a from fuel limiter" MAP 0x51DEC TD_FLOAT32_IEEE 0 TCZ_FN1020LO_COPY 0 200
 /begin AXIS_DESCR FIX_AXIS NO_INPUT_QUANTITY TCX_FN1020LO_COPY 14 0 13 FIX_AXIS_PAR 0 0 14 /end AXIS_DESCR
 /begin AXIS_DESCR FIX_AXIS NO_INPUT_QUANTITY TCY_FN1020LO_COPY 14 0 13 FIX_AXIS_PAR 0 0 14 /end AXIS_DESCR
/end CHARACTERISTIC
/begin COMPU_METHOD TCZ_FN1020LO_COPY "FN1020LO_COPY Z-axis conversion" RAT_FUNC "%10.5" "unitless" COEFFS 0 1 0 0 0 1 /end COMPU_METHOD
/begin COMPU_METHOD TCX_FN1020LO_COPY "FN1020LO_COPY X-axis conversion" RAT_FUNC "%10.5" "degC" COEFFS 0 1 0 0 0 1 /end COMPU_METHOD
/begin COMPU_METHOD TCY_FN1020LO_COPY "FN1020LO_COPY Y-axis conversion" RAT_FUNC "%10.5" "unitless" COEFFS 0 1 0 0 0 1 /end COMPU_METHOD
/begin CHARACTERISTIC FN1020L_A "X Norm=FN014DS, Y Norm=unknown" MAP 0x46C0C TD_FLOAT32_IEEE 0 TCZ_FN1020L_A 0 200
 /begin AXIS_DESCR FIX_AXIS NO_INPUT_QUANTITY TCX_FN1020L_A 14 0 13 FIX_AXIS_PAR 0 0 14 /end AXIS_DESCR
 /begin AXIS_DESCR FIX_AXIS NO_INPUT_QUANTITY TCY_FN1020L_A 14 0 13 FIX_AXIS_PAR 0 0 14 /end AXIS_DESCR
/end CHARACTERISTIC
/begin COMPU_METHOD TCZ_FN1020L_A "FN1020L_A Z-axis conversion" RAT_FUNC "%10.5" "unitless" COEFFS 0 1 0 0 0 1 /end COMPU_METHOD
/begin COMPU_METHOD TCX_FN1020L_A "FN1020L_A X-axis conversion" RAT_FUNC "%10.5" "RPM" COEFFS 0 1 0 0 0 1 /end COMPU_METHOD
/begin COMPU_METHOD TCY_FN1020L_A "FN1020L_A Y-axis conversion" RAT_FUNC "%10.5" "Unitless" COEFFS 0 1 0 0 0 1 /end COMPU_METHOD
/begin CHARACTERISTIC FN1020PH_A "X Norm=FN014P, Y Norm=unknown, Limit fuel based on engine speed and vehicle speed at high altitude" MAP 0x4722C TD_FLOAT32_IEEE 0 TCZ_FN1020PH_A 0 200
 /begin AXIS_DESCR FIX_AXIS NO_INPUT_QUANTITY TCX_FN1020PH_A 14 0 13 FIX_AXIS_PAR 0 0 14 /end AXIS_DESCR
 /begin AXIS_DESCR FIX_AXIS NO_INPUT_QUANTITY TCY_FN1020PH_A 14 0 13 FIX_AXIS_PAR 0 0 14 /end AXIS_DESCR
/end CHARACTERISTIC
/begin COMPU_METHOD TCZ_FN1020PH_A "FN1020PH_A Z-axis conversion" RAT_FUNC "%10.5" "unitless" COEFFS 0 1 0 0 0 1 /end COMPU_METHOD
/begin COMPU_METHOD TCX_FN1020PH_A "FN1020PH_A X-axis conversion" RAT_FUNC "%10.5" "RPM" COEFFS 0 1 0 0 0 1 /end COMPU_METHOD
/begin COMPU_METHOD TCY_FN1020PH_A "FN1020PH_A Y-axis conversion" RAT_FUNC "%10.5" "Unitless" COEFFS 0 1 0 0 0 1 /end COMPU_METHOD
/begin CHARACTERISTIC FN1020PLO_COPY "X Norm=FN_TQ122P_ECT, Y Norm=FN_TQ117, Copy of fn1020pl_a from fuel limiter" MAP 0x5210C TD_FLOAT32_IEEE 0 TCZ_FN1020PLO_COPY 0 200
 /begin AXIS_DESCR FIX_AXIS NO_INPUT_QUANTITY TCX_FN1020PLO_COPY 14 0 13 FIX_AXIS_PAR 0 0 14 /end AXIS_DESCR
 /begin AXIS_DESCR FIX_AXIS NO_INPUT_QUANTITY TCY_FN1020PLO_COPY 14 0 13 FIX_AXIS_PAR 0 0 14 /end AXIS_DESCR
/end CHARACTERISTIC
/begin COMPU_METHOD TCZ_FN1020PLO_COPY "FN1020PLO_COPY Z-axis conversion" RAT_FUNC "%10.5" "unitless" COEFFS 0 1 0 0 0 1 /end COMPU_METHOD
/begin COMPU_METHOD TCX_FN1020PLO_COPY "FN1020PLO_COPY X-axis conversion" RAT_FUNC "%10.5" "degC" COEFFS 0 1 0 0 0 1 /end COMPU_METHOD
/begin COMPU_METHOD TCY_FN1020PLO_COPY "FN1020PLO_COPY Y-axis conversion" RAT_FUNC "%10.5" "unitless" COEFFS 0 1 0 0 0 1 /end COMPU_METHOD
/begin CHARACTERISTIC FN1020PL_A "X Norm=FN014P, Y Norm=unknown" MAP 0x46F1C TD_FLOAT32_IEEE 0 TCZ_FN1020PL_A 0 200
 /begin AXIS_DESCR FIX_AXIS NO_INPUT_QUANTITY TCX_FN1020PL_A 14 0 13 FIX_AXIS_PAR 0 0 14 /end AXIS_DESCR
 /begin AXIS_DESCR FIX_AXIS NO_INPUT_QUANTITY TCY_FN1020PL_A 14 0 13 FIX_AXIS_PAR 0 0 14 /end AXIS_DESCR
/end CHARACTERISTIC
/begin COMPU_METHOD TCZ_FN1020PL_A "FN1020PL_A Z-axis conversion" RAT_FUNC "%10.5" "unitless" COEFFS 0 1 0 0 0 1 /end COMPU_METHOD
/begin COMPU_METHOD TCX_FN1020PL_A "FN1020PL_A X-axis conversion" RAT_FUNC "%10.5" "RPM" COEFFS 0 1 0 0 0 1 /end COMPU_METHOD
/begin COMPU_METHOD TCY_FN1020PL_A "FN1020PL_A Y-axis conversion" RAT_FUNC "%10.5" "Unitless" COEFFS 0 1 0 0 0 1 /end COMPU_METHOD
/begin MEASUREMENT FN1020_MFMTQ "Torque fuel limit function output" FLOAT32_IEEE MC_FN1020_MFMTQ 0 0 0 0 ECU_ADDRESS 0x3FA82C /end MEASUREMENT
/begin COMPU_METHOD MC_FN1020_MFMTQ "FN1020_MFMTQ conversion" RAT_FUNC "%10.5" "Unitless" COEFFS 0 1 0 0 0 1 /end COMPU_METHOD
/begin MEASUREMENT FN1020_MFMTQ_P "Torque fuel limit function output for pilot mode" FLOAT32_IEEE MC_FN1020_MFMTQ_P 0 0 0 0 ECU_ADDRESS 0x3FA828 /end MEASUREMENT
/begin COMPU_METHOD MC_FN1020_MFMTQ_P "FN1020_MFMTQ_P conversion" RAT_FUNC "%10.5" "Unitless" COEFFS 0 1 0 0 0 1 /end COMPU_METHOD
/begin CHARACTERISTIC FN103CP "" CURVE 0x4532C FD_FLOAT32_IEEE 0 FCY_FN103CP -100 100 /begin AXIS_DESCR STD_AXIS NERR FCX_FN103CP 10 -5000 5000 /end AXIS_DESCR /end CHARACTERISTIC
/begin COMPU_METHOD FCX_FN103CP "FN103CP X-axis conversion" RAT_FUNC "%10.5" "RPM" COEFFS 0 1 0 0 0 1 /end COMPU_METHOD
/begin COMPU_METHOD FCY_FN103CP "FN103CP Y-axis conversion" RAT_FUNC "%10.5" "unitless" COEFFS 0 1 0 0 0 1 /end COMPU_METHOD
/begin CHARACTERISTIC FN103CRU "" CURVE 0x4528C FD_FLOAT32_IEEE 0 FCY_FN103CRU -100 100 /begin AXIS_DESCR STD_AXIS N FCX_FN103CRU 10 0 5000 /end AXIS_DESCR /end CHARACTERISTIC
/begin COMPU_METHOD FCX_FN103CRU "FN103CRU X-axis conversion" RAT_FUNC "%10.5" "RPM" COEFFS 0 1 0 0 0 1 /end COMPU_METHOD
/begin COMPU_METHOD FCY_FN103CRU "FN103CRU Y-axis conversion" RAT_FUNC "%10.5" "unitless" COEFFS 0 1 0 0 0 1 /end COMPU_METHOD
/begin CHARACTERISTIC FN103CRUR "" CURVE 0x4523C FD_FLOAT32_IEEE 0 FCY_FN103CRUR -100 100 /begin AXIS_DESCR STD_AXIS NERR FCX_FN103CRUR 10 -5000 5000 /end AXIS_DESCR /end CHARACTERISTIC
/begin COMPU_METHOD FCX_FN103CRUR "FN103CRUR X-axis conversion" RAT_FUNC "%10.5" "RPM" COEFFS 0 1 0 0 0 1 /end COMPU_METHOD
/begin COMPU_METHOD FCY_FN103CRUR "FN103CRUR Y-axis conversion" RAT_FUNC "%10.5" "unitless" COEFFS 0 1 0 0 0 1 /end COMPU_METHOD
/begin CHARACTERISTIC FN103DRV "Governor proportional gain in 'drive' or 'reverse'" CURVE 0x44C0C FD_FLOAT32_IEEE 0 FCY_FN103DRV 0 1 /begin AXIS_DESCR STD_AXIS NERR FCX_FN103DRV 10 -5000 5000 /end AXIS_DESCR /end CHARACTERISTIC
/begin COMPU_METHOD FCX_FN103DRV "FN103DRV X-axis conversion" RAT_FUNC "%10.5" "RPM" COEFFS 0 1 0 0 0 1 /end COMPU_METHOD
/begin COMPU_METHOD FCY_FN103DRV "FN103DRV Y-axis conversion" RAT_FUNC "%10.5" "unitless" COEFFS 0 1 0 0 0 1 /end COMPU_METHOD
/begin CHARACTERISTIC FN103DRVX "" CURVE 0x4537C FD_FLOAT32_IEEE 0 FCY_FN103DRVX -100 100 /begin AXIS_DESCR STD_AXIS NERR FCX_FN103DRVX 10 -5000 5000 /end AXIS_DESCR /end CHARACTERISTIC
/begin COMPU_METHOD FCX_FN103DRVX "FN103DRVX X-axis conversion" RAT_FUNC "%10.5" "RPM" COEFFS 0 1 0 0 0 1 /end COMPU_METHOD
/begin COMPU_METHOD FCY_FN103DRVX "FN103DRVX Y-axis conversion" RAT_FUNC "%10.5" "unitless" COEFFS 0 1 0 0 0 1 /end COMPU_METHOD
/begin CHARACTERISTIC FN103DRV_P "Governor proportional gain in 'drive' or 'reverse' - pilot fuelling mode" CURVE 0x44C5C FD_FLOAT32_IEEE 0 FCY_FN103DRV_P 0 1 /begin AXIS_DESCR STD_AXIS NERR FCX_FN103DRV_P 10 -2000 5000 /end AXIS_DESCR /end CHARACTERISTIC
/begin COMPU_METHOD FCX_FN103DRV_P "FN103DRV_P X-axis conversion" RAT_FUNC "%10.5" "RPM" COEFFS 0 1 0 0 0 1 /end COMPU_METHOD
/begin COMPU_METHOD FCY_FN103DRV_P "FN103DRV_P Y-axis conversion" RAT_FUNC "%10.5" "unitless" COEFFS 0 1 0 0 0 1 /end COMPU_METHOD
/begin CHARACTERISTIC FN103FASTCRU "" CURVE 0x454C4 FD_FLOAT32_IEEE 0 FCY_FN103FASTCRU -100 100 /begin AXIS_DESCR STD_AXIS N FCX_FN103FASTCRU 10 0 5000 /end AXIS_DESCR /end CHARACTERISTIC
/begin COMPU_METHOD FCX_FN103FASTCRU "FN103FASTCRU X-axis conversion" RAT_FUNC "%10.5" "RPM" COEFFS 0 1 0 0 0 1 /end COMPU_METHOD
/begin COMPU_METHOD FCY_FN103FASTCRU "FN103FASTCRU Y-axis conversion" RAT_FUNC "%10.5" "unitless" COEFFS 0 1 0 0 0 1 /end COMPU_METHOD
/begin CHARACTERISTIC FN103FSTCRUR "" CURVE 0x451EC FD_FLOAT32_IEEE 0 FCY_FN103FSTCRUR -100 100 /begin AXIS_DESCR STD_AXIS NERR FCX_FN103FSTCRUR 10 -5000 5000 /end AXIS_DESCR /end CHARACTERISTIC
/begin COMPU_METHOD FCX_FN103FSTCRUR "FN103FSTCRUR X-axis conversion" RAT_FUNC "%10.5" "RPM" COEFFS 0 1 0 0 0 1 /end COMPU_METHOD
/begin COMPU_METHOD FCY_FN103FSTCRUR "FN103FSTCRUR Y-axis conversion" RAT_FUNC "%10.5" "unitless" COEFFS 0 1 0 0 0 1 /end COMPU_METHOD
/begin CHARACTERISTIC FN103NEU "Governor proportional gain in 'park' or 'neutral'" CURVE 0x44B6C FD_FLOAT32_IEEE 0 FCY_FN103NEU 0 1 /begin AXIS_DESCR STD_AXIS NERR FCX_FN103NEU 10 -5000 5000 /end AXIS_DESCR /end CHARACTERISTIC
/begin COMPU_METHOD FCX_FN103NEU "FN103NEU X-axis conversion" RAT_FUNC "%10.5" "RPM" COEFFS 0 1 0 0 0 1 /end COMPU_METHOD
/begin COMPU_METHOD FCY_FN103NEU "FN103NEU Y-axis conversion" RAT_FUNC "%10.5" "unitless" COEFFS 0 1 0 0 0 1 /end COMPU_METHOD
/begin CHARACTERISTIC FN103NEUX "" CURVE 0x453CC FD_FLOAT32_IEEE 0 FCY_FN103NEUX -100 100 /begin AXIS_DESCR STD_AXIS NERR FCX_FN103NEUX 10 -5000 5000 /end AXIS_DESCR /end CHARACTERISTIC
/begin COMPU_METHOD FCX_FN103NEUX "FN103NEUX X-axis conversion" RAT_FUNC "%10.5" "RPM" COEFFS 0 1 0 0 0 1 /end COMPU_METHOD
/begin COMPU_METHOD FCY_FN103NEUX "FN103NEUX Y-axis conversion" RAT_FUNC "%10.5" "unitless" COEFFS 0 1 0 0 0 1 /end COMPU_METHOD
/begin CHARACTERISTIC FN103NEU_P "Governor proportional gain in 'park' or 'neutral' - pilot fuelling mode" CURVE 0x44BBC FD_FLOAT32_IEEE 0 FCY_FN103NEU_P 0 1 /begin AXIS_DESCR STD_AXIS NERR FCX_FN103NEU_P 10 -2000 5000 /end AXIS_DESCR /end CHARACTERISTIC
/begin COMPU_METHOD FCX_FN103NEU_P "FN103NEU_P X-axis conversion" RAT_FUNC "%10.5" "RPM" COEFFS 0 1 0 0 0 1 /end COMPU_METHOD
/begin COMPU_METHOD FCY_FN103NEU_P "FN103NEU_P Y-axis conversion" RAT_FUNC "%10.5" "unitless" COEFFS 0 1 0 0 0 1 /end COMPU_METHOD
/begin CHARACTERISTIC FN103SRC "" CURVE 0x452DC FD_FLOAT32_IEEE 0 FCY_FN103SRC -100 100 /begin AXIS_DESCR STD_AXIS NERR FCX_FN103SRC 10 -5000 5000 /end AXIS_DESCR /end CHARACTERISTIC
/begin COMPU_METHOD FCX_FN103SRC "FN103SRC X-axis conversion" RAT_FUNC "%10.5" "RPM" COEFFS 0 1 0 0 0 1 /end COMPU_METHOD
/begin COMPU_METHOD FCY_FN103SRC "FN103SRC Y-axis conversion" RAT_FUNC "%10.5" "unitless" COEFFS 0 1 0 0 0 1 /end COMPU_METHOD
/begin CHARACTERISTIC FN104DN "Drive/Neutral Feed-Forward Adder for MFGOV_PI" CURVE 0x44DEC FD_FLOAT32_IEEE 0 FCY_FN104DN -20 20 /begin AXIS_DESCR STD_AXIS TOT FCX_FN104DN 8 -40 300 /end AXIS_DESCR /end CHARACTERISTIC
/begin COMPU_METHOD FCX_FN104DN "FN104DN X-axis conversion" RAT_FUNC "%10.5" "degF" COEFFS 0 1 0 0 0 1 /end COMPU_METHOD
/begin COMPU_METHOD FCY_FN104DN "FN104DN Y-axis conversion" RAT_FUNC "%10.5" "unitless" COEFFS 0 1 0 0 0 1 /end COMPU_METHOD
/begin CHARACTERISTIC FN104ND "Neutral/Drive Feed-Forward Adder for MFGOV_PI" CURVE 0x44D6C FD_FLOAT32_IEEE 0 FCY_FN104ND 0 20 /begin AXIS_DESCR STD_AXIS TOT FCX_FN104ND 8 -40 300 /end AXIS_DESCR /end CHARACTERISTIC
/begin COMPU_METHOD FCX_FN104ND "FN104ND X-axis conversion" RAT_FUNC "%10.5" "degF" COEFFS 0 1 0 0 0 1 /end COMPU_METHOD
/begin COMPU_METHOD FCY_FN104ND "FN104ND Y-axis conversion" RAT_FUNC "%10.5" "unitless" COEFFS 0 1 0 0 0 1 /end COMPU_METHOD
/begin CHARACTERISTIC FN105D "Isochronous governor reference fuel in 'drive' or 'reverse'" CURVE 0x44B2C FD_FLOAT32_IEEE 0 FCY_FN105D 0 80 /begin AXIS_DESCR STD_AXIS EOT_C FCX_FN105D 8 -40 150 /end AXIS_DESCR /end CHARACTERISTIC
/begin COMPU_METHOD FCX_FN105D "FN105D X-axis conversion" RAT_FUNC "%10.5" "degC" COEFFS 0 1 0 0 0 1 /end COMPU_METHOD
/begin COMPU_METHOD FCY_FN105D "FN105D Y-axis conversion" RAT_FUNC "%10.5" "unitless" COEFFS 0 1 0 0 0 1 /end COMPU_METHOD
/begin CHARACTERISTIC FN105N "Isochronous governor reference fuel in 'park' or 'neutral'" CURVE 0x44AEC FD_FLOAT32_IEEE 0 FCY_FN105N 0 80 /begin AXIS_DESCR STD_AXIS EOT_C FCX_FN105N 8 -40 150 /end AXIS_DESCR /end CHARACTERISTIC
/begin COMPU_METHOD FCX_FN105N "FN105N X-axis conversion" RAT_FUNC "%10.5" "degC" COEFFS 0 1 0 0 0 1 /end COMPU_METHOD
/begin COMPU_METHOD FCY_FN105N "FN105N Y-axis conversion" RAT_FUNC "%10.5" "unitless" COEFFS 0 1 0 0 0 1 /end COMPU_METHOD
/begin CHARACTERISTIC FN106DS "Isochronous govern I-term seed (Crank mode)" CURVE 0x4502C FD_FLOAT32_IEEE 0 FCY_FN106DS 0 80 /begin AXIS_DESCR STD_AXIS EOT_C FCX_FN106DS 8 -40 150 /end AXIS_DESCR /end CHARACTERISTIC
/begin COMPU_METHOD FCX_FN106DS "FN106DS X-axis conversion" RAT_FUNC "%10.5" "degC" COEFFS 0 1 0 0 0 1 /end COMPU_METHOD
/begin COMPU_METHOD FCY_FN106DS "FN106DS Y-axis conversion" RAT_FUNC "%10.5" "unitless" COEFFS 0 1 0 0 0 1 /end COMPU_METHOD
/begin CHARACTERISTIC FN107 "Idle speed setpoint" CURVE 0x449AC FD_FLOAT32_IEEE 0 FCY_FN107 400 4000 /begin AXIS_DESCR STD_AXIS EOT_C FCX_FN107 6 -40 150 /end AXIS_DESCR /end CHARACTERISTIC
/begin COMPU_METHOD FCX_FN107 "FN107 X-axis conversion" RAT_FUNC "%10.5" "degC" COEFFS 0 1 0 0 0 1 /end COMPU_METHOD
/begin COMPU_METHOD FCY_FN107 "FN107 Y-axis conversion" RAT_FUNC "%10.5" "RPM" COEFFS 0 1 0 0 0 1 /end COMPU_METHOD
/begin CHARACTERISTIC FN108DS "Feed-Forward term for A/C clutch On/Off" CURVE 0x44E2C FD_FLOAT32_IEEE 0 FCY_FN108DS 0 5 /begin AXIS_DESCR STD_AXIS IAT FCX_FN108DS 8 -40 300 /end AXIS_DESCR /end CHARACTERISTIC
/begin COMPU_METHOD FCX_FN108DS "FN108DS X-axis conversion" RAT_FUNC "%10.5" "degC" COEFFS 0 1 0 0 0 1 /end COMPU_METHOD
/begin COMPU_METHOD FCY_FN108DS "FN108DS Y-axis conversion" RAT_FUNC "%10.5" "unitless" COEFFS 0 1 0 0 0 1 /end COMPU_METHOD
/begin CHARACTERISTIC FN109 "Road speed limiter" CURVE 0x449DC FD_FLOAT32_IEEE 0 FCY_FN109 650 4000 /begin AXIS_DESCR STD_AXIS RDSP_FILT FCX_FN109 6 0 180 /end AXIS_DESCR /end CHARACTERISTIC
/begin COMPU_METHOD FCX_FN109 "FN109 X-axis conversion" RAT_FUNC "%10.5" "KPH" COEFFS 0 1 0 0 0 1 /end COMPU_METHOD
/begin COMPU_METHOD FCY_FN109 "FN109 Y-axis conversion" RAT_FUNC "%10.5" "RPM" COEFFS 0 1 0 0 0 1 /end COMPU_METHOD
/begin CHARACTERISTIC FN110 "Fuel density adjustment" CURVE 0x45FA4 FD_FLOAT32_IEEE 0 FCY_FN110 0.7 1.3 /begin AXIS_DESCR STD_AXIS EOT_C FCX_FN110 8 -40 150 /end AXIS_DESCR /end CHARACTERISTIC
/begin COMPU_METHOD FCX_FN110 "FN110 X-axis conversion" RAT_FUNC "%10.5" "degC" COEFFS 0 1 0 0 0 1 /end COMPU_METHOD
/begin COMPU_METHOD FCY_FN110 "FN110 Y-axis conversion" RAT_FUNC "%10.5" "unitless" COEFFS 0 1 0 0 0 1 /end COMPU_METHOD
/begin CHARACTERISTIC FN1108 "X Norm=FN021DS, Y Norm=FN035DS, All-speed fuel quantity table" MAP 0x455F4 TD_FLOAT32_IEEE 0 TCZ_FN1108 -1024 1023
 /begin AXIS_DESCR FIX_AXIS NO_INPUT_QUANTITY TCX_FN1108 14 0 13 FIX_AXIS_PAR 0 0 14 /end AXIS_DESCR
 /begin AXIS_DESCR FIX_AXIS NO_INPUT_QUANTITY TCY_FN1108 14 0 13 FIX_AXIS_PAR 0 0 14 /end AXIS_DESCR
/end CHARACTERISTIC
/begin COMPU_METHOD TCZ_FN1108 "FN1108 Z-axis conversion" RAT_FUNC "%10.5" "unitless" COEFFS 0 1 0 0 0 1 /end COMPU_METHOD
/begin COMPU_METHOD TCX_FN1108 "FN1108 X-axis conversion" RAT_FUNC "%10.5" "RPM" COEFFS 0 1 0 0 0 1 /end COMPU_METHOD
/begin COMPU_METHOD TCY_FN1108 "FN1108 Y-axis conversion" RAT_FUNC "%10.5" "ADct" COEFFS 0 1 0 0 0 1 /end COMPU_METHOD
/begin CHARACTERISTIC FN1108C "X Norm=FN021_IPP, Y Norm=FN028_IPP, All-speed fuel quantity table" MAP 0x45C14 TD_FLOAT32_IEEE 0 TCZ_FN1108C -1024 1023
 /begin AXIS_DESCR FIX_AXIS NO_INPUT_QUANTITY TCX_FN1108C 14 0 13 FIX_AXIS_PAR 0 0 14 /end AXIS_DESCR
 /begin AXIS_DESCR FIX_AXIS NO_INPUT_QUANTITY TCY_FN1108C 14 0 13 FIX_AXIS_PAR 0 0 14 /end AXIS_DESCR
/end CHARACTERISTIC
/begin COMPU_METHOD TCZ_FN1108C "FN1108C Z-axis conversion" RAT_FUNC "%10.5" "unitless" COEFFS 0 1 0 0 0 1 /end COMPU_METHOD
/begin COMPU_METHOD TCX_FN1108C "FN1108C X-axis conversion" RAT_FUNC "%10.5" "RPM" COEFFS 0 1 0 0 0 1 /end COMPU_METHOD
/begin COMPU_METHOD TCY_FN1108C "FN1108C Y-axis conversion" RAT_FUNC "%10.5" "unitless" COEFFS 0 1 0 0 0 1 /end COMPU_METHOD
/begin CHARACTERISTIC FN1108P "X Norm=FN021P, Y Norm=FN035P, All-speed fuel quantity table" MAP 0x45904 TD_FLOAT32_IEEE 0 TCZ_FN1108P -1024 1023
 /begin AXIS_DESCR FIX_AXIS NO_INPUT_QUANTITY TCX_FN1108P 14 0 13 FIX_AXIS_PAR 0 0 14 /end AXIS_DESCR
 /begin AXIS_DESCR FIX_AXIS NO_INPUT_QUANTITY TCY_FN1108P 14 0 13 FIX_AXIS_PAR 0 0 14 /end AXIS_DESCR
/end CHARACTERISTIC
/begin COMPU_METHOD TCZ_FN1108P "FN1108P Z-axis conversion" RAT_FUNC "%10.5" "unitless" COEFFS 0 1 0 0 0 1 /end COMPU_METHOD
/begin COMPU_METHOD TCX_FN1108P "FN1108P X-axis conversion" RAT_FUNC "%10.5" "RPM" COEFFS 0 1 0 0 0 1 /end COMPU_METHOD
/begin COMPU_METHOD TCY_FN1108P "FN1108P Y-axis conversion" RAT_FUNC "%10.5" "ADct" COEFFS 0 1 0 0 0 1 /end COMPU_METHOD
/begin CHARACTERISTIC FN1108P_COPY "X Norm=FN_TQ109, Y Norm=FN_TQ110, Copy of fn1108p 'pilot pedal fuel' table from fuel control strategy" MAP 0x5274C TD_FLOAT32_IEEE 0 TCZ_FN1108P_COPY -1024 1023
 /begin AXIS_DESCR FIX_AXIS NO_INPUT_QUANTITY TCX_FN1108P_COPY 14 0 13 FIX_AXIS_PAR 0 0 14 /end AXIS_DESCR
 /begin AXIS_DESCR FIX_AXIS NO_INPUT_QUANTITY TCY_FN1108P_COPY 14 0 13 FIX_AXIS_PAR 0 0 14 /end AXIS_DESCR
/end CHARACTERISTIC
/begin COMPU_METHOD TCZ_FN1108P_COPY "FN1108P_COPY Z-axis conversion" RAT_FUNC "%10.5" "unitless" COEFFS 0 1 0 0 0 1 /end COMPU_METHOD
/begin COMPU_METHOD TCX_FN1108P_COPY "FN1108P_COPY X-axis conversion" RAT_FUNC "%10.5" "unitless" COEFFS 0 1 0 0 0 1 /end COMPU_METHOD
/begin COMPU_METHOD TCY_FN1108P_COPY "FN1108P_COPY Y-axis conversion" RAT_FUNC "%10.5" "unitless" COEFFS 0 1 0 0 0 1 /end COMPU_METHOD
/begin CHARACTERISTIC FN1108_COPY "X Norm=FN_TQ109, Y Norm=FN_TQ110, Copy of fn1108 singlr shot pedal fuel table from fuel control strategy" MAP 0x5242C TD_FLOAT32_IEEE 0 TCZ_FN1108_COPY -1024 1023
 /begin AXIS_DESCR FIX_AXIS NO_INPUT_QUANTITY TCX_FN1108_COPY 14 0 13 FIX_AXIS_PAR 0 0 14 /end AXIS_DESCR
 /begin AXIS_DESCR FIX_AXIS NO_INPUT_QUANTITY TCY_FN1108_COPY 14 0 13 FIX_AXIS_PAR 0 0 14 /end AXIS_DESCR
/end CHARACTERISTIC
/begin COMPU_METHOD TCZ_FN1108_COPY "FN1108_COPY Z-axis conversion" RAT_FUNC "%10.5" "unitless" COEFFS 0 1 0 0 0 1 /end COMPU_METHOD
/begin COMPU_METHOD TCX_FN1108_COPY "FN1108_COPY X-axis conversion" RAT_FUNC "%10.5" "unitless" COEFFS 0 1 0 0 0 1 /end COMPU_METHOD
/begin COMPU_METHOD TCY_FN1108_COPY "FN1108_COPY Y-axis conversion" RAT_FUNC "%10.5" "unitless" COEFFS 0 1 0 0 0 1 /end COMPU_METHOD
/begin CHARACTERISTIC FN111DN "Timer term for Drive/Neutral engagement delay" CURVE 0x44DAC FD_FLOAT32_IEEE 0 FCY_FN111DN 0 65535 /begin AXIS_DESCR STD_AXIS TOT FCX_FN111DN 8 -40 300 /end AXIS_DESCR /end CHARACTERISTIC
/begin COMPU_METHOD FCX_FN111DN "FN111DN X-axis conversion" RAT_FUNC "%10.5" "degF" COEFFS 0 1 0 0 0 1 /end COMPU_METHOD
/begin COMPU_METHOD FCY_FN111DN "FN111DN Y-axis conversion" RAT_FUNC "%10.5" "ms" COEFFS 0 1 0 0 0 1 /end COMPU_METHOD
/begin CHARACTERISTIC FN111ND "Timer term for Neutral/Drive engagement delay" CURVE 0x44D2C FD_FLOAT32_IEEE 0 FCY_FN111ND 0 65535 /begin AXIS_DESCR STD_AXIS TOT FCX_FN111ND 8 -40 300 /end AXIS_DESCR /end CHARACTERISTIC
/begin COMPU_METHOD FCX_FN111ND "FN111ND X-axis conversion" RAT_FUNC "%10.5" "degF" COEFFS 0 1 0 0 0 1 /end COMPU_METHOD
/begin COMPU_METHOD FCY_FN111ND "FN111ND Y-axis conversion" RAT_FUNC "%10.5" "ms" COEFFS 0 1 0 0 0 1 /end COMPU_METHOD
/begin CHARACTERISTIC FN1120H_A "X Norm=FN012DS_A, Y Norm=FN030DS_A" MAP 0x4793C TD_FLOAT32_IEEE 0 TCZ_FN1120H_A 0 1000
 /begin AXIS_DESCR FIX_AXIS NO_INPUT_QUANTITY TCX_FN1120H_A 14 0 13 FIX_AXIS_PAR 0 0 14 /end AXIS_DESCR
 /begin AXIS_DESCR FIX_AXIS NO_INPUT_QUANTITY TCY_FN1120H_A 14 0 13 FIX_AXIS_PAR 0 0 14 /end AXIS_DESCR
/end CHARACTERISTIC
/begin COMPU_METHOD TCZ_FN1120H_A "FN1120H_A Z-axis conversion" RAT_FUNC "%10.5" "unitless" COEFFS 0 1 0 0 0 1 /end COMPU_METHOD
/begin COMPU_METHOD TCX_FN1120H_A "FN1120H_A X-axis conversion" RAT_FUNC "%10.5" "RPM" COEFFS 0 1 0 0 0 1 /end COMPU_METHOD
/begin COMPU_METHOD TCY_FN1120H_A "FN1120H_A Y-axis conversion" RAT_FUNC "%10.5" "kPa" COEFFS 0 1 0 0 0 1 /end COMPU_METHOD
/begin CHARACTERISTIC FN1120L_A "X Norm=FN012DS_A, Y Norm=FN030DS_A" MAP 0x47C4C TD_FLOAT32_IEEE 0 TCZ_FN1120L_A 0 1000
 /begin AXIS_DESCR FIX_AXIS NO_INPUT_QUANTITY TCX_FN1120L_A 14 0 13 FIX_AXIS_PAR 0 0 14 /end AXIS_DESCR
 /begin AXIS_DESCR FIX_AXIS NO_INPUT_QUANTITY TCY_FN1120L_A 14 0 13 FIX_AXIS_PAR 0 0 14 /end AXIS_DESCR
/end CHARACTERISTIC
/begin COMPU_METHOD TCZ_FN1120L_A "FN1120L_A Z-axis conversion" RAT_FUNC "%10.5" "unitless" COEFFS 0 1 0 0 0 1 /end COMPU_METHOD
/begin COMPU_METHOD TCX_FN1120L_A "FN1120L_A X-axis conversion" RAT_FUNC "%10.5" "RPM" COEFFS 0 1 0 0 0 1 /end COMPU_METHOD
/begin COMPU_METHOD TCY_FN1120L_A "FN1120L_A Y-axis conversion" RAT_FUNC "%10.5" "kPa" COEFFS 0 1 0 0 0 1 /end COMPU_METHOD
/begin CHARACTERISTIC FN1120PH_B "X Norm=FN012P_B, Y Norm=FN030P_B, boost limited smoke control table" MAP 0x480EC TD_FLOAT32_IEEE 0 TCZ_FN1120PH_B 0 1000
 /begin AXIS_DESCR FIX_AXIS NO_INPUT_QUANTITY TCX_FN1120PH_B 10 0 9 FIX_AXIS_PAR 0 0 10 /end AXIS_DESCR
 /begin AXIS_DESCR FIX_AXIS NO_INPUT_QUANTITY TCY_FN1120PH_B 10 0 9 FIX_AXIS_PAR 0 0 10 /end AXIS_DESCR
/end CHARACTERISTIC
/begin COMPU_METHOD TCZ_FN1120PH_B "FN1120PH_B Z-axis conversion" RAT_FUNC "%10.5" "unitless" COEFFS 0 1 0 0 0 1 /end COMPU_METHOD
/begin COMPU_METHOD TCX_FN1120PH_B "FN1120PH_B X-axis conversion" RAT_FUNC "%10.5" "RPM" COEFFS 0 1 0 0 0 1 /end COMPU_METHOD
/begin COMPU_METHOD TCY_FN1120PH_B "FN1120PH_B Y-axis conversion" RAT_FUNC "%10.5" "kPa" COEFFS 0 1 0 0 0 1 /end COMPU_METHOD
/begin CHARACTERISTIC FN1120PL_B "X Norm=FN012P_B, Y Norm=FN030P_B" MAP 0x47F5C TD_FLOAT32_IEEE 0 TCZ_FN1120PL_B 0 1000
 /begin AXIS_DESCR FIX_AXIS NO_INPUT_QUANTITY TCX_FN1120PL_B 10 0 9 FIX_AXIS_PAR 0 0 10 /end AXIS_DESCR
 /begin AXIS_DESCR FIX_AXIS NO_INPUT_QUANTITY TCY_FN1120PL_B 10 0 9 FIX_AXIS_PAR 0 0 10 /end AXIS_DESCR
/end CHARACTERISTIC
/begin COMPU_METHOD TCZ_FN1120PL_B "FN1120PL_B Z-axis conversion" RAT_FUNC "%10.5" "unitless" COEFFS 0 1 0 0 0 1 /end COMPU_METHOD
/begin COMPU_METHOD TCX_FN1120PL_B "FN1120PL_B X-axis conversion" RAT_FUNC "%10.5" "RPM" COEFFS 0 1 0 0 0 1 /end COMPU_METHOD
/begin COMPU_METHOD TCY_FN1120PL_B "FN1120PL_B Y-axis conversion" RAT_FUNC "%10.5" "kPa" COEFFS 0 1 0 0 0 1 /end COMPU_METHOD
/begin CHARACTERISTIC FN1200DSH_A "X Norm=FN019DS_A, Y Norm=FN013DS_A" MAP 0x49A84 TD_FLOAT32_IEEE 0 TCZ_FN1200DSH_A -100 200
 /begin AXIS_DESCR FIX_AXIS NO_INPUT_QUANTITY TCX_FN1200DSH_A 14 0 13 FIX_AXIS_PAR 0 0 14 /end AXIS_DESCR
 /begin AXIS_DESCR FIX_AXIS NO_INPUT_QUANTITY TCY_FN1200DSH_A 14 0 13 FIX_AXIS_PAR 0 0 14 /end AXIS_DESCR
/end CHARACTERISTIC
/begin COMPU_METHOD TCZ_FN1200DSH_A "FN1200DSH_A Z-axis conversion" RAT_FUNC "%10.5" "unitless" COEFFS 0 1 0 0 0 1 /end COMPU_METHOD
/begin COMPU_METHOD TCX_FN1200DSH_A "FN1200DSH_A X-axis conversion" RAT_FUNC "%10.5" "unitless" COEFFS 0 1 0 0 0 1 /end COMPU_METHOD
/begin COMPU_METHOD TCY_FN1200DSH_A "FN1200DSH_A Y-axis conversion" RAT_FUNC "%10.5" "unitless" COEFFS 0 1 0 0 0 1 /end COMPU_METHOD
/begin CHARACTERISTIC FN1200DSL_A "X Norm=FN019DS_A, Y Norm=FN013DS_A" MAP 0x49774 TD_FLOAT32_IEEE 0 TCZ_FN1200DSL_A -100 200
 /begin AXIS_DESCR FIX_AXIS NO_INPUT_QUANTITY TCX_FN1200DSL_A 14 0 13 FIX_AXIS_PAR 0 0 14 /end AXIS_DESCR
 /begin AXIS_DESCR FIX_AXIS NO_INPUT_QUANTITY TCY_FN1200DSL_A 14 0 13 FIX_AXIS_PAR 0 0 14 /end AXIS_DESCR
/end CHARACTERISTIC
/begin COMPU_METHOD TCZ_FN1200DSL_A "FN1200DSL_A Z-axis conversion" RAT_FUNC "%10.5" "unitless" COEFFS 0 1 0 0 0 1 /end COMPU_METHOD
/begin COMPU_METHOD TCX_FN1200DSL_A "FN1200DSL_A X-axis conversion" RAT_FUNC "%10.5" "unitless" COEFFS 0 1 0 0 0 1 /end COMPU_METHOD
/begin COMPU_METHOD TCY_FN1200DSL_A "FN1200DSL_A Y-axis conversion" RAT_FUNC "%10.5" "unitless" COEFFS 0 1 0 0 0 1 /end COMPU_METHOD
/begin CHARACTERISTIC FN1200DSL_FB "X Norm=FN019DS_A, Y Norm=FN013DS_A, DIT full boost table." MAP 0x4A3B4 TD_FLOAT32_IEEE 0 TCZ_FN1200DSL_FB -15 15
 /begin AXIS_DESCR FIX_AXIS NO_INPUT_QUANTITY TCX_FN1200DSL_FB 14 0 13 FIX_AXIS_PAR 0 0 14 /end AXIS_DESCR
 /begin AXIS_DESCR FIX_AXIS NO_INPUT_QUANTITY TCY_FN1200DSL_FB 14 0 13 FIX_AXIS_PAR 0 0 14 /end AXIS_DESCR
/end CHARACTERISTIC
/begin COMPU_METHOD TCZ_FN1200DSL_FB "FN1200DSL_FB Z-axis conversion" RAT_FUNC "%10.5" "unitless" COEFFS 0 1 0 0 0 1 /end COMPU_METHOD
/begin COMPU_METHOD TCX_FN1200DSL_FB "FN1200DSL_FB X-axis conversion" RAT_FUNC "%10.5" "unitless" COEFFS 0 1 0 0 0 1 /end COMPU_METHOD
/begin COMPU_METHOD TCY_FN1200DSL_FB "FN1200DSL_FB Y-axis conversion" RAT_FUNC "%10.5" "unitless" COEFFS 0 1 0 0 0 1 /end COMPU_METHOD
/begin CHARACTERISTIC FN1200DSL_NB "X Norm=FN019DS_A, Y Norm=FN013DS_A, DIT full boost table." MAP 0x4A6C4 TD_FLOAT32_IEEE 0 TCZ_FN1200DSL_NB -15 15
 /begin AXIS_DESCR FIX_AXIS NO_INPUT_QUANTITY TCX_FN1200DSL_NB 14 0 13 FIX_AXIS_PAR 0 0 14 /end AXIS_DESCR
 /begin AXIS_DESCR FIX_AXIS NO_INPUT_QUANTITY TCY_FN1200DSL_NB 14 0 13 FIX_AXIS_PAR 0 0 14 /end AXIS_DESCR
/end CHARACTERISTIC
/begin COMPU_METHOD TCZ_FN1200DSL_NB "FN1200DSL_NB Z-axis conversion" RAT_FUNC "%10.5" "unitless" COEFFS 0 1 0 0 0 1 /end COMPU_METHOD
/begin COMPU_METHOD TCX_FN1200DSL_NB "FN1200DSL_NB X-axis conversion" RAT_FUNC "%10.5" "unitless" COEFFS 0 1 0 0 0 1 /end COMPU_METHOD
/begin COMPU_METHOD TCY_FN1200DSL_NB "FN1200DSL_NB Y-axis conversion" RAT_FUNC "%10.5" "unitless" COEFFS 0 1 0 0 0 1 /end COMPU_METHOD
/begin CHARACTERISTIC FN1200FB "X Norm=FN019DS_A, Y Norm=FN013DS_A, Full boost table." MAP 0x49D94 TD_FLOAT32_IEEE 0 TCZ_FN1200FB 0 300
 /begin AXIS_DESCR FIX_AXIS NO_INPUT_QUANTITY TCX_FN1200FB 14 0 13 FIX_AXIS_PAR 0 0 14 /end AXIS_DESCR
 /begin AXIS_DESCR FIX_AXIS NO_INPUT_QUANTITY TCY_FN1200FB 14 0 13 FIX_AXIS_PAR 0 0 14 /end AXIS_DESCR
/end CHARACTERISTIC
/begin COMPU_METHOD TCZ_FN1200FB "FN1200FB Z-axis conversion" RAT_FUNC "%10.5" "kPa" COEFFS 0 1 0 0 0 1 /end COMPU_METHOD
/begin COMPU_METHOD TCX_FN1200FB "FN1200FB X-axis conversion" RAT_FUNC "%10.5" "unitless" COEFFS 0 1 0 0 0 1 /end COMPU_METHOD
/begin COMPU_METHOD TCY_FN1200FB "FN1200FB Y-axis conversion" RAT_FUNC "%10.5" "unitless" COEFFS 0 1 0 0 0 1 /end COMPU_METHOD
/begin CHARACTERISTIC FN1200NB "X Norm=FN019DS_A, Y Norm=FN013DS_A, No boost table." MAP 0x4A0A4 TD_FLOAT32_IEEE 0 TCZ_FN1200NB 0 300
 /begin AXIS_DESCR FIX_AXIS NO_INPUT_QUANTITY TCX_FN1200NB 14 0 13 FIX_AXIS_PAR 0 0 14 /end AXIS_DESCR
 /begin AXIS_DESCR FIX_AXIS NO_INPUT_QUANTITY TCY_FN1200NB 14 0 13 FIX_AXIS_PAR 0 0 14 /end AXIS_DESCR
/end CHARACTERISTIC
/begin COMPU_METHOD TCZ_FN1200NB "FN1200NB Z-axis conversion" RAT_FUNC "%10.5" "kPa" COEFFS 0 1 0 0 0 1 /end COMPU_METHOD
/begin COMPU_METHOD TCX_FN1200NB "FN1200NB X-axis conversion" RAT_FUNC "%10.5" "unitless" COEFFS 0 1 0 0 0 1 /end COMPU_METHOD
/begin COMPU_METHOD TCY_FN1200NB "FN1200NB Y-axis conversion" RAT_FUNC "%10.5" "unitless" COEFFS 0 1 0 0 0 1 /end COMPU_METHOD
/begin CHARACTERISTIC FN1202DSH "X Norm=FN019DS, Y Norm=FNMATDS" MAP 0x495BC TD_FLOAT32_IEEE 0 TCZ_FN1202DSH -500 500
 /begin AXIS_DESCR FIX_AXIS NO_INPUT_QUANTITY TCX_FN1202DSH 11 0 10 FIX_AXIS_PAR 0 0 11 /end AXIS_DESCR
 /begin AXIS_DESCR FIX_AXIS NO_INPUT_QUANTITY TCY_FN1202DSH 10 0 9 FIX_AXIS_PAR 0 0 10 /end AXIS_DESCR
/end CHARACTERISTIC
/begin COMPU_METHOD TCZ_FN1202DSH "FN1202DSH Z-axis conversion" RAT_FUNC "%10.5" "unitless" COEFFS 0 1 0 0 0 1 /end COMPU_METHOD
/begin COMPU_METHOD TCX_FN1202DSH "FN1202DSH X-axis conversion" RAT_FUNC "%10.5" "unitless" COEFFS 0 1 0 0 0 1 /end COMPU_METHOD
/begin COMPU_METHOD TCY_FN1202DSH "FN1202DSH Y-axis conversion" RAT_FUNC "%10.5" "unitless" COEFFS 0 1 0 0 0 1 /end COMPU_METHOD
/begin CHARACTERISTIC FN1202DSL "X Norm=FN019DS, Y Norm=FNMATDS" MAP 0x49404 TD_FLOAT32_IEEE 0 TCZ_FN1202DSL -500 500
 /begin AXIS_DESCR FIX_AXIS NO_INPUT_QUANTITY TCX_FN1202DSL 11 0 10 FIX_AXIS_PAR 0 0 11 /end AXIS_DESCR
 /begin AXIS_DESCR FIX_AXIS NO_INPUT_QUANTITY TCY_FN1202DSL 10 0 9 FIX_AXIS_PAR 0 0 10 /end AXIS_DESCR
/end CHARACTERISTIC
/begin COMPU_METHOD TCZ_FN1202DSL "FN1202DSL Z-axis conversion" RAT_FUNC "%10.5" "unitless" COEFFS 0 1 0 0 0 1 /end COMPU_METHOD
/begin COMPU_METHOD TCX_FN1202DSL "FN1202DSL X-axis conversion" RAT_FUNC "%10.5" "unitless" COEFFS 0 1 0 0 0 1 /end COMPU_METHOD
/begin COMPU_METHOD TCY_FN1202DSL "FN1202DSL Y-axis conversion" RAT_FUNC "%10.5" "unitless" COEFFS 0 1 0 0 0 1 /end COMPU_METHOD
/begin CHARACTERISTIC FN1205DSH "X Norm=FN033DS, Y Norm=FN032DS" MAP 0x4AAD4 TD_FLOAT32_IEEE 0 TCZ_FN1205DSH -500 500
 /begin AXIS_DESCR FIX_AXIS NO_INPUT_QUANTITY TCX_FN1205DSH 8 0 7 FIX_AXIS_PAR 0 0 8 /end AXIS_DESCR
 /begin AXIS_DESCR FIX_AXIS NO_INPUT_QUANTITY TCY_FN1205DSH 8 0 7 FIX_AXIS_PAR 0 0 8 /end AXIS_DESCR
/end CHARACTERISTIC
/begin COMPU_METHOD TCZ_FN1205DSH "FN1205DSH Z-axis conversion" RAT_FUNC "%10.5" "unitless" COEFFS 0 1 0 0 0 1 /end COMPU_METHOD
/begin COMPU_METHOD TCX_FN1205DSH "FN1205DSH X-axis conversion" RAT_FUNC "%10.5" "unitless" COEFFS 0 1 0 0 0 1 /end COMPU_METHOD
/begin COMPU_METHOD TCY_FN1205DSH "FN1205DSH Y-axis conversion" RAT_FUNC "%10.5" "unitless" COEFFS 0 1 0 0 0 1 /end COMPU_METHOD
/begin CHARACTERISTIC FN1205DSL "X Norm=FN033DS, Y Norm=FN032DS" MAP 0x4A9D4 TD_FLOAT32_IEEE 0 TCZ_FN1205DSL -500 500
 /begin AXIS_DESCR FIX_AXIS NO_INPUT_QUANTITY TCX_FN1205DSL 8 0 7 FIX_AXIS_PAR 0 0 8 /end AXIS_DESCR
 /begin AXIS_DESCR FIX_AXIS NO_INPUT_QUANTITY TCY_FN1205DSL 8 0 7 FIX_AXIS_PAR 0 0 8 /end AXIS_DESCR
/end CHARACTERISTIC
/begin COMPU_METHOD TCZ_FN1205DSL "FN1205DSL Z-axis conversion" RAT_FUNC "%10.5" "unitless" COEFFS 0 1 0 0 0 1 /end COMPU_METHOD
/begin COMPU_METHOD TCX_FN1205DSL "FN1205DSL X-axis conversion" RAT_FUNC "%10.5" "unitless" COEFFS 0 1 0 0 0 1 /end COMPU_METHOD
/begin COMPU_METHOD TCY_FN1205DSL "FN1205DSL Y-axis conversion" RAT_FUNC "%10.5" "unitless" COEFFS 0 1 0 0 0 1 /end COMPU_METHOD
/begin CHARACTERISTIC FN1300P_HI_A "X Norm=unknown, Y Norm=unknown" MAP 0x4C334 TD_FLOAT32_IEEE 0 TCZ_FN1300P_HI_A 0 30
 /begin AXIS_DESCR FIX_AXIS NO_INPUT_QUANTITY TCX_FN1300P_HI_A 14 0 13 FIX_AXIS_PAR 0 0 14 /end AXIS_DESCR
 /begin AXIS_DESCR FIX_AXIS NO_INPUT_QUANTITY TCY_FN1300P_HI_A 14 0 13 FIX_AXIS_PAR 0 0 14 /end AXIS_DESCR
/end CHARACTERISTIC
/begin COMPU_METHOD TCZ_FN1300P_HI_A "FN1300P_HI_A Z-axis conversion" RAT_FUNC "%10.5" "unitless" COEFFS 0 1 0 0 0 1 /end COMPU_METHOD
/begin COMPU_METHOD TCX_FN1300P_HI_A "FN1300P_HI_A X-axis conversion" RAT_FUNC "%10.5" "Unitless" COEFFS 0 1 0 0 0 1 /end COMPU_METHOD
/begin COMPU_METHOD TCY_FN1300P_HI_A "FN1300P_HI_A Y-axis conversion" RAT_FUNC "%10.5" "Unitless" COEFFS 0 1 0 0 0 1 /end COMPU_METHOD
/begin CHARACTERISTIC FN1300P_LO_A "X Norm=FN011P_A, Y Norm=FN031P_A" MAP 0x4C024 TD_FLOAT32_IEEE 0 TCZ_FN1300P_LO_A 0 30
 /begin AXIS_DESCR FIX_AXIS NO_INPUT_QUANTITY TCX_FN1300P_LO_A 14 0 13 FIX_AXIS_PAR 0 0 14 /end AXIS_DESCR
 /begin AXIS_DESCR FIX_AXIS NO_INPUT_QUANTITY TCY_FN1300P_LO_A 14 0 13 FIX_AXIS_PAR 0 0 14 /end AXIS_DESCR
/end CHARACTERISTIC
/begin COMPU_METHOD TCZ_FN1300P_LO_A "FN1300P_LO_A Z-axis conversion" RAT_FUNC "%10.5" "unitless" COEFFS 0 1 0 0 0 1 /end COMPU_METHOD
/begin COMPU_METHOD TCX_FN1300P_LO_A "FN1300P_LO_A X-axis conversion" RAT_FUNC "%10.5" "RPM" COEFFS 0 1 0 0 0 1 /end COMPU_METHOD
/begin COMPU_METHOD TCY_FN1300P_LO_A "FN1300P_LO_A Y-axis conversion" RAT_FUNC "%10.5" "unitless" COEFFS 0 1 0 0 0 1 /end COMPU_METHOD
/begin CHARACTERISTIC FN1300_HI_A "X Norm=FN011DS_A, Y Norm=FN031DS_A" MAP 0x4BD14 TD_FLOAT32_IEEE 0 TCZ_FN1300_HI_A 0 30
 /begin AXIS_DESCR FIX_AXIS NO_INPUT_QUANTITY TCX_FN1300_HI_A 14 0 13 FIX_AXIS_PAR 0 0 14 /end AXIS_DESCR
 /begin AXIS_DESCR FIX_AXIS NO_INPUT_QUANTITY TCY_FN1300_HI_A 14 0 13 FIX_AXIS_PAR 0 0 14 /end AXIS_DESCR
/end CHARACTERISTIC
/begin COMPU_METHOD TCZ_FN1300_HI_A "FN1300_HI_A Z-axis conversion" RAT_FUNC "%10.5" "unitless" COEFFS 0 1 0 0 0 1 /end COMPU_METHOD
/begin COMPU_METHOD TCX_FN1300_HI_A "FN1300_HI_A X-axis conversion" RAT_FUNC "%10.5" "RPM" COEFFS 0 1 0 0 0 1 /end COMPU_METHOD
/begin COMPU_METHOD TCY_FN1300_HI_A "FN1300_HI_A Y-axis conversion" RAT_FUNC "%10.5" "unitless" COEFFS 0 1 0 0 0 1 /end COMPU_METHOD
/begin CHARACTERISTIC FN1300_LO_A "X Norm=FN011DS_A, Y Norm=FN031DS_A" MAP 0x4BA04 TD_FLOAT32_IEEE 0 TCZ_FN1300_LO_A 0 30
 /begin AXIS_DESCR FIX_AXIS NO_INPUT_QUANTITY TCX_FN1300_LO_A 14 0 13 FIX_AXIS_PAR 0 0 14 /end AXIS_DESCR
 /begin AXIS_DESCR FIX_AXIS NO_INPUT_QUANTITY TCY_FN1300_LO_A 14 0 13 FIX_AXIS_PAR 0 0 14 /end AXIS_DESCR
/end CHARACTERISTIC
/begin COMPU_METHOD TCZ_FN1300_LO_A "FN1300_LO_A Z-axis conversion" RAT_FUNC "%10.5" "unitless" COEFFS 0 1 0 0 0 1 /end COMPU_METHOD
/begin COMPU_METHOD TCX_FN1300_LO_A "FN1300_LO_A X-axis conversion" RAT_FUNC "%10.5" "RPM" COEFFS 0 1 0 0 0 1 /end COMPU_METHOD
/begin COMPU_METHOD TCY_FN1300_LO_A "FN1300_LO_A Y-axis conversion" RAT_FUNC "%10.5" "unitless" COEFFS 0 1 0 0 0 1 /end COMPU_METHOD
/begin CHARACTERISTIC FN1302 "X Norm=FN053DS, Y Norm=FN052DS, Pilot mode VFDES multiplier table" MAP 0x46084 TD_FLOAT32_IEEE 0 TCZ_FN1302 0 1.9999
 /begin AXIS_DESCR FIX_AXIS NO_INPUT_QUANTITY TCX_FN1302 10 0 9 FIX_AXIS_PAR 0 0 10 /end AXIS_DESCR
 /begin AXIS_DESCR FIX_AXIS NO_INPUT_QUANTITY TCY_FN1302 10 0 9 FIX_AXIS_PAR 0 0 10 /end AXIS_DESCR
/end CHARACTERISTIC
/begin COMPU_METHOD TCZ_FN1302 "FN1302 Z-axis conversion" RAT_FUNC "%10.5" "unitless" COEFFS 0 1 0 0 0 1 /end COMPU_METHOD
/begin COMPU_METHOD TCX_FN1302 "FN1302 X-axis conversion" RAT_FUNC "%10.5" "RPM" COEFFS 0 1 0 0 0 1 /end COMPU_METHOD
/begin COMPU_METHOD TCY_FN1302 "FN1302 Y-axis conversion" RAT_FUNC "%10.5" "unitless" COEFFS 0 1 0 0 0 1 /end COMPU_METHOD
/begin CHARACTERISTIC FN1303DSL "X Norm=FN058DS, Y Norm=FN057DS" MAP 0x48FEC TD_FLOAT32_IEEE 0 TCZ_FN1303DSL -500 500
 /begin AXIS_DESCR FIX_AXIS NO_INPUT_QUANTITY TCX_FN1303DSL 10 0 9 FIX_AXIS_PAR 0 0 10 /end AXIS_DESCR
 /begin AXIS_DESCR FIX_AXIS NO_INPUT_QUANTITY TCY_FN1303DSL 10 0 9 FIX_AXIS_PAR 0 0 10 /end AXIS_DESCR
/end CHARACTERISTIC
/begin COMPU_METHOD TCZ_FN1303DSL "FN1303DSL Z-axis conversion" RAT_FUNC "%10.5" "unitless" COEFFS 0 1 0 0 0 1 /end COMPU_METHOD
/begin COMPU_METHOD TCX_FN1303DSL "FN1303DSL X-axis conversion" RAT_FUNC "%10.5" "unitless" COEFFS 0 1 0 0 0 1 /end COMPU_METHOD
/begin COMPU_METHOD TCY_FN1303DSL "FN1303DSL Y-axis conversion" RAT_FUNC "%10.5" "unitless" COEFFS 0 1 0 0 0 1 /end COMPU_METHOD
/begin CHARACTERISTIC FN1304DSL "X Norm=FN060DS, Y Norm=FN059DS" MAP 0x48E5C TD_FLOAT32_IEEE 0 TCZ_FN1304DSL -500 500
 /begin AXIS_DESCR FIX_AXIS NO_INPUT_QUANTITY TCX_FN1304DSL 10 0 9 FIX_AXIS_PAR 0 0 10 /end AXIS_DESCR
 /begin AXIS_DESCR FIX_AXIS NO_INPUT_QUANTITY TCY_FN1304DSL 10 0 9 FIX_AXIS_PAR 0 0 10 /end AXIS_DESCR
/end CHARACTERISTIC
/begin COMPU_METHOD TCZ_FN1304DSL "FN1304DSL Z-axis conversion" RAT_FUNC "%10.5" "unitless" COEFFS 0 1 0 0 0 1 /end COMPU_METHOD
/begin COMPU_METHOD TCX_FN1304DSL "FN1304DSL X-axis conversion" RAT_FUNC "%10.5" "unitless" COEFFS 0 1 0 0 0 1 /end COMPU_METHOD
/begin COMPU_METHOD TCY_FN1304DSL "FN1304DSL Y-axis conversion" RAT_FUNC "%10.5" "unitless" COEFFS 0 1 0 0 0 1 /end COMPU_METHOD
/begin CHARACTERISTIC FN1400 "X Norm=FN047DS, Y Norm=FN046DS, ICP control feed forward table" MAP 0x4C644 TD_FLOAT32_IEEE 0 TCZ_FN1400 0 1
 /begin AXIS_DESCR FIX_AXIS NO_INPUT_QUANTITY TCX_FN1400 11 0 10 FIX_AXIS_PAR 0 0 11 /end AXIS_DESCR
 /begin AXIS_DESCR FIX_AXIS NO_INPUT_QUANTITY TCY_FN1400 11 0 10 FIX_AXIS_PAR 0 0 11 /end AXIS_DESCR
/end CHARACTERISTIC
/begin COMPU_METHOD TCZ_FN1400 "FN1400 Z-axis conversion" RAT_FUNC "%10.5" "MPa" COEFFS 0 1 0 0 0 1 /end COMPU_METHOD
/begin COMPU_METHOD TCX_FN1400 "FN1400 X-axis conversion" RAT_FUNC "%10.5" "MPa" COEFFS 0 1 0 0 0 1 /end COMPU_METHOD
/begin COMPU_METHOD TCY_FN1400 "FN1400 Y-axis conversion" RAT_FUNC "%10.5" "L/min" COEFFS 0 1 0 0 0 1 /end COMPU_METHOD
/begin CHARACTERISTIC FN1615MIS "X Norm=FN070MIS, Y Norm=FN034MIS, Torque table used by the misfire monitor, with 10x8 breakpoints for 97MY." MAP 0x59BF4 TD_FLOAT32_IEEE 0 TCZ_FN1615MIS 0 510
 /begin AXIS_DESCR FIX_AXIS NO_INPUT_QUANTITY TCX_FN1615MIS 10 0 9 FIX_AXIS_PAR 0 0 10 /end AXIS_DESCR
 /begin AXIS_DESCR FIX_AXIS NO_INPUT_QUANTITY TCY_FN1615MIS 8 0 7 FIX_AXIS_PAR 0 0 8 /end AXIS_DESCR
/end CHARACTERISTIC
/begin COMPU_METHOD TCZ_FN1615MIS "FN1615MIS Z-axis conversion" RAT_FUNC "%10.5" "lbf*ft" COEFFS 0 1 0 0 0 1 /end COMPU_METHOD
/begin COMPU_METHOD TCX_FN1615MIS "FN1615MIS X-axis conversion" RAT_FUNC "%10.5" "RPM" COEFFS 0 1 0 0 0 1 /end COMPU_METHOD
/begin COMPU_METHOD TCY_FN1615MIS "FN1615MIS Y-axis conversion" RAT_FUNC "%10.5" "%" COEFFS 0 1 0 0 0 1 /end COMPU_METHOD
/begin MEASUREMENT FN1615_DATA "Current indicated torque used in misfire" FLOAT32_IEEE MC_FN1615_DATA 0 0 0 0 ECU_ADDRESS 0x3FB368 /end MEASUREMENT
/begin COMPU_METHOD MC_FN1615_DATA "FN1615_DATA conversion" RAT_FUNC "%10.5" "Unitless" COEFFS 0 1 0 0 0 1 /end COMPU_METHOD
/begin CHARACTERISTIC FN1619 "X Norm=FN070C, Y Norm=FNAC_NORM, A/C Torque mapping data as a function of engine speed, FN070C and A/C pressure, FNAC_NORM." MAP 0x424E4 TD_FLOAT32_IEEE 0 TCZ_FN1619 0 510
 /begin AXIS_DESCR FIX_AXIS NO_INPUT_QUANTITY TCX_FN1619 6 0 5 FIX_AXIS_PAR 0 0 6 /end AXIS_DESCR
 /begin AXIS_DESCR FIX_AXIS NO_INPUT_QUANTITY TCY_FN1619 6 0 5 FIX_AXIS_PAR 0 0 6 /end AXIS_DESCR
/end CHARACTERISTIC
/begin COMPU_METHOD TCZ_FN1619 "FN1619 Z-axis conversion" RAT_FUNC "%10.5" "lbf*ft" COEFFS 0 1 0 0 0 1 /end COMPU_METHOD
/begin COMPU_METHOD TCX_FN1619 "FN1619 X-axis conversion" RAT_FUNC "%10.5" "RPM" COEFFS 0 1 0 0 0 1 /end COMPU_METHOD
/begin COMPU_METHOD TCY_FN1619 "FN1619 Y-axis conversion" RAT_FUNC "%10.5" "PSI" COEFFS 0 1 0 0 0 1 /end COMPU_METHOD
/begin CHARACTERISTIC FN2000_MAP "mfdes normalising function for fn2002_map" CURVE 0x4383C FD_FLOAT32_IEEE 0 FCY_FN2000_MAP 0 8 /begin AXIS_DESCR STD_AXIS MFDES FCX_FN2000_MAP 8 -2048 2047.94 /end AXIS_DESCR /end CHARACTERISTIC
/begin COMPU_METHOD FCX_FN2000_MAP "FN2000_MAP X-axis conversion" RAT_FUNC "%10.5" "unitless" COEFFS 0 1 0 0 0 1 /end COMPU_METHOD
/begin COMPU_METHOD FCY_FN2000_MAP "FN2000_MAP Y-axis conversion" RAT_FUNC "%10.5" "unitless" COEFFS 0 1 0 0 0 1 /end COMPU_METHOD
/begin CHARACTERISTIC FN2001_MAP "Engine speed normalising function for fn2002_map" CURVE 0x437DC FD_FLOAT32_IEEE 0 FCY_FN2001_MAP 0 12 /begin AXIS_DESCR STD_AXIS N FCX_FN2001_MAP 12 0 8000 /end AXIS_DESCR /end CHARACTERISTIC
/begin COMPU_METHOD FCX_FN2001_MAP "FN2001_MAP X-axis conversion" RAT_FUNC "%10.5" "RPM" COEFFS 0 1 0 0 0 1 /end COMPU_METHOD
/begin COMPU_METHOD FCY_FN2001_MAP "FN2001_MAP Y-axis conversion" RAT_FUNC "%10.5" "unitless" COEFFS 0 1 0 0 0 1 /end COMPU_METHOD
/begin CHARACTERISTIC FN2002_MAP "X Norm=FN2001_MAP, Y Norm=FN2000_MAP, Unfiltered inferred map based on N and MFDES" MAP 0x4387C TD_FLOAT32_IEEE 0 TCZ_FN2002_MAP 0 500
 /begin AXIS_DESCR FIX_AXIS NO_INPUT_QUANTITY TCX_FN2002_MAP 12 0 11 FIX_AXIS_PAR 0 0 12 /end AXIS_DESCR
 /begin AXIS_DESCR FIX_AXIS NO_INPUT_QUANTITY TCY_FN2002_MAP 8 0 7 FIX_AXIS_PAR 0 0 8 /end AXIS_DESCR
/end CHARACTERISTIC
/begin COMPU_METHOD TCZ_FN2002_MAP "FN2002_MAP Z-axis conversion" RAT_FUNC "%10.5" "kPa" COEFFS 0 1 0 0 0 1 /end COMPU_METHOD
/begin COMPU_METHOD TCX_FN2002_MAP "FN2002_MAP X-axis conversion" RAT_FUNC "%10.5" "RPM" COEFFS 0 1 0 0 0 1 /end COMPU_METHOD
/begin COMPU_METHOD TCY_FN2002_MAP "FN2002_MAP Y-axis conversion" RAT_FUNC "%10.5" "unitless" COEFFS 0 1 0 0 0 1 /end COMPU_METHOD
/begin CHARACTERISTIC FN2010DS "Custom Drive-by-Wire Pedal curve (Diesel)" CURVE 0x43E8C FD_FLOAT32_IEEE 0 FCY_FN2010DS 0 1023 /begin AXIS_DESCR STD_AXIS NO_INPUT_QUANTITY FCX_FN2010DS 14 0 1023 /end AXIS_DESCR /end CHARACTERISTIC
/begin COMPU_METHOD FCX_FN2010DS "FN2010DS X-axis conversion" RAT_FUNC "%10.5" "unitless" COEFFS 0 1 0 0 0 1 /end COMPU_METHOD
/begin COMPU_METHOD FCY_FN2010DS "FN2010DS Y-axis conversion" RAT_FUNC "%10.5" "unitless" COEFFS 0 1 0 0 0 1 /end COMPU_METHOD
/begin CHARACTERISTIC FN2011 "Variable filter constant based on PPS rate of chg" CURVE 0x43EFC FD_FLOAT32_IEEE 0 FCY_FN2011 0 64 /begin AXIS_DESCR STD_AXIS AD_ROC_PPS FCX_FN2011 11 -512 512 /end AXIS_DESCR /end CHARACTERISTIC
/begin COMPU_METHOD FCX_FN2011 "FN2011 X-axis conversion" RAT_FUNC "%10.5" "unitless" COEFFS 0 1 0 0 0 1 /end COMPU_METHOD
/begin COMPU_METHOD FCY_FN2011 "FN2011 Y-axis conversion" RAT_FUNC "%10.5" "unitless" COEFFS 0 1 0 0 0 1 /end COMPU_METHOD
/begin CHARACTERISTIC FN2_TQ_LOALT_BASE_REV "X Norm=FN_TQ114, Y Norm=FN_TQ104, Fuel required for desired gross torque" MAP 0x517AC TD_FLOAT32_IEEE 0 TCZ_FN2_TQ_LOALT_BASE_REV 0 1000
 /begin AXIS_DESCR FIX_AXIS NO_INPUT_QUANTITY TCX_FN2_TQ_LOALT_BASE_REV 14 0 13 FIX_AXIS_PAR 0 0 14 /end AXIS_DESCR
 /begin AXIS_DESCR FIX_AXIS NO_INPUT_QUANTITY TCY_FN2_TQ_LOALT_BASE_REV 14 0 13 FIX_AXIS_PAR 0 0 14 /end AXIS_DESCR
/end CHARACTERISTIC
/begin COMPU_METHOD TCZ_FN2_TQ_LOALT_BASE_REV "FN2_TQ_LOALT_BASE_REV Z-axis conversion" RAT_FUNC "%10.5" "unitless" COEFFS 0 1 0 0 0 1 /end COMPU_METHOD
/begin COMPU_METHOD TCX_FN2_TQ_LOALT_BASE_REV "FN2_TQ_LOALT_BASE_REV X-axis conversion" RAT_FUNC "%10.5" "unitless" COEFFS 0 1 0 0 0 1 /end COMPU_METHOD
/begin COMPU_METHOD TCY_FN2_TQ_LOALT_BASE_REV "FN2_TQ_LOALT_BASE_REV Y-axis conversion" RAT_FUNC "%10.5" "lbf*ft" COEFFS 0 1 0 0 0 1 /end COMPU_METHOD
/begin CHARACTERISTIC FN352DS "MAF frequency to eng units (gram/sec) transfer function" CURVE 0x4166C FD_FLOAT32_IEEE 0 FCY_FN352DS 0 744 /begin AXIS_DESCR STD_AXIS NO_INPUT_QUANTITY FCX_FN352DS 25 0 20000 /end AXIS_DESCR /end CHARACTERISTIC
/begin COMPU_METHOD FCX_FN352DS "FN352DS X-axis conversion" RAT_FUNC "%10.5" "Hz" COEFFS 0 1 0 0 0 1 /end COMPU_METHOD
/begin COMPU_METHOD FCY_FN352DS "FN352DS Y-axis conversion" RAT_FUNC "%10.5" "g/s" COEFFS 0 1 0 0 0 1 /end COMPU_METHOD
/begin CHARACTERISTIC FN352_ANALOG "MAF A/D counts to eng units (g/s) transfer function" CURVE 0x415EC FD_FLOAT32_IEEE 0 FCY_FN352_ANALOG 0 750 /begin AXIS_DESCR STD_AXIS MAF_CNTS FCX_FN352_ANALOG 15 0 1023 /end AXIS_DESCR /end CHARACTERISTIC
/begin COMPU_METHOD FCX_FN352_ANALOG "FN352_ANALOG X-axis conversion" RAT_FUNC "%10.5" "ADct" COEFFS 0 1 0 0 0 1 /end COMPU_METHOD
/begin COMPU_METHOD FCY_FN352_ANALOG "FN352_ANALOG Y-axis conversion" RAT_FUNC "%10.5" "g/s" COEFFS 0 1 0 0 0 1 /end COMPU_METHOD
/begin CHARACTERISTIC FN403 "Engine oil temp multiplier" CURVE 0x4B47C FD_FLOAT32_IEEE 0 FCY_FN403 0 5 /begin AXIS_DESCR STD_AXIS EOT_C FCX_FN403 9 -40 150 /end AXIS_DESCR /end CHARACTERISTIC
/begin COMPU_METHOD FCX_FN403 "FN403 X-axis conversion" RAT_FUNC "%10.5" "degC" COEFFS 0 1 0 0 0 1 /end COMPU_METHOD
/begin COMPU_METHOD FCY_FN403 "FN403 Y-axis conversion" RAT_FUNC "%10.5" "unitless" COEFFS 0 1 0 0 0 1 /end COMPU_METHOD
/begin CHARACTERISTIC FN423 "" CURVE 0x4546C FD_FLOAT32_IEEE 0 FCY_FN423 -100 100 /begin AXIS_DESCR STD_AXIS ARC_MULT FCX_FN423 11 -5000 5000 /end AXIS_DESCR /end CHARACTERISTIC
/begin COMPU_METHOD FCX_FN423 "FN423 X-axis conversion" RAT_FUNC "%10.5" "unitless" COEFFS 0 1 0 0 0 1 /end COMPU_METHOD
/begin COMPU_METHOD FCY_FN423 "FN423 Y-axis conversion" RAT_FUNC "%10.5" "unitless" COEFFS 0 1 0 0 0 1 /end COMPU_METHOD
/begin CHARACTERISTIC FN425 "" CURVE 0x5980C FD_FLOAT32_IEEE 0 FCY_FN425 -100 100 /begin AXIS_DESCR STD_AXIS MPH_FILT FCX_FN425 9 0 255 /end AXIS_DESCR /end CHARACTERISTIC
/begin COMPU_METHOD FCX_FN425 "FN425 X-axis conversion" RAT_FUNC "%10.5" "MPH" COEFFS 0 1 0 0 0 1 /end COMPU_METHOD
/begin COMPU_METHOD FCY_FN425 "FN425 Y-axis conversion" RAT_FUNC "%10.5" "unitless" COEFFS 0 1 0 0 0 1 /end COMPU_METHOD
/begin CHARACTERISTIC FN426 "" CURVE 0x597DC FD_FLOAT32_IEEE 0 FCY_FN426 0 100 /begin AXIS_DESCR STD_AXIS DSSPD_MPH_SP FCX_FN426 6 0 255 /end AXIS_DESCR /end CHARACTERISTIC
/begin COMPU_METHOD FCX_FN426 "FN426 X-axis conversion" RAT_FUNC "%10.5" "MPH" COEFFS 0 1 0 0 0 1 /end COMPU_METHOD
/begin COMPU_METHOD FCY_FN426 "FN426 Y-axis conversion" RAT_FUNC "%10.5" "unitless" COEFFS 0 1 0 0 0 1 /end COMPU_METHOD
/begin CHARACTERISTIC FN427 "" CURVE 0x59854 FD_FLOAT32_IEEE 0 FCY_FN427 -100 100 /begin AXIS_DESCR STD_AXIS DSSPD_MPHERR_FILT FCX_FN427 6 -255 255 /end AXIS_DESCR /end CHARACTERISTIC
/begin COMPU_METHOD FCX_FN427 "FN427 X-axis conversion" RAT_FUNC "%10.5" "MPH" COEFFS 0 1 0 0 0 1 /end COMPU_METHOD
/begin COMPU_METHOD FCY_FN427 "FN427 Y-axis conversion" RAT_FUNC "%10.5" "unitless" COEFFS 0 1 0 0 0 1 /end COMPU_METHOD
/begin CHARACTERISTIC FN428 "" CURVE 0x59884 FD_FLOAT32_IEEE 0 FCY_FN428 -100 100 /begin AXIS_DESCR STD_AXIS MPH_FILT FCX_FN428 9 0 255 /end AXIS_DESCR /end CHARACTERISTIC
/begin COMPU_METHOD FCX_FN428 "FN428 X-axis conversion" RAT_FUNC "%10.5" "MPH" COEFFS 0 1 0 0 0 1 /end COMPU_METHOD
/begin COMPU_METHOD FCY_FN428 "FN428 Y-axis conversion" RAT_FUNC "%10.5" "unitless" COEFFS 0 1 0 0 0 1 /end COMPU_METHOD
/begin CHARACTERISTIC FN4444DSH "X Norm=FN056DS, Y Norm=FN055DS" MAP 0x492C0 TD_FLOAT32_IEEE 0 TCZ_FN4444DSH -500 500
 /begin AXIS_DESCR FIX_AXIS NO_INPUT_QUANTITY TCX_FN4444DSH 9 0 8 FIX_AXIS_PAR 0 0 9 /end AXIS_DESCR
 /begin AXIS_DESCR FIX_AXIS NO_INPUT_QUANTITY TCY_FN4444DSH 9 0 8 FIX_AXIS_PAR 0 0 9 /end AXIS_DESCR
/end CHARACTERISTIC
/begin COMPU_METHOD TCZ_FN4444DSH "FN4444DSH Z-axis conversion" RAT_FUNC "%10.5" "unitless" COEFFS 0 1 0 0 0 1 /end COMPU_METHOD
/begin COMPU_METHOD TCX_FN4444DSH "FN4444DSH X-axis conversion" RAT_FUNC "%10.5" "unitless" COEFFS 0 1 0 0 0 1 /end COMPU_METHOD
/begin COMPU_METHOD TCY_FN4444DSH "FN4444DSH Y-axis conversion" RAT_FUNC "%10.5" "unitless" COEFFS 0 1 0 0 0 1 /end COMPU_METHOD
/begin CHARACTERISTIC FN4444DSL "X Norm=FN056DS, Y Norm=FN055DS" MAP 0x4917C TD_FLOAT32_IEEE 0 TCZ_FN4444DSL -500 500
 /begin AXIS_DESCR FIX_AXIS NO_INPUT_QUANTITY TCX_FN4444DSL 9 0 8 FIX_AXIS_PAR 0 0 9 /end AXIS_DESCR
 /begin AXIS_DESCR FIX_AXIS NO_INPUT_QUANTITY TCY_FN4444DSL 9 0 8 FIX_AXIS_PAR 0 0 9 /end AXIS_DESCR
/end CHARACTERISTIC
/begin COMPU_METHOD TCZ_FN4444DSL "FN4444DSL Z-axis conversion" RAT_FUNC "%10.5" "unitless" COEFFS 0 1 0 0 0 1 /end COMPU_METHOD
/begin COMPU_METHOD TCX_FN4444DSL "FN4444DSL X-axis conversion" RAT_FUNC "%10.5" "unitless" COEFFS 0 1 0 0 0 1 /end COMPU_METHOD
/begin COMPU_METHOD TCY_FN4444DSL "FN4444DSL Y-axis conversion" RAT_FUNC "%10.5" "unitless" COEFFS 0 1 0 0 0 1 /end COMPU_METHOD
/begin CHARACTERISTIC FN642V_C "Proportional ECT control in degC." CURVE 0x5996C FD_FLOAT32_IEEE 0 FCY_FN642V_C 0 7000 /begin AXIS_DESCR STD_AXIS VFD_ECT_ER_DEGC FCX_FN642V_C 6 -65536 65534 /end AXIS_DESCR /end CHARACTERISTIC
/begin COMPU_METHOD FCX_FN642V_C "FN642V_C X-axis conversion" RAT_FUNC "%10.5" "degC" COEFFS 0 1 0 0 0 1 /end COMPU_METHOD
/begin COMPU_METHOD FCY_FN642V_C "FN642V_C Y-axis conversion" RAT_FUNC "%10.5" "RPM" COEFFS 0 1 0 0 0 1 /end COMPU_METHOD
/begin CHARACTERISTIC FN642V_C_EOT "Proportional EOT control in degC." CURVE 0x59A2C FD_FLOAT32_IEEE 0 FCY_FN642V_C_EOT 0 7000 /begin AXIS_DESCR STD_AXIS VFD_ECT_ER_DEGC FCX_FN642V_C_EOT 6 -65536 65534 /end AXIS_DESCR /end CHARACTERISTIC
/begin COMPU_METHOD FCX_FN642V_C_EOT "FN642V_C_EOT X-axis conversion" RAT_FUNC "%10.5" "degC" COEFFS 0 1 0 0 0 1 /end COMPU_METHOD
/begin COMPU_METHOD FCY_FN642V_C_EOT "FN642V_C_EOT Y-axis conversion" RAT_FUNC "%10.5" "RPM" COEFFS 0 1 0 0 0 1 /end COMPU_METHOD
/begin CHARACTERISTIC FN643V_C "Viscuous fan speed vs. AAT in degC" CURVE 0x5992C FD_FLOAT32_IEEE 0 FCY_FN643V_C 0 7000 /begin AXIS_DESCR STD_AXIS AAT FCX_FN643V_C 7 -40 254 /end AXIS_DESCR /end CHARACTERISTIC
/begin COMPU_METHOD FCX_FN643V_C "FN643V_C X-axis conversion" RAT_FUNC "%10.5" "degC" COEFFS 0 1 0 0 0 1 /end COMPU_METHOD
/begin COMPU_METHOD FCY_FN643V_C "FN643V_C Y-axis conversion" RAT_FUNC "%10.5" "RPM" COEFFS 0 1 0 0 0 1 /end COMPU_METHOD
/begin CHARACTERISTIC FN644V " Viscous fan:  output duty cycle offset vs. requested fan speed" CURVE 0x5999C FD_FLOAT32_IEEE 0 FCY_FN644V 0 1 /begin AXIS_DESCR STD_AXIS VFD_REQ_N FCX_FN644V 7 0 7000 /end AXIS_DESCR /end CHARACTERISTIC
/begin COMPU_METHOD FCX_FN644V "FN644V X-axis conversion" RAT_FUNC "%10.5" "RPM" COEFFS 0 1 0 0 0 1 /end COMPU_METHOD
/begin COMPU_METHOD FCY_FN644V "FN644V Y-axis conversion" RAT_FUNC "%10.5" "unitless" COEFFS 0 1 0 0 0 1 /end COMPU_METHOD
/begin CHARACTERISTIC FN689VSS "Min. engine speed at a given TP to test VSS input" CURVE 0x4489C FD_FLOAT32_IEEE 0 FCY_FN689VSS 0 16383 /begin AXIS_DESCR STD_AXIS PPS_REL FCX_FN689VSS 7 0 1023.98 /end AXIS_DESCR /end CHARACTERISTIC
/begin COMPU_METHOD FCX_FN689VSS "FN689VSS X-axis conversion" RAT_FUNC "%10.5" "COUNTS" COEFFS 0 1 0 0 0 1 /end COMPU_METHOD
/begin COMPU_METHOD FCY_FN689VSS "FN689VSS Y-axis conversion" RAT_FUNC "%10.5" "RPM" COEFFS 0 1 0 0 0 1 /end COMPU_METHOD
/begin CHARACTERISTIC FN7000 "X Norm=FN022DS, Y Norm=FN023DS, Glow plug lamp activation time table" MAP 0x52E6C TD_FLOAT32_IEEE 0 TCZ_FN7000 0 300
 /begin AXIS_DESCR FIX_AXIS NO_INPUT_QUANTITY TCX_FN7000 11 0 10 FIX_AXIS_PAR 0 0 11 /end AXIS_DESCR
 /begin AXIS_DESCR FIX_AXIS NO_INPUT_QUANTITY TCY_FN7000 6 0 5 FIX_AXIS_PAR 0 0 6 /end AXIS_DESCR
/end CHARACTERISTIC
/begin COMPU_METHOD TCZ_FN7000 "FN7000 Z-axis conversion" RAT_FUNC "%10.5" "s" COEFFS 0 1 0 0 0 1 /end COMPU_METHOD
/begin COMPU_METHOD TCX_FN7000 "FN7000 X-axis conversion" RAT_FUNC "%10.5" "degC" COEFFS 0 1 0 0 0 1 /end COMPU_METHOD
/begin COMPU_METHOD TCY_FN7000 "FN7000 Y-axis conversion" RAT_FUNC "%10.5" "V" COEFFS 0 1 0 0 0 1 /end COMPU_METHOD
/begin CHARACTERISTIC FN700HIALT "GPC activation time function at high altitude" CURVE 0x52E0C FD_FLOAT32_IEEE 0 FCY_FN700HIALT 0 300 /begin AXIS_DESCR STD_AXIS EOT_C FCX_FN700HIALT 12 -40 150 /end AXIS_DESCR /end CHARACTERISTIC
/begin COMPU_METHOD FCX_FN700HIALT "FN700HIALT X-axis conversion" RAT_FUNC "%10.5" "degC" COEFFS 0 1 0 0 0 1 /end COMPU_METHOD
/begin COMPU_METHOD FCY_FN700HIALT "FN700HIALT Y-axis conversion" RAT_FUNC "%10.5" "unitless" COEFFS 0 1 0 0 0 1 /end COMPU_METHOD
/begin CHARACTERISTIC FN700LOALT "GPC activation time function at low altitude" CURVE 0x52DAC FD_FLOAT32_IEEE 0 FCY_FN700LOALT 0 300 /begin AXIS_DESCR STD_AXIS EOT_C FCX_FN700LOALT 12 -40 150 /end AXIS_DESCR /end CHARACTERISTIC
/begin COMPU_METHOD FCX_FN700LOALT "FN700LOALT X-axis conversion" RAT_FUNC "%10.5" "degC" COEFFS 0 1 0 0 0 1 /end COMPU_METHOD
/begin COMPU_METHOD FCY_FN700LOALT "FN700LOALT Y-axis conversion" RAT_FUNC "%10.5" "unitless" COEFFS 0 1 0 0 0 1 /end COMPU_METHOD
/begin CHARACTERISTIC FN704DS "Adder for glow plug lamp altitude compensation" CURVE 0x53024 FD_FLOAT32_IEEE 0 FCY_FN704DS 0 30 /begin AXIS_DESCR STD_AXIS BP_KPA FCX_FN704DS 5 0 150 /end AXIS_DESCR /end CHARACTERISTIC
/begin COMPU_METHOD FCX_FN704DS "FN704DS X-axis conversion" RAT_FUNC "%10.5" "kPa" COEFFS 0 1 0 0 0 1 /end COMPU_METHOD
/begin COMPU_METHOD FCY_FN704DS "FN704DS Y-axis conversion" RAT_FUNC "%10.5" "s" COEFFS 0 1 0 0 0 1 /end COMPU_METHOD
/begin CHARACTERISTIC FN766MIS "Calculate reduction in misfire daccel thresholds as a function of spark retard from MBT." CURVE 0x59BAC FD_FLOAT32_IEEE 0 FCY_FN766MIS 0 1 /begin AXIS_DESCR STD_AXIS NO_INPUT_QUANTITY FCX_FN766MIS 9 0 63.75 /end AXIS_DESCR /end CHARACTERISTIC
/begin COMPU_METHOD FCX_FN766MIS "FN766MIS X-axis conversion" RAT_FUNC "%10.5" "DEG" COEFFS 0 1 0 0 0 1 /end COMPU_METHOD
/begin COMPU_METHOD FCY_FN766MIS "FN766MIS Y-axis conversion" RAT_FUNC "%10.5" "UNITLESS" COEFFS 0 1 0 0 0 1 /end COMPU_METHOD
/begin CHARACTERISTIC FN800DS "Exhaust back pressure sensor transfer function" CURVE 0x417AC FD_FLOAT32_IEEE 0 FCY_FN800DS 0 400 /begin AXIS_DESCR STD_AXIS EBP_CNTS FCX_FN800DS 10 0 1023 /end AXIS_DESCR /end CHARACTERISTIC
/begin COMPU_METHOD FCX_FN800DS "FN800DS X-axis conversion" RAT_FUNC "%10.5" "ADct" COEFFS 0 1 0 0 0 1 /end COMPU_METHOD
/begin COMPU_METHOD FCY_FN800DS "FN800DS Y-axis conversion" RAT_FUNC "%10.5" "kPa" COEFFS 0 1 0 0 0 1 /end COMPU_METHOD
/begin CHARACTERISTIC FN808A "Engine oil temperature sensor transfer function" CURVE 0x4113C FD_FLOAT32_IEEE 0 FCY_FN808A -40 150 /begin AXIS_DESCR STD_AXIS EOT_CNTS FCX_FN808A 24 0 1023 /end AXIS_DESCR /end CHARACTERISTIC
/begin COMPU_METHOD FCX_FN808A "FN808A X-axis conversion" RAT_FUNC "%10.5" "ADct" COEFFS 0 1 0 0 0 1 /end COMPU_METHOD
/begin COMPU_METHOD FCY_FN808A "FN808A Y-axis conversion" RAT_FUNC "%10.5" "degC" COEFFS 0 1 0 0 0 1 /end COMPU_METHOD
/begin CHARACTERISTIC FN809A "Intake Air Temperature sensor transfer function" CURVE 0x4173C FD_FLOAT32_IEEE 0 FCY_FN809A -40 150 /begin AXIS_DESCR STD_AXIS IAT_CNTS FCX_FN809A 14 0 1023 /end AXIS_DESCR /end CHARACTERISTIC
/begin COMPU_METHOD FCX_FN809A "FN809A X-axis conversion" RAT_FUNC "%10.5" "ADct" COEFFS 0 1 0 0 0 1 /end COMPU_METHOD
/begin COMPU_METHOD FCY_FN809A "FN809A Y-axis conversion" RAT_FUNC "%10.5" "degC" COEFFS 0 1 0 0 0 1 /end COMPU_METHOD
/begin CHARACTERISTIC FN809B "Manifold air temperature sensor transfer function" CURVE 0x4100C FD_FLOAT32_IEEE 0 FCY_FN809B -40 150 /begin AXIS_DESCR STD_AXIS MAT_CNTS FCX_FN809B 14 0 1023 /end AXIS_DESCR /end CHARACTERISTIC
/begin COMPU_METHOD FCX_FN809B "FN809B X-axis conversion" RAT_FUNC "%10.5" "ADct" COEFFS 0 1 0 0 0 1 /end COMPU_METHOD
/begin COMPU_METHOD FCY_FN809B "FN809B Y-axis conversion" RAT_FUNC "%10.5" "degC" COEFFS 0 1 0 0 0 1 /end COMPU_METHOD
/begin CHARACTERISTIC FN896 "Fan airflow adder as a function of VSF" CURVE 0x599D4 FD_FLOAT32_IEEE 0 FCY_FN896 0 0.992 /begin AXIS_DESCR STD_AXIS VSF FCX_FN896 6 0 31 /end AXIS_DESCR /end CHARACTERISTIC
/begin COMPU_METHOD FCX_FN896 "FN896 X-axis conversion" RAT_FUNC "%10.5" "ENUMERATED" COEFFS 0 1 0 0 0 1 /end COMPU_METHOD
/begin COMPU_METHOD FCY_FN896 "FN896 Y-axis conversion" RAT_FUNC "%10.5" "PPM" COEFFS 0 1 0 0 0 1 /end COMPU_METHOD
/begin CHARACTERISTIC FN966 "Shaft speed limiter function" CURVE 0x4827C FD_FLOAT32_IEEE 0 FCY_FN966 0 1 /begin AXIS_DESCR STD_AXIS NOBART FCX_FN966 10 0 100000 /end AXIS_DESCR /end CHARACTERISTIC
/begin COMPU_METHOD FCX_FN966 "FN966 X-axis conversion" RAT_FUNC "%10.5" "RPM" COEFFS 0 1 0 0 0 1 /end COMPU_METHOD
/begin COMPU_METHOD FCY_FN966 "FN966 Y-axis conversion" RAT_FUNC "%10.5" "unitless" COEFFS 0 1 0 0 0 1 /end COMPU_METHOD
/begin CHARACTERISTIC FN967 "Road speed limiter function" CURVE 0x482CC FD_FLOAT32_IEEE 0 FCY_FN967 0 1 /begin AXIS_DESCR STD_AXIS MPH_FILT FCX_FN967 10 0 300 /end AXIS_DESCR /end CHARACTERISTIC
/begin COMPU_METHOD FCX_FN967 "FN967 X-axis conversion" RAT_FUNC "%10.5" "MPH" COEFFS 0 1 0 0 0 1 /end COMPU_METHOD
/begin COMPU_METHOD FCY_FN967 "FN967 Y-axis conversion" RAT_FUNC "%10.5" "unitless" COEFFS 0 1 0 0 0 1 /end COMPU_METHOD
/begin CHARACTERISTIC FNACC_DELAY "Delay to synchronise A/C ON and ISC compensation - with system not cycling" CURVE 0x4238C FD_FLOAT32_IEEE 0 FCY_FNACC_DELAY 0 62 /begin AXIS_DESCR STD_AXIS NO_INPUT_QUANTITY FCX_FNACC_DELAY 6 0 16383.8 /end AXIS_DESCR /end CHARACTERISTIC
/begin COMPU_METHOD FCX_FNACC_DELAY "FNACC_DELAY X-axis conversion" RAT_FUNC "%10.5" "RPM" COEFFS 0 1 0 0 0 1 /end COMPU_METHOD
/begin COMPU_METHOD FCY_FNACC_DELAY "FNACC_DELAY Y-axis conversion" RAT_FUNC "%10.5" "s" COEFFS 0 1 0 0 0 1 /end COMPU_METHOD
/begin CHARACTERISTIC FNACC_DELAY2 "Delay to synchronise A/C ON and ISC compensation - with system cycling" CURVE 0x423BC FD_FLOAT32_IEEE 0 FCY_FNACC_DELAY2 0 62 /begin AXIS_DESCR STD_AXIS N FCX_FNACC_DELAY2 6 0 16383.8 /end AXIS_DESCR /end CHARACTERISTIC
/begin COMPU_METHOD FCX_FNACC_DELAY2 "FNACC_DELAY2 X-axis conversion" RAT_FUNC "%10.5" "RPM" COEFFS 0 1 0 0 0 1 /end COMPU_METHOD
/begin COMPU_METHOD FCY_FNACC_DELAY2 "FNACC_DELAY2 Y-axis conversion" RAT_FUNC "%10.5" "s" COEFFS 0 1 0 0 0 1 /end COMPU_METHOD
/begin CHARACTERISTIC FNAC_MATNORM "MAT normalising function for FNAC_MINOFF table." CURVE 0x422AC FD_FLOAT32_IEEE 0 FCY_FNAC_MATNORM 0 5 /begin AXIS_DESCR STD_AXIS MAT FCX_FNAC_MATNORM 6 -110 110 /end AXIS_DESCR /end CHARACTERISTIC
/begin COMPU_METHOD FCX_FNAC_MATNORM "FNAC_MATNORM X-axis conversion" RAT_FUNC "%10.5" "degC" COEFFS 0 1 0 0 0 1 /end COMPU_METHOD
/begin COMPU_METHOD FCY_FNAC_MATNORM "FNAC_MATNORM Y-axis conversion" RAT_FUNC "%10.5" "Unitless" COEFFS 0 1 0 0 0 1 /end COMPU_METHOD
/begin CHARACTERISTIC FNAC_MINOFF_D "X Norm=FNAC_MPHNORM, Y Norm=FNAC_MATNORM, A/C minimum off time as a function of MAT and vehicle speed." MAP 0x422DC TD_FLOAT32_IEEE 0 TCZ_FNAC_MINOFF_D 0 62
 /begin AXIS_DESCR FIX_AXIS NO_INPUT_QUANTITY TCX_FNAC_MINOFF_D 6 0 5 FIX_AXIS_PAR 0 0 6 /end AXIS_DESCR
 /begin AXIS_DESCR FIX_AXIS NO_INPUT_QUANTITY TCY_FNAC_MINOFF_D 6 0 5 FIX_AXIS_PAR 0 0 6 /end AXIS_DESCR
/end CHARACTERISTIC
/begin COMPU_METHOD TCZ_FNAC_MINOFF_D "FNAC_MINOFF_D Z-axis conversion" RAT_FUNC "%10.5" "s" COEFFS 0 1 0 0 0 1 /end COMPU_METHOD
/begin COMPU_METHOD TCX_FNAC_MINOFF_D "FNAC_MINOFF_D X-axis conversion" RAT_FUNC "%10.5" "MPH" COEFFS 0 1 0 0 0 1 /end COMPU_METHOD
/begin COMPU_METHOD TCY_FNAC_MINOFF_D "FNAC_MINOFF_D Y-axis conversion" RAT_FUNC "%10.5" "degC" COEFFS 0 1 0 0 0 1 /end COMPU_METHOD
/begin CHARACTERISTIC FNAC_MPHNORM "MPH Filtered normalising function for FNAC_MINOFF table." CURVE 0x4227C FD_FLOAT32_IEEE 0 FCY_FNAC_MPHNORM 0 5 /begin AXIS_DESCR STD_AXIS VSBAR FCX_FNAC_MPHNORM 6 0 127.5 /end AXIS_DESCR /end CHARACTERISTIC
/begin COMPU_METHOD FCX_FNAC_MPHNORM "FNAC_MPHNORM X-axis conversion" RAT_FUNC "%10.5" "MPH" COEFFS 0 1 0 0 0 1 /end COMPU_METHOD
/begin COMPU_METHOD FCY_FNAC_MPHNORM "FNAC_MPHNORM Y-axis conversion" RAT_FUNC "%10.5" "Unitless" COEFFS 0 1 0 0 0 1 /end COMPU_METHOD
/begin CHARACTERISTIC FNAC_NORM "ACPRES normalizing function." CURVE 0x424AC FD_FLOAT32_IEEE 0 FCY_FNAC_NORM 0 5 /begin AXIS_DESCR STD_AXIS ACPRES FCX_FNAC_NORM 7 0 510 /end AXIS_DESCR /end CHARACTERISTIC
/begin COMPU_METHOD FCX_FNAC_NORM "FNAC_NORM X-axis conversion" RAT_FUNC "%10.5" "PSI" COEFFS 0 1 0 0 0 1 /end COMPU_METHOD
/begin COMPU_METHOD FCY_FNAC_NORM "FNAC_NORM Y-axis conversion" RAT_FUNC "%10.5" "normalised" COEFFS 0 1 0 0 0 1 /end COMPU_METHOD
/begin CHARACTERISTIC FNALTIVPWR "Alternator IVPWR table from Engine speed" CURVE 0x59A5C FD_FLOAT32_IEEE 0 FCY_FNALTIVPWR 0 25.2 /begin AXIS_DESCR STD_AXIS NO_INPUT_QUANTITY FCX_FNALTIVPWR 8 0 16800 /end AXIS_DESCR /end CHARACTERISTIC
/begin COMPU_METHOD FCX_FNALTIVPWR "FNALTIVPWR X-axis conversion" RAT_FUNC "%10.5" "RPM" COEFFS 0 1 0 0 0 1 /end COMPU_METHOD
/begin COMPU_METHOD FCY_FNALTIVPWR "FNALTIVPWR Y-axis conversion" RAT_FUNC "%10.5" "V" COEFFS 0 1 0 0 0 1 /end COMPU_METHOD
/begin CHARACTERISTIC FNBARO_V2KPA "Transfer function for barometric pressure transducer from volts to kpa" CURVE 0x4125C FD_FLOAT32_IEEE 0 FCY_FNBARO_V2KPA 0 120 /begin AXIS_DESCR STD_AXIS BP_VOLTAGE FCX_FNBARO_V2KPA 15 0 5 /end AXIS_DESCR /end CHARACTERISTIC
/begin COMPU_METHOD FCX_FNBARO_V2KPA "FNBARO_V2KPA X-axis conversion" RAT_FUNC "%10.5" "V" COEFFS 0 1 0 0 0 1 /end COMPU_METHOD
/begin COMPU_METHOD FCY_FNBARO_V2KPA "FNBARO_V2KPA Y-axis conversion" RAT_FUNC "%10.5" "kPa" COEFFS 0 1 0 0 0 1 /end COMPU_METHOD
/begin CHARACTERISTIC FNBPTC_REC "BP filter constant selection based on RPM." CURVE 0x4294C FD_FLOAT32_IEEE 0 FCY_FNBPTC_REC 0 64 /begin AXIS_DESCR STD_AXIS N FCX_FNBPTC_REC 14 0 8000 /end AXIS_DESCR /end CHARACTERISTIC
/begin COMPU_METHOD FCX_FNBPTC_REC "FNBPTC_REC X-axis conversion" RAT_FUNC "%10.5" "RPM" COEFFS 0 1 0 0 0 1 /end COMPU_METHOD
/begin COMPU_METHOD FCY_FNBPTC_REC "FNBPTC_REC Y-axis conversion" RAT_FUNC "%10.5" "s" COEFFS 0 1 0 0 0 1 /end COMPU_METHOD
/begin CHARACTERISTIC FNCOLDEBPG "engine speed output table based on EOT for EPB cold idle kicker" CURVE 0x44ABC FD_FLOAT32_IEEE 0 FCY_FNCOLDEBPG 0 16383.8 /begin AXIS_DESCR STD_AXIS EOT_C FCX_FNCOLDEBPG 6 -8192 8191 /end AXIS_DESCR /end CHARACTERISTIC
/begin COMPU_METHOD FCX_FNCOLDEBPG "FNCOLDEBPG X-axis conversion" RAT_FUNC "%10.5" "degC" COEFFS 0 1 0 0 0 1 /end COMPU_METHOD
/begin COMPU_METHOD FCY_FNCOLDEBPG "FNCOLDEBPG Y-axis conversion" RAT_FUNC "%10.5" "RPM" COEFFS 0 1 0 0 0 1 /end COMPU_METHOD
/begin CHARACTERISTIC FNCOLDIDL "Idle speed setpoint adder" CURVE 0x4494C FD_FLOAT32_IEEE 0 FCY_FNCOLDIDL 400 4000 /begin AXIS_DESCR STD_AXIS MAT FCX_FNCOLDIDL 6 -40 150 /end AXIS_DESCR /end CHARACTERISTIC
/begin COMPU_METHOD FCX_FNCOLDIDL "FNCOLDIDL X-axis conversion" RAT_FUNC "%10.5" "degC" COEFFS 0 1 0 0 0 1 /end COMPU_METHOD
/begin COMPU_METHOD FCY_FNCOLDIDL "FNCOLDIDL Y-axis conversion" RAT_FUNC "%10.5" "RPM" COEFFS 0 1 0 0 0 1 /end COMPU_METHOD
/begin CHARACTERISTIC FNCOLDIDLEBPGMLT "Cold idle speed EBP multiplier table" CURVE 0x44A8C FD_FLOAT32_IEEE 0 FCY_FNCOLDIDLEBPGMLT 0 1.9999 /begin AXIS_DESCR STD_AXIS NO_INPUT_QUANTITY FCX_FNCOLDIDLEBPGMLT 6 0 50000 /end AXIS_DESCR /end CHARACTERISTIC
/begin COMPU_METHOD FCX_FNCOLDIDLEBPGMLT "FNCOLDIDLEBPGMLT X-axis conversion" RAT_FUNC "%10.5" "unitless" COEFFS 0 1 0 0 0 1 /end COMPU_METHOD
/begin COMPU_METHOD FCY_FNCOLDIDLEBPGMLT "FNCOLDIDLEBPGMLT Y-axis conversion" RAT_FUNC "%10.5" "unitless" COEFFS 0 1 0 0 0 1 /end COMPU_METHOD
/begin CHARACTERISTIC FNCOLDIDLMLT "Timer based multiplier for NLIDLE" CURVE 0x4491C FD_FLOAT32_IEEE 0 FCY_FNCOLDIDLMLT 0 1 /begin AXIS_DESCR STD_AXIS COLDIDLETMR FCX_FNCOLDIDLMLT 6 0 4000 /end AXIS_DESCR /end CHARACTERISTIC
/begin COMPU_METHOD FCX_FNCOLDIDLMLT "FNCOLDIDLMLT X-axis conversion" RAT_FUNC "%10.5" "s" COEFFS 0 1 0 0 0 1 /end COMPU_METHOD
/begin COMPU_METHOD FCY_FNCOLDIDLMLT "FNCOLDIDLMLT Y-axis conversion" RAT_FUNC "%10.5" "unitless" COEFFS 0 1 0 0 0 1 /end COMPU_METHOD
/begin CHARACTERISTIC FNCRPYICP_ROC "Engine speed based ICP adder" CURVE 0x4B5E4 FD_FLOAT32_IEEE 0 FCY_FNCRPYICP_ROC 0 5 /begin AXIS_DESCR STD_AXIS N FCX_FNCRPYICP_ROC 8 0 6000 /end AXIS_DESCR /end CHARACTERISTIC
/begin COMPU_METHOD FCX_FNCRPYICP_ROC "FNCRPYICP_ROC X-axis conversion" RAT_FUNC "%10.5" "RPM" COEFFS 0 1 0 0 0 1 /end COMPU_METHOD
/begin COMPU_METHOD FCY_FNCRPYICP_ROC "FNCRPYICP_ROC Y-axis conversion" RAT_FUNC "%10.5" "MPa" COEFFS 0 1 0 0 0 1 /end COMPU_METHOD
/begin CHARACTERISTIC FNCUR_N_MAX_TQ "X Norm=FN_TQ115, Y Norm=FN_TQ102, Calculates maximum torque at current engine speed" MAP 0x4FEAC TD_FLOAT32_IEEE 0 TCZ_FNCUR_N_MAX_TQ -400 1600
 /begin AXIS_DESCR FIX_AXIS NO_INPUT_QUANTITY TCX_FNCUR_N_MAX_TQ 14 0 13 FIX_AXIS_PAR 0 0 14 /end AXIS_DESCR
 /begin AXIS_DESCR FIX_AXIS NO_INPUT_QUANTITY TCY_FNCUR_N_MAX_TQ 14 0 13 FIX_AXIS_PAR 0 0 14 /end AXIS_DESCR
/end CHARACTERISTIC
/begin COMPU_METHOD TCZ_FNCUR_N_MAX_TQ "FNCUR_N_MAX_TQ Z-axis conversion" RAT_FUNC "%10.5" "lbf*ft" COEFFS 0 1 0 0 0 1 /end COMPU_METHOD
/begin COMPU_METHOD TCX_FNCUR_N_MAX_TQ "FNCUR_N_MAX_TQ X-axis conversion" RAT_FUNC "%10.5" "RPM" COEFFS 0 1 0 0 0 1 /end COMPU_METHOD
/begin COMPU_METHOD TCY_FNCUR_N_MAX_TQ "FNCUR_N_MAX_TQ Y-axis conversion" RAT_FUNC "%10.5" "degC" COEFFS 0 1 0 0 0 1 /end COMPU_METHOD
/begin CHARACTERISTIC FNDIT403 "Engine oil temperature function" CURVE 0x48CBC FD_FLOAT32_IEEE 0 FCY_FNDIT403 -15 15 /begin AXIS_DESCR STD_AXIS EOT_C FCX_FNDIT403 10 -40 150 /end AXIS_DESCR /end CHARACTERISTIC
/begin COMPU_METHOD FCX_FNDIT403 "FNDIT403 X-axis conversion" RAT_FUNC "%10.5" "degC" COEFFS 0 1 0 0 0 1 /end COMPU_METHOD
/begin COMPU_METHOD FCY_FNDIT403 "FNDIT403 Y-axis conversion" RAT_FUNC "%10.5" "unitless" COEFFS 0 1 0 0 0 1 /end COMPU_METHOD
/begin CHARACTERISTIC FNDIT_MFN_KDSH "X Norm=FNN_DSH_DIT, Y Norm=FNMFDES_DSH_DIT, DIT dash adder table" MAP 0x4ABD4 TD_FLOAT32_IEEE 0 TCZ_FNDIT_MFN_KDSH -15 15
 /begin AXIS_DESCR FIX_AXIS NO_INPUT_QUANTITY TCX_FNDIT_MFN_KDSH 9 0 8 FIX_AXIS_PAR 0 0 9 /end AXIS_DESCR
 /begin AXIS_DESCR FIX_AXIS NO_INPUT_QUANTITY TCY_FNDIT_MFN_KDSH 9 0 8 FIX_AXIS_PAR 0 0 9 /end AXIS_DESCR
/end CHARACTERISTIC
/begin COMPU_METHOD TCZ_FNDIT_MFN_KDSH "FNDIT_MFN_KDSH Z-axis conversion" RAT_FUNC "%10.5" "unitless" COEFFS 0 1 0 0 0 1 /end COMPU_METHOD
/begin COMPU_METHOD TCX_FNDIT_MFN_KDSH "FNDIT_MFN_KDSH X-axis conversion" RAT_FUNC "%10.5" "RPM" COEFFS 0 1 0 0 0 1 /end COMPU_METHOD
/begin COMPU_METHOD TCY_FNDIT_MFN_KDSH "FNDIT_MFN_KDSH Y-axis conversion" RAT_FUNC "%10.5" "unitless" COEFFS 0 1 0 0 0 1 /end COMPU_METHOD
/begin CHARACTERISTIC FNDOLCAL "Volume Fuel cal. correction for DOL calc." CURVE 0x45F5C FD_FLOAT32_IEEE 0 FCY_FNDOLCAL 0 150 /begin AXIS_DESCR STD_AXIS VFDES FCX_FNDOLCAL 9 0 150 /end AXIS_DESCR /end CHARACTERISTIC
/begin COMPU_METHOD FCX_FNDOLCAL "FNDOLCAL X-axis conversion" RAT_FUNC "%10.5" "mL" COEFFS 0 1 0 0 0 1 /end COMPU_METHOD
/begin COMPU_METHOD FCY_FNDOLCAL "FNDOLCAL Y-axis conversion" RAT_FUNC "%10.5" "unitless" COEFFS 0 1 0 0 0 1 /end COMPU_METHOD
/begin CHARACTERISTIC FNEBPNORM "Norm function for fneotebpcorr" CURVE 0x4411C FD_FLOAT32_IEEE 0 FCY_FNEBPNORM 0 400 /begin AXIS_DESCR STD_AXIS EBP_ENG_KPA FCX_FNEBPNORM 12 0 400 /end AXIS_DESCR /end CHARACTERISTIC
/begin COMPU_METHOD FCX_FNEBPNORM "FNEBPNORM X-axis conversion" RAT_FUNC "%10.5" "kPa" COEFFS 0 1 0 0 0 1 /end COMPU_METHOD
/begin COMPU_METHOD FCY_FNEBPNORM "FNEBPNORM Y-axis conversion" RAT_FUNC "%10.5" "kPa" COEFFS 0 1 0 0 0 1 /end COMPU_METHOD
/begin CHARACTERISTIC FNEBPTC_REC "EBP Filter time constant" CURVE 0x442FC FD_FLOAT32_IEEE 0 FCY_FNEBPTC_REC 0 64 /begin AXIS_DESCR STD_AXIS N FCX_FNEBPTC_REC 14 0 8000 /end AXIS_DESCR /end CHARACTERISTIC
/begin COMPU_METHOD FCX_FNEBPTC_REC "FNEBPTC_REC X-axis conversion" RAT_FUNC "%10.5" "RPM" COEFFS 0 1 0 0 0 1 /end COMPU_METHOD
/begin COMPU_METHOD FCY_FNEBPTC_REC "FNEBPTC_REC Y-axis conversion" RAT_FUNC "%10.5" "s" COEFFS 0 1 0 0 0 1 /end COMPU_METHOD
/begin CHARACTERISTIC FNECTCNTLMC "ECT cold fault counter limit table" CURVE 0x42FDC FD_FLOAT32_IEEE 0 FCY_FNECTCNTLMC -65535 65535 /begin AXIS_DESCR STD_AXIS ECT_C FCX_FNECTCNTLMC 14 -4096 4095.88 /end AXIS_DESCR /end CHARACTERISTIC
/begin COMPU_METHOD FCX_FNECTCNTLMC "FNECTCNTLMC X-axis conversion" RAT_FUNC "%10.5" "degC" COEFFS 0 1 0 0 0 1 /end COMPU_METHOD
/begin COMPU_METHOD FCY_FNECTCNTLMC "FNECTCNTLMC Y-axis conversion" RAT_FUNC "%10.5" "unitless" COEFFS 0 1 0 0 0 1 /end COMPU_METHOD
/begin CHARACTERISTIC FNECTCNTLMH "ECT hot fault counter limit table" CURVE 0x4304C FD_FLOAT32_IEEE 0 FCY_FNECTCNTLMH -65535 65535 /begin AXIS_DESCR STD_AXIS ECT_C FCX_FNECTCNTLMH 14 -4096 4095.88 /end AXIS_DESCR /end CHARACTERISTIC
/begin COMPU_METHOD FCX_FNECTCNTLMH "FNECTCNTLMH X-axis conversion" RAT_FUNC "%10.5" "degC" COEFFS 0 1 0 0 0 1 /end COMPU_METHOD
/begin COMPU_METHOD FCY_FNECTCNTLMH "FNECTCNTLMH Y-axis conversion" RAT_FUNC "%10.5" "unitless" COEFFS 0 1 0 0 0 1 /end COMPU_METHOD
/begin CHARACTERISTIC FNECTTC_REC "Time constant table for ECT filter based on Engine speed." CURVE 0x42D3C FD_FLOAT32_IEEE 0 FCY_FNECTTC_REC 0 64 /begin AXIS_DESCR STD_AXIS N FCX_FNECTTC_REC 14 0 8000 /end AXIS_DESCR /end CHARACTERISTIC
/begin COMPU_METHOD FCX_FNECTTC_REC "FNECTTC_REC X-axis conversion" RAT_FUNC "%10.5" "RPM" COEFFS 0 1 0 0 0 1 /end COMPU_METHOD
/begin COMPU_METHOD FCY_FNECTTC_REC "FNECTTC_REC Y-axis conversion" RAT_FUNC "%10.5" "s" COEFFS 0 1 0 0 0 1 /end COMPU_METHOD
/begin CHARACTERISTIC FNECT_FNW "Engine coolant temperature sensor transfer function" CURVE 0x4107C FD_FLOAT32_IEEE 0 FCY_FNECT_FNW -40 150 /begin AXIS_DESCR STD_AXIS ECT_CNTS FCX_FNECT_FNW 24 0 1023 /end AXIS_DESCR /end CHARACTERISTIC
/begin COMPU_METHOD FCX_FNECT_FNW "FNECT_FNW X-axis conversion" RAT_FUNC "%10.5" "ADct" COEFFS 0 1 0 0 0 1 /end COMPU_METHOD
/begin COMPU_METHOD FCY_FNECT_FNW "FNECT_FNW Y-axis conversion" RAT_FUNC "%10.5" "degC" COEFFS 0 1 0 0 0 1 /end COMPU_METHOD
/begin CHARACTERISTIC FNEGRPTC_REC "EGRP filter time constant selection based on RPM." CURVE 0x430BC FD_FLOAT32_IEEE 0 FCY_FNEGRPTC_REC 0 64 /begin AXIS_DESCR STD_AXIS N FCX_FNEGRPTC_REC 14 0 8000 /end AXIS_DESCR /end CHARACTERISTIC
/begin COMPU_METHOD FCX_FNEGRPTC_REC "FNEGRPTC_REC X-axis conversion" RAT_FUNC "%10.5" "RPM" COEFFS 0 1 0 0 0 1 /end COMPU_METHOD
/begin COMPU_METHOD FCY_FNEGRPTC_REC "FNEGRPTC_REC Y-axis conversion" RAT_FUNC "%10.5" "s" COEFFS 0 1 0 0 0 1 /end COMPU_METHOD
/begin CHARACTERISTIC FNEGRP_FNW "Transferfunction for EGRP" CURVE 0x414BC FD_FLOAT32_IEEE 0 FCY_FNEGRP_FNW 0 1 /begin AXIS_DESCR STD_AXIS EGRP_RAW FCX_FNEGRP_FNW 24 0 1023 /end AXIS_DESCR /end CHARACTERISTIC
/begin COMPU_METHOD FCX_FNEGRP_FNW "FNEGRP_FNW X-axis conversion" RAT_FUNC "%10.5" "ADct" COEFFS 0 1 0 0 0 1 /end COMPU_METHOD
/begin COMPU_METHOD FCY_FNEGRP_FNW "FNEGRP_FNW Y-axis conversion" RAT_FUNC "%10.5" "%" COEFFS 0 1 0 0 0 1 /end COMPU_METHOD
/begin CHARACTERISTIC FNEGR_DEF_MULT "" CURVE 0x5329C FD_FLOAT32_IEEE 0 FCY_FNEGR_DEF_MULT 0 100
 /begin AXIS_DESCR STD_AXIS NO_INPUT_QUANTITY FCX_FNEGR_DEF_MULT 14 -150000 10000 /end AXIS_DESCR
/end CHARACTERISTIC
/begin COMPU_METHOD FCX_FNEGR_DEF_MULT "FNEGR_DEF_MULT X-axis conversion" RAT_FUNC "%10.5" "unitless" COEFFS 0 1 0 0 0 1 /end COMPU_METHOD
/begin COMPU_METHOD FCY_FNEGR_DEF_MULT "FNEGR_DEF_MULT Y-axis conversion" RAT_FUNC "%10.5" "unitless" COEFFS 0 1 0 0 0 1 /end COMPU_METHOD
/begin CHARACTERISTIC FNEGR_KI "" CURVE 0x5337C FD_FLOAT32_IEEE 0 FCY_FNEGR_KI 0 100 /begin AXIS_DESCR STD_AXIS N FCX_FNEGR_KI 14 0 5100 /end AXIS_DESCR /end CHARACTERISTIC
/begin COMPU_METHOD FCX_FNEGR_KI "FNEGR_KI X-axis conversion" RAT_FUNC "%10.5" "unitless" COEFFS 0 1 0 0 0 1 /end COMPU_METHOD
/begin COMPU_METHOD FCY_FNEGR_KI "FNEGR_KI Y-axis conversion" RAT_FUNC "%10.5" "unitless" COEFFS 0 1 0 0 0 1 /end COMPU_METHOD
/begin CHARACTERISTIC FNEGR_KP "" CURVE 0x5330C FD_FLOAT32_IEEE 0 FCY_FNEGR_KP 0 1000 /begin AXIS_DESCR STD_AXIS N FCX_FNEGR_KP 14 0 5500 /end AXIS_DESCR /end CHARACTERISTIC
/begin COMPU_METHOD FCX_FNEGR_KP "FNEGR_KP X-axis conversion" RAT_FUNC "%10.5" "unitless" COEFFS 0 1 0 0 0 1 /end COMPU_METHOD
/begin COMPU_METHOD FCY_FNEGR_KP "FNEGR_KP Y-axis conversion" RAT_FUNC "%10.5" "unitless" COEFFS 0 1 0 0 0 1 /end COMPU_METHOD
/begin CHARACTERISTIC FNEGR_MAF_SP "X Norm=FN090DS_EGR, Y Norm=FN091DS_EGR" MAP 0x533EC TD_FLOAT32_IEEE 0 TCZ_FNEGR_MAF_SP 0 1000
 /begin AXIS_DESCR FIX_AXIS NO_INPUT_QUANTITY TCX_FNEGR_MAF_SP 14 0 13 FIX_AXIS_PAR 0 0 14 /end AXIS_DESCR
 /begin AXIS_DESCR FIX_AXIS NO_INPUT_QUANTITY TCY_FNEGR_MAF_SP 14 0 13 FIX_AXIS_PAR 0 0 14 /end AXIS_DESCR
/end CHARACTERISTIC
/begin COMPU_METHOD TCZ_FNEGR_MAF_SP "FNEGR_MAF_SP Z-axis conversion" RAT_FUNC "%10.5" "unitless" COEFFS 0 1 0 0 0 1 /end COMPU_METHOD
/begin COMPU_METHOD TCX_FNEGR_MAF_SP "FNEGR_MAF_SP X-axis conversion" RAT_FUNC "%10.5" "unitless" COEFFS 0 1 0 0 0 1 /end COMPU_METHOD
/begin COMPU_METHOD TCY_FNEGR_MAF_SP "FNEGR_MAF_SP Y-axis conversion" RAT_FUNC "%10.5" "unitless" COEFFS 0 1 0 0 0 1 /end COMPU_METHOD
/begin CHARACTERISTIC FNEGR_PPS_DIF "" CURVE 0x5322C FD_FLOAT32_IEEE 0 FCY_FNEGR_PPS_DIF 0 100 /begin AXIS_DESCR STD_AXIS EGR_PPS_DIF FCX_FNEGR_PPS_DIF 14 -5000 5000 /end AXIS_DESCR /end CHARACTERISTIC
/begin COMPU_METHOD FCX_FNEGR_PPS_DIF "FNEGR_PPS_DIF X-axis conversion" RAT_FUNC "%10.5" "unitless" COEFFS 0 1 0 0 0 1 /end COMPU_METHOD
/begin COMPU_METHOD FCY_FNEGR_PPS_DIF "FNEGR_PPS_DIF Y-axis conversion" RAT_FUNC "%10.5" "unitless" COEFFS 0 1 0 0 0 1 /end COMPU_METHOD
/begin CHARACTERISTIC FNEGR_PPS_FOF "" CURVE 0x531BC FD_FLOAT32_IEEE 0 FCY_FNEGR_PPS_FOF 0 100 /begin AXIS_DESCR STD_AXIS EGR_PPS_FOF FCX_FNEGR_PPS_FOF 14 0 1500 /end AXIS_DESCR /end CHARACTERISTIC
/begin COMPU_METHOD FCX_FNEGR_PPS_FOF "FNEGR_PPS_FOF X-axis conversion" RAT_FUNC "%10.5" "unitless" COEFFS 0 1 0 0 0 1 /end COMPU_METHOD
/begin COMPU_METHOD FCY_FNEGR_PPS_FOF "FNEGR_PPS_FOF Y-axis conversion" RAT_FUNC "%10.5" "unitless" COEFFS 0 1 0 0 0 1 /end COMPU_METHOD
/begin CHARACTERISTIC FNEGR_PPS_MLT "X Norm=FNEGR_PPS_FOF, Y Norm=FNEGR_PPS_DIF" MAP 0x536FC TD_FLOAT32_IEEE 0 TCZ_FNEGR_PPS_MLT 0 100
 /begin AXIS_DESCR FIX_AXIS NO_INPUT_QUANTITY TCX_FNEGR_PPS_MLT 14 0 13 FIX_AXIS_PAR 0 0 14 /end AXIS_DESCR
 /begin AXIS_DESCR FIX_AXIS NO_INPUT_QUANTITY TCY_FNEGR_PPS_MLT 14 0 13 FIX_AXIS_PAR 0 0 14 /end AXIS_DESCR
/end CHARACTERISTIC
/begin COMPU_METHOD TCZ_FNEGR_PPS_MLT "FNEGR_PPS_MLT Z-axis conversion" RAT_FUNC "%10.5" "unitless" COEFFS 0 1 0 0 0 1 /end COMPU_METHOD
/begin COMPU_METHOD TCX_FNEGR_PPS_MLT "FNEGR_PPS_MLT X-axis conversion" RAT_FUNC "%10.5" "unitless" COEFFS 0 1 0 0 0 1 /end COMPU_METHOD
/begin COMPU_METHOD TCY_FNEGR_PPS_MLT "FNEGR_PPS_MLT Y-axis conversion" RAT_FUNC "%10.5" "unitless" COEFFS 0 1 0 0 0 1 /end COMPU_METHOD
/begin CHARACTERISTIC FNEGR_TRNS "X Norm=FN090DS_EGR, Y Norm=FN091DS_EGR" MAP 0x53A0C TD_FLOAT32_IEEE 0 TCZ_FNEGR_TRNS 0 1000
 /begin AXIS_DESCR FIX_AXIS NO_INPUT_QUANTITY TCX_FNEGR_TRNS 14 0 13 FIX_AXIS_PAR 0 0 14 /end AXIS_DESCR
 /begin AXIS_DESCR FIX_AXIS NO_INPUT_QUANTITY TCY_FNEGR_TRNS 14 0 13 FIX_AXIS_PAR 0 0 14 /end AXIS_DESCR
/end CHARACTERISTIC
/begin COMPU_METHOD TCZ_FNEGR_TRNS "FNEGR_TRNS Z-axis conversion" RAT_FUNC "%10.5" "unitless" COEFFS 0 1 0 0 0 1 /end COMPU_METHOD
/begin COMPU_METHOD TCX_FNEGR_TRNS "FNEGR_TRNS X-axis conversion" RAT_FUNC "%10.5" "unitless" COEFFS 0 1 0 0 0 1 /end COMPU_METHOD
/begin COMPU_METHOD TCY_FNEGR_TRNS "FNEGR_TRNS Y-axis conversion" RAT_FUNC "%10.5" "unitless" COEFFS 0 1 0 0 0 1 /end COMPU_METHOD
/begin CHARACTERISTIC FNEOTCNTLMC "EOT cold error counter limit table" CURVE 0x42C5C FD_FLOAT32_IEEE 0 FCY_FNEOTCNTLMC -65535 65535 /begin AXIS_DESCR STD_AXIS EOT_C FCX_FNEOTCNTLMC 14 -8192 8191 /end AXIS_DESCR /end CHARACTERISTIC
/begin COMPU_METHOD FCX_FNEOTCNTLMC "FNEOTCNTLMC X-axis conversion" RAT_FUNC "%10.5" "degC" COEFFS 0 1 0 0 0 1 /end COMPU_METHOD
/begin COMPU_METHOD FCY_FNEOTCNTLMC "FNEOTCNTLMC Y-axis conversion" RAT_FUNC "%10.5" "unitless" COEFFS 0 1 0 0 0 1 /end COMPU_METHOD
/begin CHARACTERISTIC FNEOTCNTLMH "EOT hot error counter limit table" CURVE 0x42CCC FD_FLOAT32_IEEE 0 FCY_FNEOTCNTLMH -65535 65535 /begin AXIS_DESCR STD_AXIS EOT_C FCX_FNEOTCNTLMH 14 -8192 8191 /end AXIS_DESCR /end CHARACTERISTIC
/begin COMPU_METHOD FCX_FNEOTCNTLMH "FNEOTCNTLMH X-axis conversion" RAT_FUNC "%10.5" "degC" COEFFS 0 1 0 0 0 1 /end COMPU_METHOD
/begin COMPU_METHOD FCY_FNEOTCNTLMH "FNEOTCNTLMH Y-axis conversion" RAT_FUNC "%10.5" "unitless" COEFFS 0 1 0 0 0 1 /end COMPU_METHOD
/begin CHARACTERISTIC FNEOTC_FRICT_NORM "" CURVE 0x4D79C FD_FLOAT32_IEEE 0 FCY_FNEOTC_FRICT_NORM 0 14 /begin AXIS_DESCR STD_AXIS EOT_C FCX_FNEOTC_FRICT_NORM 14 -800 800 /end AXIS_DESCR /end CHARACTERISTIC
/begin COMPU_METHOD FCX_FNEOTC_FRICT_NORM "FNEOTC_FRICT_NORM X-axis conversion" RAT_FUNC "%10.5" "unitless" COEFFS 0 1 0 0 0 1 /end COMPU_METHOD
/begin COMPU_METHOD FCY_FNEOTC_FRICT_NORM "FNEOTC_FRICT_NORM Y-axis conversion" RAT_FUNC "%10.5" "unitless" COEFFS 0 1 0 0 0 1 /end COMPU_METHOD
/begin CHARACTERISTIC FNEOTEBPCORR "X Norm=FNEOTNORM, Y Norm=FNEBPNORM, EBP correction multiplier" MAP 0x4417C TD_FLOAT32_IEEE 0 TCZ_FNEOTEBPCORR 0 400
 /begin AXIS_DESCR FIX_AXIS NO_INPUT_QUANTITY TCX_FNEOTEBPCORR 8 0 7 FIX_AXIS_PAR 0 0 8 /end AXIS_DESCR
 /begin AXIS_DESCR FIX_AXIS NO_INPUT_QUANTITY TCY_FNEOTEBPCORR 12 0 11 FIX_AXIS_PAR 0 0 12 /end AXIS_DESCR
/end CHARACTERISTIC
/begin COMPU_METHOD TCZ_FNEOTEBPCORR "FNEOTEBPCORR Z-axis conversion" RAT_FUNC "%10.5" "kPa" COEFFS 0 1 0 0 0 1 /end COMPU_METHOD
/begin COMPU_METHOD TCX_FNEOTEBPCORR "FNEOTEBPCORR X-axis conversion" RAT_FUNC "%10.5" "degC" COEFFS 0 1 0 0 0 1 /end COMPU_METHOD
/begin COMPU_METHOD TCY_FNEOTEBPCORR "FNEOTEBPCORR Y-axis conversion" RAT_FUNC "%10.5" "kPa" COEFFS 0 1 0 0 0 1 /end COMPU_METHOD
/begin CHARACTERISTIC FNEOTICPCORR_A "X Norm=FNEOT_ICPNORM_A, Y Norm=FNICPNORM_A" MAP 0x4131C TD_FLOAT32_IEEE 0 TCZ_FNEOTICPCORR_A -10 10
 /begin AXIS_DESCR FIX_AXIS NO_INPUT_QUANTITY TCX_FNEOTICPCORR_A 4 0 3 FIX_AXIS_PAR 0 0 4 /end AXIS_DESCR
 /begin AXIS_DESCR FIX_AXIS NO_INPUT_QUANTITY TCY_FNEOTICPCORR_A 4 0 3 FIX_AXIS_PAR 0 0 4 /end AXIS_DESCR
/end CHARACTERISTIC
/begin COMPU_METHOD TCZ_FNEOTICPCORR_A "FNEOTICPCORR_A Z-axis conversion" RAT_FUNC "%10.5" "unitless" COEFFS 0 1 0 0 0 1 /end COMPU_METHOD
/begin COMPU_METHOD TCX_FNEOTICPCORR_A "FNEOTICPCORR_A X-axis conversion" RAT_FUNC "%10.5" "degC" COEFFS 0 1 0 0 0 1 /end COMPU_METHOD
/begin COMPU_METHOD TCY_FNEOTICPCORR_A "FNEOTICPCORR_A Y-axis conversion" RAT_FUNC "%10.5" "MPa" COEFFS 0 1 0 0 0 1 /end COMPU_METHOD
/begin CHARACTERISTIC FNEOTMAPCORR "X Norm=FNEOTNORM, Y Norm=FNMAPNORM, MAP Correction multiplier based on MAP raw value and EOT_C" MAP 0x4365C TD_FLOAT32_IEEE 0 TCZ_FNEOTMAPCORR -10 10
 /begin AXIS_DESCR FIX_AXIS NO_INPUT_QUANTITY TCX_FNEOTMAPCORR 8 0 7 FIX_AXIS_PAR 0 0 8 /end AXIS_DESCR
 /begin AXIS_DESCR FIX_AXIS NO_INPUT_QUANTITY TCY_FNEOTMAPCORR 12 0 11 FIX_AXIS_PAR 0 0 12 /end AXIS_DESCR
/end CHARACTERISTIC
/begin COMPU_METHOD TCZ_FNEOTMAPCORR "FNEOTMAPCORR Z-axis conversion" RAT_FUNC "%10.5" "unitless" COEFFS 0 1 0 0 0 1 /end COMPU_METHOD
/begin COMPU_METHOD TCX_FNEOTMAPCORR "FNEOTMAPCORR X-axis conversion" RAT_FUNC "%10.5" "degC" COEFFS 0 1 0 0 0 1 /end COMPU_METHOD
/begin COMPU_METHOD TCY_FNEOTMAPCORR "FNEOTMAPCORR Y-axis conversion" RAT_FUNC "%10.5" "kPa" COEFFS 0 1 0 0 0 1 /end COMPU_METHOD
/begin CHARACTERISTIC FNEOTNORM "EOT_C normalising function for fneotmapcorr" CURVE 0x435BC FD_FLOAT32_IEEE 0 FCY_FNEOTNORM 0 8 /begin AXIS_DESCR STD_AXIS EOT_C FCX_FNEOTNORM 8 -8192 8191 /end AXIS_DESCR /end CHARACTERISTIC
/begin COMPU_METHOD FCX_FNEOTNORM "FNEOTNORM X-axis conversion" RAT_FUNC "%10.5" "degC" COEFFS 0 1 0 0 0 1 /end COMPU_METHOD
/begin COMPU_METHOD FCY_FNEOTNORM "FNEOTNORM Y-axis conversion" RAT_FUNC "%10.5" "unitless" COEFFS 0 1 0 0 0 1 /end COMPU_METHOD
/begin CHARACTERISTIC FNEOTTC_REC "Time constant table for EOT filter based on Engine speed." CURVE 0x429BC FD_FLOAT32_IEEE 0 FCY_FNEOTTC_REC 0 64 /begin AXIS_DESCR STD_AXIS N FCX_FNEOTTC_REC 14 0 8000 /end AXIS_DESCR /end CHARACTERISTIC
/begin COMPU_METHOD FCX_FNEOTTC_REC "FNEOTTC_REC X-axis conversion" RAT_FUNC "%10.5" "RPM" COEFFS 0 1 0 0 0 1 /end COMPU_METHOD
/begin COMPU_METHOD FCY_FNEOTTC_REC "FNEOTTC_REC Y-axis conversion" RAT_FUNC "%10.5" "s" COEFFS 0 1 0 0 0 1 /end COMPU_METHOD
/begin CHARACTERISTIC FNEOT_ICPNORM_A "" CURVE 0x412FC FD_FLOAT32_IEEE 0 FCY_FNEOT_ICPNORM_A 0 9 /begin AXIS_DESCR STD_AXIS EOT_C FCX_FNEOT_ICPNORM_A 4 -40 150 /end AXIS_DESCR /end CHARACTERISTIC
/begin COMPU_METHOD FCX_FNEOT_ICPNORM_A "FNEOT_ICPNORM_A X-axis conversion" RAT_FUNC "%10.5" "degC" COEFFS 0 1 0 0 0 1 /end COMPU_METHOD
/begin COMPU_METHOD FCY_FNEOT_ICPNORM_A "FNEOT_ICPNORM_A Y-axis conversion" RAT_FUNC "%10.5" "unitless" COEFFS 0 1 0 0 0 1 /end COMPU_METHOD
/begin CHARACTERISTIC FNGOVFLRSEED "Flair 'SEED' function, Automatic in Drive Only" CURVE 0x451AC FD_FLOAT32_IEEE 0 FCY_FNGOVFLRSEED 0 160 /begin AXIS_DESCR STD_AXIS EOT_C FCX_FNGOVFLRSEED 8 -40 150 /end AXIS_DESCR /end CHARACTERISTIC
/begin COMPU_METHOD FCX_FNGOVFLRSEED "FNGOVFLRSEED X-axis conversion" RAT_FUNC "%10.5" "degC" COEFFS 0 1 0 0 0 1 /end COMPU_METHOD
/begin COMPU_METHOD FCY_FNGOVFLRSEED "FNGOVFLRSEED Y-axis conversion" RAT_FUNC "%10.5" "unitless" COEFFS 0 1 0 0 0 1 /end COMPU_METHOD
/begin CHARACTERISTIC FNHICAM "Idle speed setpoint adder for 'HICAM' feature" CURVE 0x4497C FD_FLOAT32_IEEE 0 FCY_FNHICAM 0 500 /begin AXIS_DESCR STD_AXIS EOT_C FCX_FNHICAM 6 -40 150 /end AXIS_DESCR /end CHARACTERISTIC
/begin COMPU_METHOD FCX_FNHICAM "FNHICAM X-axis conversion" RAT_FUNC "%10.5" "degC" COEFFS 0 1 0 0 0 1 /end COMPU_METHOD
/begin COMPU_METHOD FCY_FNHICAM "FNHICAM Y-axis conversion" RAT_FUNC "%10.5" "RPM" COEFFS 0 1 0 0 0 1 /end COMPU_METHOD
/begin CHARACTERISTIC FNIATMAFCORR "X Norm=FNMAFNORM, Y Norm=FNIATNORM, MAF temperature compensation multiplier table" MAP 0x4342C TD_FLOAT32_IEEE 0 TCZ_FNIATMAFCORR -10 10
 /begin AXIS_DESCR FIX_AXIS NO_INPUT_QUANTITY TCX_FNIATMAFCORR 12 0 11 FIX_AXIS_PAR 0 0 12 /end AXIS_DESCR
 /begin AXIS_DESCR FIX_AXIS NO_INPUT_QUANTITY TCY_FNIATMAFCORR 8 0 7 FIX_AXIS_PAR 0 0 8 /end AXIS_DESCR
/end CHARACTERISTIC
/begin COMPU_METHOD TCZ_FNIATMAFCORR "FNIATMAFCORR Z-axis conversion" RAT_FUNC "%10.5" "unitless" COEFFS 0 1 0 0 0 1 /end COMPU_METHOD
/begin COMPU_METHOD TCX_FNIATMAFCORR "FNIATMAFCORR X-axis conversion" RAT_FUNC "%10.5" "g/s" COEFFS 0 1 0 0 0 1 /end COMPU_METHOD
/begin COMPU_METHOD TCY_FNIATMAFCORR "FNIATMAFCORR Y-axis conversion" RAT_FUNC "%10.5" "degC" COEFFS 0 1 0 0 0 1 /end COMPU_METHOD
/begin CHARACTERISTIC FNIATNORM "Ambient Air Temp normalization function" CURVE 0x432AC FD_FLOAT32_IEEE 0 FCY_FNIATNORM 0 7 /begin AXIS_DESCR STD_AXIS AAT FCX_FNIATNORM 8 -40 150 /end AXIS_DESCR /end CHARACTERISTIC
/begin COMPU_METHOD FCX_FNIATNORM "FNIATNORM X-axis conversion" RAT_FUNC "%10.5" "degC" COEFFS 0 1 0 0 0 1 /end COMPU_METHOD
/begin COMPU_METHOD FCY_FNIATNORM "FNIATNORM Y-axis conversion" RAT_FUNC "%10.5" "unitless" COEFFS 0 1 0 0 0 1 /end COMPU_METHOD
/begin CHARACTERISTIC FNIATTC_REC "IAT filter constant selection based on RPM." CURVE 0x440AC FD_FLOAT32_IEEE 0 FCY_FNIATTC_REC 0 64 /begin AXIS_DESCR STD_AXIS N FCX_FNIATTC_REC 14 0 8000 /end AXIS_DESCR /end CHARACTERISTIC
/begin COMPU_METHOD FCX_FNIATTC_REC "FNIATTC_REC X-axis conversion" RAT_FUNC "%10.5" "RPM" COEFFS 0 1 0 0 0 1 /end COMPU_METHOD
/begin COMPU_METHOD FCY_FNIATTC_REC "FNIATTC_REC Y-axis conversion" RAT_FUNC "%10.5" "s" COEFFS 0 1 0 0 0 1 /end COMPU_METHOD
/begin CHARACTERISTIC FNICPBLEED_TM "" CURVE 0x413CC FD_FLOAT32_IEEE 0 FCY_FNICPBLEED_TM 0 65535 /begin AXIS_DESCR STD_AXIS EOT_C FCX_FNICPBLEED_TM 8 -8200 8200 /end AXIS_DESCR /end CHARACTERISTIC
/begin COMPU_METHOD FCX_FNICPBLEED_TM "FNICPBLEED_TM X-axis conversion" RAT_FUNC "%10.5" "degC" COEFFS 0 1 0 0 0 1 /end COMPU_METHOD
/begin COMPU_METHOD FCY_FNICPBLEED_TM "FNICPBLEED_TM Y-axis conversion" RAT_FUNC "%10.5" "ms" COEFFS 0 1 0 0 0 1 /end COMPU_METHOD
/begin CHARACTERISTIC FNICPDESCRK_A "X Norm=FN056DS_A, Y Norm=FN055DS_A" MAP 0x4D29C TD_FLOAT32_IEEE 0 TCZ_FNICPDESCRK_A 0 30
 /begin AXIS_DESCR FIX_AXIS NO_INPUT_QUANTITY TCX_FNICPDESCRK_A 9 0 8 FIX_AXIS_PAR 0 0 9 /end AXIS_DESCR
 /begin AXIS_DESCR FIX_AXIS NO_INPUT_QUANTITY TCY_FNICPDESCRK_A 9 0 8 FIX_AXIS_PAR 0 0 9 /end AXIS_DESCR
/end CHARACTERISTIC
/begin COMPU_METHOD TCZ_FNICPDESCRK_A "FNICPDESCRK_A Z-axis conversion" RAT_FUNC "%10.5" "unitless" COEFFS 0 1 0 0 0 1 /end COMPU_METHOD
/begin COMPU_METHOD TCX_FNICPDESCRK_A "FNICPDESCRK_A X-axis conversion" RAT_FUNC "%10.5" "unitless" COEFFS 0 1 0 0 0 1 /end COMPU_METHOD
/begin COMPU_METHOD TCY_FNICPDESCRK_A "FNICPDESCRK_A Y-axis conversion" RAT_FUNC "%10.5" "unitless" COEFFS 0 1 0 0 0 1 /end COMPU_METHOD
/begin CHARACTERISTIC FNICPEOTLMX "Limit maximum ICP desired as function of EOT" CURVE 0x4B7F4 FD_FLOAT32_IEEE 0 FCY_FNICPEOTLMX 0 30 /begin AXIS_DESCR STD_AXIS EOT_C FCX_FNICPEOTLMX 13 -300 300 /end AXIS_DESCR /end CHARACTERISTIC
/begin COMPU_METHOD FCX_FNICPEOTLMX "FNICPEOTLMX X-axis conversion" RAT_FUNC "%10.5" "degC" COEFFS 0 1 0 0 0 1 /end COMPU_METHOD
/begin COMPU_METHOD FCY_FNICPEOTLMX "FNICPEOTLMX Y-axis conversion" RAT_FUNC "%10.5" "MPa" COEFFS 0 1 0 0 0 1 /end COMPU_METHOD
/begin CHARACTERISTIC FNICPNORM_A "" CURVE 0x412DC FD_FLOAT32_IEEE 0 FCY_FNICPNORM_A 0 11 /begin AXIS_DESCR STD_AXIS ICP_ENG FCX_FNICPNORM_A 4 0 40 /end AXIS_DESCR /end CHARACTERISTIC
/begin COMPU_METHOD FCX_FNICPNORM_A "FNICPNORM_A X-axis conversion" RAT_FUNC "%10.5" "MPa" COEFFS 0 1 0 0 0 1 /end COMPU_METHOD
/begin COMPU_METHOD FCY_FNICPNORM_A "FNICPNORM_A Y-axis conversion" RAT_FUNC "%10.5" "unitless" COEFFS 0 1 0 0 0 1 /end COMPU_METHOD
/begin CHARACTERISTIC FNICPTC_REC "Time constant value for ICP_Mpa output filter based on Engine speed" CURVE 0x4315C FD_FLOAT32_IEEE 0 FCY_FNICPTC_REC 0 64 /begin AXIS_DESCR STD_AXIS N FCX_FNICPTC_REC 14 0 16383.8 /end AXIS_DESCR /end CHARACTERISTIC
/begin COMPU_METHOD FCX_FNICPTC_REC "FNICPTC_REC X-axis conversion" RAT_FUNC "%10.5" "RPM" COEFFS 0 1 0 0 0 1 /end COMPU_METHOD
/begin COMPU_METHOD FCY_FNICPTC_REC "FNICPTC_REC Y-axis conversion" RAT_FUNC "%10.5" "s" COEFFS 0 1 0 0 0 1 /end COMPU_METHOD
/begin CHARACTERISTIC FNICP_DES_LMT_LO "" CURVE 0x4B624 FD_FLOAT32_IEEE 0 FCY_FNICP_DES_LMT_LO -100000 100000 /begin AXIS_DESCR STD_AXIS N FCX_FNICP_DES_LMT_LO 14 0 6000 /end AXIS_DESCR /end CHARACTERISTIC
/begin COMPU_METHOD FCX_FNICP_DES_LMT_LO "FNICP_DES_LMT_LO X-axis conversion" RAT_FUNC "%10.5" "unitless" COEFFS 0 1 0 0 0 1 /end COMPU_METHOD
/begin COMPU_METHOD FCY_FNICP_DES_LMT_LO "FNICP_DES_LMT_LO Y-axis conversion" RAT_FUNC "%10.5" "unitless" COEFFS 0 1 0 0 0 1 /end COMPU_METHOD
/begin CHARACTERISTIC FNICP_DRV_ADD "Engine Oil Temp based ICP adder - Drive gear" CURVE 0x4B694 FD_FLOAT32_IEEE 0 FCY_FNICP_DRV_ADD 0 5 /begin AXIS_DESCR STD_AXIS EOT_C FCX_FNICP_DRV_ADD 8 -40 150 /end AXIS_DESCR /end CHARACTERISTIC
/begin COMPU_METHOD FCX_FNICP_DRV_ADD "FNICP_DRV_ADD X-axis conversion" RAT_FUNC "%10.5" "degC" COEFFS 0 1 0 0 0 1 /end COMPU_METHOD
/begin COMPU_METHOD FCY_FNICP_DRV_ADD "FNICP_DRV_ADD Y-axis conversion" RAT_FUNC "%10.5" "MPa" COEFFS 0 1 0 0 0 1 /end COMPU_METHOD
/begin CHARACTERISTIC FNICP_DRV_ADD_P "Engine Oil Temp based ICP adder - Drive gear" CURVE 0x4B6D4 FD_FLOAT32_IEEE 0 FCY_FNICP_DRV_ADD_P 0 5 /begin AXIS_DESCR STD_AXIS EOT_C FCX_FNICP_DRV_ADD_P 8 -40 150 /end AXIS_DESCR /end CHARACTERISTIC
/begin COMPU_METHOD FCX_FNICP_DRV_ADD_P "FNICP_DRV_ADD_P X-axis conversion" RAT_FUNC "%10.5" "degC" COEFFS 0 1 0 0 0 1 /end COMPU_METHOD
/begin COMPU_METHOD FCY_FNICP_DRV_ADD_P "FNICP_DRV_ADD_P Y-axis conversion" RAT_FUNC "%10.5" "MPa" COEFFS 0 1 0 0 0 1 /end COMPU_METHOD
/begin CHARACTERISTIC FNICP_KI_EOT "EOT-based ICP Integral term" CURVE 0x4B714 FD_FLOAT32_IEEE 0 FCY_FNICP_KI_EOT 0 1 /begin AXIS_DESCR STD_AXIS EOT_C FCX_FNICP_KI_EOT 14 -40 150 /end AXIS_DESCR /end CHARACTERISTIC
/begin COMPU_METHOD FCX_FNICP_KI_EOT "FNICP_KI_EOT X-axis conversion" RAT_FUNC "%10.5" "degC" COEFFS 0 1 0 0 0 1 /end COMPU_METHOD
/begin COMPU_METHOD FCY_FNICP_KI_EOT "FNICP_KI_EOT Y-axis conversion" RAT_FUNC "%10.5" "unitless" COEFFS 0 1 0 0 0 1 /end COMPU_METHOD
/begin CHARACTERISTIC FNICP_KP_EOT "EOT-based ICP Proportional term" CURVE 0x4B784 FD_FLOAT32_IEEE 0 FCY_FNICP_KP_EOT 0 1 /begin AXIS_DESCR STD_AXIS EOT_C FCX_FNICP_KP_EOT 14 -40 150 /end AXIS_DESCR /end CHARACTERISTIC
/begin COMPU_METHOD FCX_FNICP_KP_EOT "FNICP_KP_EOT X-axis conversion" RAT_FUNC "%10.5" "degC" COEFFS 0 1 0 0 0 1 /end COMPU_METHOD
/begin COMPU_METHOD FCY_FNICP_KP_EOT "FNICP_KP_EOT Y-axis conversion" RAT_FUNC "%10.5" "unitless" COEFFS 0 1 0 0 0 1 /end COMPU_METHOD
/begin CHARACTERISTIC FNICP_MF_KDSH "X Norm=FN040DS_KDSH, Y Norm=FN041DS_KDSH" MAP 0x4CF8C TD_FLOAT32_IEEE 0 TCZ_FNICP_MF_KDSH 0 30
 /begin AXIS_DESCR FIX_AXIS NO_INPUT_QUANTITY TCX_FNICP_MF_KDSH 14 0 13 FIX_AXIS_PAR 0 0 14 /end AXIS_DESCR
 /begin AXIS_DESCR FIX_AXIS NO_INPUT_QUANTITY TCY_FNICP_MF_KDSH 14 0 13 FIX_AXIS_PAR 0 0 14 /end AXIS_DESCR
/end CHARACTERISTIC
/begin COMPU_METHOD TCZ_FNICP_MF_KDSH "FNICP_MF_KDSH Z-axis conversion" RAT_FUNC "%10.5" "unitless" COEFFS 0 1 0 0 0 1 /end COMPU_METHOD
/begin COMPU_METHOD TCX_FNICP_MF_KDSH "FNICP_MF_KDSH X-axis conversion" RAT_FUNC "%10.5" "unitless" COEFFS 0 1 0 0 0 1 /end COMPU_METHOD
/begin COMPU_METHOD TCY_FNICP_MF_KDSH "FNICP_MF_KDSH Y-axis conversion" RAT_FUNC "%10.5" "unitless" COEFFS 0 1 0 0 0 1 /end COMPU_METHOD
/begin CHARACTERISTIC FNICP_MPA2V "" CURVE 0x41394 FD_FLOAT32_IEEE 0 FCY_FNICP_MPA2V -15 15 /begin AXIS_DESCR STD_AXIS BP_MPA FCX_FNICP_MPA2V 7 0 50 /end AXIS_DESCR /end CHARACTERISTIC
/begin COMPU_METHOD FCX_FNICP_MPA2V "FNICP_MPA2V X-axis conversion" RAT_FUNC "%10.5" "MPa" COEFFS 0 1 0 0 0 1 /end COMPU_METHOD
/begin COMPU_METHOD FCY_FNICP_MPA2V "FNICP_MPA2V Y-axis conversion" RAT_FUNC "%10.5" "V" COEFFS 0 1 0 0 0 1 /end COMPU_METHOD
/begin CHARACTERISTIC FNICP_V2MPA "Transfer function for injector  control pressure transducer from volts to MPA" CURVE 0x4135C FD_FLOAT32_IEEE 0 FCY_FNICP_V2MPA 0 50 /begin AXIS_DESCR STD_AXIS NO_INPUT_QUANTITY FCX_FNICP_V2MPA 7 0 5 /end AXIS_DESCR /end CHARACTERISTIC
/begin COMPU_METHOD FCX_FNICP_V2MPA "FNICP_V2MPA X-axis conversion" RAT_FUNC "%10.5" "V" COEFFS 0 1 0 0 0 1 /end COMPU_METHOD
/begin COMPU_METHOD FCY_FNICP_V2MPA "FNICP_V2MPA Y-axis conversion" RAT_FUNC "%10.5" "MPa" COEFFS 0 1 0 0 0 1 /end COMPU_METHOD
/begin CHARACTERISTIC FNIDLCOT "A/C clutch delay time after start." CURVE 0x423EC FD_FLOAT32_IEEE 0 FCY_FNIDLCOT 0 62 /begin AXIS_DESCR STD_AXIS N FCX_FNIDLCOT 6 0 16383.8 /end AXIS_DESCR /end CHARACTERISTIC
/begin COMPU_METHOD FCX_FNIDLCOT "FNIDLCOT X-axis conversion" RAT_FUNC "%10.5" "RPM" COEFFS 0 1 0 0 0 1 /end COMPU_METHOD
/begin COMPU_METHOD FCY_FNIDLCOT "FNIDLCOT Y-axis conversion" RAT_FUNC "%10.5" "s" COEFFS 0 1 0 0 0 1 /end COMPU_METHOD
/begin CHARACTERISTIC FNIDLCOT2 "A/C clutch delay time when cycling." CURVE 0x4241C FD_FLOAT32_IEEE 0 FCY_FNIDLCOT2 0 62 /begin AXIS_DESCR STD_AXIS N FCX_FNIDLCOT2 6 0 16383.8 /end AXIS_DESCR /end CHARACTERISTIC
/begin COMPU_METHOD FCX_FNIDLCOT2 "FNIDLCOT2 X-axis conversion" RAT_FUNC "%10.5" "RPM" COEFFS 0 1 0 0 0 1 /end COMPU_METHOD
/begin COMPU_METHOD FCY_FNIDLCOT2 "FNIDLCOT2 Y-axis conversion" RAT_FUNC "%10.5" "s" COEFFS 0 1 0 0 0 1 /end COMPU_METHOD
/begin CHARACTERISTIC FNITHPTC_REC "ITHP filter constant selection based on RPM." CURVE 0x4437C FD_FLOAT32_IEEE 0 FCY_FNITHPTC_REC 0 64 /begin AXIS_DESCR STD_AXIS N FCX_FNITHPTC_REC 14 0 8000 /end AXIS_DESCR /end CHARACTERISTIC
/begin COMPU_METHOD FCX_FNITHPTC_REC "FNITHPTC_REC X-axis conversion" RAT_FUNC "%10.5" "RPM" COEFFS 0 1 0 0 0 1 /end COMPU_METHOD
/begin COMPU_METHOD FCY_FNITHPTC_REC "FNITHPTC_REC Y-axis conversion" RAT_FUNC "%10.5" "s" COEFFS 0 1 0 0 0 1 /end COMPU_METHOD
/begin CHARACTERISTIC FNITH_DTY_MAG "" CURVE 0x5646C FD_FLOAT32_IEEE 0 FCY_FNITH_DTY_MAG 0 100 /begin AXIS_DESCR STD_AXIS ITH_DTY FCX_FNITH_DTY_MAG 14 -100 100 /end AXIS_DESCR /end CHARACTERISTIC
/begin COMPU_METHOD FCX_FNITH_DTY_MAG "FNITH_DTY_MAG X-axis conversion" RAT_FUNC "%10.5" "unitless" COEFFS 0 1 0 0 0 1 /end COMPU_METHOD
/begin COMPU_METHOD FCY_FNITH_DTY_MAG "FNITH_DTY_MAG Y-axis conversion" RAT_FUNC "%10.5" "unitless" COEFFS 0 1 0 0 0 1 /end COMPU_METHOD
/begin CHARACTERISTIC FNITH_FF "" CURVE 0x564DC FD_FLOAT32_IEEE 0 FCY_FNITH_FF 0 100 /begin AXIS_DESCR STD_AXIS ITH_DES FCX_FNITH_FF 14 0 100 /end AXIS_DESCR /end CHARACTERISTIC
/begin COMPU_METHOD FCX_FNITH_FF "FNITH_FF X-axis conversion" RAT_FUNC "%10.5" "unitless" COEFFS 0 1 0 0 0 1 /end COMPU_METHOD
/begin COMPU_METHOD FCY_FNITH_FF "FNITH_FF Y-axis conversion" RAT_FUNC "%10.5" "unitless" COEFFS 0 1 0 0 0 1 /end COMPU_METHOD
/begin CHARACTERISTIC FNITH_HIALT "X Norm=FN090DS_ITH, Y Norm=FN091DS_ITH" MAP 0x5654C TD_FLOAT32_IEEE 0 TCZ_FNITH_HIALT 0 5000
 /begin AXIS_DESCR FIX_AXIS NO_INPUT_QUANTITY TCX_FNITH_HIALT 14 0 13 FIX_AXIS_PAR 0 0 14 /end AXIS_DESCR
 /begin AXIS_DESCR FIX_AXIS NO_INPUT_QUANTITY TCY_FNITH_HIALT 14 0 13 FIX_AXIS_PAR 0 0 14 /end AXIS_DESCR
/end CHARACTERISTIC
/begin COMPU_METHOD TCZ_FNITH_HIALT "FNITH_HIALT Z-axis conversion" RAT_FUNC "%10.5" "unitless" COEFFS 0 1 0 0 0 1 /end COMPU_METHOD
/begin COMPU_METHOD TCX_FNITH_HIALT "FNITH_HIALT X-axis conversion" RAT_FUNC "%10.5" "unitless" COEFFS 0 1 0 0 0 1 /end COMPU_METHOD
/begin COMPU_METHOD TCY_FNITH_HIALT "FNITH_HIALT Y-axis conversion" RAT_FUNC "%10.5" "unitless" COEFFS 0 1 0 0 0 1 /end COMPU_METHOD
/begin CHARACTERISTIC FNITH_IVP_MLT "" CURVE 0x563FC FD_FLOAT32_IEEE 0 FCY_FNITH_IVP_MLT 0 100 /begin AXIS_DESCR STD_AXIS IVPWR FCX_FNITH_IVP_MLT 14 0 100 /end AXIS_DESCR /end CHARACTERISTIC
/begin COMPU_METHOD FCX_FNITH_IVP_MLT "FNITH_IVP_MLT X-axis conversion" RAT_FUNC "%10.5" "unitless" COEFFS 0 1 0 0 0 1 /end COMPU_METHOD
/begin COMPU_METHOD FCY_FNITH_IVP_MLT "FNITH_IVP_MLT Y-axis conversion" RAT_FUNC "%10.5" "unitless" COEFFS 0 1 0 0 0 1 /end COMPU_METHOD
/begin CHARACTERISTIC FNITH_LOALT "X Norm=FN090DS_ITH, Y Norm=FN091DS_ITH" MAP 0x5685C TD_FLOAT32_IEEE 0 TCZ_FNITH_LOALT 0 5000
 /begin AXIS_DESCR FIX_AXIS NO_INPUT_QUANTITY TCX_FNITH_LOALT 14 0 13 FIX_AXIS_PAR 0 0 14 /end AXIS_DESCR
 /begin AXIS_DESCR FIX_AXIS NO_INPUT_QUANTITY TCY_FNITH_LOALT 14 0 13 FIX_AXIS_PAR 0 0 14 /end AXIS_DESCR
/end CHARACTERISTIC
/begin COMPU_METHOD TCZ_FNITH_LOALT "FNITH_LOALT Z-axis conversion" RAT_FUNC "%10.5" "unitless" COEFFS 0 1 0 0 0 1 /end COMPU_METHOD
/begin COMPU_METHOD TCX_FNITH_LOALT "FNITH_LOALT X-axis conversion" RAT_FUNC "%10.5" "unitless" COEFFS 0 1 0 0 0 1 /end COMPU_METHOD
/begin COMPU_METHOD TCY_FNITH_LOALT "FNITH_LOALT Y-axis conversion" RAT_FUNC "%10.5" "unitless" COEFFS 0 1 0 0 0 1 /end COMPU_METHOD
/begin CHARACTERISTIC FNIVPWRTC_REC "IVPWR filter constant selection based on RPM." CURVE 0x443EC FD_FLOAT32_IEEE 0 FCY_FNIVPWRTC_REC 0 64 /begin AXIS_DESCR STD_AXIS N FCX_FNIVPWRTC_REC 14 0 8000 /end AXIS_DESCR /end CHARACTERISTIC
/begin COMPU_METHOD FCX_FNIVPWRTC_REC "FNIVPWRTC_REC X-axis conversion" RAT_FUNC "%10.5" "RPM" COEFFS 0 1 0 0 0 1 /end COMPU_METHOD
/begin COMPU_METHOD FCY_FNIVPWRTC_REC "FNIVPWRTC_REC Y-axis conversion" RAT_FUNC "%10.5" "s" COEFFS 0 1 0 0 0 1 /end COMPU_METHOD
/begin CHARACTERISTIC FNMAFNORM "Mass Air Flow normalization function" CURVE 0x432EC FD_FLOAT32_IEEE 0 FCY_FNMAFNORM 0 11 /begin AXIS_DESCR STD_AXIS MAF_ENG_UNITS FCX_FNMAFNORM 12 0 750 /end AXIS_DESCR /end CHARACTERISTIC
/begin COMPU_METHOD FCX_FNMAFNORM "FNMAFNORM X-axis conversion" RAT_FUNC "%10.5" "g/s" COEFFS 0 1 0 0 0 1 /end COMPU_METHOD
/begin COMPU_METHOD FCY_FNMAFNORM "FNMAFNORM Y-axis conversion" RAT_FUNC "%10.5" "unitless" COEFFS 0 1 0 0 0 1 /end COMPU_METHOD
/begin CHARACTERISTIC FNMAFORLLMN "MAF based on the engine rpm table used to determine maf_status" CURVE 0x4157C FD_FLOAT32_IEEE 0 FCY_FNMAFORLLMN 0 343.316 /begin AXIS_DESCR STD_AXIS N FCX_FNMAFORLLMN 14 0 16383.8 /end AXIS_DESCR /end CHARACTERISTIC
/begin COMPU_METHOD FCX_FNMAFORLLMN "FNMAFORLLMN X-axis conversion" RAT_FUNC "%10.5" "RPM" COEFFS 0 1 0 0 0 1 /end COMPU_METHOD
/begin COMPU_METHOD FCY_FNMAFORLLMN "FNMAFORLLMN Y-axis conversion" RAT_FUNC "%10.5" "lbm/min" COEFFS 0 1 0 0 0 1 /end COMPU_METHOD
/begin CHARACTERISTIC FNMAFORMAX "MAF selected based on rpm during out of range diagnostic" CURVE 0x433BC FD_FLOAT32_IEEE 0 FCY_FNMAFORMAX 0 343.316 /begin AXIS_DESCR STD_AXIS N FCX_FNMAFORMAX 14 0 16383.8 /end AXIS_DESCR /end CHARACTERISTIC
/begin COMPU_METHOD FCX_FNMAFORMAX "FNMAFORMAX X-axis conversion" RAT_FUNC "%10.5" "RPM" COEFFS 0 1 0 0 0 1 /end COMPU_METHOD
/begin COMPU_METHOD FCY_FNMAFORMAX "FNMAFORMAX Y-axis conversion" RAT_FUNC "%10.5" "lbm/min" COEFFS 0 1 0 0 0 1 /end COMPU_METHOD
/begin CHARACTERISTIC FNMAFTC_REC "MAF filter constant selection based on RPM." CURVE 0x4334C FD_FLOAT32_IEEE 0 FCY_FNMAFTC_REC 0 64 /begin AXIS_DESCR STD_AXIS N FCX_FNMAFTC_REC 14 0 8000 /end AXIS_DESCR /end CHARACTERISTIC
/begin COMPU_METHOD FCX_FNMAFTC_REC "FNMAFTC_REC X-axis conversion" RAT_FUNC "%10.5" "RPM" COEFFS 0 1 0 0 0 1 /end COMPU_METHOD
/begin COMPU_METHOD FCY_FNMAFTC_REC "FNMAFTC_REC Y-axis conversion" RAT_FUNC "%10.5" "s" COEFFS 0 1 0 0 0 1 /end COMPU_METHOD
/begin CHARACTERISTIC FNMAPNORM "MAP raw value normalising  function for fneotmapcorr" CURVE 0x435FC FD_FLOAT32_IEEE 0 FCY_FNMAPNORM 0 11 /begin AXIS_DESCR STD_AXIS MAP_RAW_KPA FCX_FNMAPNORM 12 0 277 /end AXIS_DESCR /end CHARACTERISTIC
/begin COMPU_METHOD FCX_FNMAPNORM "FNMAPNORM X-axis conversion" RAT_FUNC "%10.5" "kPa" COEFFS 0 1 0 0 0 1 /end COMPU_METHOD
/begin COMPU_METHOD FCY_FNMAPNORM "FNMAPNORM Y-axis conversion" RAT_FUNC "%10.5" "unitless" COEFFS 0 1 0 0 0 1 /end COMPU_METHOD
/begin CHARACTERISTIC FNMAPTC_REC "MAP filter constant selection based on RPM." CURVE 0x439FC FD_FLOAT32_IEEE 0 FCY_FNMAPTC_REC 0 64 /begin AXIS_DESCR STD_AXIS N FCX_FNMAPTC_REC 14 0 8000 /end AXIS_DESCR /end CHARACTERISTIC
/begin COMPU_METHOD FCX_FNMAPTC_REC "FNMAPTC_REC X-axis conversion" RAT_FUNC "%10.5" "RPM" COEFFS 0 1 0 0 0 1 /end COMPU_METHOD
/begin COMPU_METHOD FCY_FNMAPTC_REC "FNMAPTC_REC Y-axis conversion" RAT_FUNC "%10.5" "s" COEFFS 0 1 0 0 0 1 /end COMPU_METHOD
/begin CHARACTERISTIC FNMAP_V2KPA "Transfer function for map pressure transducer from volts to kpa" CURVE 0x411FC FD_FLOAT32_IEEE 0 FCY_FNMAP_V2KPA 0 300 /begin AXIS_DESCR STD_AXIS NO_INPUT_QUANTITY FCX_FNMAP_V2KPA 10 0 5 /end AXIS_DESCR /end CHARACTERISTIC
/begin COMPU_METHOD FCX_FNMAP_V2KPA "FNMAP_V2KPA X-axis conversion" RAT_FUNC "%10.5" "V" COEFFS 0 1 0 0 0 1 /end COMPU_METHOD
/begin COMPU_METHOD FCY_FNMAP_V2KPA "FNMAP_V2KPA Y-axis conversion" RAT_FUNC "%10.5" "kPa" COEFFS 0 1 0 0 0 1 /end COMPU_METHOD
/begin CHARACTERISTIC FNMATDS "" CURVE 0x48BDC FD_FLOAT32_IEEE 0 FCY_FNMATDS 0 10 /begin AXIS_DESCR STD_AXIS NO_INPUT_QUANTITY FCX_FNMATDS 10 -500 500 /end AXIS_DESCR /end CHARACTERISTIC
/begin COMPU_METHOD FCX_FNMATDS "FNMATDS X-axis conversion" RAT_FUNC "%10.5" "unitless" COEFFS 0 1 0 0 0 1 /end COMPU_METHOD
/begin COMPU_METHOD FCY_FNMATDS "FNMATDS Y-axis conversion" RAT_FUNC "%10.5" "unitless" COEFFS 0 1 0 0 0 1 /end COMPU_METHOD
/begin CHARACTERISTIC FNMATTC_REC "Filter time constant" CURVE 0x43BCC FD_FLOAT32_IEEE 0 FCY_FNMATTC_REC 0 64 /begin AXIS_DESCR STD_AXIS N FCX_FNMATTC_REC 14 0 8000 /end AXIS_DESCR /end CHARACTERISTIC
/begin COMPU_METHOD FCX_FNMATTC_REC "FNMATTC_REC X-axis conversion" RAT_FUNC "%10.5" "RPM" COEFFS 0 1 0 0 0 1 /end COMPU_METHOD
/begin COMPU_METHOD FCY_FNMATTC_REC "FNMATTC_REC Y-axis conversion" RAT_FUNC "%10.5" "s" COEFFS 0 1 0 0 0 1 /end COMPU_METHOD
/begin CHARACTERISTIC FNMFDES_DSH_DIT "Mass fuel desired filter normalization function" CURVE 0x48C2C FD_FLOAT32_IEEE 0 FCY_FNMFDES_DSH_DIT -15 15
 /begin AXIS_DESCR STD_AXIS DIT_MF_DIFF_FILT FCX_FNMFDES_DSH_DIT 9 -2048 2047.94 /end AXIS_DESCR
/end CHARACTERISTIC
/begin COMPU_METHOD FCX_FNMFDES_DSH_DIT "FNMFDES_DSH_DIT X-axis conversion" RAT_FUNC "%10.5" "unitless" COEFFS 0 1 0 0 0 1 /end COMPU_METHOD
/begin COMPU_METHOD FCY_FNMFDES_DSH_DIT "FNMFDES_DSH_DIT Y-axis conversion" RAT_FUNC "%10.5" "unitless" COEFFS 0 1 0 0 0 1 /end COMPU_METHOD
/begin CHARACTERISTIC FNMFDES_DSH_ICP "" CURVE 0x4B85C FD_FLOAT32_IEEE 0 FCY_FNMFDES_DSH_ICP -21 21 /begin AXIS_DESCR STD_AXIS ICP_MF_DIFF_FILT FCX_FNMFDES_DSH_ICP 25 -350 350 /end AXIS_DESCR /end CHARACTERISTIC
/begin COMPU_METHOD FCX_FNMFDES_DSH_ICP "FNMFDES_DSH_ICP X-axis conversion" RAT_FUNC "%10.5" "unitless" COEFFS 0 1 0 0 0 1 /end COMPU_METHOD
/begin COMPU_METHOD FCY_FNMFDES_DSH_ICP "FNMFDES_DSH_ICP Y-axis conversion" RAT_FUNC "%10.5" "unitless" COEFFS 0 1 0 0 0 1 /end COMPU_METHOD
/begin CHARACTERISTIC FNMISACT "Time delay in seconds for Misfire monitoring based on ACT" CURVE 0x59DDC FD_FLOAT32_IEEE 0 FCY_FNMISACT 0 65535 /begin AXIS_DESCR STD_AXIS ACT FCX_FNMISACT 6 -256 254 /end AXIS_DESCR /end CHARACTERISTIC
/begin COMPU_METHOD FCX_FNMISACT "FNMISACT X-axis conversion" RAT_FUNC "%10.5" "DEGREES F" COEFFS 0 1 0 0 0 1 /end COMPU_METHOD
/begin COMPU_METHOD FCY_FNMISACT "FNMISACT Y-axis conversion" RAT_FUNC "%10.5" "s" COEFFS 0 1 0 0 0 1 /end COMPU_METHOD
/begin CHARACTERISTIC FNMISOK_97 "X Norm=FN070MIS, Y Norm=FN034MIS, Disable table for misfire detection, with 10x8 normalized N and Load breakpoints for 97MY." MAP 0x59E0C TD_FLOAT32_IEEE 0 TCZ_FNMISOK_97 0 1.99219
 /begin AXIS_DESCR FIX_AXIS NO_INPUT_QUANTITY TCX_FNMISOK_97 10 0 9 FIX_AXIS_PAR 0 0 10 /end AXIS_DESCR
 /begin AXIS_DESCR FIX_AXIS NO_INPUT_QUANTITY TCY_FNMISOK_97 8 0 7 FIX_AXIS_PAR 0 0 8 /end AXIS_DESCR
/end CHARACTERISTIC
/begin COMPU_METHOD TCZ_FNMISOK_97 "FNMISOK_97 Z-axis conversion" RAT_FUNC "%10.5" "unitless" COEFFS 0 1 0 0 0 1 /end COMPU_METHOD
/begin COMPU_METHOD TCX_FNMISOK_97 "FNMISOK_97 X-axis conversion" RAT_FUNC "%10.5" "RPM" COEFFS 0 1 0 0 0 1 /end COMPU_METHOD
/begin COMPU_METHOD TCY_FNMISOK_97 "FNMISOK_97 Y-axis conversion" RAT_FUNC "%10.5" "%" COEFFS 0 1 0 0 0 1 /end COMPU_METHOD
/begin MEASUREMENT FNMISOK_DATA "current value from FNMISOK table" FLOAT32_IEEE MC_FNMISOK_DATA 0 0 0 0 ECU_ADDRESS 0x3FB374 /end MEASUREMENT
/begin COMPU_METHOD MC_FNMISOK_DATA "FNMISOK_DATA conversion" RAT_FUNC "%10.5" "Unitless" COEFFS 0 1 0 0 0 1 /end COMPU_METHOD
/begin CHARACTERISTIC FNMISPCT_97 "X Norm=FN070MIS, Y Norm=FN034MIS, Maximum allowable misfire rate before malf, supports 10x8 N and Load normalizing functions for 97MY." MAP 0x5A25C TD_FLOAT32_IEEE 0 TCZ_FNMISPCT_97 0 0.996094
 /begin AXIS_DESCR FIX_AXIS NO_INPUT_QUANTITY TCX_FNMISPCT_97 10 0 9 FIX_AXIS_PAR 0 0 10 /end AXIS_DESCR
 /begin AXIS_DESCR FIX_AXIS NO_INPUT_QUANTITY TCY_FNMISPCT_97 8 0 7 FIX_AXIS_PAR 0 0 8 /end AXIS_DESCR
/end CHARACTERISTIC
/begin COMPU_METHOD TCZ_FNMISPCT_97 "FNMISPCT_97 Z-axis conversion" RAT_FUNC "%10.5" "%" COEFFS 0 1 0 0 0 1 /end COMPU_METHOD
/begin COMPU_METHOD TCX_FNMISPCT_97 "FNMISPCT_97 X-axis conversion" RAT_FUNC "%10.5" "RPM" COEFFS 0 1 0 0 0 1 /end COMPU_METHOD
/begin COMPU_METHOD TCY_FNMISPCT_97 "FNMISPCT_97 Y-axis conversion" RAT_FUNC "%10.5" "%" COEFFS 0 1 0 0 0 1 /end COMPU_METHOD
/begin CHARACTERISTIC FNMNT_EGR_KEXH "X Norm=FNMNT_EGR_KEXH_X_NORM, Y Norm=FNMNT_EGR_KEXH_Y_NORM" MAP 0x56EDC TD_FLOAT32_IEEE 0 TCZ_FNMNT_EGR_KEXH 0 10
 /begin AXIS_DESCR FIX_AXIS NO_INPUT_QUANTITY TCX_FNMNT_EGR_KEXH 11 0 10 FIX_AXIS_PAR 0 0 11 /end AXIS_DESCR
 /begin AXIS_DESCR FIX_AXIS NO_INPUT_QUANTITY TCY_FNMNT_EGR_KEXH 11 0 10 FIX_AXIS_PAR 0 0 11 /end AXIS_DESCR
/end CHARACTERISTIC
/begin COMPU_METHOD TCZ_FNMNT_EGR_KEXH "FNMNT_EGR_KEXH Z-axis conversion" RAT_FUNC "%10.5" "unitless" COEFFS 0 1 0 0 0 1 /end COMPU_METHOD
/begin COMPU_METHOD TCX_FNMNT_EGR_KEXH "FNMNT_EGR_KEXH X-axis conversion" RAT_FUNC "%10.5" "unitless" COEFFS 0 1 0 0 0 1 /end COMPU_METHOD
/begin COMPU_METHOD TCY_FNMNT_EGR_KEXH "FNMNT_EGR_KEXH Y-axis conversion" RAT_FUNC "%10.5" "unitless" COEFFS 0 1 0 0 0 1 /end COMPU_METHOD
/begin CHARACTERISTIC FNMNT_EGR_KEXH_X_NORM "" CURVE 0x56CCC FD_FLOAT32_IEEE 0 FCY_FNMNT_EGR_KEXH_X_NORM 0 14 /begin AXIS_DESCR STD_AXIS MNT_ERPM FCX_FNMNT_EGR_KEXH_X_NORM 11 0 5500 /end AXIS_DESCR /end CHARACTERISTIC
/begin COMPU_METHOD FCX_FNMNT_EGR_KEXH_X_NORM "FNMNT_EGR_KEXH_X_NORM X-axis conversion" RAT_FUNC "%10.5" "unitless" COEFFS 0 1 0 0 0 1 /end COMPU_METHOD
/begin COMPU_METHOD FCY_FNMNT_EGR_KEXH_X_NORM "FNMNT_EGR_KEXH_X_NORM Y-axis conversion" RAT_FUNC "%10.5" "unitless" COEFFS 0 1 0 0 0 1 /end COMPU_METHOD
/begin CHARACTERISTIC FNMNT_EGR_KEXH_Y_NORM "" CURVE 0x56D24 FD_FLOAT32_IEEE 0 FCY_FNMNT_EGR_KEXH_Y_NORM 0 14 /begin AXIS_DESCR STD_AXIS MNT_MFDES FCX_FNMNT_EGR_KEXH_Y_NORM 11 0 200 /end AXIS_DESCR /end CHARACTERISTIC
/begin COMPU_METHOD FCX_FNMNT_EGR_KEXH_Y_NORM "FNMNT_EGR_KEXH_Y_NORM X-axis conversion" RAT_FUNC "%10.5" "unitless" COEFFS 0 1 0 0 0 1 /end COMPU_METHOD
/begin COMPU_METHOD FCY_FNMNT_EGR_KEXH_Y_NORM "FNMNT_EGR_KEXH_Y_NORM Y-axis conversion" RAT_FUNC "%10.5" "unitless" COEFFS 0 1 0 0 0 1 /end COMPU_METHOD
/begin CHARACTERISTIC FNMNT_FLOW "" CURVE 0x56C5C FD_FLOAT32_IEEE 0 FCY_FNMNT_FLOW 0 14 /begin AXIS_DESCR STD_AXIS MNT_P_RATIO FCX_FNMNT_FLOW 14 0 10 /end AXIS_DESCR /end CHARACTERISTIC
/begin COMPU_METHOD FCX_FNMNT_FLOW "FNMNT_FLOW X-axis conversion" RAT_FUNC "%10.5" "unitless" COEFFS 0 1 0 0 0 1 /end COMPU_METHOD
/begin COMPU_METHOD FCY_FNMNT_FLOW "FNMNT_FLOW Y-axis conversion" RAT_FUNC "%10.5" "unitless" COEFFS 0 1 0 0 0 1 /end COMPU_METHOD
/begin CHARACTERISTIC FNMNT_VOL_EFF "X Norm=FNMNT_VOL_EFF_X_NORM, Y Norm=FNMNT_VOL_EFF_Y_NORM" MAP 0x570C0 TD_FLOAT32_IEEE 0 TCZ_FNMNT_VOL_EFF 0 10
 /begin AXIS_DESCR FIX_AXIS NO_INPUT_QUANTITY TCX_FNMNT_VOL_EFF 11 0 10 FIX_AXIS_PAR 0 0 11 /end AXIS_DESCR
 /begin AXIS_DESCR FIX_AXIS NO_INPUT_QUANTITY TCY_FNMNT_VOL_EFF 11 0 10 FIX_AXIS_PAR 0 0 11 /end AXIS_DESCR
/end CHARACTERISTIC
/begin COMPU_METHOD TCZ_FNMNT_VOL_EFF "FNMNT_VOL_EFF Z-axis conversion" RAT_FUNC "%10.5" "unitless" COEFFS 0 1 0 0 0 1 /end COMPU_METHOD
/begin COMPU_METHOD TCX_FNMNT_VOL_EFF "FNMNT_VOL_EFF X-axis conversion" RAT_FUNC "%10.5" "unitless" COEFFS 0 1 0 0 0 1 /end COMPU_METHOD
/begin COMPU_METHOD TCY_FNMNT_VOL_EFF "FNMNT_VOL_EFF Y-axis conversion" RAT_FUNC "%10.5" "unitless" COEFFS 0 1 0 0 0 1 /end COMPU_METHOD
/begin CHARACTERISTIC FNMNT_VOL_EFF1 "X Norm=FNMNT_VOL_EFF1_X_NORM, Y Norm=FNMNT_VOL_EFF1_Y_NORM" MAP 0x572A4 TD_FLOAT32_IEEE 0 TCZ_FNMNT_VOL_EFF1 0 10
 /begin AXIS_DESCR FIX_AXIS NO_INPUT_QUANTITY TCX_FNMNT_VOL_EFF1 11 0 10 FIX_AXIS_PAR 0 0 11 /end AXIS_DESCR
 /begin AXIS_DESCR FIX_AXIS NO_INPUT_QUANTITY TCY_FNMNT_VOL_EFF1 11 0 10 FIX_AXIS_PAR 0 0 11 /end AXIS_DESCR
/end CHARACTERISTIC
/begin COMPU_METHOD TCZ_FNMNT_VOL_EFF1 "FNMNT_VOL_EFF1 Z-axis conversion" RAT_FUNC "%10.5" "unitless" COEFFS 0 1 0 0 0 1 /end COMPU_METHOD
/begin COMPU_METHOD TCX_FNMNT_VOL_EFF1 "FNMNT_VOL_EFF1 X-axis conversion" RAT_FUNC "%10.5" "unitless" COEFFS 0 1 0 0 0 1 /end COMPU_METHOD
/begin COMPU_METHOD TCY_FNMNT_VOL_EFF1 "FNMNT_VOL_EFF1 Y-axis conversion" RAT_FUNC "%10.5" "unitless" COEFFS 0 1 0 0 0 1 /end COMPU_METHOD
/begin CHARACTERISTIC FNMNT_VOL_EFF1_X_NORM "" CURVE 0x56E2C FD_FLOAT32_IEEE 0 FCY_FNMNT_VOL_EFF1_X_NORM 0 14 /begin AXIS_DESCR STD_AXIS MNT_MFDES FCX_FNMNT_VOL_EFF1_X_NORM 11 0 200 /end AXIS_DESCR /end CHARACTERISTIC
/begin COMPU_METHOD FCX_FNMNT_VOL_EFF1_X_NORM "FNMNT_VOL_EFF1_X_NORM X-axis conversion" RAT_FUNC "%10.5" "unitless" COEFFS 0 1 0 0 0 1 /end COMPU_METHOD
/begin COMPU_METHOD FCY_FNMNT_VOL_EFF1_X_NORM "FNMNT_VOL_EFF1_X_NORM Y-axis conversion" RAT_FUNC "%10.5" "unitless" COEFFS 0 1 0 0 0 1 /end COMPU_METHOD
/begin CHARACTERISTIC FNMNT_VOL_EFF1_Y_NORM "" CURVE 0x56E84 FD_FLOAT32_IEEE 0 FCY_FNMNT_VOL_EFF1_Y_NORM 0 14 /begin AXIS_DESCR STD_AXIS MNT_DP FCX_FNMNT_VOL_EFF1_Y_NORM 11 0 200 /end AXIS_DESCR /end CHARACTERISTIC
/begin COMPU_METHOD FCX_FNMNT_VOL_EFF1_Y_NORM "FNMNT_VOL_EFF1_Y_NORM X-axis conversion" RAT_FUNC "%10.5" "unitless" COEFFS 0 1 0 0 0 1 /end COMPU_METHOD
/begin COMPU_METHOD FCY_FNMNT_VOL_EFF1_Y_NORM "FNMNT_VOL_EFF1_Y_NORM Y-axis conversion" RAT_FUNC "%10.5" "unitless" COEFFS 0 1 0 0 0 1 /end COMPU_METHOD
/begin CHARACTERISTIC FNMNT_VOL_EFF_X_NORM "" CURVE 0x56D7C FD_FLOAT32_IEEE 0 FCY_FNMNT_VOL_EFF_X_NORM 0 14 /begin AXIS_DESCR STD_AXIS MNT_ERPM FCX_FNMNT_VOL_EFF_X_NORM 11 0 5500 /end AXIS_DESCR /end CHARACTERISTIC
/begin COMPU_METHOD FCX_FNMNT_VOL_EFF_X_NORM "FNMNT_VOL_EFF_X_NORM X-axis conversion" RAT_FUNC "%10.5" "unitless" COEFFS 0 1 0 0 0 1 /end COMPU_METHOD
/begin COMPU_METHOD FCY_FNMNT_VOL_EFF_X_NORM "FNMNT_VOL_EFF_X_NORM Y-axis conversion" RAT_FUNC "%10.5" "unitless" COEFFS 0 1 0 0 0 1 /end COMPU_METHOD
/begin CHARACTERISTIC FNMNT_VOL_EFF_Y_NORM "" CURVE 0x56DD4 FD_FLOAT32_IEEE 0 FCY_FNMNT_VOL_EFF_Y_NORM 0 14 /begin AXIS_DESCR STD_AXIS MNT_MFDES FCX_FNMNT_VOL_EFF_Y_NORM 11 0 200 /end AXIS_DESCR /end CHARACTERISTIC
/begin COMPU_METHOD FCX_FNMNT_VOL_EFF_Y_NORM "FNMNT_VOL_EFF_Y_NORM X-axis conversion" RAT_FUNC "%10.5" "unitless" COEFFS 0 1 0 0 0 1 /end COMPU_METHOD
/begin COMPU_METHOD FCY_FNMNT_VOL_EFF_Y_NORM "FNMNT_VOL_EFF_Y_NORM Y-axis conversion" RAT_FUNC "%10.5" "unitless" COEFFS 0 1 0 0 0 1 /end COMPU_METHOD
/begin CHARACTERISTIC FNN_DSH_DIT "normalising function for fndit_mfn_kdsh" CURVE 0x48C74 FD_FLOAT32_IEEE 0 FCY_FNN_DSH_DIT 0 9 /begin AXIS_DESCR STD_AXIS DIT_N_DIFF_FILT FCX_FNN_DSH_DIT 9 0 16383.8 /end AXIS_DESCR /end CHARACTERISTIC
/begin COMPU_METHOD FCX_FNN_DSH_DIT "FNN_DSH_DIT X-axis conversion" RAT_FUNC "%10.5" "RPM" COEFFS 0 1 0 0 0 1 /end COMPU_METHOD
/begin COMPU_METHOD FCY_FNN_DSH_DIT "FNN_DSH_DIT Y-axis conversion" RAT_FUNC "%10.5" "unitless" COEFFS 0 1 0 0 0 1 /end COMPU_METHOD
/begin CHARACTERISTIC FNN_FRICT_NORM "" CURVE 0x4D80C FD_FLOAT32_IEEE 0 FCY_FNN_FRICT_NORM 0 14 /begin AXIS_DESCR STD_AXIS N FCX_FNN_FRICT_NORM 14 0 8000 /end AXIS_DESCR /end CHARACTERISTIC
/begin COMPU_METHOD FCX_FNN_FRICT_NORM "FNN_FRICT_NORM X-axis conversion" RAT_FUNC "%10.5" "unitless" COEFFS 0 1 0 0 0 1 /end COMPU_METHOD
/begin COMPU_METHOD FCY_FNN_FRICT_NORM "FNN_FRICT_NORM Y-axis conversion" RAT_FUNC "%10.5" "unitless" COEFFS 0 1 0 0 0 1 /end COMPU_METHOD
/begin CHARACTERISTIC FNPPS_TPO "" CURVE 0x43F54 FD_FLOAT32_IEEE 0 FCY_FNPPS_TPO 0 1 /begin AXIS_DESCR STD_AXIS PPS FCX_FNPPS_TPO 14 0 1024 /end AXIS_DESCR /end CHARACTERISTIC
/begin COMPU_METHOD FCX_FNPPS_TPO "FNPPS_TPO X-axis conversion" RAT_FUNC "%10.5" "unitless" COEFFS 0 1 0 0 0 1 /end COMPU_METHOD
/begin COMPU_METHOD FCY_FNPPS_TPO "FNPPS_TPO Y-axis conversion" RAT_FUNC "%10.5" "unitless" COEFFS 0 1 0 0 0 1 /end COMPU_METHOD
/begin CHARACTERISTIC FNPRED_MIN_TQ "X Norm=FN_TQ121, Y Norm=FN_TQ100, Outputs a correction for motoring torque curve based on eot_c and tq_min_brk_res" MAP 0x501CC TD_FLOAT32_IEEE 0 TCZ_FNPRED_MIN_TQ -400 1600
 /begin AXIS_DESCR FIX_AXIS NO_INPUT_QUANTITY TCX_FNPRED_MIN_TQ 14 0 13 FIX_AXIS_PAR 0 0 14 /end AXIS_DESCR
 /begin AXIS_DESCR FIX_AXIS NO_INPUT_QUANTITY TCY_FNPRED_MIN_TQ 14 0 13 FIX_AXIS_PAR 0 0 14 /end AXIS_DESCR
/end CHARACTERISTIC
/begin COMPU_METHOD TCZ_FNPRED_MIN_TQ "FNPRED_MIN_TQ Z-axis conversion" RAT_FUNC "%10.5" "lbf*ft" COEFFS 0 1 0 0 0 1 /end COMPU_METHOD
/begin COMPU_METHOD TCX_FNPRED_MIN_TQ "FNPRED_MIN_TQ X-axis conversion" RAT_FUNC "%10.5" "unitless" COEFFS 0 1 0 0 0 1 /end COMPU_METHOD
/begin COMPU_METHOD TCY_FNPRED_MIN_TQ "FNPRED_MIN_TQ Y-axis conversion" RAT_FUNC "%10.5" "degC" COEFFS 0 1 0 0 0 1 /end COMPU_METHOD
/begin CHARACTERISTIC FNRDON1 "Trans pedal conversion RAM fox function" CURVE 0x3FBC90 FD_FLOAT32_IEEE 0 FCY_FNRDON1 0 100 /begin AXIS_DESCR STD_AXIS PPS FCX_FNRDON1 3 0 1024 /end AXIS_DESCR /end CHARACTERISTIC
/begin COMPU_METHOD FCX_FNRDON1 "FNRDON1 X-axis conversion" RAT_FUNC "%10.5" "ADct" COEFFS 0 1 0 0 0 1 /end COMPU_METHOD
/begin COMPU_METHOD FCY_FNRDON1 "FNRDON1 Y-axis conversion" RAT_FUNC "%10.5" "%" COEFFS 0 1 0 0 0 1 /end COMPU_METHOD
/begin CHARACTERISTIC FNSPMF "" CURVE 0x48D7C FD_FLOAT32_IEEE 0 FCY_FNSPMF 0 1 /begin AXIS_DESCR STD_AXIS MFDES FCX_FNSPMF 14 0 135 /end AXIS_DESCR /end CHARACTERISTIC
/begin COMPU_METHOD FCX_FNSPMF "FNSPMF X-axis conversion" RAT_FUNC "%10.5" "unitless" COEFFS 0 1 0 0 0 1 /end COMPU_METHOD
/begin COMPU_METHOD FCY_FNSPMF "FNSPMF Y-axis conversion" RAT_FUNC "%10.5" "unitless" COEFFS 0 1 0 0 0 1 /end COMPU_METHOD
/begin CHARACTERISTIC FNSPNT "" CURVE 0x48D0C FD_FLOAT32_IEEE 0 FCY_FNSPNT 0 1 /begin AXIS_DESCR STD_AXIS N FCX_FNSPNT 14 0 6000 /end AXIS_DESCR /end CHARACTERISTIC
/begin COMPU_METHOD FCX_FNSPNT "FNSPNT X-axis conversion" RAT_FUNC "%10.5" "RPM" COEFFS 0 1 0 0 0 1 /end COMPU_METHOD
/begin COMPU_METHOD FCY_FNSPNT "FNSPNT Y-axis conversion" RAT_FUNC "%10.5" "unitless" COEFFS 0 1 0 0 0 1 /end COMPU_METHOD
/begin CHARACTERISTIC FNTQCOMB_MULT "X Norm=FNTQ_MFCOMB_NORM, Y Norm=FNTQ_MAFCOMB_NORM" MAP 0x4F33C TD_FLOAT32_IEEE 0 TCZ_FNTQCOMB_MULT 0 500
 /begin AXIS_DESCR FIX_AXIS NO_INPUT_QUANTITY TCX_FNTQCOMB_MULT 14 0 13 FIX_AXIS_PAR 0 0 14 /end AXIS_DESCR
 /begin AXIS_DESCR FIX_AXIS NO_INPUT_QUANTITY TCY_FNTQCOMB_MULT 14 0 13 FIX_AXIS_PAR 0 0 14 /end AXIS_DESCR
/end CHARACTERISTIC
/begin COMPU_METHOD TCZ_FNTQCOMB_MULT "FNTQCOMB_MULT Z-axis conversion" RAT_FUNC "%10.5" "unitless" COEFFS 0 1 0 0 0 1 /end COMPU_METHOD
/begin COMPU_METHOD TCX_FNTQCOMB_MULT "FNTQCOMB_MULT X-axis conversion" RAT_FUNC "%10.5" "unitless" COEFFS 0 1 0 0 0 1 /end COMPU_METHOD
/begin COMPU_METHOD TCY_FNTQCOMB_MULT "FNTQCOMB_MULT Y-axis conversion" RAT_FUNC "%10.5" "unitless" COEFFS 0 1 0 0 0 1 /end COMPU_METHOD
/begin CHARACTERISTIC FNTQ_DELTAP "X Norm=FNTQ_DP_N_NORM, Y Norm=FNTQ_DP_DPERR_NORM" MAP 0x4ECFC TD_FLOAT32_IEEE 0 TCZ_FNTQ_DELTAP 0 500
 /begin AXIS_DESCR FIX_AXIS NO_INPUT_QUANTITY TCX_FNTQ_DELTAP 14 0 13 FIX_AXIS_PAR 0 0 14 /end AXIS_DESCR
 /begin AXIS_DESCR FIX_AXIS NO_INPUT_QUANTITY TCY_FNTQ_DELTAP 14 0 13 FIX_AXIS_PAR 0 0 14 /end AXIS_DESCR
/end CHARACTERISTIC
/begin COMPU_METHOD TCZ_FNTQ_DELTAP "FNTQ_DELTAP Z-axis conversion" RAT_FUNC "%10.5" "unitless" COEFFS 0 1 0 0 0 1 /end COMPU_METHOD
/begin COMPU_METHOD TCX_FNTQ_DELTAP "FNTQ_DELTAP X-axis conversion" RAT_FUNC "%10.5" "unitless" COEFFS 0 1 0 0 0 1 /end COMPU_METHOD
/begin COMPU_METHOD TCY_FNTQ_DELTAP "FNTQ_DELTAP Y-axis conversion" RAT_FUNC "%10.5" "unitless" COEFFS 0 1 0 0 0 1 /end COMPU_METHOD
/begin CHARACTERISTIC FNTQ_DP_DPERR_NORM "" CURVE 0x4D56C FD_FLOAT32_IEEE 0 FCY_FNTQ_DP_DPERR_NORM 0 14 /begin AXIS_DESCR STD_AXIS TQ_DELTAP_ERR FCX_FNTQ_DP_DPERR_NORM 14 -500 500 /end AXIS_DESCR /end CHARACTERISTIC
/begin COMPU_METHOD FCX_FNTQ_DP_DPERR_NORM "FNTQ_DP_DPERR_NORM X-axis conversion" RAT_FUNC "%10.5" "unitless" COEFFS 0 1 0 0 0 1 /end COMPU_METHOD
/begin COMPU_METHOD FCY_FNTQ_DP_DPERR_NORM "FNTQ_DP_DPERR_NORM Y-axis conversion" RAT_FUNC "%10.5" "unitless" COEFFS 0 1 0 0 0 1 /end COMPU_METHOD
/begin CHARACTERISTIC FNTQ_DP_HIALT "X Norm=FN090DS_TQ, Y Norm=FN091DS_TQ" MAP 0x4E39C TD_FLOAT32_IEEE 0 TCZ_FNTQ_DP_HIALT 0 500
 /begin AXIS_DESCR FIX_AXIS NO_INPUT_QUANTITY TCX_FNTQ_DP_HIALT 14 0 13 FIX_AXIS_PAR 0 0 14 /end AXIS_DESCR
 /begin AXIS_DESCR FIX_AXIS NO_INPUT_QUANTITY TCY_FNTQ_DP_HIALT 14 0 13 FIX_AXIS_PAR 0 0 14 /end AXIS_DESCR
/end CHARACTERISTIC
/begin COMPU_METHOD TCZ_FNTQ_DP_HIALT "FNTQ_DP_HIALT Z-axis conversion" RAT_FUNC "%10.5" "unitless" COEFFS 0 1 0 0 0 1 /end COMPU_METHOD
/begin COMPU_METHOD TCX_FNTQ_DP_HIALT "FNTQ_DP_HIALT X-axis conversion" RAT_FUNC "%10.5" "unitless" COEFFS 0 1 0 0 0 1 /end COMPU_METHOD
/begin COMPU_METHOD TCY_FNTQ_DP_HIALT "FNTQ_DP_HIALT Y-axis conversion" RAT_FUNC "%10.5" "unitless" COEFFS 0 1 0 0 0 1 /end COMPU_METHOD
/begin CHARACTERISTIC FNTQ_DP_LOALT "X Norm=FN090DS_TQ, Y Norm=FN091DS_TQ" MAP 0x4E9DC TD_FLOAT32_IEEE 0 TCZ_FNTQ_DP_LOALT 0 500
 /begin AXIS_DESCR FIX_AXIS NO_INPUT_QUANTITY TCX_FNTQ_DP_LOALT 14 0 13 FIX_AXIS_PAR 0 0 14 /end AXIS_DESCR
 /begin AXIS_DESCR FIX_AXIS NO_INPUT_QUANTITY TCY_FNTQ_DP_LOALT 14 0 13 FIX_AXIS_PAR 0 0 14 /end AXIS_DESCR
/end CHARACTERISTIC
/begin COMPU_METHOD TCZ_FNTQ_DP_LOALT "FNTQ_DP_LOALT Z-axis conversion" RAT_FUNC "%10.5" "unitless" COEFFS 0 1 0 0 0 1 /end COMPU_METHOD
/begin COMPU_METHOD TCX_FNTQ_DP_LOALT "FNTQ_DP_LOALT X-axis conversion" RAT_FUNC "%10.5" "unitless" COEFFS 0 1 0 0 0 1 /end COMPU_METHOD
/begin COMPU_METHOD TCY_FNTQ_DP_LOALT "FNTQ_DP_LOALT Y-axis conversion" RAT_FUNC "%10.5" "unitless" COEFFS 0 1 0 0 0 1 /end COMPU_METHOD
/begin CHARACTERISTIC FNTQ_DP_MEDALT "X Norm=FN090DS_TQ, Y Norm=FN091DS_TQ" MAP 0x4E6BC TD_FLOAT32_IEEE 0 TCZ_FNTQ_DP_MEDALT 0 500
 /begin AXIS_DESCR FIX_AXIS NO_INPUT_QUANTITY TCX_FNTQ_DP_MEDALT 14 0 13 FIX_AXIS_PAR 0 0 14 /end AXIS_DESCR
 /begin AXIS_DESCR FIX_AXIS NO_INPUT_QUANTITY TCY_FNTQ_DP_MEDALT 14 0 13 FIX_AXIS_PAR 0 0 14 /end AXIS_DESCR
/end CHARACTERISTIC
/begin COMPU_METHOD TCZ_FNTQ_DP_MEDALT "FNTQ_DP_MEDALT Z-axis conversion" RAT_FUNC "%10.5" "unitless" COEFFS 0 1 0 0 0 1 /end COMPU_METHOD
/begin COMPU_METHOD TCX_FNTQ_DP_MEDALT "FNTQ_DP_MEDALT X-axis conversion" RAT_FUNC "%10.5" "unitless" COEFFS 0 1 0 0 0 1 /end COMPU_METHOD
/begin COMPU_METHOD TCY_FNTQ_DP_MEDALT "FNTQ_DP_MEDALT Y-axis conversion" RAT_FUNC "%10.5" "unitless" COEFFS 0 1 0 0 0 1 /end COMPU_METHOD
/begin CHARACTERISTIC FNTQ_DP_N_NORM "" CURVE 0x4D5DC FD_FLOAT32_IEEE 0 FCY_FNTQ_DP_N_NORM 0 14 /begin AXIS_DESCR STD_AXIS N FCX_FNTQ_DP_N_NORM 14 0 8000 /end AXIS_DESCR /end CHARACTERISTIC
/begin COMPU_METHOD FCX_FNTQ_DP_N_NORM "FNTQ_DP_N_NORM X-axis conversion" RAT_FUNC "%10.5" "unitless" COEFFS 0 1 0 0 0 1 /end COMPU_METHOD
/begin COMPU_METHOD FCY_FNTQ_DP_N_NORM "FNTQ_DP_N_NORM Y-axis conversion" RAT_FUNC "%10.5" "unitless" COEFFS 0 1 0 0 0 1 /end COMPU_METHOD
/begin CHARACTERISTIC FNTQ_DTQ_DICP "" CURVE 0x4D64C FD_FLOAT32_IEEE 0 FCY_FNTQ_DTQ_DICP 0 14 /begin AXIS_DESCR STD_AXIS N FCX_FNTQ_DTQ_DICP 14 0 8000 /end AXIS_DESCR /end CHARACTERISTIC
/begin COMPU_METHOD FCX_FNTQ_DTQ_DICP "FNTQ_DTQ_DICP X-axis conversion" RAT_FUNC "%10.5" "unitless" COEFFS 0 1 0 0 0 1 /end COMPU_METHOD
/begin COMPU_METHOD FCY_FNTQ_DTQ_DICP "FNTQ_DTQ_DICP Y-axis conversion" RAT_FUNC "%10.5" "unitless" COEFFS 0 1 0 0 0 1 /end COMPU_METHOD
/begin CHARACTERISTIC FNTQ_MAFCOMB_NORM "" CURVE 0x4D6BC FD_FLOAT32_IEEE 0 FCY_FNTQ_MAFCOMB_NORM 0 14 /begin AXIS_DESCR STD_AXIS MAF_MG_STK FCX_FNTQ_MAFCOMB_NORM 14 0 4096 /end AXIS_DESCR /end CHARACTERISTIC
/begin COMPU_METHOD FCX_FNTQ_MAFCOMB_NORM "FNTQ_MAFCOMB_NORM X-axis conversion" RAT_FUNC "%10.5" "unitless" COEFFS 0 1 0 0 0 1 /end COMPU_METHOD
/begin COMPU_METHOD FCY_FNTQ_MAFCOMB_NORM "FNTQ_MAFCOMB_NORM Y-axis conversion" RAT_FUNC "%10.5" "unitless" COEFFS 0 1 0 0 0 1 /end COMPU_METHOD
/begin CHARACTERISTIC FNTQ_MFCOMB_NORM "" CURVE 0x4D72C FD_FLOAT32_IEEE 0 FCY_FNTQ_MFCOMB_NORM 0 14 /begin AXIS_DESCR STD_AXIS MFDES FCX_FNTQ_MFCOMB_NORM 14 -2048 2048 /end AXIS_DESCR /end CHARACTERISTIC
/begin COMPU_METHOD FCX_FNTQ_MFCOMB_NORM "FNTQ_MFCOMB_NORM X-axis conversion" RAT_FUNC "%10.5" "unitless" COEFFS 0 1 0 0 0 1 /end COMPU_METHOD
/begin COMPU_METHOD FCY_FNTQ_MFCOMB_NORM "FNTQ_MFCOMB_NORM Y-axis conversion" RAT_FUNC "%10.5" "unitless" COEFFS 0 1 0 0 0 1 /end COMPU_METHOD
/begin CHARACTERISTIC FNTQ_TAU_NORM "" CURVE 0x4D87C FD_FLOAT32_IEEE 0 FCY_FNTQ_TAU_NORM 0 14 /begin AXIS_DESCR STD_AXIS N FCX_FNTQ_TAU_NORM 14 0 8000 /end AXIS_DESCR /end CHARACTERISTIC
/begin COMPU_METHOD FCX_FNTQ_TAU_NORM "FNTQ_TAU_NORM X-axis conversion" RAT_FUNC "%10.5" "unitless" COEFFS 0 1 0 0 0 1 /end COMPU_METHOD
/begin COMPU_METHOD FCY_FNTQ_TAU_NORM "FNTQ_TAU_NORM Y-axis conversion" RAT_FUNC "%10.5" "unitless" COEFFS 0 1 0 0 0 1 /end COMPU_METHOD
/begin CHARACTERISTIC FNVGT_EBPG_COLD_ADDR "X Norm=FN090_VGT, Y Norm=FN091_VGT" MAP 0x57BBC TD_FLOAT32_IEEE 0 TCZ_FNVGT_EBPG_COLD_ADDR -20 250
 /begin AXIS_DESCR FIX_AXIS NO_INPUT_QUANTITY TCX_FNVGT_EBPG_COLD_ADDR 14 0 13 FIX_AXIS_PAR 0 0 14 /end AXIS_DESCR
 /begin AXIS_DESCR FIX_AXIS NO_INPUT_QUANTITY TCY_FNVGT_EBPG_COLD_ADDR 14 0 13 FIX_AXIS_PAR 0 0 14 /end AXIS_DESCR
/end CHARACTERISTIC
/begin COMPU_METHOD TCZ_FNVGT_EBPG_COLD_ADDR "FNVGT_EBPG_COLD_ADDR Z-axis conversion" RAT_FUNC "%10.5" "unitless" COEFFS 0 1 0 0 0 1 /end COMPU_METHOD
/begin COMPU_METHOD TCX_FNVGT_EBPG_COLD_ADDR "FNVGT_EBPG_COLD_ADDR X-axis conversion" RAT_FUNC "%10.5" "unitless" COEFFS 0 1 0 0 0 1 /end COMPU_METHOD
/begin COMPU_METHOD TCY_FNVGT_EBPG_COLD_ADDR "FNVGT_EBPG_COLD_ADDR Y-axis conversion" RAT_FUNC "%10.5" "unitless" COEFFS 0 1 0 0 0 1 /end COMPU_METHOD
/begin CHARACTERISTIC FNVGT_EBPG_DES_EGR_HI "X Norm=FN090_VGT, Y Norm=FN091_VGT" MAP 0x587FC TD_FLOAT32_IEEE 0 TCZ_FNVGT_EBPG_DES_EGR_HI -10 250
 /begin AXIS_DESCR FIX_AXIS NO_INPUT_QUANTITY TCX_FNVGT_EBPG_DES_EGR_HI 14 0 13 FIX_AXIS_PAR 0 0 14 /end AXIS_DESCR
 /begin AXIS_DESCR FIX_AXIS NO_INPUT_QUANTITY TCY_FNVGT_EBPG_DES_EGR_HI 14 0 13 FIX_AXIS_PAR 0 0 14 /end AXIS_DESCR
/end CHARACTERISTIC
/begin COMPU_METHOD TCZ_FNVGT_EBPG_DES_EGR_HI "FNVGT_EBPG_DES_EGR_HI Z-axis conversion" RAT_FUNC "%10.5" "unitless" COEFFS 0 1 0 0 0 1 /end COMPU_METHOD
/begin COMPU_METHOD TCX_FNVGT_EBPG_DES_EGR_HI "FNVGT_EBPG_DES_EGR_HI X-axis conversion" RAT_FUNC "%10.5" "unitless" COEFFS 0 1 0 0 0 1 /end COMPU_METHOD
/begin COMPU_METHOD TCY_FNVGT_EBPG_DES_EGR_HI "FNVGT_EBPG_DES_EGR_HI Y-axis conversion" RAT_FUNC "%10.5" "unitless" COEFFS 0 1 0 0 0 1 /end COMPU_METHOD
/begin CHARACTERISTIC FNVGT_EBPG_DES_EGR_LO "X Norm=FN090_VGT, Y Norm=FN091_VGT" MAP 0x58B0C TD_FLOAT32_IEEE 0 TCZ_FNVGT_EBPG_DES_EGR_LO -10 250
 /begin AXIS_DESCR FIX_AXIS NO_INPUT_QUANTITY TCX_FNVGT_EBPG_DES_EGR_LO 14 0 13 FIX_AXIS_PAR 0 0 14 /end AXIS_DESCR
 /begin AXIS_DESCR FIX_AXIS NO_INPUT_QUANTITY TCY_FNVGT_EBPG_DES_EGR_LO 14 0 13 FIX_AXIS_PAR 0 0 14 /end AXIS_DESCR
/end CHARACTERISTIC
/begin COMPU_METHOD TCZ_FNVGT_EBPG_DES_EGR_LO "FNVGT_EBPG_DES_EGR_LO Z-axis conversion" RAT_FUNC "%10.5" "unitless" COEFFS 0 1 0 0 0 1 /end COMPU_METHOD
/begin COMPU_METHOD TCX_FNVGT_EBPG_DES_EGR_LO "FNVGT_EBPG_DES_EGR_LO X-axis conversion" RAT_FUNC "%10.5" "unitless" COEFFS 0 1 0 0 0 1 /end COMPU_METHOD
/begin COMPU_METHOD TCY_FNVGT_EBPG_DES_EGR_LO "FNVGT_EBPG_DES_EGR_LO Y-axis conversion" RAT_FUNC "%10.5" "unitless" COEFFS 0 1 0 0 0 1 /end COMPU_METHOD
/begin CHARACTERISTIC FNVGT_EBPG_DES_NEGR_HI "X Norm=FN090_VGT, Y Norm=FN091_VGT" MAP 0x58E1C TD_FLOAT32_IEEE 0 TCZ_FNVGT_EBPG_DES_NEGR_HI -10 250
 /begin AXIS_DESCR FIX_AXIS NO_INPUT_QUANTITY TCX_FNVGT_EBPG_DES_NEGR_HI 14 0 13 FIX_AXIS_PAR 0 0 14 /end AXIS_DESCR
 /begin AXIS_DESCR FIX_AXIS NO_INPUT_QUANTITY TCY_FNVGT_EBPG_DES_NEGR_HI 14 0 13 FIX_AXIS_PAR 0 0 14 /end AXIS_DESCR
/end CHARACTERISTIC
/begin COMPU_METHOD TCZ_FNVGT_EBPG_DES_NEGR_HI "FNVGT_EBPG_DES_NEGR_HI Z-axis conversion" RAT_FUNC "%10.5" "unitless" COEFFS 0 1 0 0 0 1 /end COMPU_METHOD
/begin COMPU_METHOD TCX_FNVGT_EBPG_DES_NEGR_HI "FNVGT_EBPG_DES_NEGR_HI X-axis conversion" RAT_FUNC "%10.5" "unitless" COEFFS 0 1 0 0 0 1 /end COMPU_METHOD
/begin COMPU_METHOD TCY_FNVGT_EBPG_DES_NEGR_HI "FNVGT_EBPG_DES_NEGR_HI Y-axis conversion" RAT_FUNC "%10.5" "unitless" COEFFS 0 1 0 0 0 1 /end COMPU_METHOD
/begin CHARACTERISTIC FNVGT_EBPG_DES_NEGR_LO "X Norm=FN090_VGT, Y Norm=FN091_VGT" MAP 0x5912C TD_FLOAT32_IEEE 0 TCZ_FNVGT_EBPG_DES_NEGR_LO -10 250
 /begin AXIS_DESCR FIX_AXIS NO_INPUT_QUANTITY TCX_FNVGT_EBPG_DES_NEGR_LO 14 0 13 FIX_AXIS_PAR 0 0 14 /end AXIS_DESCR
 /begin AXIS_DESCR FIX_AXIS NO_INPUT_QUANTITY TCY_FNVGT_EBPG_DES_NEGR_LO 14 0 13 FIX_AXIS_PAR 0 0 14 /end AXIS_DESCR
/end CHARACTERISTIC
/begin COMPU_METHOD TCZ_FNVGT_EBPG_DES_NEGR_LO "FNVGT_EBPG_DES_NEGR_LO Z-axis conversion" RAT_FUNC "%10.5" "unitless" COEFFS 0 1 0 0 0 1 /end COMPU_METHOD
/begin COMPU_METHOD TCX_FNVGT_EBPG_DES_NEGR_LO "FNVGT_EBPG_DES_NEGR_LO X-axis conversion" RAT_FUNC "%10.5" "unitless" COEFFS 0 1 0 0 0 1 /end COMPU_METHOD
/begin COMPU_METHOD TCY_FNVGT_EBPG_DES_NEGR_LO "FNVGT_EBPG_DES_NEGR_LO Y-axis conversion" RAT_FUNC "%10.5" "unitless" COEFFS 0 1 0 0 0 1 /end COMPU_METHOD
/begin CHARACTERISTIC FNVGT_EBPG_FF_EGR "X Norm=FN090_VGT, Y Norm=FN091_VGT" MAP 0x57ECC TD_FLOAT32_IEEE 0 TCZ_FNVGT_EBPG_FF_EGR 0 1
 /begin AXIS_DESCR FIX_AXIS NO_INPUT_QUANTITY TCX_FNVGT_EBPG_FF_EGR 14 0 13 FIX_AXIS_PAR 0 0 14 /end AXIS_DESCR
 /begin AXIS_DESCR FIX_AXIS NO_INPUT_QUANTITY TCY_FNVGT_EBPG_FF_EGR 14 0 13 FIX_AXIS_PAR 0 0 14 /end AXIS_DESCR
/end CHARACTERISTIC
/begin COMPU_METHOD TCZ_FNVGT_EBPG_FF_EGR "FNVGT_EBPG_FF_EGR Z-axis conversion" RAT_FUNC "%10.5" "unitless" COEFFS 0 1 0 0 0 1 /end COMPU_METHOD
/begin COMPU_METHOD TCX_FNVGT_EBPG_FF_EGR "FNVGT_EBPG_FF_EGR X-axis conversion" RAT_FUNC "%10.5" "unitless" COEFFS 0 1 0 0 0 1 /end COMPU_METHOD
/begin COMPU_METHOD TCY_FNVGT_EBPG_FF_EGR "FNVGT_EBPG_FF_EGR Y-axis conversion" RAT_FUNC "%10.5" "unitless" COEFFS 0 1 0 0 0 1 /end COMPU_METHOD
/begin CHARACTERISTIC FNVGT_EBPG_FF_NEGR "X Norm=FN090_VGT, Y Norm=FN091_VGT" MAP 0x581DC TD_FLOAT32_IEEE 0 TCZ_FNVGT_EBPG_FF_NEGR 0 1
 /begin AXIS_DESCR FIX_AXIS NO_INPUT_QUANTITY TCX_FNVGT_EBPG_FF_NEGR 14 0 13 FIX_AXIS_PAR 0 0 14 /end AXIS_DESCR
 /begin AXIS_DESCR FIX_AXIS NO_INPUT_QUANTITY TCY_FNVGT_EBPG_FF_NEGR 14 0 13 FIX_AXIS_PAR 0 0 14 /end AXIS_DESCR
/end CHARACTERISTIC
/begin COMPU_METHOD TCZ_FNVGT_EBPG_FF_NEGR "FNVGT_EBPG_FF_NEGR Z-axis conversion" RAT_FUNC "%10.5" "unitless" COEFFS 0 1 0 0 0 1 /end COMPU_METHOD
/begin COMPU_METHOD TCX_FNVGT_EBPG_FF_NEGR "FNVGT_EBPG_FF_NEGR X-axis conversion" RAT_FUNC "%10.5" "unitless" COEFFS 0 1 0 0 0 1 /end COMPU_METHOD
/begin COMPU_METHOD TCY_FNVGT_EBPG_FF_NEGR "FNVGT_EBPG_FF_NEGR Y-axis conversion" RAT_FUNC "%10.5" "unitless" COEFFS 0 1 0 0 0 1 /end COMPU_METHOD
/begin CHARACTERISTIC FNVGT_EOT_COLD_MULT "" CURVE 0x5759C FD_FLOAT32_IEEE 0 FCY_FNVGT_EOT_COLD_MULT 0 1 /begin AXIS_DESCR STD_AXIS EOT_C FCX_FNVGT_EOT_COLD_MULT 14 -40 150 /end AXIS_DESCR /end CHARACTERISTIC
/begin COMPU_METHOD FCX_FNVGT_EOT_COLD_MULT "FNVGT_EOT_COLD_MULT X-axis conversion" RAT_FUNC "%10.5" "unitless" COEFFS 0 1 0 0 0 1 /end COMPU_METHOD
/begin COMPU_METHOD FCY_FNVGT_EOT_COLD_MULT "FNVGT_EOT_COLD_MULT Y-axis conversion" RAT_FUNC "%10.5" "unitless" COEFFS 0 1 0 0 0 1 /end COMPU_METHOD
/begin CHARACTERISTIC FNVGT_EOT_DUTY_MAX "" CURVE 0x57B4C FD_FLOAT32_IEEE 0 FCY_FNVGT_EOT_DUTY_MAX 0 1 /begin AXIS_DESCR STD_AXIS EOT_C FCX_FNVGT_EOT_DUTY_MAX 14 -40 150 /end AXIS_DESCR /end CHARACTERISTIC
/begin COMPU_METHOD FCX_FNVGT_EOT_DUTY_MAX "FNVGT_EOT_DUTY_MAX X-axis conversion" RAT_FUNC "%10.5" "unitless" COEFFS 0 1 0 0 0 1 /end COMPU_METHOD
/begin COMPU_METHOD FCY_FNVGT_EOT_DUTY_MAX "FNVGT_EOT_DUTY_MAX Y-axis conversion" RAT_FUNC "%10.5" "unitless" COEFFS 0 1 0 0 0 1 /end COMPU_METHOD
/begin CHARACTERISTIC FNVGT_MAP_CLIP "" CURVE 0x5760C FD_FLOAT32_IEEE 0 FCY_FNVGT_MAP_CLIP 0 1 /begin AXIS_DESCR STD_AXIS VGT_OB_KPA FCX_FNVGT_MAP_CLIP 14 0 255.992 /end AXIS_DESCR /end CHARACTERISTIC
/begin COMPU_METHOD FCX_FNVGT_MAP_CLIP "FNVGT_MAP_CLIP X-axis conversion" RAT_FUNC "%10.5" "unitless" COEFFS 0 1 0 0 0 1 /end COMPU_METHOD
/begin COMPU_METHOD FCY_FNVGT_MAP_CLIP "FNVGT_MAP_CLIP Y-axis conversion" RAT_FUNC "%10.5" "unitless" COEFFS 0 1 0 0 0 1 /end COMPU_METHOD
/begin CHARACTERISTIC FNVGT_MAP_MAX "X Norm=FN090_VGT, Y Norm=FN091_VGT" MAP 0x584EC TD_FLOAT32_IEEE 0 TCZ_FNVGT_MAP_MAX 0 255.992
 /begin AXIS_DESCR FIX_AXIS NO_INPUT_QUANTITY TCX_FNVGT_MAP_MAX 14 0 13 FIX_AXIS_PAR 0 0 14 /end AXIS_DESCR
 /begin AXIS_DESCR FIX_AXIS NO_INPUT_QUANTITY TCY_FNVGT_MAP_MAX 14 0 13 FIX_AXIS_PAR 0 0 14 /end AXIS_DESCR
/end CHARACTERISTIC
/begin COMPU_METHOD TCZ_FNVGT_MAP_MAX "FNVGT_MAP_MAX Z-axis conversion" RAT_FUNC "%10.5" "unitless" COEFFS 0 1 0 0 0 1 /end COMPU_METHOD
/begin COMPU_METHOD TCX_FNVGT_MAP_MAX "FNVGT_MAP_MAX X-axis conversion" RAT_FUNC "%10.5" "unitless" COEFFS 0 1 0 0 0 1 /end COMPU_METHOD
/begin COMPU_METHOD TCY_FNVGT_MAP_MAX "FNVGT_MAP_MAX Y-axis conversion" RAT_FUNC "%10.5" "unitless" COEFFS 0 1 0 0 0 1 /end COMPU_METHOD
/begin CHARACTERISTIC FNVGT_MF_TRNS_MULT "" CURVE 0x5767C FD_FLOAT32_IEEE 0 FCY_FNVGT_MF_TRNS_MULT 0 1
 /begin AXIS_DESCR STD_AXIS NO_INPUT_QUANTITY FCX_FNVGT_MF_TRNS_MULT 14 -1000 1000 /end AXIS_DESCR
/end CHARACTERISTIC
/begin COMPU_METHOD FCX_FNVGT_MF_TRNS_MULT "FNVGT_MF_TRNS_MULT X-axis conversion" RAT_FUNC "%10.5" "unitless" COEFFS 0 1 0 0 0 1 /end COMPU_METHOD
/begin COMPU_METHOD FCY_FNVGT_MF_TRNS_MULT "FNVGT_MF_TRNS_MULT Y-axis conversion" RAT_FUNC "%10.5" "unitless" COEFFS 0 1 0 0 0 1 /end COMPU_METHOD
/begin CHARACTERISTIC FNVGT_N_DUTY_LMX "" CURVE 0x578AC FD_FLOAT32_IEEE 0 FCY_FNVGT_N_DUTY_LMX 0 1 /begin AXIS_DESCR STD_AXIS N FCX_FNVGT_N_DUTY_LMX 14 0 5000 /end AXIS_DESCR /end CHARACTERISTIC
/begin COMPU_METHOD FCX_FNVGT_N_DUTY_LMX "FNVGT_N_DUTY_LMX X-axis conversion" RAT_FUNC "%10.5" "unitless" COEFFS 0 1 0 0 0 1 /end COMPU_METHOD
/begin COMPU_METHOD FCY_FNVGT_N_DUTY_LMX "FNVGT_N_DUTY_LMX Y-axis conversion" RAT_FUNC "%10.5" "unitless" COEFFS 0 1 0 0 0 1 /end COMPU_METHOD
/begin CHARACTERISTIC FNVGT_OB_MFL_PCT "" CURVE 0x576EC FD_FLOAT32_IEEE 0 FCY_FNVGT_OB_MFL_PCT 0.5 1 /begin AXIS_DESCR STD_AXIS VGT_OB_KPA FCX_FNVGT_OB_MFL_PCT 14 0 255.992 /end AXIS_DESCR /end CHARACTERISTIC
/begin COMPU_METHOD FCX_FNVGT_OB_MFL_PCT "FNVGT_OB_MFL_PCT X-axis conversion" RAT_FUNC "%10.5" "unitless" COEFFS 0 1 0 0 0 1 /end COMPU_METHOD
/begin COMPU_METHOD FCY_FNVGT_OB_MFL_PCT "FNVGT_OB_MFL_PCT Y-axis conversion" RAT_FUNC "%10.5" "unitless" COEFFS 0 1 0 0 0 1 /end COMPU_METHOD
/begin CHARACTERISTIC FNVGT_OL_DUTY "X Norm=FN090_VGT, Y Norm=FN091_VGT" MAP 0x5943C TD_FLOAT32_IEEE 0 TCZ_FNVGT_OL_DUTY 0 1
 /begin AXIS_DESCR FIX_AXIS NO_INPUT_QUANTITY TCX_FNVGT_OL_DUTY 14 0 13 FIX_AXIS_PAR 0 0 14 /end AXIS_DESCR
 /begin AXIS_DESCR FIX_AXIS NO_INPUT_QUANTITY TCY_FNVGT_OL_DUTY 14 0 13 FIX_AXIS_PAR 0 0 14 /end AXIS_DESCR
/end CHARACTERISTIC
/begin COMPU_METHOD TCZ_FNVGT_OL_DUTY "FNVGT_OL_DUTY Z-axis conversion" RAT_FUNC "%10.5" "unitless" COEFFS 0 1 0 0 0 1 /end COMPU_METHOD
/begin COMPU_METHOD TCX_FNVGT_OL_DUTY "FNVGT_OL_DUTY X-axis conversion" RAT_FUNC "%10.5" "unitless" COEFFS 0 1 0 0 0 1 /end COMPU_METHOD
/begin COMPU_METHOD TCY_FNVGT_OL_DUTY "FNVGT_OL_DUTY Y-axis conversion" RAT_FUNC "%10.5" "unitless" COEFFS 0 1 0 0 0 1 /end COMPU_METHOD
/begin CHARACTERISTIC FNVGT_PID_KD "" CURVE 0x5775C FD_FLOAT32_IEEE 0 FCY_FNVGT_PID_KD -10 10 /begin AXIS_DESCR STD_AXIS EOT_C FCX_FNVGT_PID_KD 14 -200 400 /end AXIS_DESCR /end CHARACTERISTIC
/begin COMPU_METHOD FCX_FNVGT_PID_KD "FNVGT_PID_KD X-axis conversion" RAT_FUNC "%10.5" "unitless" COEFFS 0 1 0 0 0 1 /end COMPU_METHOD
/begin COMPU_METHOD FCY_FNVGT_PID_KD "FNVGT_PID_KD Y-axis conversion" RAT_FUNC "%10.5" "unitless" COEFFS 0 1 0 0 0 1 /end COMPU_METHOD
/begin CHARACTERISTIC FNVGT_PID_KI "" CURVE 0x577CC FD_FLOAT32_IEEE 0 FCY_FNVGT_PID_KI -10 10 /begin AXIS_DESCR STD_AXIS EOT_C FCX_FNVGT_PID_KI 14 -200 400 /end AXIS_DESCR /end CHARACTERISTIC
/begin COMPU_METHOD FCX_FNVGT_PID_KI "FNVGT_PID_KI X-axis conversion" RAT_FUNC "%10.5" "unitless" COEFFS 0 1 0 0 0 1 /end COMPU_METHOD
/begin COMPU_METHOD FCY_FNVGT_PID_KI "FNVGT_PID_KI Y-axis conversion" RAT_FUNC "%10.5" "unitless" COEFFS 0 1 0 0 0 1 /end COMPU_METHOD
/begin CHARACTERISTIC FNVGT_PID_KP "" CURVE 0x5783C FD_FLOAT32_IEEE 0 FCY_FNVGT_PID_KP -10 10 /begin AXIS_DESCR STD_AXIS EOT_C FCX_FNVGT_PID_KP 14 -200 400 /end AXIS_DESCR /end CHARACTERISTIC
/begin COMPU_METHOD FCX_FNVGT_PID_KP "FNVGT_PID_KP X-axis conversion" RAT_FUNC "%10.5" "unitless" COEFFS 0 1 0 0 0 1 /end COMPU_METHOD
/begin COMPU_METHOD FCY_FNVGT_PID_KP "FNVGT_PID_KP Y-axis conversion" RAT_FUNC "%10.5" "unitless" COEFFS 0 1 0 0 0 1 /end COMPU_METHOD
/begin CHARACTERISTIC FNVMOV_LOAD "MMinimum load as a function of ECT to infer the vehicle is moving" CURVE 0x448DC FD_FLOAT32_IEEE 0 FCY_FNVMOV_LOAD 0 1.999 /begin AXIS_DESCR STD_AXIS ECT FCX_FNVMOV_LOAD 7 -256 254 /end AXIS_DESCR /end CHARACTERISTIC
/begin COMPU_METHOD FCX_FNVMOV_LOAD "FNVMOV_LOAD X-axis conversion" RAT_FUNC "%10.5" "DEGF" COEFFS 0 1 0 0 0 1 /end COMPU_METHOD
/begin COMPU_METHOD FCY_FNVMOV_LOAD "FNVMOV_LOAD Y-axis conversion" RAT_FUNC "%10.5" "UNITLESS" COEFFS 0 1 0 0 0 1 /end COMPU_METHOD
/begin CHARACTERISTIC FNX300 "ICP crank steady state error minimum" CURVE 0x4323C FD_FLOAT32_IEEE 0 FCY_FNX300 0 65535 /begin AXIS_DESCR STD_AXIS NO_INPUT_QUANTITY FCX_FNX300 14 -40 150 /end AXIS_DESCR /end CHARACTERISTIC
/begin COMPU_METHOD FCX_FNX300 "FNX300 X-axis conversion" RAT_FUNC "%10.5" "unitless" COEFFS 0 1 0 0 0 1 /end COMPU_METHOD
/begin COMPU_METHOD FCY_FNX300 "FNX300 Y-axis conversion" RAT_FUNC "%10.5" "s" COEFFS 0 1 0 0 0 1 /end COMPU_METHOD
/begin CHARACTERISTIC FN_090_DP "" CURVE 0x53D4C FD_FLOAT32_IEEE 0 FCY_FN_090_DP 0 14 /begin AXIS_DESCR STD_AXIS N FCX_FN_090_DP 14 0 5000 /end AXIS_DESCR /end CHARACTERISTIC
/begin COMPU_METHOD FCX_FN_090_DP "FN_090_DP X-axis conversion" RAT_FUNC "%10.5" "unitless" COEFFS 0 1 0 0 0 1 /end COMPU_METHOD
/begin COMPU_METHOD FCY_FN_090_DP "FN_090_DP Y-axis conversion" RAT_FUNC "%10.5" "unitless" COEFFS 0 1 0 0 0 1 /end COMPU_METHOD
/begin CHARACTERISTIC FN_091_DP "" CURVE 0x53DBC FD_FLOAT32_IEEE 0 FCY_FN_091_DP 0 14 /begin AXIS_DESCR STD_AXIS MFDES FCX_FN_091_DP 14 0 150 /end AXIS_DESCR /end CHARACTERISTIC
/begin COMPU_METHOD FCX_FN_091_DP "FN_091_DP X-axis conversion" RAT_FUNC "%10.5" "unitless" COEFFS 0 1 0 0 0 1 /end COMPU_METHOD
/begin COMPU_METHOD FCY_FN_091_DP "FN_091_DP Y-axis conversion" RAT_FUNC "%10.5" "unitless" COEFFS 0 1 0 0 0 1 /end COMPU_METHOD
/begin CHARACTERISTIC FN_092_DP "" CURVE 0x53E9C FD_FLOAT32_IEEE 0 FCY_FN_092_DP 0 15 /begin AXIS_DESCR STD_AXIS DP_EGR_MFLW FCX_FN_092_DP 14 0 10000 /end AXIS_DESCR /end CHARACTERISTIC
/begin COMPU_METHOD FCX_FN_092_DP "FN_092_DP X-axis conversion" RAT_FUNC "%10.5" "unitless" COEFFS 0 1 0 0 0 1 /end COMPU_METHOD
/begin COMPU_METHOD FCY_FN_092_DP "FN_092_DP Y-axis conversion" RAT_FUNC "%10.5" "unitless" COEFFS 0 1 0 0 0 1 /end COMPU_METHOD
/begin CHARACTERISTIC FN_092_DP_A "" CURVE 0x53E2C FD_FLOAT32_IEEE 0 FCY_FN_092_DP_A 0 15 /begin AXIS_DESCR STD_AXIS MGP FCX_FN_092_DP_A 14 0 1e+06 /end AXIS_DESCR /end CHARACTERISTIC
/begin COMPU_METHOD FCX_FN_092_DP_A "FN_092_DP_A X-axis conversion" RAT_FUNC "%10.5" "unitless" COEFFS 0 1 0 0 0 1 /end COMPU_METHOD
/begin COMPU_METHOD FCY_FN_092_DP_A "FN_092_DP_A Y-axis conversion" RAT_FUNC "%10.5" "unitless" COEFFS 0 1 0 0 0 1 /end COMPU_METHOD
/begin CHARACTERISTIC FN_093_DP "" CURVE 0x53F0C FD_FLOAT32_IEEE 0 FCY_FN_093_DP 0 15 /begin AXIS_DESCR STD_AXIS DP_DP FCX_FN_093_DP 14 -150 50 /end AXIS_DESCR /end CHARACTERISTIC
/begin COMPU_METHOD FCX_FN_093_DP "FN_093_DP X-axis conversion" RAT_FUNC "%10.5" "unitless" COEFFS 0 1 0 0 0 1 /end COMPU_METHOD
/begin COMPU_METHOD FCY_FN_093_DP "FN_093_DP Y-axis conversion" RAT_FUNC "%10.5" "unitless" COEFFS 0 1 0 0 0 1 /end COMPU_METHOD
/begin CHARACTERISTIC FN_093_DP_A "" CURVE 0x53F7C FD_FLOAT32_IEEE 0 FCY_FN_093_DP_A 0 15 /begin AXIS_DESCR STD_AXIS MFDES FCX_FN_093_DP_A 14 -150 350 /end AXIS_DESCR /end CHARACTERISTIC
/begin COMPU_METHOD FCX_FN_093_DP_A "FN_093_DP_A X-axis conversion" RAT_FUNC "%10.5" "unitless" COEFFS 0 1 0 0 0 1 /end COMPU_METHOD
/begin COMPU_METHOD FCY_FN_093_DP_A "FN_093_DP_A Y-axis conversion" RAT_FUNC "%10.5" "unitless" COEFFS 0 1 0 0 0 1 /end COMPU_METHOD
/begin CHARACTERISTIC FN_095_DP "" CURVE 0x53FEC FD_FLOAT32_IEEE 0 FCY_FN_095_DP 0 15 /begin AXIS_DESCR STD_AXIS DP_EGRP_DES FCX_FN_095_DP 14 0 1 /end AXIS_DESCR /end CHARACTERISTIC
/begin COMPU_METHOD FCX_FN_095_DP "FN_095_DP X-axis conversion" RAT_FUNC "%10.5" "unitless" COEFFS 0 1 0 0 0 1 /end COMPU_METHOD
/begin COMPU_METHOD FCY_FN_095_DP "FN_095_DP Y-axis conversion" RAT_FUNC "%10.5" "unitless" COEFFS 0 1 0 0 0 1 /end COMPU_METHOD
/begin CHARACTERISTIC FN_1327[0] "Fuel Pulsewidth register map" VALUE 0x418B0 SD_UBYTE 0 SC_FN_1327 0 12 /end CHARACTERISTIC
/begin COMPU_METHOD SC_FN_1327 "FN_1327 conversion" RAT_FUNC "%3.0" "Unitless" COEFFS 0 1 0 0 0 1 /end COMPU_METHOD
/begin CHARACTERISTIC FN_1327[10] "Fuel Pulsewidth register map" VALUE 0x418BA SD_UBYTE 0 SC_FN_1327 0 12 /end CHARACTERISTIC
/begin CHARACTERISTIC FN_1327[11] "Fuel Pulsewidth register map" VALUE 0x418BB SD_UBYTE 0 SC_FN_1327 0 12 /end CHARACTERISTIC
/begin CHARACTERISTIC FN_1327[1] "Fuel Pulsewidth register map" VALUE 0x418B1 SD_UBYTE 0 SC_FN_1327 0 12 /end CHARACTERISTIC
/begin CHARACTERISTIC FN_1327[2] "Fuel Pulsewidth register map" VALUE 0x418B2 SD_UBYTE 0 SC_FN_1327 0 12 /end CHARACTERISTIC
/begin CHARACTERISTIC FN_1327[3] "Fuel Pulsewidth register map" VALUE 0x418B3 SD_UBYTE 0 SC_FN_1327 0 12 /end CHARACTERISTIC
/begin CHARACTERISTIC FN_1327[4] "Fuel Pulsewidth register map" VALUE 0x418B4 SD_UBYTE 0 SC_FN_1327 0 12 /end CHARACTERISTIC
/begin CHARACTERISTIC FN_1327[5] "Fuel Pulsewidth register map" VALUE 0x418B5 SD_UBYTE 0 SC_FN_1327 0 12 /end CHARACTERISTIC
/begin CHARACTERISTIC FN_1327[6] "Fuel Pulsewidth register map" VALUE 0x418B6 SD_UBYTE 0 SC_FN_1327 0 12 /end CHARACTERISTIC
/begin CHARACTERISTIC FN_1327[7] "Fuel Pulsewidth register map" VALUE 0x418B7 SD_UBYTE 0 SC_FN_1327 0 12 /end CHARACTERISTIC
/begin CHARACTERISTIC FN_1327[8] "Fuel Pulsewidth register map" VALUE 0x418B8 SD_UBYTE 0 SC_FN_1327 0 12 /end CHARACTERISTIC
/begin CHARACTERISTIC FN_1327[9] "Fuel Pulsewidth register map" VALUE 0x418B9 SD_UBYTE 0 SC_FN_1327 0 12 /end CHARACTERISTIC
/begin CHARACTERISTIC FN_1329[0] "Injector Firing Order" VALUE 0x418A4 SD_UBYTE 0 SC_FN_1329 1 12 /end CHARACTERISTIC
/begin COMPU_METHOD SC_FN_1329 "FN_1329 conversion" RAT_FUNC "%3.0" "Unitless" COEFFS 0 1 0 0 0 1 /end COMPU_METHOD
/begin CHARACTERISTIC FN_1329[10] "Injector Firing Order" VALUE 0x418AE SD_UBYTE 0 SC_FN_1329 1 12 /end CHARACTERISTIC
/begin CHARACTERISTIC FN_1329[11] "Injector Firing Order" VALUE 0x418AF SD_UBYTE 0 SC_FN_1329 1 12 /end CHARACTERISTIC
/begin CHARACTERISTIC FN_1329[1] "Injector Firing Order" VALUE 0x418A5 SD_UBYTE 0 SC_FN_1329 1 12 /end CHARACTERISTIC
/begin CHARACTERISTIC FN_1329[2] "Injector Firing Order" VALUE 0x418A6 SD_UBYTE 0 SC_FN_1329 1 12 /end CHARACTERISTIC
/begin CHARACTERISTIC FN_1329[3] "Injector Firing Order" VALUE 0x418A7 SD_UBYTE 0 SC_FN_1329 1 12 /end CHARACTERISTIC
/begin CHARACTERISTIC FN_1329[4] "Injector Firing Order" VALUE 0x418A8 SD_UBYTE 0 SC_FN_1329 1 12 /end CHARACTERISTIC
/begin CHARACTERISTIC FN_1329[5] "Injector Firing Order" VALUE 0x418A9 SD_UBYTE 0 SC_FN_1329 1 12 /end CHARACTERISTIC
/begin CHARACTERISTIC FN_1329[6] "Injector Firing Order" VALUE 0x418AA SD_UBYTE 0 SC_FN_1329 1 12 /end CHARACTERISTIC
/begin CHARACTERISTIC FN_1329[7] "Injector Firing Order" VALUE 0x418AB SD_UBYTE 0 SC_FN_1329 1 12 /end CHARACTERISTIC
/begin CHARACTERISTIC FN_1329[8] "Injector Firing Order" VALUE 0x418AC SD_UBYTE 0 SC_FN_1329 1 12 /end CHARACTERISTIC
/begin CHARACTERISTIC FN_1329[9] "Injector Firing Order" VALUE 0x418AD SD_UBYTE 0 SC_FN_1329 1 12 /end CHARACTERISTIC
/begin CHARACTERISTIC FN_AC_A_OFF "Delay between the system requesting the A/C off and the Air turn off as a function of engine speed." CURVE 0x4244C FD_FLOAT32_IEEE 0 FCY_FN_AC_A_OFF 0 63.999 /begin AXIS_DESCR STD_AXIS N FCX_FN_AC_A_OFF 6 0 8000 /end AXIS_DESCR /end CHARACTERISTIC
/begin COMPU_METHOD FCX_FN_AC_A_OFF "FN_AC_A_OFF X-axis conversion" RAT_FUNC "%10.5" "RPM" COEFFS 0 1 0 0 0 1 /end COMPU_METHOD
/begin COMPU_METHOD FCY_FN_AC_A_OFF "FN_AC_A_OFF Y-axis conversion" RAT_FUNC "%10.5" "s" COEFFS 0 1 0 0 0 1 /end COMPU_METHOD
/begin CHARACTERISTIC FN_AC_C_OFF "Delay between the system requesting the A/C off and the Clutch disengaging as a function of engine speed." CURVE 0x4247C FD_FLOAT32_IEEE 0 FCY_FN_AC_C_OFF 0 63.999 /begin AXIS_DESCR STD_AXIS N FCX_FN_AC_C_OFF 6 0 8000 /end AXIS_DESCR /end CHARACTERISTIC
/begin COMPU_METHOD FCX_FN_AC_C_OFF "FN_AC_C_OFF X-axis conversion" RAT_FUNC "%10.5" "RPM" COEFFS 0 1 0 0 0 1 /end COMPU_METHOD
/begin COMPU_METHOD FCY_FN_AC_C_OFF "FN_AC_C_OFF Y-axis conversion" RAT_FUNC "%10.5" "s" COEFFS 0 1 0 0 0 1 /end COMPU_METHOD
/begin CHARACTERISTIC FN_AFRMNH_A "X Norm=FN090_AFR_A, Y Norm=FN091_AFR_A" MAP 0x4753C TD_FLOAT32_IEEE 0 TCZ_FN_AFRMNH_A 0 100
 /begin AXIS_DESCR FIX_AXIS NO_INPUT_QUANTITY TCX_FN_AFRMNH_A 8 0 7 FIX_AXIS_PAR 0 0 8 /end AXIS_DESCR
 /begin AXIS_DESCR FIX_AXIS NO_INPUT_QUANTITY TCY_FN_AFRMNH_A 8 0 7 FIX_AXIS_PAR 0 0 8 /end AXIS_DESCR
/end CHARACTERISTIC
/begin COMPU_METHOD TCZ_FN_AFRMNH_A "FN_AFRMNH_A Z-axis conversion" RAT_FUNC "%10.5" "unitless" COEFFS 0 1 0 0 0 1 /end COMPU_METHOD
/begin COMPU_METHOD TCX_FN_AFRMNH_A "FN_AFRMNH_A X-axis conversion" RAT_FUNC "%10.5" "RPM" COEFFS 0 1 0 0 0 1 /end COMPU_METHOD
/begin COMPU_METHOD TCY_FN_AFRMNH_A "FN_AFRMNH_A Y-axis conversion" RAT_FUNC "%10.5" "g/s" COEFFS 0 1 0 0 0 1 /end COMPU_METHOD
/begin CHARACTERISTIC FN_AFRMNL_A "X Norm=FN090_AFR_A, Y Norm=FN091_AFR_A" MAP 0x4763C TD_FLOAT32_IEEE 0 TCZ_FN_AFRMNL_A 0 200
 /begin AXIS_DESCR FIX_AXIS NO_INPUT_QUANTITY TCX_FN_AFRMNL_A 8 0 7 FIX_AXIS_PAR 0 0 8 /end AXIS_DESCR
 /begin AXIS_DESCR FIX_AXIS NO_INPUT_QUANTITY TCY_FN_AFRMNL_A 8 0 7 FIX_AXIS_PAR 0 0 8 /end AXIS_DESCR
/end CHARACTERISTIC
/begin COMPU_METHOD TCZ_FN_AFRMNL_A "FN_AFRMNL_A Z-axis conversion" RAT_FUNC "%10.5" "unitless" COEFFS 0 1 0 0 0 1 /end COMPU_METHOD
/begin COMPU_METHOD TCX_FN_AFRMNL_A "FN_AFRMNL_A X-axis conversion" RAT_FUNC "%10.5" "RPM" COEFFS 0 1 0 0 0 1 /end COMPU_METHOD
/begin COMPU_METHOD TCY_FN_AFRMNL_A "FN_AFRMNL_A Y-axis conversion" RAT_FUNC "%10.5" "g/s" COEFFS 0 1 0 0 0 1 /end COMPU_METHOD
/begin CHARACTERISTIC FN_AFRMNPH_A "X Norm=FN090P_AFR_A, Y Norm=FN091P_AFR_A" MAP 0x4783C TD_FLOAT32_IEEE 0 TCZ_FN_AFRMNPH_A 0 200
 /begin AXIS_DESCR FIX_AXIS NO_INPUT_QUANTITY TCX_FN_AFRMNPH_A 8 0 7 FIX_AXIS_PAR 0 0 8 /end AXIS_DESCR
 /begin AXIS_DESCR FIX_AXIS NO_INPUT_QUANTITY TCY_FN_AFRMNPH_A 8 0 7 FIX_AXIS_PAR 0 0 8 /end AXIS_DESCR
/end CHARACTERISTIC
/begin COMPU_METHOD TCZ_FN_AFRMNPH_A "FN_AFRMNPH_A Z-axis conversion" RAT_FUNC "%10.5" "unitless" COEFFS 0 1 0 0 0 1 /end COMPU_METHOD
/begin COMPU_METHOD TCX_FN_AFRMNPH_A "FN_AFRMNPH_A X-axis conversion" RAT_FUNC "%10.5" "unitless" COEFFS 0 1 0 0 0 1 /end COMPU_METHOD
/begin COMPU_METHOD TCY_FN_AFRMNPH_A "FN_AFRMNPH_A Y-axis conversion" RAT_FUNC "%10.5" "g/s" COEFFS 0 1 0 0 0 1 /end COMPU_METHOD
/begin CHARACTERISTIC FN_AFRMNPL_A "X Norm=FN090P_AFR_A, Y Norm=FN091P_AFR_A" MAP 0x4773C TD_FLOAT32_IEEE 0 TCZ_FN_AFRMNPL_A 0 200
 /begin AXIS_DESCR FIX_AXIS NO_INPUT_QUANTITY TCX_FN_AFRMNPL_A 8 0 7 FIX_AXIS_PAR 0 0 8 /end AXIS_DESCR
 /begin AXIS_DESCR FIX_AXIS NO_INPUT_QUANTITY TCY_FN_AFRMNPL_A 8 0 7 FIX_AXIS_PAR 0 0 8 /end AXIS_DESCR
/end CHARACTERISTIC
/begin COMPU_METHOD TCZ_FN_AFRMNPL_A "FN_AFRMNPL_A Z-axis conversion" RAT_FUNC "%10.5" "unitless" COEFFS 0 1 0 0 0 1 /end COMPU_METHOD
/begin COMPU_METHOD TCX_FN_AFRMNPL_A "FN_AFRMNPL_A X-axis conversion" RAT_FUNC "%10.5" "unitless" COEFFS 0 1 0 0 0 1 /end COMPU_METHOD
/begin COMPU_METHOD TCY_FN_AFRMNPL_A "FN_AFRMNPL_A Y-axis conversion" RAT_FUNC "%10.5" "g/s" COEFFS 0 1 0 0 0 1 /end COMPU_METHOD
/begin CHARACTERISTIC FN_BP2ALT "Barometric pressure multiplier function" CURVE 0x4290C FD_FLOAT32_IEEE 0 FCY_FN_BP2ALT 0 2 /begin AXIS_DESCR STD_AXIS NO_INPUT_QUANTITY FCX_FN_BP2ALT 8 0 300 /end AXIS_DESCR /end CHARACTERISTIC
/begin COMPU_METHOD FCX_FN_BP2ALT "FN_BP2ALT X-axis conversion" RAT_FUNC "%10.5" "unitless" COEFFS 0 1 0 0 0 1 /end COMPU_METHOD
/begin COMPU_METHOD FCY_FN_BP2ALT "FN_BP2ALT Y-axis conversion" RAT_FUNC "%10.5" "unitless" COEFFS 0 1 0 0 0 1 /end COMPU_METHOD
/begin CHARACTERISTIC FN_BP2ALT_DIT "DIT altitude multiplier factor table" CURVE 0x48DEC FD_FLOAT32_IEEE 0 FCY_FN_BP2ALT_DIT -100 200 /begin AXIS_DESCR STD_AXIS BP_KPA FCX_FN_BP2ALT_DIT 14 0 2000 /end AXIS_DESCR /end CHARACTERISTIC
/begin COMPU_METHOD FCX_FN_BP2ALT_DIT "FN_BP2ALT_DIT X-axis conversion" RAT_FUNC "%10.5" "kPa" COEFFS 0 1 0 0 0 1 /end COMPU_METHOD
/begin COMPU_METHOD FCY_FN_BP2ALT_DIT "FN_BP2ALT_DIT Y-axis conversion" RAT_FUNC "%10.5" "unitless" COEFFS 0 1 0 0 0 1 /end COMPU_METHOD
/begin CHARACTERISTIC FN_COND_MULT_ROC "" CURVE 0x5405C FD_FLOAT32_IEEE 0 FCY_FN_COND_MULT_ROC -1 2 /begin AXIS_DESCR STD_AXIS N FCX_FN_COND_MULT_ROC 14 0 5500 /end AXIS_DESCR /end CHARACTERISTIC
/begin COMPU_METHOD FCX_FN_COND_MULT_ROC "FN_COND_MULT_ROC X-axis conversion" RAT_FUNC "%10.5" "unitless" COEFFS 0 1 0 0 0 1 /end COMPU_METHOD
/begin COMPU_METHOD FCY_FN_COND_MULT_ROC "FN_COND_MULT_ROC Y-axis conversion" RAT_FUNC "%10.5" "unitless" COEFFS 0 1 0 0 0 1 /end COMPU_METHOD
/begin CHARACTERISTIC FN_DP_ANTI_FOUL "" CURVE 0x540CC FD_FLOAT32_IEEE 0 FCY_FN_DP_ANTI_FOUL 0 15 /begin AXIS_DESCR STD_AXIS EOT_C FCX_FN_DP_ANTI_FOUL 14 -40 150 /end AXIS_DESCR /end CHARACTERISTIC
/begin COMPU_METHOD FCX_FN_DP_ANTI_FOUL "FN_DP_ANTI_FOUL X-axis conversion" RAT_FUNC "%10.5" "unitless" COEFFS 0 1 0 0 0 1 /end COMPU_METHOD
/begin COMPU_METHOD FCY_FN_DP_ANTI_FOUL "FN_DP_ANTI_FOUL Y-axis conversion" RAT_FUNC "%10.5" "unitless" COEFFS 0 1 0 0 0 1 /end COMPU_METHOD
/begin CHARACTERISTIC FN_DP_ANTI_FOUL_MLT "" CURVE 0x5413C FD_FLOAT32_IEEE 0 FCY_FN_DP_ANTI_FOUL_MLT 0 10
 /begin AXIS_DESCR STD_AXIS DP_ANTI_FOUL_TMR FCX_FN_DP_ANTI_FOUL_MLT 14 0 2048 /end AXIS_DESCR
/end CHARACTERISTIC
/begin COMPU_METHOD FCX_FN_DP_ANTI_FOUL_MLT "FN_DP_ANTI_FOUL_MLT X-axis conversion" RAT_FUNC "%10.5" "s" COEFFS 0 1 0 0 0 1 /end COMPU_METHOD
/begin COMPU_METHOD FCY_FN_DP_ANTI_FOUL_MLT "FN_DP_ANTI_FOUL_MLT Y-axis conversion" RAT_FUNC "%10.5" "unitless" COEFFS 0 1 0 0 0 1 /end COMPU_METHOD
/begin CHARACTERISTIC FN_DP_EGRPCT_LMX "" CURVE 0x541AC FD_FLOAT32_IEEE 0 FCY_FN_DP_EGRPCT_LMX 0 15 /begin AXIS_DESCR STD_AXIS DP_TOT_MASS_FLOW FCX_FN_DP_EGRPCT_LMX 14 0 50000 /end AXIS_DESCR /end CHARACTERISTIC
/begin COMPU_METHOD FCX_FN_DP_EGRPCT_LMX "FN_DP_EGRPCT_LMX X-axis conversion" RAT_FUNC "%10.5" "unitless" COEFFS 0 1 0 0 0 1 /end COMPU_METHOD
/begin COMPU_METHOD FCY_FN_DP_EGRPCT_LMX "FN_DP_EGRPCT_LMX Y-axis conversion" RAT_FUNC "%10.5" "unitless" COEFFS 0 1 0 0 0 1 /end COMPU_METHOD
/begin CHARACTERISTIC FN_DP_EGRVP_DES "X Norm=FN_092_DP, Y Norm=FN_093_DP" MAP 0x55A9C TD_FLOAT32_IEEE 0 TCZ_FN_DP_EGRVP_DES 0 1
 /begin AXIS_DESCR FIX_AXIS NO_INPUT_QUANTITY TCX_FN_DP_EGRVP_DES 14 0 13 FIX_AXIS_PAR 0 0 14 /end AXIS_DESCR
 /begin AXIS_DESCR FIX_AXIS NO_INPUT_QUANTITY TCY_FN_DP_EGRVP_DES 14 0 13 FIX_AXIS_PAR 0 0 14 /end AXIS_DESCR
/end CHARACTERISTIC
/begin COMPU_METHOD TCZ_FN_DP_EGRVP_DES "FN_DP_EGRVP_DES Z-axis conversion" RAT_FUNC "%10.5" "unitless" COEFFS 0 1 0 0 0 1 /end COMPU_METHOD
/begin COMPU_METHOD TCX_FN_DP_EGRVP_DES "FN_DP_EGRVP_DES X-axis conversion" RAT_FUNC "%10.5" "unitless" COEFFS 0 1 0 0 0 1 /end COMPU_METHOD
/begin COMPU_METHOD TCY_FN_DP_EGRVP_DES "FN_DP_EGRVP_DES Y-axis conversion" RAT_FUNC "%10.5" "unitless" COEFFS 0 1 0 0 0 1 /end COMPU_METHOD
/begin CHARACTERISTIC FN_DP_EGR_FF_A "X Norm=FN_092_DP_A, Y Norm=FN_095_DP" MAP 0x5452C TD_FLOAT32_IEEE 0 TCZ_FN_DP_EGR_FF_A 0 1
 /begin AXIS_DESCR FIX_AXIS NO_INPUT_QUANTITY TCX_FN_DP_EGR_FF_A 14 0 13 FIX_AXIS_PAR 0 0 14 /end AXIS_DESCR
 /begin AXIS_DESCR FIX_AXIS NO_INPUT_QUANTITY TCY_FN_DP_EGR_FF_A 14 0 13 FIX_AXIS_PAR 0 0 14 /end AXIS_DESCR
/end CHARACTERISTIC
/begin COMPU_METHOD TCZ_FN_DP_EGR_FF_A "FN_DP_EGR_FF_A Z-axis conversion" RAT_FUNC "%10.5" "unitless" COEFFS 0 1 0 0 0 1 /end COMPU_METHOD
/begin COMPU_METHOD TCX_FN_DP_EGR_FF_A "FN_DP_EGR_FF_A X-axis conversion" RAT_FUNC "%10.5" "unitless" COEFFS 0 1 0 0 0 1 /end COMPU_METHOD
/begin COMPU_METHOD TCY_FN_DP_EGR_FF_A "FN_DP_EGR_FF_A Y-axis conversion" RAT_FUNC "%10.5" "unitless" COEFFS 0 1 0 0 0 1 /end COMPU_METHOD
/begin CHARACTERISTIC FN_DP_EGR_PCT_DES_HI "X Norm=FN_090_DP, Y Norm=FN_091_DP" MAP 0x5483C TD_FLOAT32_IEEE 0 TCZ_FN_DP_EGR_PCT_DES_HI 0 100
 /begin AXIS_DESCR FIX_AXIS NO_INPUT_QUANTITY TCX_FN_DP_EGR_PCT_DES_HI 14 0 13 FIX_AXIS_PAR 0 0 14 /end AXIS_DESCR
 /begin AXIS_DESCR FIX_AXIS NO_INPUT_QUANTITY TCY_FN_DP_EGR_PCT_DES_HI 14 0 13 FIX_AXIS_PAR 0 0 14 /end AXIS_DESCR
/end CHARACTERISTIC
/begin COMPU_METHOD TCZ_FN_DP_EGR_PCT_DES_HI "FN_DP_EGR_PCT_DES_HI Z-axis conversion" RAT_FUNC "%10.5" "unitless" COEFFS 0 1 0 0 0 1 /end COMPU_METHOD
/begin COMPU_METHOD TCX_FN_DP_EGR_PCT_DES_HI "FN_DP_EGR_PCT_DES_HI X-axis conversion" RAT_FUNC "%10.5" "unitless" COEFFS 0 1 0 0 0 1 /end COMPU_METHOD
/begin COMPU_METHOD TCY_FN_DP_EGR_PCT_DES_HI "FN_DP_EGR_PCT_DES_HI Y-axis conversion" RAT_FUNC "%10.5" "unitless" COEFFS 0 1 0 0 0 1 /end COMPU_METHOD
/begin CHARACTERISTIC FN_DP_EGR_PCT_DES_LO "X Norm=FN_090_DP, Y Norm=FN_091_DP" MAP 0x54B4C TD_FLOAT32_IEEE 0 TCZ_FN_DP_EGR_PCT_DES_LO 0 100
 /begin AXIS_DESCR FIX_AXIS NO_INPUT_QUANTITY TCX_FN_DP_EGR_PCT_DES_LO 14 0 13 FIX_AXIS_PAR 0 0 14 /end AXIS_DESCR
 /begin AXIS_DESCR FIX_AXIS NO_INPUT_QUANTITY TCY_FN_DP_EGR_PCT_DES_LO 14 0 13 FIX_AXIS_PAR 0 0 14 /end AXIS_DESCR
/end CHARACTERISTIC
/begin COMPU_METHOD TCZ_FN_DP_EGR_PCT_DES_LO "FN_DP_EGR_PCT_DES_LO Z-axis conversion" RAT_FUNC "%10.5" "unitless" COEFFS 0 1 0 0 0 1 /end COMPU_METHOD
/begin COMPU_METHOD TCX_FN_DP_EGR_PCT_DES_LO "FN_DP_EGR_PCT_DES_LO X-axis conversion" RAT_FUNC "%10.5" "unitless" COEFFS 0 1 0 0 0 1 /end COMPU_METHOD
/begin COMPU_METHOD TCY_FN_DP_EGR_PCT_DES_LO "FN_DP_EGR_PCT_DES_LO Y-axis conversion" RAT_FUNC "%10.5" "unitless" COEFFS 0 1 0 0 0 1 /end COMPU_METHOD
/begin CHARACTERISTIC FN_DP_MAT_MULT "" CURVE 0x5421C FD_FLOAT32_IEEE 0 FCY_FN_DP_MAT_MULT -200 200 /begin AXIS_DESCR STD_AXIS MAT FCX_FN_DP_MAT_MULT 14 -200 200 /end AXIS_DESCR /end CHARACTERISTIC
/begin COMPU_METHOD FCX_FN_DP_MAT_MULT "FN_DP_MAT_MULT X-axis conversion" RAT_FUNC "%10.5" "degC" COEFFS 0 1 0 0 0 1 /end COMPU_METHOD
/begin COMPU_METHOD FCY_FN_DP_MAT_MULT "FN_DP_MAT_MULT Y-axis conversion" RAT_FUNC "%10.5" "unitless" COEFFS 0 1 0 0 0 1 /end COMPU_METHOD
/begin CHARACTERISTIC FN_DP_PLUS "" CURVE 0x5428C FD_FLOAT32_IEEE 0 FCY_FN_DP_PLUS 0 1 /begin AXIS_DESCR STD_AXIS DP_DP FCX_FN_DP_PLUS 14 -150 50 /end AXIS_DESCR /end CHARACTERISTIC
/begin COMPU_METHOD FCX_FN_DP_PLUS "FN_DP_PLUS X-axis conversion" RAT_FUNC "%10.5" "unitless" COEFFS 0 1 0 0 0 1 /end COMPU_METHOD
/begin COMPU_METHOD FCY_FN_DP_PLUS "FN_DP_PLUS Y-axis conversion" RAT_FUNC "%10.5" "unitless" COEFFS 0 1 0 0 0 1 /end COMPU_METHOD
/begin CHARACTERISTIC FN_DP_VOL_EFF_A "X Norm=FN_090_DP, Y Norm=FN_093_DP_A" MAP 0x55DAC TD_FLOAT32_IEEE 0 TCZ_FN_DP_VOL_EFF_A 0 100
 /begin AXIS_DESCR FIX_AXIS NO_INPUT_QUANTITY TCX_FN_DP_VOL_EFF_A 14 0 13 FIX_AXIS_PAR 0 0 14 /end AXIS_DESCR
 /begin AXIS_DESCR FIX_AXIS NO_INPUT_QUANTITY TCY_FN_DP_VOL_EFF_A 14 0 13 FIX_AXIS_PAR 0 0 14 /end AXIS_DESCR
/end CHARACTERISTIC
/begin COMPU_METHOD TCZ_FN_DP_VOL_EFF_A "FN_DP_VOL_EFF_A Z-axis conversion" RAT_FUNC "%10.5" "unitless" COEFFS 0 1 0 0 0 1 /end COMPU_METHOD
/begin COMPU_METHOD TCX_FN_DP_VOL_EFF_A "FN_DP_VOL_EFF_A X-axis conversion" RAT_FUNC "%10.5" "unitless" COEFFS 0 1 0 0 0 1 /end COMPU_METHOD
/begin COMPU_METHOD TCY_FN_DP_VOL_EFF_A "FN_DP_VOL_EFF_A Y-axis conversion" RAT_FUNC "%10.5" "unitless" COEFFS 0 1 0 0 0 1 /end COMPU_METHOD
/begin CHARACTERISTIC FN_DUAL_ALT_ADD "Additional Crank fuel function for dual alternator trucks" CURVE 0x4506C FD_FLOAT32_IEEE 0 FCY_FN_DUAL_ALT_ADD -2048 2047 /begin AXIS_DESCR STD_AXIS EOT_C FCX_FN_DUAL_ALT_ADD 8 -8192 8191 /end AXIS_DESCR /end CHARACTERISTIC
/begin COMPU_METHOD FCX_FN_DUAL_ALT_ADD "FN_DUAL_ALT_ADD X-axis conversion" RAT_FUNC "%10.5" "degC" COEFFS 0 1 0 0 0 1 /end COMPU_METHOD
/begin COMPU_METHOD FCY_FN_DUAL_ALT_ADD "FN_DUAL_ALT_ADD Y-axis conversion" RAT_FUNC "%10.5" "unitless" COEFFS 0 1 0 0 0 1 /end COMPU_METHOD
/begin CHARACTERISTIC FN_ECT_THLD_ECT_COLD "" CURVE 0x42EFC FD_FLOAT32_IEEE 0 FCY_FN_ECT_THLD_ECT_COLD 0 65535 /begin AXIS_DESCR STD_AXIS ECT_C FCX_FN_ECT_THLD_ECT_COLD 14 -4096 4095.88 /end AXIS_DESCR /end CHARACTERISTIC
/begin COMPU_METHOD FCX_FN_ECT_THLD_ECT_COLD "FN_ECT_THLD_ECT_COLD X-axis conversion" RAT_FUNC "%10.5" "degC" COEFFS 0 1 0 0 0 1 /end COMPU_METHOD
/begin COMPU_METHOD FCY_FN_ECT_THLD_ECT_COLD "FN_ECT_THLD_ECT_COLD Y-axis conversion" RAT_FUNC "%10.5" "unitless" COEFFS 0 1 0 0 0 1 /end COMPU_METHOD
/begin CHARACTERISTIC FN_ECT_THLD_ECT_HOT "" CURVE 0x42E1C FD_FLOAT32_IEEE 0 FCY_FN_ECT_THLD_ECT_HOT 0 65535 /begin AXIS_DESCR STD_AXIS ECT_C FCX_FN_ECT_THLD_ECT_HOT 14 -4096 4095.88 /end AXIS_DESCR /end CHARACTERISTIC
/begin COMPU_METHOD FCX_FN_ECT_THLD_ECT_HOT "FN_ECT_THLD_ECT_HOT X-axis conversion" RAT_FUNC "%10.5" "degC" COEFFS 0 1 0 0 0 1 /end COMPU_METHOD
/begin COMPU_METHOD FCY_FN_ECT_THLD_ECT_HOT "FN_ECT_THLD_ECT_HOT Y-axis conversion" RAT_FUNC "%10.5" "unitless" COEFFS 0 1 0 0 0 1 /end COMPU_METHOD
/begin CHARACTERISTIC FN_ECT_THLD_IAT_COLD "" CURVE 0x42E8C FD_FLOAT32_IEEE 0 FCY_FN_ECT_THLD_IAT_COLD 0 65535 /begin AXIS_DESCR STD_AXIS IAT FCX_FN_ECT_THLD_IAT_COLD 14 -4096 4095.88 /end AXIS_DESCR /end CHARACTERISTIC
/begin COMPU_METHOD FCX_FN_ECT_THLD_IAT_COLD "FN_ECT_THLD_IAT_COLD X-axis conversion" RAT_FUNC "%10.5" "degC" COEFFS 0 1 0 0 0 1 /end COMPU_METHOD
/begin COMPU_METHOD FCY_FN_ECT_THLD_IAT_COLD "FN_ECT_THLD_IAT_COLD Y-axis conversion" RAT_FUNC "%10.5" "unitless" COEFFS 0 1 0 0 0 1 /end COMPU_METHOD
/begin CHARACTERISTIC FN_ECT_THLD_IAT_HOT "" CURVE 0x42DAC FD_FLOAT32_IEEE 0 FCY_FN_ECT_THLD_IAT_HOT 0 65535 /begin AXIS_DESCR STD_AXIS IAT FCX_FN_ECT_THLD_IAT_HOT 14 -4096 4095.88 /end AXIS_DESCR /end CHARACTERISTIC
/begin COMPU_METHOD FCX_FN_ECT_THLD_IAT_HOT "FN_ECT_THLD_IAT_HOT X-axis conversion" RAT_FUNC "%10.5" "degC" COEFFS 0 1 0 0 0 1 /end COMPU_METHOD
/begin COMPU_METHOD FCY_FN_ECT_THLD_IAT_HOT "FN_ECT_THLD_IAT_HOT Y-axis conversion" RAT_FUNC "%10.5" "unitless" COEFFS 0 1 0 0 0 1 /end COMPU_METHOD
/begin CHARACTERISTIC FN_ECT_THLD_TST_TM "Threshold monitor timer output comparison table." CURVE 0x42F6C FD_FLOAT32_IEEE 0 FCY_FN_ECT_THLD_TST_TM 0 64 /begin AXIS_DESCR STD_AXIS ECT_C FCX_FN_ECT_THLD_TST_TM 14 -100 400 /end AXIS_DESCR /end CHARACTERISTIC
/begin COMPU_METHOD FCX_FN_ECT_THLD_TST_TM "FN_ECT_THLD_TST_TM X-axis conversion" RAT_FUNC "%10.5" "degC" COEFFS 0 1 0 0 0 1 /end COMPU_METHOD
/begin COMPU_METHOD FCY_FN_ECT_THLD_TST_TM "FN_ECT_THLD_TST_TM Y-axis conversion" RAT_FUNC "%10.5" "unitless" COEFFS 0 1 0 0 0 1 /end COMPU_METHOD
/begin CHARACTERISTIC FN_EGR_MFN_TRNS_MULT "X Norm=FN_N_DIF_EGR, Y Norm=FN_MFDES_DIF_EGR" MAP 0x5439C TD_FLOAT32_IEEE 0 TCZ_FN_EGR_MFN_TRNS_MULT 0 2
 /begin AXIS_DESCR FIX_AXIS NO_INPUT_QUANTITY TCX_FN_EGR_MFN_TRNS_MULT 10 0 9 FIX_AXIS_PAR 0 0 10 /end AXIS_DESCR
 /begin AXIS_DESCR FIX_AXIS NO_INPUT_QUANTITY TCY_FN_EGR_MFN_TRNS_MULT 10 0 9 FIX_AXIS_PAR 0 0 10 /end AXIS_DESCR
/end CHARACTERISTIC
/begin COMPU_METHOD TCZ_FN_EGR_MFN_TRNS_MULT "FN_EGR_MFN_TRNS_MULT Z-axis conversion" RAT_FUNC "%10.5" "unitless" COEFFS 0 1 0 0 0 1 /end COMPU_METHOD
/begin COMPU_METHOD TCX_FN_EGR_MFN_TRNS_MULT "FN_EGR_MFN_TRNS_MULT X-axis conversion" RAT_FUNC "%10.5" "RPM" COEFFS 0 1 0 0 0 1 /end COMPU_METHOD
/begin COMPU_METHOD TCY_FN_EGR_MFN_TRNS_MULT "FN_EGR_MFN_TRNS_MULT Y-axis conversion" RAT_FUNC "%10.5" "unitless" COEFFS 0 1 0 0 0 1 /end COMPU_METHOD
/begin CHARACTERISTIC FN_EOTN "Max engine speed for pilot based on engine oil temp" CURVE 0x486FC FD_FLOAT32_IEEE 0 FCY_FN_EOTN 0 6000 /begin AXIS_DESCR STD_AXIS EOT_C FCX_FN_EOTN 14 -40 150 /end AXIS_DESCR /end CHARACTERISTIC
/begin COMPU_METHOD FCX_FN_EOTN "FN_EOTN X-axis conversion" RAT_FUNC "%10.5" "degC" COEFFS 0 1 0 0 0 1 /end COMPU_METHOD
/begin COMPU_METHOD FCY_FN_EOTN "FN_EOTN Y-axis conversion" RAT_FUNC "%10.5" "RPM" COEFFS 0 1 0 0 0 1 /end COMPU_METHOD
/begin CHARACTERISTIC FN_EOT_IPR_FLOW "Normalization function" CURVE 0x4B924 FD_FLOAT32_IEEE 0 FCY_FN_EOT_IPR_FLOW 0 20 /begin AXIS_DESCR STD_AXIS EOT_C FCX_FN_EOT_IPR_FLOW 14 -150 350 /end AXIS_DESCR /end CHARACTERISTIC
/begin COMPU_METHOD FCX_FN_EOT_IPR_FLOW "FN_EOT_IPR_FLOW X-axis conversion" RAT_FUNC "%10.5" "degC" COEFFS 0 1 0 0 0 1 /end COMPU_METHOD
/begin COMPU_METHOD FCY_FN_EOT_IPR_FLOW "FN_EOT_IPR_FLOW Y-axis conversion" RAT_FUNC "%10.5" "unitless" COEFFS 0 1 0 0 0 1 /end COMPU_METHOD
/begin CHARACTERISTIC FN_EOT_THLD_EOT_COLD "EOT cold error threshold count table based on EOT value" CURVE 0x42BEC FD_FLOAT32_IEEE 0 FCY_FN_EOT_THLD_EOT_COLD 0 65535 /begin AXIS_DESCR STD_AXIS EOT_C FCX_FN_EOT_THLD_EOT_COLD 14 -8192 8191 /end AXIS_DESCR /end CHARACTERISTIC
/begin COMPU_METHOD FCX_FN_EOT_THLD_EOT_COLD "FN_EOT_THLD_EOT_COLD X-axis conversion" RAT_FUNC "%10.5" "degC" COEFFS 0 1 0 0 0 1 /end COMPU_METHOD
/begin COMPU_METHOD FCY_FN_EOT_THLD_EOT_COLD "FN_EOT_THLD_EOT_COLD Y-axis conversion" RAT_FUNC "%10.5" "unitless" COEFFS 0 1 0 0 0 1 /end COMPU_METHOD
/begin CHARACTERISTIC FN_EOT_THLD_EOT_HOT "EOT hot error threshold count table based on EOT value" CURVE 0x42B0C FD_FLOAT32_IEEE 0 FCY_FN_EOT_THLD_EOT_HOT 0 65535 /begin AXIS_DESCR STD_AXIS EOT_C FCX_FN_EOT_THLD_EOT_HOT 14 -8192 8191 /end AXIS_DESCR /end CHARACTERISTIC
/begin COMPU_METHOD FCX_FN_EOT_THLD_EOT_HOT "FN_EOT_THLD_EOT_HOT X-axis conversion" RAT_FUNC "%10.5" "degC" COEFFS 0 1 0 0 0 1 /end COMPU_METHOD
/begin COMPU_METHOD FCY_FN_EOT_THLD_EOT_HOT "FN_EOT_THLD_EOT_HOT Y-axis conversion" RAT_FUNC "%10.5" "unitless" COEFFS 0 1 0 0 0 1 /end COMPU_METHOD
/begin CHARACTERISTIC FN_EOT_THLD_IAT_COLD "EOT  cold error threshold count table based on IAT value." CURVE 0x42B7C FD_FLOAT32_IEEE 0 FCY_FN_EOT_THLD_IAT_COLD -65535 65535 /begin AXIS_DESCR STD_AXIS IAT FCX_FN_EOT_THLD_IAT_COLD 14 -4096 4095.88 /end AXIS_DESCR /end CHARACTERISTIC
/begin COMPU_METHOD FCX_FN_EOT_THLD_IAT_COLD "FN_EOT_THLD_IAT_COLD X-axis conversion" RAT_FUNC "%10.5" "degC" COEFFS 0 1 0 0 0 1 /end COMPU_METHOD
/begin COMPU_METHOD FCY_FN_EOT_THLD_IAT_COLD "FN_EOT_THLD_IAT_COLD Y-axis conversion" RAT_FUNC "%10.5" "unitless" COEFFS 0 1 0 0 0 1 /end COMPU_METHOD
/begin CHARACTERISTIC FN_EOT_THLD_IAT_HOT "EOT hot error threshold count table based on IAT value." CURVE 0x42A9C FD_FLOAT32_IEEE 0 FCY_FN_EOT_THLD_IAT_HOT -65535 65535 /begin AXIS_DESCR STD_AXIS IAT FCX_FN_EOT_THLD_IAT_HOT 14 -4096 4095.88 /end AXIS_DESCR /end CHARACTERISTIC
/begin COMPU_METHOD FCX_FN_EOT_THLD_IAT_HOT "FN_EOT_THLD_IAT_HOT X-axis conversion" RAT_FUNC "%10.5" "degC" COEFFS 0 1 0 0 0 1 /end COMPU_METHOD
/begin COMPU_METHOD FCY_FN_EOT_THLD_IAT_HOT "FN_EOT_THLD_IAT_HOT Y-axis conversion" RAT_FUNC "%10.5" "unitless" COEFFS 0 1 0 0 0 1 /end COMPU_METHOD
/begin CHARACTERISTIC FN_EOT_THLD_TST_TM "EOT threshold timer counter table." CURVE 0x42A2C FD_FLOAT32_IEEE 0 FCY_FN_EOT_THLD_TST_TM 0 6000 /begin AXIS_DESCR STD_AXIS EOT_C FCX_FN_EOT_THLD_TST_TM 14 -100 400 /end AXIS_DESCR /end CHARACTERISTIC
/begin COMPU_METHOD FCX_FN_EOT_THLD_TST_TM "FN_EOT_THLD_TST_TM X-axis conversion" RAT_FUNC "%10.5" "degC" COEFFS 0 1 0 0 0 1 /end COMPU_METHOD
/begin COMPU_METHOD FCY_FN_EOT_THLD_TST_TM "FN_EOT_THLD_TST_TM Y-axis conversion" RAT_FUNC "%10.5" "s" COEFFS 0 1 0 0 0 1 /end COMPU_METHOD
/begin CHARACTERISTIC FN_FRICTION "X Norm=FNN_FRICT_NORM, Y Norm=FNEOTC_FRICT_NORM" MAP 0x4F01C TD_FLOAT32_IEEE 0 TCZ_FN_FRICTION 0 500
 /begin AXIS_DESCR FIX_AXIS NO_INPUT_QUANTITY TCX_FN_FRICTION 14 0 13 FIX_AXIS_PAR 0 0 14 /end AXIS_DESCR
 /begin AXIS_DESCR FIX_AXIS NO_INPUT_QUANTITY TCY_FN_FRICTION 14 0 13 FIX_AXIS_PAR 0 0 14 /end AXIS_DESCR
/end CHARACTERISTIC
/begin COMPU_METHOD TCZ_FN_FRICTION "FN_FRICTION Z-axis conversion" RAT_FUNC "%10.5" "unitless" COEFFS 0 1 0 0 0 1 /end COMPU_METHOD
/begin COMPU_METHOD TCX_FN_FRICTION "FN_FRICTION X-axis conversion" RAT_FUNC "%10.5" "unitless" COEFFS 0 1 0 0 0 1 /end COMPU_METHOD
/begin COMPU_METHOD TCY_FN_FRICTION "FN_FRICTION Y-axis conversion" RAT_FUNC "%10.5" "unitless" COEFFS 0 1 0 0 0 1 /end COMPU_METHOD
/begin CHARACTERISTIC FN_FRICTION_COPY "X Norm=FN_TQ118, Y Norm=FNEOTC_FRICT_NORM, Output is the engine torque at a given engine speed and eot." MAP 0x52A6C TD_FLOAT32_IEEE 0 TCZ_FN_FRICTION_COPY 0 500
 /begin AXIS_DESCR FIX_AXIS NO_INPUT_QUANTITY TCX_FN_FRICTION_COPY 14 0 13 FIX_AXIS_PAR 0 0 14 /end AXIS_DESCR
 /begin AXIS_DESCR FIX_AXIS NO_INPUT_QUANTITY TCY_FN_FRICTION_COPY 14 0 13 FIX_AXIS_PAR 0 0 14 /end AXIS_DESCR
/end CHARACTERISTIC
/begin COMPU_METHOD TCZ_FN_FRICTION_COPY "FN_FRICTION_COPY Z-axis conversion" RAT_FUNC "%10.5" "lbf*ft" COEFFS 0 1 0 0 0 1 /end COMPU_METHOD
/begin COMPU_METHOD TCX_FN_FRICTION_COPY "FN_FRICTION_COPY X-axis conversion" RAT_FUNC "%10.5" "unitless" COEFFS 0 1 0 0 0 1 /end COMPU_METHOD
/begin COMPU_METHOD TCY_FN_FRICTION_COPY "FN_FRICTION_COPY Y-axis conversion" RAT_FUNC "%10.5" "unitless" COEFFS 0 1 0 0 0 1 /end COMPU_METHOD
/begin CHARACTERISTIC FN_HIALT_MN "X Norm=FN090DS_TQ, Y Norm=FN091DS_TQ" MAP 0x4DA3C TD_FLOAT32_IEEE 0 TCZ_FN_HIALT_MN -500 1000
 /begin AXIS_DESCR FIX_AXIS NO_INPUT_QUANTITY TCX_FN_HIALT_MN 14 0 13 FIX_AXIS_PAR 0 0 14 /end AXIS_DESCR
 /begin AXIS_DESCR FIX_AXIS NO_INPUT_QUANTITY TCY_FN_HIALT_MN 14 0 13 FIX_AXIS_PAR 0 0 14 /end AXIS_DESCR
/end CHARACTERISTIC
/begin COMPU_METHOD TCZ_FN_HIALT_MN "FN_HIALT_MN Z-axis conversion" RAT_FUNC "%10.5" "unitless" COEFFS 0 1 0 0 0 1 /end COMPU_METHOD
/begin COMPU_METHOD TCX_FN_HIALT_MN "FN_HIALT_MN X-axis conversion" RAT_FUNC "%10.5" "unitless" COEFFS 0 1 0 0 0 1 /end COMPU_METHOD
/begin COMPU_METHOD TCY_FN_HIALT_MN "FN_HIALT_MN Y-axis conversion" RAT_FUNC "%10.5" "unitless" COEFFS 0 1 0 0 0 1 /end COMPU_METHOD
/begin CHARACTERISTIC FN_HIALT_MN_COPY "X Norm=FN_TQ114, Y Norm=FN_TQ120, Copy of fn_hialt_mn from the torque calculator" MAP 0x504EC TD_FLOAT32_IEEE 0 TCZ_FN_HIALT_MN_COPY -500 1000
 /begin AXIS_DESCR FIX_AXIS NO_INPUT_QUANTITY TCX_FN_HIALT_MN_COPY 14 0 13 FIX_AXIS_PAR 0 0 14 /end AXIS_DESCR
 /begin AXIS_DESCR FIX_AXIS NO_INPUT_QUANTITY TCY_FN_HIALT_MN_COPY 14 0 13 FIX_AXIS_PAR 0 0 14 /end AXIS_DESCR
/end CHARACTERISTIC
/begin COMPU_METHOD TCZ_FN_HIALT_MN_COPY "FN_HIALT_MN_COPY Z-axis conversion" RAT_FUNC "%10.5" "unitless" COEFFS 0 1 0 0 0 1 /end COMPU_METHOD
/begin COMPU_METHOD TCX_FN_HIALT_MN_COPY "FN_HIALT_MN_COPY X-axis conversion" RAT_FUNC "%10.5" "unitless" COEFFS 0 1 0 0 0 1 /end COMPU_METHOD
/begin COMPU_METHOD TCY_FN_HIALT_MN_COPY "FN_HIALT_MN_COPY Y-axis conversion" RAT_FUNC "%10.5" "unitless" COEFFS 0 1 0 0 0 1 /end COMPU_METHOD
/begin CHARACTERISTIC FN_HIALT_MN_COPY2 "X Norm=FN_TQ119, Y Norm=FN_TQ112, Copy of fn_hialt_mn from torque calcualtor" MAP 0x50B2C TD_FLOAT32_IEEE 0 TCZ_FN_HIALT_MN_COPY2 -500 1000
 /begin AXIS_DESCR FIX_AXIS NO_INPUT_QUANTITY TCX_FN_HIALT_MN_COPY2 14 0 13 FIX_AXIS_PAR 0 0 14 /end AXIS_DESCR
 /begin AXIS_DESCR FIX_AXIS NO_INPUT_QUANTITY TCY_FN_HIALT_MN_COPY2 14 0 13 FIX_AXIS_PAR 0 0 14 /end AXIS_DESCR
/end CHARACTERISTIC
/begin COMPU_METHOD TCZ_FN_HIALT_MN_COPY2 "FN_HIALT_MN_COPY2 Z-axis conversion" RAT_FUNC "%10.5" "lbf*ft" COEFFS 0 1 0 0 0 1 /end COMPU_METHOD
/begin COMPU_METHOD TCX_FN_HIALT_MN_COPY2 "FN_HIALT_MN_COPY2 X-axis conversion" RAT_FUNC "%10.5" "unitless" COEFFS 0 1 0 0 0 1 /end COMPU_METHOD
/begin COMPU_METHOD TCY_FN_HIALT_MN_COPY2 "FN_HIALT_MN_COPY2 Y-axis conversion" RAT_FUNC "%10.5" "unitless" COEFFS 0 1 0 0 0 1 /end COMPU_METHOD
/begin CHARACTERISTIC FN_HIALT_MN_COPY3 "X Norm=FN_TQ114, Y Norm=FN_TQ123, Copy of fn_hialt_mn from torque calculator" MAP 0x5116C TD_FLOAT32_IEEE 0 TCZ_FN_HIALT_MN_COPY3 -500 1000
 /begin AXIS_DESCR FIX_AXIS NO_INPUT_QUANTITY TCX_FN_HIALT_MN_COPY3 14 0 13 FIX_AXIS_PAR 0 0 14 /end AXIS_DESCR
 /begin AXIS_DESCR FIX_AXIS NO_INPUT_QUANTITY TCY_FN_HIALT_MN_COPY3 14 0 13 FIX_AXIS_PAR 0 0 14 /end AXIS_DESCR
/end CHARACTERISTIC
/begin COMPU_METHOD TCZ_FN_HIALT_MN_COPY3 "FN_HIALT_MN_COPY3 Z-axis conversion" RAT_FUNC "%10.5" "lbf*ft" COEFFS 0 1 0 0 0 1 /end COMPU_METHOD
/begin COMPU_METHOD TCX_FN_HIALT_MN_COPY3 "FN_HIALT_MN_COPY3 X-axis conversion" RAT_FUNC "%10.5" "unitless" COEFFS 0 1 0 0 0 1 /end COMPU_METHOD
/begin COMPU_METHOD TCY_FN_HIALT_MN_COPY3 "FN_HIALT_MN_COPY3 Y-axis conversion" RAT_FUNC "%10.5" "unitless" COEFFS 0 1 0 0 0 1 /end COMPU_METHOD
/begin CHARACTERISTIC FN_ICPA "X Norm=FN090_ICPA, Y Norm=FN091_ICPA, fuel limit based on ICP" MAP 0x4831C TD_FLOAT32_IEEE 0 TCZ_FN_ICPA -2048 2048
 /begin AXIS_DESCR FIX_AXIS NO_INPUT_QUANTITY TCX_FN_ICPA 14 0 13 FIX_AXIS_PAR 0 0 14 /end AXIS_DESCR
 /begin AXIS_DESCR FIX_AXIS NO_INPUT_QUANTITY TCY_FN_ICPA 14 0 13 FIX_AXIS_PAR 0 0 14 /end AXIS_DESCR
/end CHARACTERISTIC
/begin COMPU_METHOD TCZ_FN_ICPA "FN_ICPA Z-axis conversion" RAT_FUNC "%10.5" "unitless" COEFFS 0 1 0 0 0 1 /end COMPU_METHOD
/begin COMPU_METHOD TCX_FN_ICPA "FN_ICPA X-axis conversion" RAT_FUNC "%10.5" "RPM" COEFFS 0 1 0 0 0 1 /end COMPU_METHOD
/begin COMPU_METHOD TCY_FN_ICPA "FN_ICPA Y-axis conversion" RAT_FUNC "%10.5" "MPa" COEFFS 0 1 0 0 0 1 /end COMPU_METHOD
/begin CHARACTERISTIC FN_ICP_AD_TC "ICP filter time constant table based on MFDES." CURVE 0x431CC FD_FLOAT32_IEEE 0 FCY_FN_ICP_AD_TC 0 64
 /begin AXIS_DESCR STD_AXIS ICPSP_MFDES_DIFF FCX_FN_ICP_AD_TC 14 -2048 2047.94 /end AXIS_DESCR
/end CHARACTERISTIC
/begin COMPU_METHOD FCX_FN_ICP_AD_TC "FN_ICP_AD_TC X-axis conversion" RAT_FUNC "%10.5" "unitless" COEFFS 0 1 0 0 0 1 /end COMPU_METHOD
/begin COMPU_METHOD FCY_FN_ICP_AD_TC "FN_ICP_AD_TC Y-axis conversion" RAT_FUNC "%10.5" "s" COEFFS 0 1 0 0 0 1 /end COMPU_METHOD
/begin CHARACTERISTIC FN_ICP_DES_OFST_A "X Norm=FN090_ICP_A, Y Norm=FN091_ICP_A" MAP 0x4C828 TD_FLOAT32_IEEE 0 TCZ_FN_ICP_DES_OFST_A -25 25
 /begin AXIS_DESCR FIX_AXIS NO_INPUT_QUANTITY TCX_FN_ICP_DES_OFST_A 9 0 8 FIX_AXIS_PAR 0 0 9 /end AXIS_DESCR
 /begin AXIS_DESCR FIX_AXIS NO_INPUT_QUANTITY TCY_FN_ICP_DES_OFST_A 9 0 8 FIX_AXIS_PAR 0 0 9 /end AXIS_DESCR
/end CHARACTERISTIC
/begin COMPU_METHOD TCZ_FN_ICP_DES_OFST_A "FN_ICP_DES_OFST_A Z-axis conversion" RAT_FUNC "%10.5" "unitless" COEFFS 0 1 0 0 0 1 /end COMPU_METHOD
/begin COMPU_METHOD TCX_FN_ICP_DES_OFST_A "FN_ICP_DES_OFST_A X-axis conversion" RAT_FUNC "%10.5" "RPM" COEFFS 0 1 0 0 0 1 /end COMPU_METHOD
/begin COMPU_METHOD TCY_FN_ICP_DES_OFST_A "FN_ICP_DES_OFST_A Y-axis conversion" RAT_FUNC "%10.5" "unitless" COEFFS 0 1 0 0 0 1 /end COMPU_METHOD
/begin CHARACTERISTIC FN_ID_SEED "Underrun 'SEED' function in Drive Only" CURVE 0x44CEC FD_FLOAT32_IEEE 0 FCY_FN_ID_SEED 0 80 /begin AXIS_DESCR STD_AXIS EOT_C FCX_FN_ID_SEED 8 -40 150 /end AXIS_DESCR /end CHARACTERISTIC
/begin COMPU_METHOD FCX_FN_ID_SEED "FN_ID_SEED X-axis conversion" RAT_FUNC "%10.5" "degC" COEFFS 0 1 0 0 0 1 /end COMPU_METHOD
/begin COMPU_METHOD FCY_FN_ID_SEED "FN_ID_SEED Y-axis conversion" RAT_FUNC "%10.5" "unitless" COEFFS 0 1 0 0 0 1 /end COMPU_METHOD
/begin CHARACTERISTIC FN_INFMAT_ADDER "X Norm=FN_N_MAT_NORM, Y Norm=FN_MFDES_MAT_NORM, Inferred MAT offset value" MAP 0x43CDC TD_FLOAT32_IEEE 0 TCZ_FN_INFMAT_ADDER -2048 2047.94
 /begin AXIS_DESCR FIX_AXIS NO_INPUT_QUANTITY TCX_FN_INFMAT_ADDER 12 0 11 FIX_AXIS_PAR 0 0 12 /end AXIS_DESCR
 /begin AXIS_DESCR FIX_AXIS NO_INPUT_QUANTITY TCY_FN_INFMAT_ADDER 8 0 7 FIX_AXIS_PAR 0 0 8 /end AXIS_DESCR
/end CHARACTERISTIC
/begin COMPU_METHOD TCZ_FN_INFMAT_ADDER "FN_INFMAT_ADDER Z-axis conversion" RAT_FUNC "%10.5" "unitless" COEFFS 0 1 0 0 0 1 /end COMPU_METHOD
/begin COMPU_METHOD TCX_FN_INFMAT_ADDER "FN_INFMAT_ADDER X-axis conversion" RAT_FUNC "%10.5" "RPM" COEFFS 0 1 0 0 0 1 /end COMPU_METHOD
/begin COMPU_METHOD TCY_FN_INFMAT_ADDER "FN_INFMAT_ADDER Y-axis conversion" RAT_FUNC "%10.5" "unitless" COEFFS 0 1 0 0 0 1 /end COMPU_METHOD
/begin CHARACTERISTIC FN_INFMAT_BASE "Inferred MAT base Value" CURVE 0x43B6C FD_FLOAT32_IEEE 0 FCY_FN_INFMAT_BASE -4096 4095.88 /begin AXIS_DESCR STD_AXIS AAT FCX_FN_INFMAT_BASE 12 -8192 8191 /end AXIS_DESCR /end CHARACTERISTIC
/begin COMPU_METHOD FCX_FN_INFMAT_BASE "FN_INFMAT_BASE X-axis conversion" RAT_FUNC "%10.5" "degC" COEFFS 0 1 0 0 0 1 /end COMPU_METHOD
/begin COMPU_METHOD FCY_FN_INFMAT_BASE "FN_INFMAT_BASE Y-axis conversion" RAT_FUNC "%10.5" "degC" COEFFS 0 1 0 0 0 1 /end COMPU_METHOD
/begin CHARACTERISTIC FN_IN_SEED "Underrun 'SEED' function in neutral" CURVE 0x44CAC FD_FLOAT32_IEEE 0 FCY_FN_IN_SEED 0 80 /begin AXIS_DESCR STD_AXIS EOT_C FCX_FN_IN_SEED 8 -40 150 /end AXIS_DESCR /end CHARACTERISTIC
/begin COMPU_METHOD FCX_FN_IN_SEED "FN_IN_SEED X-axis conversion" RAT_FUNC "%10.5" "degC" COEFFS 0 1 0 0 0 1 /end COMPU_METHOD
/begin COMPU_METHOD FCY_FN_IN_SEED "FN_IN_SEED Y-axis conversion" RAT_FUNC "%10.5" "unitless" COEFFS 0 1 0 0 0 1 /end COMPU_METHOD
/begin CHARACTERISTIC FN_IPR_FLOW_KINJ "X Norm=FN_VFDES_IPR_FLOW, Y Norm=FN_EOT_IPR_FLOW" MAP 0x4C96C TD_FLOAT32_IEEE 0 TCZ_FN_IPR_FLOW_KINJ 0 100
 /begin AXIS_DESCR FIX_AXIS NO_INPUT_QUANTITY TCX_FN_IPR_FLOW_KINJ 14 0 13 FIX_AXIS_PAR 0 0 14 /end AXIS_DESCR
 /begin AXIS_DESCR FIX_AXIS NO_INPUT_QUANTITY TCY_FN_IPR_FLOW_KINJ 14 0 13 FIX_AXIS_PAR 0 0 14 /end AXIS_DESCR
/end CHARACTERISTIC
/begin COMPU_METHOD TCZ_FN_IPR_FLOW_KINJ "FN_IPR_FLOW_KINJ Z-axis conversion" RAT_FUNC "%10.5" "unitless" COEFFS 0 1 0 0 0 1 /end COMPU_METHOD
/begin COMPU_METHOD TCX_FN_IPR_FLOW_KINJ "FN_IPR_FLOW_KINJ X-axis conversion" RAT_FUNC "%10.5" "unitless" COEFFS 0 1 0 0 0 1 /end COMPU_METHOD
/begin COMPU_METHOD TCY_FN_IPR_FLOW_KINJ "FN_IPR_FLOW_KINJ Y-axis conversion" RAT_FUNC "%10.5" "degC" COEFFS 0 1 0 0 0 1 /end COMPU_METHOD
/begin CHARACTERISTIC FN_IPR_FLOW_KINJ_P "X Norm=FN_VFDES_IPR_FLOW, Y Norm=FN_EOT_IPR_FLOW" MAP 0x4CC7C TD_FLOAT32_IEEE 0 TCZ_FN_IPR_FLOW_KINJ_P 0 100
 /begin AXIS_DESCR FIX_AXIS NO_INPUT_QUANTITY TCX_FN_IPR_FLOW_KINJ_P 14 0 13 FIX_AXIS_PAR 0 0 14 /end AXIS_DESCR
 /begin AXIS_DESCR FIX_AXIS NO_INPUT_QUANTITY TCY_FN_IPR_FLOW_KINJ_P 14 0 13 FIX_AXIS_PAR 0 0 14 /end AXIS_DESCR
/end CHARACTERISTIC
/begin COMPU_METHOD TCZ_FN_IPR_FLOW_KINJ_P "FN_IPR_FLOW_KINJ_P Z-axis conversion" RAT_FUNC "%10.5" "unitless" COEFFS 0 1 0 0 0 1 /end COMPU_METHOD
/begin COMPU_METHOD TCX_FN_IPR_FLOW_KINJ_P "FN_IPR_FLOW_KINJ_P X-axis conversion" RAT_FUNC "%10.5" "unitless" COEFFS 0 1 0 0 0 1 /end COMPU_METHOD
/begin COMPU_METHOD TCY_FN_IPR_FLOW_KINJ_P "FN_IPR_FLOW_KINJ_P Y-axis conversion" RAT_FUNC "%10.5" "degC" COEFFS 0 1 0 0 0 1 /end COMPU_METHOD
/begin CHARACTERISTIC FN_ITH_ANTI_FOUL "" CURVE 0x5623C FD_FLOAT32_IEEE 0 FCY_FN_ITH_ANTI_FOUL 0 1 /begin AXIS_DESCR STD_AXIS EOT_C FCX_FN_ITH_ANTI_FOUL 14 -50 150 /end AXIS_DESCR /end CHARACTERISTIC
/begin COMPU_METHOD FCX_FN_ITH_ANTI_FOUL "FN_ITH_ANTI_FOUL X-axis conversion" RAT_FUNC "%10.5" "unitless" COEFFS 0 1 0 0 0 1 /end COMPU_METHOD
/begin COMPU_METHOD FCY_FN_ITH_ANTI_FOUL "FN_ITH_ANTI_FOUL Y-axis conversion" RAT_FUNC "%10.5" "unitless" COEFFS 0 1 0 0 0 1 /end COMPU_METHOD
/begin CHARACTERISTIC FN_ITH_COND_MULT_ROC "" CURVE 0x562AC FD_FLOAT32_IEEE 0 FCY_FN_ITH_COND_MULT_ROC -1 2 /begin AXIS_DESCR STD_AXIS N FCX_FN_ITH_COND_MULT_ROC 14 0 5500 /end AXIS_DESCR /end CHARACTERISTIC
/begin COMPU_METHOD FCX_FN_ITH_COND_MULT_ROC "FN_ITH_COND_MULT_ROC X-axis conversion" RAT_FUNC "%10.5" "RPM" COEFFS 0 1 0 0 0 1 /end COMPU_METHOD
/begin COMPU_METHOD FCY_FN_ITH_COND_MULT_ROC "FN_ITH_COND_MULT_ROC Y-axis conversion" RAT_FUNC "%10.5" "unitless" COEFFS 0 1 0 0 0 1 /end COMPU_METHOD
/begin CHARACTERISTIC FN_ITH_MAT_MULT "" CURVE 0x5631C FD_FLOAT32_IEEE 0 FCY_FN_ITH_MAT_MULT -200 200 /begin AXIS_DESCR STD_AXIS MAT FCX_FN_ITH_MAT_MULT 14 -50 300 /end AXIS_DESCR /end CHARACTERISTIC
/begin COMPU_METHOD FCX_FN_ITH_MAT_MULT "FN_ITH_MAT_MULT X-axis conversion" RAT_FUNC "%10.5" "degC" COEFFS 0 1 0 0 0 1 /end COMPU_METHOD
/begin COMPU_METHOD FCY_FN_ITH_MAT_MULT "FN_ITH_MAT_MULT Y-axis conversion" RAT_FUNC "%10.5" "unitless" COEFFS 0 1 0 0 0 1 /end COMPU_METHOD
/begin CHARACTERISTIC FN_ITH_TRNS_MULT "" CURVE 0x5638C FD_FLOAT32_IEEE 0 FCY_FN_ITH_TRNS_MULT 0 1 /begin AXIS_DESCR STD_AXIS ITH_MF_TRNS_FILT FCX_FN_ITH_TRNS_MULT 14 -350 350 /end AXIS_DESCR /end CHARACTERISTIC
/begin COMPU_METHOD FCX_FN_ITH_TRNS_MULT "FN_ITH_TRNS_MULT X-axis conversion" RAT_FUNC "%10.5" "unitless" COEFFS 0 1 0 0 0 1 /end COMPU_METHOD
/begin COMPU_METHOD FCY_FN_ITH_TRNS_MULT "FN_ITH_TRNS_MULT Y-axis conversion" RAT_FUNC "%10.5" "unitless" COEFFS 0 1 0 0 0 1 /end COMPU_METHOD
/begin CHARACTERISTIC FN_LOALT_MN "X Norm=FN090DS_TQ, Y Norm=FN091DS_TQ" MAP 0x4E07C TD_FLOAT32_IEEE 0 TCZ_FN_LOALT_MN -500 1000
 /begin AXIS_DESCR FIX_AXIS NO_INPUT_QUANTITY TCX_FN_LOALT_MN 14 0 13 FIX_AXIS_PAR 0 0 14 /end AXIS_DESCR
 /begin AXIS_DESCR FIX_AXIS NO_INPUT_QUANTITY TCY_FN_LOALT_MN 14 0 13 FIX_AXIS_PAR 0 0 14 /end AXIS_DESCR
/end CHARACTERISTIC
/begin COMPU_METHOD TCZ_FN_LOALT_MN "FN_LOALT_MN Z-axis conversion" RAT_FUNC "%10.5" "unitless" COEFFS 0 1 0 0 0 1 /end COMPU_METHOD
/begin COMPU_METHOD TCX_FN_LOALT_MN "FN_LOALT_MN X-axis conversion" RAT_FUNC "%10.5" "unitless" COEFFS 0 1 0 0 0 1 /end COMPU_METHOD
/begin COMPU_METHOD TCY_FN_LOALT_MN "FN_LOALT_MN Y-axis conversion" RAT_FUNC "%10.5" "unitless" COEFFS 0 1 0 0 0 1 /end COMPU_METHOD
/begin CHARACTERISTIC FN_LOALT_MN_COPY "X Norm=FN_TQ114, Y Norm=FN_TQ120, Copy of fn_loalt_mn from the torque calculator" MAP 0x5080C TD_FLOAT32_IEEE 0 TCZ_FN_LOALT_MN_COPY -500 1000
 /begin AXIS_DESCR FIX_AXIS NO_INPUT_QUANTITY TCX_FN_LOALT_MN_COPY 14 0 13 FIX_AXIS_PAR 0 0 14 /end AXIS_DESCR
 /begin AXIS_DESCR FIX_AXIS NO_INPUT_QUANTITY TCY_FN_LOALT_MN_COPY 14 0 13 FIX_AXIS_PAR 0 0 14 /end AXIS_DESCR
/end CHARACTERISTIC
/begin COMPU_METHOD TCZ_FN_LOALT_MN_COPY "FN_LOALT_MN_COPY Z-axis conversion" RAT_FUNC "%10.5" "unitless" COEFFS 0 1 0 0 0 1 /end COMPU_METHOD
/begin COMPU_METHOD TCX_FN_LOALT_MN_COPY "FN_LOALT_MN_COPY X-axis conversion" RAT_FUNC "%10.5" "unitless" COEFFS 0 1 0 0 0 1 /end COMPU_METHOD
/begin COMPU_METHOD TCY_FN_LOALT_MN_COPY "FN_LOALT_MN_COPY Y-axis conversion" RAT_FUNC "%10.5" "unitless" COEFFS 0 1 0 0 0 1 /end COMPU_METHOD
/begin CHARACTERISTIC FN_LOALT_MN_COPY2 "X Norm=FN_TQ119, Y Norm=FN_TQ112, Copy of fn_loalt_mn from torque calculator" MAP 0x50E4C TD_FLOAT32_IEEE 0 TCZ_FN_LOALT_MN_COPY2 -500 1000
 /begin AXIS_DESCR FIX_AXIS NO_INPUT_QUANTITY TCX_FN_LOALT_MN_COPY2 14 0 13 FIX_AXIS_PAR 0 0 14 /end AXIS_DESCR
 /begin AXIS_DESCR FIX_AXIS NO_INPUT_QUANTITY TCY_FN_LOALT_MN_COPY2 14 0 13 FIX_AXIS_PAR 0 0 14 /end AXIS_DESCR
/end CHARACTERISTIC
/begin COMPU_METHOD TCZ_FN_LOALT_MN_COPY2 "FN_LOALT_MN_COPY2 Z-axis conversion" RAT_FUNC "%10.5" "lbf*ft" COEFFS 0 1 0 0 0 1 /end COMPU_METHOD
/begin COMPU_METHOD TCX_FN_LOALT_MN_COPY2 "FN_LOALT_MN_COPY2 X-axis conversion" RAT_FUNC "%10.5" "unitless" COEFFS 0 1 0 0 0 1 /end COMPU_METHOD
/begin COMPU_METHOD TCY_FN_LOALT_MN_COPY2 "FN_LOALT_MN_COPY2 Y-axis conversion" RAT_FUNC "%10.5" "unitless" COEFFS 0 1 0 0 0 1 /end COMPU_METHOD
/begin CHARACTERISTIC FN_LOALT_MN_COPY3 "X Norm=FN_TQ114, Y Norm=FN_TQ123, Copy of fn_loalt_mn from torque calculator" MAP 0x5148C TD_FLOAT32_IEEE 0 TCZ_FN_LOALT_MN_COPY3 -500 1000
 /begin AXIS_DESCR FIX_AXIS NO_INPUT_QUANTITY TCX_FN_LOALT_MN_COPY3 14 0 13 FIX_AXIS_PAR 0 0 14 /end AXIS_DESCR
 /begin AXIS_DESCR FIX_AXIS NO_INPUT_QUANTITY TCY_FN_LOALT_MN_COPY3 14 0 13 FIX_AXIS_PAR 0 0 14 /end AXIS_DESCR
/end CHARACTERISTIC
/begin COMPU_METHOD TCZ_FN_LOALT_MN_COPY3 "FN_LOALT_MN_COPY3 Z-axis conversion" RAT_FUNC "%10.5" "lbf*ft" COEFFS 0 1 0 0 0 1 /end COMPU_METHOD
/begin COMPU_METHOD TCX_FN_LOALT_MN_COPY3 "FN_LOALT_MN_COPY3 X-axis conversion" RAT_FUNC "%10.5" "unitless" COEFFS 0 1 0 0 0 1 /end COMPU_METHOD
/begin COMPU_METHOD TCY_FN_LOALT_MN_COPY3 "FN_LOALT_MN_COPY3 Y-axis conversion" RAT_FUNC "%10.5" "unitless" COEFFS 0 1 0 0 0 1 /end COMPU_METHOD
/begin CHARACTERISTIC FN_MEDALT_MN "X Norm=FN090DS_TQ, Y Norm=FN091DS_TQ" MAP 0x4DD5C TD_FLOAT32_IEEE 0 TCZ_FN_MEDALT_MN 0 500
 /begin AXIS_DESCR FIX_AXIS NO_INPUT_QUANTITY TCX_FN_MEDALT_MN 14 0 13 FIX_AXIS_PAR 0 0 14 /end AXIS_DESCR
 /begin AXIS_DESCR FIX_AXIS NO_INPUT_QUANTITY TCY_FN_MEDALT_MN 14 0 13 FIX_AXIS_PAR 0 0 14 /end AXIS_DESCR
/end CHARACTERISTIC
/begin COMPU_METHOD TCZ_FN_MEDALT_MN "FN_MEDALT_MN Z-axis conversion" RAT_FUNC "%10.5" "unitless" COEFFS 0 1 0 0 0 1 /end COMPU_METHOD
/begin COMPU_METHOD TCX_FN_MEDALT_MN "FN_MEDALT_MN X-axis conversion" RAT_FUNC "%10.5" "unitless" COEFFS 0 1 0 0 0 1 /end COMPU_METHOD
/begin COMPU_METHOD TCY_FN_MEDALT_MN "FN_MEDALT_MN Y-axis conversion" RAT_FUNC "%10.5" "unitless" COEFFS 0 1 0 0 0 1 /end COMPU_METHOD
/begin CHARACTERISTIC FN_MFBCOL "" CURVE 0x4674C FD_FLOAT32_IEEE 0 FCY_FN_MFBCOL 0 11 /begin AXIS_DESCR STD_AXIS EOT_C FCX_FN_MFBCOL 12 -200 1000 /end AXIS_DESCR /end CHARACTERISTIC
/begin COMPU_METHOD FCX_FN_MFBCOL "FN_MFBCOL X-axis conversion" RAT_FUNC "%10.5" "unitless" COEFFS 0 1 0 0 0 1 /end COMPU_METHOD
/begin COMPU_METHOD FCY_FN_MFBCOL "FN_MFBCOL Y-axis conversion" RAT_FUNC "%10.5" "unitless" COEFFS 0 1 0 0 0 1 /end COMPU_METHOD
/begin CHARACTERISTIC FN_MFDES_DIF_EGR "" CURVE 0x542FC FD_FLOAT32_IEEE 0 FCY_FN_MFDES_DIF_EGR 0 15 /begin AXIS_DESCR STD_AXIS DP_MFDES_DIFF FCX_FN_MFDES_DIF_EGR 10 -500 500 /end AXIS_DESCR /end CHARACTERISTIC
/begin COMPU_METHOD FCX_FN_MFDES_DIF_EGR "FN_MFDES_DIF_EGR X-axis conversion" RAT_FUNC "%10.5" "unitless" COEFFS 0 1 0 0 0 1 /end COMPU_METHOD
/begin COMPU_METHOD FCY_FN_MFDES_DIF_EGR "FN_MFDES_DIF_EGR Y-axis conversion" RAT_FUNC "%10.5" "unitless" COEFFS 0 1 0 0 0 1 /end COMPU_METHOD
/begin CHARACTERISTIC FN_MFDES_MAT_NORM "Desired MAF normalising function for fn_infmat_adder" CURVE 0x43C9C FD_FLOAT32_IEEE 0 FCY_FN_MFDES_MAT_NORM 0 8
 /begin AXIS_DESCR STD_AXIS NO_INPUT_QUANTITY FCX_FN_MFDES_MAT_NORM 8 -2048 2047.94 /end AXIS_DESCR
/end CHARACTERISTIC
/begin COMPU_METHOD FCX_FN_MFDES_MAT_NORM "FN_MFDES_MAT_NORM X-axis conversion" RAT_FUNC "%10.5" "unitless" COEFFS 0 1 0 0 0 1 /end COMPU_METHOD
/begin COMPU_METHOD FCY_FN_MFDES_MAT_NORM "FN_MFDES_MAT_NORM Y-axis conversion" RAT_FUNC "%10.5" "unitless" COEFFS 0 1 0 0 0 1 /end COMPU_METHOD
/begin CHARACTERISTIC FN_MNMF "Min mass fuel for pilot based on engine speed" CURVE 0x487DC FD_FLOAT32_IEEE 0 FCY_FN_MNMF 0 135 /begin AXIS_DESCR STD_AXIS N FCX_FN_MNMF 14 0 5000 /end AXIS_DESCR /end CHARACTERISTIC
/begin COMPU_METHOD FCX_FN_MNMF "FN_MNMF X-axis conversion" RAT_FUNC "%10.5" "RPM" COEFFS 0 1 0 0 0 1 /end COMPU_METHOD
/begin COMPU_METHOD FCY_FN_MNMF "FN_MNMF Y-axis conversion" RAT_FUNC "%10.5" "unitless" COEFFS 0 1 0 0 0 1 /end COMPU_METHOD
/begin CHARACTERISTIC FN_MNT_EGR_PCT_HI_LMN "X Norm=FN_090_DP, Y Norm=FN_091_DP" MAP 0x5547C TD_FLOAT32_IEEE 0 TCZ_FN_MNT_EGR_PCT_HI_LMN 0 100
 /begin AXIS_DESCR FIX_AXIS NO_INPUT_QUANTITY TCX_FN_MNT_EGR_PCT_HI_LMN 14 0 13 FIX_AXIS_PAR 0 0 14 /end AXIS_DESCR
 /begin AXIS_DESCR FIX_AXIS NO_INPUT_QUANTITY TCY_FN_MNT_EGR_PCT_HI_LMN 14 0 13 FIX_AXIS_PAR 0 0 14 /end AXIS_DESCR
/end CHARACTERISTIC
/begin COMPU_METHOD TCZ_FN_MNT_EGR_PCT_HI_LMN "FN_MNT_EGR_PCT_HI_LMN Z-axis conversion" RAT_FUNC "%10.5" "unitless" COEFFS 0 1 0 0 0 1 /end COMPU_METHOD
/begin COMPU_METHOD TCX_FN_MNT_EGR_PCT_HI_LMN "FN_MNT_EGR_PCT_HI_LMN X-axis conversion" RAT_FUNC "%10.5" "unitless" COEFFS 0 1 0 0 0 1 /end COMPU_METHOD
/begin COMPU_METHOD TCY_FN_MNT_EGR_PCT_HI_LMN "FN_MNT_EGR_PCT_HI_LMN Y-axis conversion" RAT_FUNC "%10.5" "unitless" COEFFS 0 1 0 0 0 1 /end COMPU_METHOD
/begin CHARACTERISTIC FN_MNT_EGR_PCT_HI_LMX "X Norm=FN_090_DP, Y Norm=FN_091_DP" MAP 0x54E5C TD_FLOAT32_IEEE 0 TCZ_FN_MNT_EGR_PCT_HI_LMX 0 100
 /begin AXIS_DESCR FIX_AXIS NO_INPUT_QUANTITY TCX_FN_MNT_EGR_PCT_HI_LMX 14 0 13 FIX_AXIS_PAR 0 0 14 /end AXIS_DESCR
 /begin AXIS_DESCR FIX_AXIS NO_INPUT_QUANTITY TCY_FN_MNT_EGR_PCT_HI_LMX 14 0 13 FIX_AXIS_PAR 0 0 14 /end AXIS_DESCR
/end CHARACTERISTIC
/begin COMPU_METHOD TCZ_FN_MNT_EGR_PCT_HI_LMX "FN_MNT_EGR_PCT_HI_LMX Z-axis conversion" RAT_FUNC "%10.5" "unitless" COEFFS 0 1 0 0 0 1 /end COMPU_METHOD
/begin COMPU_METHOD TCX_FN_MNT_EGR_PCT_HI_LMX "FN_MNT_EGR_PCT_HI_LMX X-axis conversion" RAT_FUNC "%10.5" "unitless" COEFFS 0 1 0 0 0 1 /end COMPU_METHOD
/begin COMPU_METHOD TCY_FN_MNT_EGR_PCT_HI_LMX "FN_MNT_EGR_PCT_HI_LMX Y-axis conversion" RAT_FUNC "%10.5" "unitless" COEFFS 0 1 0 0 0 1 /end COMPU_METHOD
/begin RECORD_LAYOUT SD_UBYTE FNC_VALUES 1 UBYTE ROW_DIR DIRECT /end RECORD_LAYOUT
/begin RECORD_LAYOUT FD_FLOAT32_IEEE AXIS_PTS_X 1 FLOAT32_IEEE INDEX_INCR DIRECT FNC_VALUES 2 FLOAT32_IEEE ALTERNATE_WITH_X DIRECT /end RECORD_LAYOUT
/begin RECORD_LAYOUT TD_FLOAT32_IEEE FNC_VALUES 1 FLOAT32_IEEE ROW_DIR DIRECT /end RECORD_LAYOUT
/end MODULE
/end PROJECT
