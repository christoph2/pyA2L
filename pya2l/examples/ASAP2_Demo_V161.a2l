/begin PROJECT ASAP2_Example ""
/begin HEADER "ASAP2 Example File" PROJECT_NO MCD_P12_08 /* projectNumber */ VERSION "V1.61" /* versionIdentifier */ /end HEADER
/begin MODULE Example ""
/begin AXIS_PTS ASAM.C.AXIS_PTS.UBYTE_8 "Common axis for " 8454976 ASAM.M.SCALAR.SBYTE.IDENTICAL RL.AXIS_PTS.SBYTE.DECR /* depositAttr */ 0 CM.IDENTICAL 8 -128.0 127.0 DISPLAY_IDENTIFIER DI.ASAM.C.AXIS_PTS.UBYTE_8 /* display_name */ /end AXIS_PTS
/begin AXIS_PTS ASAM.C.AXIS_PTS.RESCALE "Rescale Axis" 8455088 ASAM.M.SCALAR.SBYTE.IDENTICAL RL.AXIS_PTS.RES_AXIS /* depositAttr */ 0 CM.IDENTICAL 5 0 255.0 DISPLAY_IDENTIFIER DI_0x83BA20.VTAB.RE_AXIS.X_RE_AXIS_xU8 /* display_name */ /end AXIS_PTS
/begin CHARACTERISTIC tstCom_cal_impl.Analoginput_P11 "" VAL_BLK 2357200 Scalar_FLOAT64_IEEE 0 tstCom_CM_double -1.7e+308 1.7e+308 /end CHARACTERISTIC
/begin CHARACTERISTIC tstCom_cal_impl.Analoginput_P12 "" VALUE 2357248 Scalar_FLOAT64_IEEE 0 tstCom_CM_double -1.7e+308 1.7e+308 /end CHARACTERISTIC
/begin CHARACTERISTIC tstCom_cal_impl.Analoginput_P2 "" VALUE 2356688 Scalar_FLOAT64_IEEE 0 tstCom_CM_double -1.7e+308 1.7e+308 /end CHARACTERISTIC
/begin CHARACTERISTIC tstCom_cal_impl.Analoginput_P3 "" VALUE 2356712 Scalar_FLOAT64_IEEE 0 tstCom_CM_double -1.7e+308 1.7e+308 /end CHARACTERISTIC
/begin CHARACTERISTIC ASAM.C.SCALAR.UBYTE.IDENTICAL "Scalar FW U16 and CDF20 as name" VALUE 8454144 RL.FNC.UBYTE.ROW_DIR 0 CM.IDENTICAL 10.0 200.0 /end CHARACTERISTIC
/begin CHARACTERISTIC ASAM.C.SCALAR.SBYTE.IDENTICAL "Scalar SBYTE" VALUE 8454145 RL.FNC.SBYTE.ROW_DIR 0 CM.IDENTICAL -100.0 100.0 /end CHARACTERISTIC
/begin CHARACTERISTIC ASAM.C.SCALAR.UWORD.IDENTICAL "Scalar UWORD" VALUE 8454146 RL.FNC.UWORD.ROW_DIR 0 CM.IDENTICAL 0 65535.0
 /begin ANNOTATION ANNOTATION_LABEL "ASAM Workinggroup" /* label */ /begin ANNOTATION_TEXT "Test the A2L annotation" /end ANNOTATION_TEXT /end ANNOTATION
 BIT_MASK 65535 /end CHARACTERISTIC
/begin CHARACTERISTIC ASAM.C.SCALAR.UWORD.IDENTICAL.BITMASK_0FF0 "Scalar UWORD" VALUE 8454146 RL.FNC.UWORD.ROW_DIR 0 CM.IDENTICAL 0 255.0 BIT_MASK 4080 /end CHARACTERISTIC
/begin CHARACTERISTIC ASAM.C.SCALAR.UWORD.IDENTICAL.BITMASK_0001 "Scalar UWORD" VALUE 8454146 RL.FNC.UWORD.ROW_DIR 0 CM.IDENTICAL 0 1.0 BIT_MASK 1 /end CHARACTERISTIC
/begin CHARACTERISTIC ASAM.C.SCALAR.UWORD.IDENTICAL.BITMASK_0010 "Scalar UWORD" VALUE 8454146 RL.FNC.UWORD.ROW_DIR 0 CM.IDENTICAL 0 1.0 BIT_MASK 16 /end CHARACTERISTIC
/begin CHARACTERISTIC ASAM.C.SCALAR.SWORD.IDENTICAL "Scalar SWORD" VALUE 8454148 RL.FNC.SWORD.ROW_DIR 0 CM.IDENTICAL -10000.0 20000.0 /end CHARACTERISTIC
/begin CHARACTERISTIC ASAM.C.SCALAR.SWORD.LINEAR_MUL_2 "Scalar SWORD" VALUE 8454148 RL.FNC.SWORD.ROW_DIR 0 CM.LINEAR.MUL_2 -10000.0 20000.0 /end CHARACTERISTIC
/begin CHARACTERISTIC ASAM.C.SCALAR.SWORD.RAT_FUNC_DIV_10 "Scalar SWORD" VALUE 8454148 RL.FNC.SWORD.ROW_DIR 0 CM.RAT_FUNC.DIV_10 -10000.0 20000.0 /end CHARACTERISTIC
/begin CHARACTERISTIC ASAM.C.SCALAR.SWORD.FORM_X_PLUS_4 "Scalar SWORD" VALUE 8454148 RL.FNC.SWORD.ROW_DIR 0 CM.FORM.X_PLUS_4 -10000.0 20000.0 /end CHARACTERISTIC
/begin CHARACTERISTIC ASAM.C.SCALAR.SWORD.TAB_INTP_DEFAULT_VALUE "Scalar SWORD" VALUE 8454148 RL.FNC.SWORD.ROW_DIR 0 CM.TAB_INTP.DEFAULT_VALUE -10000.0 20000.0 /end CHARACTERISTIC
/begin CHARACTERISTIC ASAM.C.SCALAR.SWORD.TAB_INTP_NO_DEFAULT_VALUE "Scalar SWORD" VALUE 8454148 RL.FNC.SWORD.ROW_DIR 0 CM.TAB_INTP.NO_DEFAULT_VALUE -10000.0 20000.0 /end CHARACTERISTIC
/begin CHARACTERISTIC ASAM.C.SCALAR.SWORD.TAB_NOINTP_DEFAULT_VALUE "Scalar SWORD" VALUE 8454148 RL.FNC.SWORD.ROW_DIR 0 CM.TAB_NOINTP.DEFAULT_VALUE -10000.0 20000.0 /end CHARACTERISTIC
/begin CHARACTERISTIC ASAM.C.SCALAR.SWORD.TAB_NOINTP_NO_DEFAULT_VALUE "Scalar SWORD" VALUE 8454148 RL.FNC.SWORD.ROW_DIR 0 CM.TAB_NOINTP.NO_DEFAULT_VALUE -10000.0 20000.0 /end CHARACTERISTIC
/begin CHARACTERISTIC ASAM.C.SCALAR.SWORD.TAB_VERB_DEFAULT_VALUE "Scalar SWORD" VALUE 8454148 RL.FNC.SWORD.ROW_DIR 0 CM.TAB_VERB.DEFAULT_VALUE -10000.0 20000.0 /end CHARACTERISTIC
/begin CHARACTERISTIC ASAM.C.SCALAR.SWORD.TAB_VERB_NO_DEFAULT_VALUE "Scalar SWORD" VALUE 8454148 RL.FNC.SWORD.ROW_DIR 0 CM.TAB_VERB.NO_DEFAULT_VALUE -10000.0 20000.0 /end CHARACTERISTIC
/begin CHARACTERISTIC ASAM.C.SCALAR.SWORD.VTAB_RANGE_DEFAULT_VALUE "Scalar SWORD" VALUE 8454148 RL.FNC.SWORD.ROW_DIR 0 CM.VTAB_RANGE.DEFAULT_VALUE -10000.0 20000.0 /end CHARACTERISTIC
/begin CHARACTERISTIC ASAM.C.SCALAR.SWORD.VTAB_RANGE_NO_DEFAULT_VALUE "Scalar SWORD" VALUE 8454148 RL.FNC.SWORD.ROW_DIR 0 CM.VTAB_RANGE.NO_DEFAULT_VALUE -10000.0 20000.0 /end CHARACTERISTIC
/begin CHARACTERISTIC ASAM.C.SCALAR.SWORD.RAT_FUNC_DIV_81_9175 "Scalar SWORD" VALUE 8454148 RL.FNC.SWORD.ROW_DIR 0 CM.RAT_FUNC.DIV_81_9175 -10000.0 20000.0 /end CHARACTERISTIC
/begin CHARACTERISTIC ASAM.C.SCALAR.ULONG.IDENTICAL "Scalar ULONG" VALUE 8454152 RL.FNC.ULONG.ROW_DIR 0 CM.IDENTICAL -1000000.0 2000000.0 /end CHARACTERISTIC
/begin CHARACTERISTIC ASAM.C.SCALAR.SLONG.IDENTICAL "Scalar SLONG" VALUE 8454156 RL.FNC.SLONG.ROW_DIR 0 CM.IDENTICAL -1000000.0 2000000.0 /end CHARACTERISTIC
/begin CHARACTERISTIC ASAM.C.SCALAR.FLOAT32_IEEE.IDENTICAL "Scalar FLOAT32_IEEE" VALUE 8454160 RL.FNC.FLOAT32_IEEE.ROW_DIR 0 CM.IDENTICAL 10.0 200.0 /end CHARACTERISTIC
/begin CHARACTERISTIC ASAM.C.SCALAR.FLOAT64_IEEE.IDENTICAL "Scalar FLOAT64_IEEE" VALUE 8454160 RL.FNC.FLOAT64_IEEE.ROW_DIR 0 CM.IDENTICAL -100.0 200.0 /end CHARACTERISTIC
/begin CHARACTERISTIC ASAM.C.ARRAY.SWORD.MATRIX_DIM_3_4.ROW_DIR "Array 3x4 of SWORD" VAL_BLK 8454400 RL.FNC.SWORD.ROW_DIR 0 CM.IDENTICAL -400.0 400.0 MATRIX_DIM 3 4 1 /end CHARACTERISTIC
/begin CHARACTERISTIC ASAM.C.ARRAY.SWORD.MATRIX_DIM_3_4.COLUMN_DIR "Array 3x4 of SWORD" VAL_BLK 8454432 RL.FNC.SWORD.COLUMN_DIR 0 CM.IDENTICAL -400.0 400.0 MATRIX_DIM 3 4 1 /end CHARACTERISTIC
/begin CHARACTERISTIC ASAM.C.ARRAY.SWORD.MATRIX_DIM_6.ROW_DIR "Array 6 of SWORD" VAL_BLK 8454464 RL.FNC.SWORD.ROW_DIR 0 CM.IDENTICAL -400.0 400.0 MATRIX_DIM 6 1 1 /end CHARACTERISTIC
/begin CHARACTERISTIC ASAM.C.ASCII.UBYTE.NUMBER_42 "ASCII string" ASCII 8454656 RL.FNC.UBYTE.ROW_DIR 0 CM.IDENTICAL 0 255.0 /end CHARACTERISTIC
/begin CHARACTERISTIC ASAM.C.CURVE.STD_AXIS "Curve with standard axis" CURVE 8454912 RL.CURVE.SWORD.SBYTE.DECR 0 CM.IDENTICAL -32268.0 32267.0
 /begin AXIS_DESCR STD_AXIS ASAM.M.SCALAR.SBYTE.IDENTICAL CM.IDENTICAL 8 -128.0 127.0 /end AXIS_DESCR
/end CHARACTERISTIC
/begin CHARACTERISTIC ASAM.C.CURVE.COM_AXIS "Curve with common axis" CURVE 8454944 RL.FNC.SWORD.ROW_DIR 0 CM.IDENTICAL -32268.0 32267.0
 /begin AXIS_DESCR COM_AXIS ASAM.M.SCALAR.SBYTE.IDENTICAL CM.IDENTICAL 8 -128.0 127.0 AXIS_PTS_REF ASAM.C.AXIS_PTS.UBYTE_8 /end AXIS_DESCR
/end CHARACTERISTIC
/begin CHARACTERISTIC ASAM.C.CURVE.FIX_AXIS.PAR_DIST "Curve with fix axis and FIX_AXIS_PAR_DIST" CURVE 8454992 RL.FNC.SWORD.ROW_DIR 0 CM.IDENTICAL -32268.0 32267.0
 /begin AXIS_DESCR FIX_AXIS ASAM.M.SCALAR.SBYTE.IDENTICAL CM.IDENTICAL 6 -128.0 127.0 /end AXIS_DESCR
/end CHARACTERISTIC
/begin CHARACTERISTIC ASAM.C.CURVE.FIX_AXIS.PAR "Curve with fix axis and FIX_AXIS_PAR" CURVE 8455008 RL.FNC.SWORD.ROW_DIR 0 CM.IDENTICAL -32268.0 32267.0
 /begin AXIS_DESCR FIX_AXIS ASAM.M.SCALAR.SBYTE.IDENTICAL CM.IDENTICAL 6 -128.0 127.0 /end AXIS_DESCR
/end CHARACTERISTIC
/begin CHARACTERISTIC ASAM.C.CURVE.FIX_AXIS.PAR_LIST "Curve with fix axis and FIX_AXIS_PAR_LIST" CURVE 8455024 RL.FNC.SWORD.ROW_DIR 0 CM.IDENTICAL -32268.0 32267.0
 /begin AXIS_DESCR FIX_AXIS ASAM.M.SCALAR.SBYTE.IDENTICAL CM.IDENTICAL 6 -128.0 127.0 /end AXIS_DESCR
/end CHARACTERISTIC
/begin CHARACTERISTIC ASAM.C.CURVE.CURVE_AXIS "Curve with curve axis" CURVE 8455040 RL.FNC.SWORD.ROW_DIR 0 CM.IDENTICAL -32268.0 32267.0
 /begin AXIS_DESCR CURVE_AXIS ASAM.M.SCALAR.SBYTE.IDENTICAL NO_COMPU_METHOD 8 -128.0 127.0 /end AXIS_DESCR
/end CHARACTERISTIC
/begin CHARACTERISTIC ASAM.C.CURVE_AXIS "Curve used as axis" CURVE 8455056 RL.CURVE.SWORD.SBYTE.INCR 0 CM.IDENTICAL -32268.0 32267.0
 /begin AXIS_DESCR STD_AXIS ASAM.M.SCALAR.SBYTE.IDENTICAL CM.IDENTICAL 8 -128.0 127.0 /end AXIS_DESCR
/end CHARACTERISTIC
/begin CHARACTERISTIC ASAM.C.CURVE.RES_AXIS "Curve with rescale axis" CURVE 8455072 RL.FNC.SWORD.ROW_DIR 0 CM.IDENTICAL -32268.0 32267.0
 /begin AXIS_DESCR RES_AXIS ASAM.M.SCALAR.SBYTE.IDENTICAL CM.IDENTICAL 9 0.0 255.0 AXIS_PTS_REF ASAM.C.AXIS_PTS.RESCALE /end AXIS_DESCR
/end CHARACTERISTIC
/begin CHARACTERISTIC ASAM.C.CURVE.STD_AXIS.MONOTONY_STRICT_INCREASE "Curve with standard axis" CURVE 8456192 RL.CURVE.SWORD.SBYTE.DECR 0 CM.IDENTICAL -32268.0 32267.0
 /begin AXIS_DESCR STD_AXIS ASAM.M.SCALAR.SBYTE.IDENTICAL CM.IDENTICAL 8 -128.0 127.0 /end AXIS_DESCR
/end CHARACTERISTIC
/begin CHARACTERISTIC ASAM.C.CURVE.STD_AXIS.MONOTONY_STRICT_DECREASE "Curve with standard axis" CURVE 8456224 RL.CURVE.SWORD.SBYTE.DECR 0 CM.IDENTICAL -32268.0 32267.0
 /begin AXIS_DESCR STD_AXIS ASAM.M.SCALAR.SBYTE.IDENTICAL CM.IDENTICAL 8 -128.0 127.0 /end AXIS_DESCR
/end CHARACTERISTIC
/begin CHARACTERISTIC ASAM.C.MAP.STD_AXIS.STD_AXIS "Map with 2x standard axis" MAP 8455168 RL.MAP.SWORD.SBYTE.SBYTE.INCR 0 CM.IDENTICAL -32268.0 32267.0
 /begin AXIS_DESCR STD_AXIS ASAM.M.SCALAR.SBYTE.IDENTICAL CM.IDENTICAL 4 -128.0 127.0 /end AXIS_DESCR
 /begin AXIS_DESCR STD_AXIS ASAM.M.SCALAR.UBYTE.TAB_VERB_NO_DEFAULT_VALUE CM.TAB_VERB.NO_DEFAULT_VALUE 5 -128.0 127.0 /end AXIS_DESCR
/end CHARACTERISTIC
/begin CHARACTERISTIC ASAM.C.MAP.COM_AXIS.FIX_AXIS "Map with 2x standard axis" MAP 8455232 RL.FNC.SWORD.ROW_DIR 0 CM.IDENTICAL -32268.0 32267.0
 /begin AXIS_DESCR COM_AXIS ASAM.M.SCALAR.SBYTE.IDENTICAL CM.IDENTICAL 8 -128.0 127.0 AXIS_PTS_REF ASAM.C.AXIS_PTS.UBYTE_8 /end AXIS_DESCR
 /begin AXIS_DESCR FIX_AXIS ASAM.M.SCALAR.SBYTE.IDENTICAL CM.IDENTICAL 3 -128.0 127.0 /end AXIS_DESCR
/end CHARACTERISTIC
/begin CHARACTERISTIC ASAM.C.CUBOID.COM_AXIS.FIX_AXIS.STD_AXIS "Map with 2x standard axis" CUBOID 8455280 RL.CUBOID.SWORD.SBYTE.DECR 0 CM.IDENTICAL -32268.0 32267.0
 /begin AXIS_DESCR COM_AXIS ASAM.M.SCALAR.SBYTE.IDENTICAL CM.IDENTICAL 8 -128.0 127.0 AXIS_PTS_REF ASAM.C.AXIS_PTS.UBYTE_8 /end AXIS_DESCR
 /begin AXIS_DESCR FIX_AXIS ASAM.M.SCALAR.SBYTE.IDENTICAL CM.IDENTICAL 3 -128.0 127.0 /end AXIS_DESCR
 /begin AXIS_DESCR STD_AXIS ASAM.M.SCALAR.SBYTE.IDENTICAL CM.IDENTICAL 4 -128.0 127.0 /end AXIS_DESCR
/end CHARACTERISTIC
/begin CHARACTERISTIC ASAM.C.DEPENDENT.REF_1.SWORD "Dependent SWORD" VALUE 8455680 RL.FNC.SWORD.ROW_DIR 0 CM.IDENTICAL -32268.0 32267.0 /end CHARACTERISTIC
/begin CHARACTERISTIC ASAM.C.DEPENDENT.REF_2.UWORD "Dependent UWORD" VALUE 8455682 RL.FNC.UWORD.ROW_DIR 0 CM.IDENTICAL 0 65535.0 /end CHARACTERISTIC
/begin CHARACTERISTIC ASAM.C.DEPENDENT.REF_3.SWORD "Dependent UWORD" VALUE 8455684 RL.FNC.SWORD.ROW_DIR 0 CM.IDENTICAL -32268.0 32267.0 /end CHARACTERISTIC
/begin CHARACTERISTIC ASAM.C.DEPENDENT.REF_4.FLOAT64_IEEE "Dependent UWORD" VALUE 8455696 RL.FNC.FLOAT64_IEEE.ROW_DIR 0 CM.IDENTICAL -32268.0 32267.0 /end CHARACTERISTIC
/begin CHARACTERISTIC ASAM.C.DEPENDENT.REF_5.FLOAT64_IEEE "Dependent UWORD" VALUE 8455688 RL.FNC.FLOAT64_IEEE.ROW_DIR 0 CM.IDENTICAL -10000.0 10000.0 /end CHARACTERISTIC
/begin CHARACTERISTIC ASAM.C.VIRTUAL.REF_1.SWORD "Virtual SWORD" VALUE 0 RL.FNC.SWORD.ROW_DIR 0 CM.IDENTICAL 0 255.0 /end CHARACTERISTIC
/begin CHARACTERISTIC ASAM.C.VIRTUAL.REF_2.UWORD "Virtual UWORD" VALUE 0 RL.FNC.UWORD.ROW_DIR 0 CM.IDENTICAL 0 255.0 /end CHARACTERISTIC
/begin CHARACTERISTIC ASAM.C.VIRTUAL.REF_3.SWORD "Virtual UWORD" VALUE 0 RL.FNC.SWORD.ROW_DIR 0 CM.IDENTICAL 0 255.0 /end CHARACTERISTIC
/begin CHARACTERISTIC ASAM.C.VIRTUAL.SYSTEM_CONSTANT_1 "Virtual value including a system constant in the calculation formula" VALUE 0 RL.FNC.FLOAT64_IEEE.ROW_DIR 0 CM.IDENTICAL 0 255.0 /end CHARACTERISTIC
/begin CHARACTERISTIC ASAM.C.VIRTUAL.ASCII "Virtual ASCII string" ASCII 0 RL.FNC.UBYTE.ROW_DIR 0 CM.IDENTICAL 0 255.0 /end CHARACTERISTIC
/begin COMPU_METHOD CM.IDENTICAL "conversion that delivers always phys = int" IDENTICAL "%3.0" "hours" /end COMPU_METHOD
/begin COMPU_METHOD CM.LINEAR.IDENT "Linear function with parameter set for phys = f(int) = 1*int + 0" LINEAR "%3.1" "m/s" COEFFS_LINEAR 1.0 0.0 /end COMPU_METHOD
/begin COMPU_METHOD CM.LINEAR.MUL_2 "Linear function with parameter set for phys = f(int) = 2*int + 0" LINEAR "%3.1" "m/s" COEFFS_LINEAR 2.0 0.0 /end COMPU_METHOD
/begin COMPU_METHOD CM.RAT_FUNC.IDENT "rational function with parameter set for int = f(phys) = phys" RAT_FUNC "%3.1" "m/s" COEFFS 0.0 1.0 0.0 0.0 0.0 1.0 /end COMPU_METHOD
/begin COMPU_METHOD CM.RAT_FUNC.DIV_10 "rational function with parameter set for impl = f(phys) = phys * 10" RAT_FUNC "%3.1" "km/h" COEFFS 0.0 10.0 0.0 0.0 0.0 1.0 /end COMPU_METHOD
/begin COMPU_METHOD CM.RAT_FUNC.DIV_81_9175 "rational function with parameter set for impl = f(phys) = phys * 81.9175" RAT_FUNC "%8.4" "grad C" COEFFS 0.0 81.9175 0.0 0.0 0.0 1.0 /end COMPU_METHOD
/begin COMPU_METHOD CM.FORM.X_PLUS_4 "" FORM "%6.1" "rpm" /begin FORMULA "X1+4" FORMULA_INV "X1-4" /end FORMULA /end COMPU_METHOD
/begin COMPU_METHOD CM.VIRTUAL.EXTERNAL_VALUE "" FORM "%6.1" "rpm" /begin FORMULA "4*X1" /end FORMULA /end COMPU_METHOD
/begin COMPU_METHOD CM.TAB_INTP.DEFAULT_VALUE "" TAB_INTP "%8.4" "U/  min  " COMPU_TAB_REF CM.TAB_INTP.DEFAULT_VALUE.REF /end COMPU_METHOD
/begin COMPU_METHOD CM.TAB_INTP.NO_DEFAULT_VALUE "" TAB_INTP "%8.4" "U/  min  " COMPU_TAB_REF CM.TAB_INTP.NO_DEFAULT_VALUE.REF /end COMPU_METHOD
/begin COMPU_METHOD CM.TAB_NOINTP.DEFAULT_VALUE "" TAB_INTP "%8.4" "U/  min  " COMPU_TAB_REF CM.TAB_NOINTP.DEFAULT_VALUE.REF /end COMPU_METHOD
/begin COMPU_METHOD CM.TAB_NOINTP.NO_DEFAULT_VALUE "" TAB_INTP "%8.4" "U/  min  " COMPU_TAB_REF CM.TAB_NOINTP.NO_DEFAULT_VALUE.REF /end COMPU_METHOD
/begin COMPU_METHOD CM.TAB_VERB.DEFAULT_VALUE "Verbal conversion with default value" TAB_VERB "%12.0" "" COMPU_TAB_REF CM.TAB_VERB.DEFAULT_VALUE.REF /end COMPU_METHOD
/begin COMPU_METHOD CM.TAB_VERB.NO_DEFAULT_VALUE "Verbal conversion without default value" TAB_VERB "%12.0" "" COMPU_TAB_REF CM.TAB_VERB.NO_DEFAULT_VALUE.REF /end COMPU_METHOD
/begin COMPU_METHOD CM.VTAB_RANGE.DEFAULT_VALUE "verbal range with default value" TAB_VERB "%4.2" "" COMPU_TAB_REF CM.VTAB_RANGE.DEFAULT_VALUE.REF /end COMPU_METHOD
/begin COMPU_METHOD CM.VTAB_RANGE.NO_DEFAULT_VALUE "verbal range without default value" TAB_VERB "%4.2" "" COMPU_TAB_REF CM.VTAB_RANGE.NO_DEFAULT_VALUE.REF /end COMPU_METHOD
/begin COMPU_TAB CM.TAB_INTP.DEFAULT_VALUE.REF "" TAB_INTP 12 DEFAULT_VALUE_NUMERIC 300.56 /* display_value */ /end COMPU_TAB
/begin COMPU_TAB CM.TAB_INTP.NO_DEFAULT_VALUE.REF "" TAB_INTP 12 /end COMPU_TAB
/begin COMPU_TAB CM.TAB_NOINTP.DEFAULT_VALUE.REF "" TAB_NOINTP 12 DEFAULT_VALUE_NUMERIC 300.56 /* display_value */ /end COMPU_TAB
/begin COMPU_TAB CM.TAB_NOINTP.NO_DEFAULT_VALUE.REF "" TAB_NOINTP 12 /end COMPU_TAB
/begin COMPU_TAB CM.TAB_VERB.DEFAULT_VALUE.REF "List of text strings and relation to impl value" TAB_VERB 3 DEFAULT_VALUE "unknown signal type" /* display_string */ /end COMPU_TAB
/begin COMPU_TAB CM.TAB_VERB.NO_DEFAULT_VALUE.REF "List of text strings and relation to impl value" TAB_VERB 6 /end COMPU_TAB
/begin COMPU_VTAB_RANGE CM.VTAB_RANGE.DEFAULT_VALUE.REF "" 11 /* numberValueTriples */ DEFAULT_VALUE "out of range value" /* display_string */ /end COMPU_VTAB_RANGE
/begin COMPU_VTAB_RANGE CM.VTAB_RANGE.NO_DEFAULT_VALUE.REF "" 11 /* numberValueTriples */ /end COMPU_VTAB_RANGE
/begin FUNCTION FunctionScalar ""
 /begin DEF_CHARACTERISTIC ASAM.C.SCALAR.FLOAT32_IEEE.IDENTICAL ASAM.C.SCALAR.FLOAT64_IEEE.IDENTICAL ASAM.C.SCALAR.SBYTE.IDENTICAL ASAM.C.SCALAR.SLONG.IDENTICAL ASAM.C.SCALAR.SWORD.FORM_X_PLUS_4 ASAM.C.SCALAR.SWORD.IDENTICAL ASAM.C.SCALAR.SWORD.LINEAR_MUL_2 ASAM.C.SCALAR.SWORD.RAT_FUNC_DIV_10 ASAM.C.SCALAR.SWORD.RAT_FUNC_DIV_81_9175 ASAM.C.SCALAR.SWORD.TAB_INTP_DEFAULT_VALUE ASAM.C.SCALAR.SWORD.TAB_INTP_NO_DEFAULT_VALUE ASAM.C.SCALAR.SWORD.TAB_NOINTP_DEFAULT_VALUE ASAM.C.SCALAR.SWORD.TAB_NOINTP_NO_DEFAULT_VALUE ASAM.C.SCALAR.SWORD.TAB_VERB_DEFAULT_VALUE ASAM.C.SCALAR.SWORD.TAB_VERB_NO_DEFAULT_VALUE ASAM.C.SCALAR.SWORD.VTAB_RANGE_DEFAULT_VALUE ASAM.C.SCALAR.SWORD.VTAB_RANGE_NO_DEFAULT_VALUE ASAM.C.SCALAR.UBYTE.IDENTICAL ASAM.C.SCALAR.ULONG.IDENTICAL ASAM.C.SCALAR.UWORD.IDENTICAL ASAM.C.SCALAR.UWORD.IDENTICAL.BITMASK_0001 ASAM.C.SCALAR.UWORD.IDENTICAL.BITMASK_0010 ASAM.C.SCALAR.UWORD.IDENTICAL.BITMASK_0FF0 /end DEF_CHARACTERISTIC
/end FUNCTION
/begin FUNCTION FunctionDependentParameters ""
 /begin DEF_CHARACTERISTIC ASAM.C.DEPENDENT.REF_1.SWORD ASAM.C.DEPENDENT.REF_2.UWORD ASAM.C.DEPENDENT.REF_3.SWORD /end DEF_CHARACTERISTIC
 /begin REF_CHARACTERISTIC ASAM.C.SCALAR.UBYTE.IDENTICAL ASAM.C.SCALAR.SBYTE.IDENTICAL /end REF_CHARACTERISTIC
/end FUNCTION
/begin FUNCTION FunctionCurveAxis "" /begin DEF_CHARACTERISTIC ASAM.C.CURVE_AXIS ASAM.C.CURVE.CURVE_AXIS /end DEF_CHARACTERISTIC /begin IN_MEASUREMENT ASAM.M.SCALAR.SBYTE.IDENTICAL /end IN_MEASUREMENT /end FUNCTION
/begin FUNCTION FunctionVirtualMeasurements "" /begin IN_MEASUREMENT ASAM.M.SCALAR.SBYTE.LINEAR_MUL_2 /end IN_MEASUREMENT /begin OUT_MEASUREMENT ASAM.M.VIRTUAL.SCALAR.SWORD.PHYSICAL /end OUT_MEASUREMENT /end FUNCTION
/begin GROUP Group_Type_All "contains all groups with special types" ROOT
 /begin SUB_GROUP Group_Type_Scalar Group_Type_Array Group_Type_Curve Group_Type_Map Group_Type_Cuboid Group_Type_ASCII /end SUB_GROUP
/end GROUP
/begin GROUP Group_Type_Scalar "Contains all scalar measurements and parameters"
 /begin REF_CHARACTERISTIC ASAM.C.SCALAR.FLOAT32_IEEE.IDENTICAL ASAM.C.SCALAR.FLOAT64_IEEE.IDENTICAL ASAM.C.SCALAR.SBYTE.IDENTICAL ASAM.C.SCALAR.SLONG.IDENTICAL ASAM.C.SCALAR.SWORD.FORM_X_PLUS_4 ASAM.C.SCALAR.SWORD.IDENTICAL ASAM.C.SCALAR.SWORD.LINEAR_MUL_2 ASAM.C.SCALAR.SWORD.RAT_FUNC_DIV_10 ASAM.C.SCALAR.SWORD.RAT_FUNC_DIV_81_9175 ASAM.C.SCALAR.SWORD.TAB_INTP_DEFAULT_VALUE ASAM.C.SCALAR.SWORD.TAB_INTP_NO_DEFAULT_VALUE ASAM.C.SCALAR.SWORD.TAB_NOINTP_DEFAULT_VALUE ASAM.C.SCALAR.SWORD.TAB_NOINTP_NO_DEFAULT_VALUE ASAM.C.SCALAR.SWORD.TAB_VERB_DEFAULT_VALUE ASAM.C.SCALAR.SWORD.TAB_VERB_NO_DEFAULT_VALUE ASAM.C.SCALAR.SWORD.VTAB_RANGE_DEFAULT_VALUE ASAM.C.SCALAR.SWORD.VTAB_RANGE_NO_DEFAULT_VALUE ASAM.C.SCALAR.UBYTE.IDENTICAL ASAM.C.SCALAR.ULONG.IDENTICAL ASAM.C.SCALAR.UWORD.IDENTICAL ASAM.C.SCALAR.UWORD.IDENTICAL.BITMASK_0001 ASAM.C.SCALAR.UWORD.IDENTICAL.BITMASK_0010 ASAM.C.SCALAR.UWORD.IDENTICAL.BITMASK_0FF0 /end REF_CHARACTERISTIC
 /begin REF_MEASUREMENT ASAM.M.SCALAR.FLOAT32.IDENTICAL ASAM.M.SCALAR.FLOAT64.IDENTICAL ASAM.M.SCALAR.SBYTE.IDENTICAL ASAM.M.SCALAR.SBYTE.LINEAR_MUL_2 ASAM.M.SCALAR.SLONG.IDENTICAL ASAM.M.SCALAR.SWORD.IDENTICAL ASAM.M.SCALAR.UBYTE.FORM_X_PLUS_4 ASAM.M.SCALAR.UBYTE.IDENTICAL ASAM.M.SCALAR.UBYTE.TAB_INTP_DEFAULT_VALUE ASAM.M.SCALAR.UBYTE.TAB_INTP_NO_DEFAULT_VALUE ASAM.M.SCALAR.UBYTE.TAB_NOINTP_DEFAULT_VALUE ASAM.M.SCALAR.UBYTE.TAB_NOINTP_NO_DEFAULT_VALUE ASAM.M.SCALAR.UBYTE.TAB_VERB_DEFAULT_VALUE ASAM.M.SCALAR.UBYTE.TAB_VERB_NO_DEFAULT_VALUE ASAM.M.SCALAR.UBYTE.VTAB_RANGE_DEFAULT_VALUE ASAM.M.SCALAR.UBYTE.VTAB_RANGE_NO_DEFAULT_VALUE ASAM.M.SCALAR.ULONG.IDENTICAL ASAM.M.SCALAR.UWORD.IDENTICAL ASAM.M.SCALAR.UWORD.IDENTICAL.BITMASK_0008 ASAM.M.SCALAR.UWORD.IDENTICAL.BITMASK_0FF0 ASAM.M.VIRTUAL.SCALAR.SWORD.PHYSICAL /end REF_MEASUREMENT
/end GROUP
/begin GROUP Group_Type_Array "Contains all array measurements and parameters"
 /begin REF_CHARACTERISTIC ASAM.C.ARRAY.SWORD.MATRIX_DIM_3_4.COLUMN_DIR ASAM.C.ARRAY.SWORD.MATRIX_DIM_3_4.ROW_DIR ASAM.C.ARRAY.SWORD.MATRIX_DIM_6.ROW_DIR /end REF_CHARACTERISTIC
 /begin REF_MEASUREMENT ASAM.M.ARRAY_SIZE_16.UBYTE.IDENTICAL ASAM.M.MATRIX_DIM_16_1_1.UBYTE.IDENTICAL ASAM.M.MATRIX_DIM_8_2_1.UBYTE.IDENTICAL /end REF_MEASUREMENT
/end GROUP
/begin GROUP Group_Type_Curve "Contains all curve parameters"
 /begin REF_CHARACTERISTIC ASAM.C.CURVE.COM_AXIS ASAM.C.CURVE.CURVE_AXIS ASAM.C.CURVE.FIX_AXIS.PAR ASAM.C.CURVE.FIX_AXIS.PAR_DIST ASAM.C.CURVE.FIX_AXIS.PAR_LIST ASAM.C.CURVE.RES_AXIS ASAM.C.CURVE.STD_AXIS ASAM.C.CURVE.STD_AXIS.MONOTONY_STRICT_DECREASE ASAM.C.CURVE.STD_AXIS.MONOTONY_STRICT_INCREASE ASAM.C.CURVE_AXIS ASAM.C.AXIS_PTS.RESCALE ASAM.C.AXIS_PTS.UBYTE_8 /end REF_CHARACTERISTIC
/end GROUP
/begin GROUP Group_Type_Map "Contains all map parameters" /begin REF_CHARACTERISTIC ASAM.C.MAP.COM_AXIS.FIX_AXIS ASAM.C.MAP.STD_AXIS.STD_AXIS /end REF_CHARACTERISTIC /end GROUP
/begin GROUP Group_Type_Cuboid "Contains all cuboid parameters" /begin REF_CHARACTERISTIC ASAM.C.CUBOID.COM_AXIS.FIX_AXIS.STD_AXIS /end REF_CHARACTERISTIC /end GROUP
/begin GROUP Group_Type_ASCII "Contains all ASCII parameters" /begin REF_CHARACTERISTIC ASAM.C.ASCII.UBYTE.NUMBER_42 /end REF_CHARACTERISTIC /end GROUP
/begin GROUP Group_Function_All "contains all groups with special functions" ROOT
 /begin SUB_GROUP Group_Function_Virtual Group_Function_Monotony Group_Function_Computation Group_Function_Bitmask /end SUB_GROUP
/end GROUP
/begin GROUP Group_Function_Virtual "Contains all functions, measurements and parameters used for virtual" /begin FUNCTION_LIST FunctionVirtualMeasurements /end FUNCTION_LIST
 /begin REF_CHARACTERISTIC ASAM.C.SCALAR.SBYTE.IDENTICAL ASAM.C.SCALAR.UBYTE.IDENTICAL ASAM.C.VIRTUAL.ASCII ASAM.C.VIRTUAL.REF_1.SWORD ASAM.C.VIRTUAL.REF_2.UWORD ASAM.C.VIRTUAL.REF_3.SWORD ASAM.C.VIRTUAL.SYSTEM_CONSTANT_1 /end REF_CHARACTERISTIC
 /begin REF_MEASUREMENT ASAM.M.SCALAR.SBYTE.LINEAR_MUL_2 ASAM.M.VIRTUAL.SCALAR.SWORD.PHYSICAL /end REF_MEASUREMENT
/end GROUP
/begin GROUP Group_Function_Monotony "Contains all functions, measurements and parameters used for monotony" /end GROUP
/begin GROUP Group_Function_Computation "Contains all measurements and parameters that have a computation method different to identical"
 /begin REF_CHARACTERISTIC ASAM.C.SCALAR.SWORD.FORM_X_PLUS_4 ASAM.C.SCALAR.SWORD.LINEAR_MUL_2 ASAM.C.SCALAR.SWORD.RAT_FUNC_DIV_10 ASAM.C.SCALAR.SWORD.RAT_FUNC_DIV_81_9175 ASAM.C.SCALAR.SWORD.TAB_INTP_DEFAULT_VALUE ASAM.C.SCALAR.SWORD.TAB_INTP_NO_DEFAULT_VALUE ASAM.C.SCALAR.SWORD.TAB_NOINTP_DEFAULT_VALUE ASAM.C.SCALAR.SWORD.TAB_NOINTP_NO_DEFAULT_VALUE ASAM.C.SCALAR.SWORD.TAB_VERB_DEFAULT_VALUE ASAM.C.SCALAR.SWORD.TAB_VERB_NO_DEFAULT_VALUE ASAM.C.SCALAR.SWORD.VTAB_RANGE_DEFAULT_VALUE ASAM.C.SCALAR.SWORD.VTAB_RANGE_NO_DEFAULT_VALUE ASAM.C.SCALAR.UWORD.IDENTICAL.BITMASK_0001 ASAM.C.SCALAR.UWORD.IDENTICAL.BITMASK_0010 ASAM.C.SCALAR.UWORD.IDENTICAL.BITMASK_0FF0 /end REF_CHARACTERISTIC
 /begin REF_MEASUREMENT ASAM.M.SCALAR.SBYTE.LINEAR_MUL_2 ASAM.M.SCALAR.UBYTE.FORM_X_PLUS_4 ASAM.M.SCALAR.UBYTE.TAB_INTP_DEFAULT_VALUE ASAM.M.SCALAR.UBYTE.TAB_INTP_NO_DEFAULT_VALUE ASAM.M.SCALAR.UBYTE.TAB_NOINTP_DEFAULT_VALUE ASAM.M.SCALAR.UBYTE.TAB_NOINTP_NO_DEFAULT_VALUE ASAM.M.SCALAR.UBYTE.TAB_VERB_DEFAULT_VALUE ASAM.M.SCALAR.UBYTE.TAB_VERB_NO_DEFAULT_VALUE ASAM.M.SCALAR.UBYTE.VTAB_RANGE_DEFAULT_VALUE ASAM.M.SCALAR.UBYTE.VTAB_RANGE_NO_DEFAULT_VALUE /end REF_MEASUREMENT
/end GROUP
/begin GROUP Group_Function_Bitmask "Contains all measurements and parameters that have a bitmask"
 /begin REF_CHARACTERISTIC ASAM.C.SCALAR.UWORD.IDENTICAL.BITMASK_0001 ASAM.C.SCALAR.UWORD.IDENTICAL.BITMASK_0010 ASAM.C.SCALAR.UWORD.IDENTICAL.BITMASK_0FF0 /end REF_CHARACTERISTIC
 /begin REF_MEASUREMENT ASAM.M.SCALAR.UWORD.IDENTICAL.BITMASK_0008 ASAM.M.SCALAR.UWORD.IDENTICAL.BITMASK_0FF0 /end REF_MEASUREMENT
/end GROUP
/begin IF_DATA XCP
 /begin PROTOCOL_LAYER 0x100 0x20 0x20 0x20 0x20 0x20 0x20 0x20 0x8 0x8 BYTE_ORDER_MSB_LAST ADDRESS_GRANULARITY_BYTE OPTIONAL_CMD SET_REQUEST OPTIONAL_CMD GET_SEED OPTIONAL_CMD UNLOCK OPTIONAL_CMD SET_MTA OPTIONAL_CMD SHORT_DOWNLOAD OPTIONAL_CMD PROGRAM_START OPTIONAL_CMD PROGRAM_CLEAR OPTIONAL_CMD PROGRAM OPTIONAL_CMD PROGRAM_RESET OPTIONAL_CMD GET_PGM_PROCESSOR_INFO OPTIONAL_CMD GET_SECTOR_INFO OPTIONAL_CMD PROGRAM_PREPARE OPTIONAL_CMD PROGRAM_NEXT OPTIONAL_CMD PROGRAM_MAX OPTIONAL_CMD PROGRAM_VERIFY OPTIONAL_CMD TRANSPORT_LAYER_CMD OPTIONAL_CMD GET_ID OPTIONAL_CMD UPLOAD OPTIONAL_CMD SHORT_UPLOAD OPTIONAL_CMD BUILD_CHECKSUM OPTIONAL_CMD DOWNLOAD_NEXT OPTIONAL_CMD SET_CAL_PAGE OPTIONAL_CMD GET_CAL_PAGE OPTIONAL_CMD CLEAR_DAQ_LIST OPTIONAL_CMD SET_DAQ_PTR OPTIONAL_CMD WRITE_DAQ OPTIONAL_CMD SET_DAQ_LIST_MODE OPTIONAL_CMD GET_DAQ_LIST_MODE OPTIONAL_CMD START_STOP_DAQ_LIST OPTIONAL_CMD FREE_DAQ OPTIONAL_CMD ALLOC_DAQ OPTIONAL_CMD ALLOC_ODT OPTIONAL_CMD ALLOC_ODT_ENTRY OPTIONAL_CMD START_STOP_SYNCH OPTIONAL_CMD DOWNLOAD OPTIONAL_CMD MODIFY_BITS OPTIONAL_CMD GET_PAG_PROCESSOR_INFO OPTIONAL_CMD GET_SEGMENT_INFO OPTIONAL_CMD GET_PAGE_INFO OPTIONAL_CMD SET_SEGMENT_MODE OPTIONAL_CMD GET_SEGMENT_MODE OPTIONAL_CMD COPY_CAL_PAGE OPTIONAL_CMD GET_DAQ_CLOCK OPTIONAL_CMD READ_DAQ OPTIONAL_CMD GET_DAQ_LIST_MODE OPTIONAL_CMD DOWNLOAD_MAX COMMUNICATION_MODE_SUPPORTED BLOCK SLAVE MASTER 0x14 0x5 /end PROTOCOL_LAYER
 /begin DAQ STATIC 0x3 0x2 0x0 OPTIMISATION_TYPE_DEFAULT ADDRESS_EXTENSION_DAQ IDENTIFICATION_FIELD_TYPE_ABSOLUTE GRANULARITY_ODT_ENTRY_SIZE_DAQ_BYTE 0x4 OVERLOAD_INDICATION_EVENT PRESCALER_SUPPORTED /begin TIMESTAMP_SUPPORTED 0x1 SIZE_DWORD UNIT_1US /end TIMESTAMP_SUPPORTED /begin DAQ_LIST 0x0 DAQ_LIST_TYPE DAQ MAX_ODT 0x5 MAX_ODT_ENTRIES 0x7 /end DAQ_LIST /begin DAQ_LIST 0x1 DAQ_LIST_TYPE DAQ MAX_ODT 0x4 MAX_ODT_ENTRIES 0x7 /end DAQ_LIST /begin DAQ_LIST 0x2 DAQ_LIST_TYPE DAQ MAX_ODT 0x3 MAX_ODT_ENTRIES 0x7 /end DAQ_LIST /begin EVENT "5ms" "5ms" 0x0 DAQ 0xFF 0x5 0x6 0xFF /end EVENT /begin EVENT "extEvent" "extEvent" 0x1 DAQ 0xFF 0x1 0x9 0xFF /end EVENT /end DAQ
 /begin XCP_ON_CAN 0x100 CAN_ID_BROADCAST 0x52 CAN_ID_MASTER 0x51 CAN_ID_SLAVE 0x50 BAUDRATE 0x7A120 /end XCP_ON_CAN
/end IF_DATA
/begin MEASUREMENT ASAM.M.SCALAR.UBYTE.IDENTICAL "Scalar measurement" UBYTE CM.IDENTICAL 0 0 0 255.0 /end MEASUREMENT
/begin MEASUREMENT ASAM.M.SCALAR.UBYTE.TAB_VERB_DEFAULT_VALUE "Scalar measurement with verbal conversion and default value" UBYTE CM.TAB_VERB.DEFAULT_VALUE 0 0 0 255.0 /end MEASUREMENT
/begin MEASUREMENT ASAM.M.SCALAR.UBYTE.TAB_VERB_NO_DEFAULT_VALUE "Scalar measurement with verbal conversion" UBYTE CM.TAB_VERB.NO_DEFAULT_VALUE 0 0 0 255.0 /end MEASUREMENT
/begin MEASUREMENT ASAM.M.SCALAR.UBYTE.VTAB_RANGE_DEFAULT_VALUE "Scalar measurement with verbal conversion and default value" UBYTE CM.VTAB_RANGE.DEFAULT_VALUE 0 0 0 255.0 /end MEASUREMENT
/begin MEASUREMENT ASAM.M.SCALAR.UBYTE.VTAB_RANGE_NO_DEFAULT_VALUE "Scalar measurement with verbal conversion and default value" UBYTE CM.VTAB_RANGE.NO_DEFAULT_VALUE 0 0 0 101.0 /end MEASUREMENT
/begin MEASUREMENT ASAM.M.SCALAR.UBYTE.TAB_INTP_DEFAULT_VALUE "Scalar measurement with verbal conversion and default value" UBYTE CM.TAB_INTP.DEFAULT_VALUE 0 0 0 255.0 /end MEASUREMENT
/begin MEASUREMENT ASAM.M.SCALAR.UBYTE.TAB_INTP_NO_DEFAULT_VALUE "Scalar measurement with verbal conversion and default value" UBYTE CM.TAB_INTP.NO_DEFAULT_VALUE 0 0 0 13.0 /end MEASUREMENT
/begin MEASUREMENT ASAM.M.SCALAR.UBYTE.TAB_NOINTP_DEFAULT_VALUE "Scalar measurement with verbal conversion and default value" UBYTE CM.TAB_NOINTP.DEFAULT_VALUE 0 0 0 255.0 /end MEASUREMENT
/begin MEASUREMENT ASAM.M.SCALAR.UBYTE.TAB_NOINTP_NO_DEFAULT_VALUE "Scalar measurement with verbal conversion and default value" UBYTE CM.TAB_NOINTP.NO_DEFAULT_VALUE 0 0 0 13.0 /end MEASUREMENT
/begin MEASUREMENT ASAM.M.SCALAR.UBYTE.FORM_X_PLUS_4 "Scalar measurement" UBYTE CM.FORM.X_PLUS_4 0 0 4.0 259.0 /end MEASUREMENT
/begin MEASUREMENT ASAM.M.SCALAR.SBYTE.IDENTICAL "Scalar measurement" SBYTE CM.IDENTICAL 0 0 -128.0 127.0 /end MEASUREMENT
/begin MEASUREMENT ASAM.M.SCALAR.SBYTE.LINEAR_MUL_2 "Scalar measurement" SBYTE CM.LINEAR.MUL_2 0 0 -256.0 254.0 /end MEASUREMENT
/begin MEASUREMENT ASAM.M.SCALAR.UWORD.IDENTICAL "Scalar measurement" UWORD CM.IDENTICAL 0 0 0 65535.0 /end MEASUREMENT
/begin MEASUREMENT ASAM.M.SCALAR.SWORD.IDENTICAL "Scalar measurement" SWORD CM.IDENTICAL 0 0 -32268.0 32267.0 /end MEASUREMENT
/begin MEASUREMENT ASAM.M.SCALAR.ULONG.IDENTICAL "Scalar measurement" ULONG CM.IDENTICAL 0 0 0 4294967295.0 /end MEASUREMENT
/begin MEASUREMENT ASAM.M.SCALAR.SLONG.IDENTICAL "Scalar measurement" SLONG CM.IDENTICAL 0 0 -2147483648.0 2147483647.0 /end MEASUREMENT
/begin MEASUREMENT ASAM.M.SCALAR.FLOAT32.IDENTICAL "Scalar measurement" FLOAT32_IEEE CM.IDENTICAL 0 0 -1e+24 1e+24 /end MEASUREMENT
/begin MEASUREMENT ASAM.M.SCALAR.FLOAT64.IDENTICAL "Scalar measurement" FLOAT64_IEEE CM.IDENTICAL 0 0 -1e+308 1e+308 /end MEASUREMENT
/begin MEASUREMENT ASAM.M.SCALAR.UWORD.IDENTICAL.BITMASK_0FF0 "Scalar measurement with Bitmask for a bit-area" UWORD CM.IDENTICAL 0 0 0 255.0 BIT_MASK 4080 /end MEASUREMENT
/begin MEASUREMENT ASAM.M.SCALAR.UWORD.IDENTICAL.BITMASK_0008 "Scalar measurement with Bitmask for a single bit" UWORD CM.IDENTICAL 0 0 0 1.0 BIT_MASK 8 /end MEASUREMENT
/begin MEASUREMENT ASAM.M.ARRAY_SIZE_16.UBYTE.IDENTICAL "Scalar measurement" UBYTE CM.IDENTICAL 0 0 0 255.0 ARRAY_SIZE 16 /* number */ /end MEASUREMENT
/begin MEASUREMENT ASAM.M.MATRIX_DIM_16_1_1.UBYTE.IDENTICAL "Scalar measurement" UBYTE CM.IDENTICAL 0 0 0 255.0 MATRIX_DIM 16 1 1 /end MEASUREMENT
/begin MEASUREMENT ASAM.M.MATRIX_DIM_8_2_1.UBYTE.IDENTICAL "Scalar measurement" UBYTE CM.IDENTICAL 0 0 0 255.0 MATRIX_DIM 8 2 1 /end MEASUREMENT
/begin MEASUREMENT ASAM.M.MATRIX_DIM_8_4_2.UBYTE.IDENTICAL "Scalar measurement" UBYTE CM.IDENTICAL 0 0 0 255.0 MATRIX_DIM 8 4 2 /end MEASUREMENT
/begin MEASUREMENT ASAM.M.VIRTUAL.SCALAR.SWORD.PHYSICAL "Virtual measurement with 2 * ASAM.M.SCALAR.SBYTE.LINEAR_MUL_2 as input (based on the phys value of ASAM.M.SCALAR.SBYTE.LINEAR_MUL_2" SWORD CM.VIRTUAL.EXTERNAL_VALUE 0 0 -32768.0 32767.0 /begin VIRTUAL ASAM.M.SCALAR.SBYTE.LINEAR_MUL_2 /end VIRTUAL /end MEASUREMENT
/begin MOD_COMMON "" ALIGNMENT_BYTE 1 ALIGNMENT_FLOAT32_IEEE 4 ALIGNMENT_FLOAT64_IEEE 4 ALIGNMENT_LONG 4 ALIGNMENT_WORD 2 BYTE_ORDER MSB_LAST /* byteOrder */ /end MOD_COMMON
/begin MOD_PAR ""
 /begin MEMORY_SEGMENT ECU_Code "Memory segment for code part of the ECU" DATA /* prgType */ FLASH /* memoryType */ EXTERN 90112 2156 /* size */ -1 /* offset_0 */ -1 /* offset_1 */ -1 /* offset_2 */ -1 /* offset_3 */ -1 /* offset_4 */
  /begin IF_DATA XCP
   /begin SEGMENT 0x0 0x2 0x0 0x0 0x0
    /begin PAGE 0x0 ECU_ACCESS_DONT_CARE XCP_READ_ACCESS_WITH_ECU_ONLY XCP_WRITE_ACCESS_NOT_ALLOWED /end PAGE
    /begin PAGE 0x1 ECU_ACCESS_DONT_CARE XCP_READ_ACCESS_WITH_ECU_ONLY XCP_WRITE_ACCESS_WITH_ECU_ONLY /end PAGE
   /end SEGMENT
  /end IF_DATA
 /end MEMORY_SEGMENT
 /begin MEMORY_SEGMENT ECU_Data "Memory segment for parameters" DATA /* prgType */ FLASH /* memoryType */ EXTERN 8454144 65536 /* size */ -1 /* offset_0 */ -1 /* offset_1 */ -1 /* offset_2 */ -1 /* offset_3 */ -1 /* offset_4 */ /end MEMORY_SEGMENT
 NO_OF_INTERFACES 1 /* num */
 SYSTEM_CONSTANT "System_Constant_1" "-3.45"
 SYSTEM_CONSTANT "System_Constant_2" "5.67"
 SYSTEM_CONSTANT "System_Constant_3" "Text in System Constant" /end MOD_PAR
/end MODULE
/end PROJECT
