/begin PROJECT DPU-2XX "Visteon Diesel"
/begin HEADER " " VERSION "1" PROJECT_NO Global /end HEADER
/begin MODULE ENGINE "International Engine Controller"
/begin MOD_COMMON " " BYTE_ORDER MSB_FIRST /end MOD_COMMON
/begin CHARACTERISTIC FN_MNT_EGR_PCT_LO_LMN "X Norm=FN_090_DP, Y Norm=FN_091_DP" MAP 0x5578C TD_FLOAT32_IEEE 0 TCZ_FN_MNT_EGR_PCT_LO_LMN 0 100
 /begin AXIS_DESCR FIX_AXIS NO_INPUT_QUANTITY TCX_FN_MNT_EGR_PCT_LO_LMN 14 0 13 FIX_AXIS_PAR 0 0 14 /end AXIS_DESCR
 /begin AXIS_DESCR FIX_AXIS NO_INPUT_QUANTITY TCY_FN_MNT_EGR_PCT_LO_LMN 14 0 13 FIX_AXIS_PAR 0 0 14 /end AXIS_DESCR
/end CHARACTERISTIC
/begin COMPU_METHOD TCZ_FN_MNT_EGR_PCT_LO_LMN "FN_MNT_EGR_PCT_LO_LMN Z-axis conversion" RAT_FUNC "%10.5" "unitless" COEFFS 0 1 0 0 0 1 /end COMPU_METHOD
/begin COMPU_METHOD TCX_FN_MNT_EGR_PCT_LO_LMN "FN_MNT_EGR_PCT_LO_LMN X-axis conversion" RAT_FUNC "%10.5" "unitless" COEFFS 0 1 0 0 0 1 /end COMPU_METHOD
/begin COMPU_METHOD TCY_FN_MNT_EGR_PCT_LO_LMN "FN_MNT_EGR_PCT_LO_LMN Y-axis conversion" RAT_FUNC "%10.5" "unitless" COEFFS 0 1 0 0 0 1 /end COMPU_METHOD
/begin CHARACTERISTIC FN_MNT_EGR_PCT_LO_LMX "X Norm=FN_090_DP, Y Norm=FN_091_DP" MAP 0x5516C TD_FLOAT32_IEEE 0 TCZ_FN_MNT_EGR_PCT_LO_LMX 0 100
 /begin AXIS_DESCR FIX_AXIS NO_INPUT_QUANTITY TCX_FN_MNT_EGR_PCT_LO_LMX 14 0 13 FIX_AXIS_PAR 0 0 14 /end AXIS_DESCR
 /begin AXIS_DESCR FIX_AXIS NO_INPUT_QUANTITY TCY_FN_MNT_EGR_PCT_LO_LMX 14 0 13 FIX_AXIS_PAR 0 0 14 /end AXIS_DESCR
/end CHARACTERISTIC
/begin COMPU_METHOD TCZ_FN_MNT_EGR_PCT_LO_LMX "FN_MNT_EGR_PCT_LO_LMX Z-axis conversion" RAT_FUNC "%10.5" "unitless" COEFFS 0 1 0 0 0 1 /end COMPU_METHOD
/begin COMPU_METHOD TCX_FN_MNT_EGR_PCT_LO_LMX "FN_MNT_EGR_PCT_LO_LMX X-axis conversion" RAT_FUNC "%10.5" "unitless" COEFFS 0 1 0 0 0 1 /end COMPU_METHOD
/begin COMPU_METHOD TCY_FN_MNT_EGR_PCT_LO_LMX "FN_MNT_EGR_PCT_LO_LMX Y-axis conversion" RAT_FUNC "%10.5" "unitless" COEFFS 0 1 0 0 0 1 /end COMPU_METHOD
/begin CHARACTERISTIC FN_MXMF "Max mass fuel for pilot based on engine speed" CURVE 0x4876C FD_FLOAT32_IEEE 0 FCY_FN_MXMF 0 135 /begin AXIS_DESCR STD_AXIS N FCX_FN_MXMF 14 0 5000 /end AXIS_DESCR /end CHARACTERISTIC
/begin COMPU_METHOD FCX_FN_MXMF "FN_MXMF X-axis conversion" RAT_FUNC "%10.5" "RPM" COEFFS 0 1 0 0 0 1 /end COMPU_METHOD
/begin COMPU_METHOD FCY_FN_MXMF "FN_MXMF Y-axis conversion" RAT_FUNC "%10.5" "unitless" COEFFS 0 1 0 0 0 1 /end COMPU_METHOD
/begin CHARACTERISTIC FN_NLINOBART "filtered o/p shaft speed based idle setpoint table." CURVE 0x44A0C FD_FLOAT32_IEEE 0 FCY_FN_NLINOBART 0 4000 /begin AXIS_DESCR STD_AXIS NOBART FCX_FN_NLINOBART 10 0 16387.5 /end AXIS_DESCR /end CHARACTERISTIC
/begin COMPU_METHOD FCX_FN_NLINOBART "FN_NLINOBART X-axis conversion" RAT_FUNC "%10.5" "RPM" COEFFS 0 1 0 0 0 1 /end COMPU_METHOD
/begin COMPU_METHOD FCY_FN_NLINOBART "FN_NLINOBART Y-axis conversion" RAT_FUNC "%10.5" "RPM" COEFFS 0 1 0 0 0 1 /end COMPU_METHOD
/begin CHARACTERISTIC FN_N_DIF_EGR "" CURVE 0x5434C FD_FLOAT32_IEEE 0 FCY_FN_N_DIF_EGR 0 15 /begin AXIS_DESCR STD_AXIS DP_EGR_N_DIFF_FILT FCX_FN_N_DIF_EGR 10 -6000 6000 /end AXIS_DESCR /end CHARACTERISTIC
/begin COMPU_METHOD FCX_FN_N_DIF_EGR "FN_N_DIF_EGR X-axis conversion" RAT_FUNC "%10.5" "RPM" COEFFS 0 1 0 0 0 1 /end COMPU_METHOD
/begin COMPU_METHOD FCY_FN_N_DIF_EGR "FN_N_DIF_EGR Y-axis conversion" RAT_FUNC "%10.5" "unitless" COEFFS 0 1 0 0 0 1 /end COMPU_METHOD
/begin CHARACTERISTIC FN_N_MAT_NORM "Engine speed normalising function for fn_infmat_adder" CURVE 0x43C3C FD_FLOAT32_IEEE 0 FCY_FN_N_MAT_NORM 0 12 /begin AXIS_DESCR STD_AXIS N FCX_FN_N_MAT_NORM 12 0 8000 /end AXIS_DESCR /end CHARACTERISTIC
/begin COMPU_METHOD FCX_FN_N_MAT_NORM "FN_N_MAT_NORM X-axis conversion" RAT_FUNC "%10.5" "RPM" COEFFS 0 1 0 0 0 1 /end COMPU_METHOD
/begin COMPU_METHOD FCY_FN_N_MAT_NORM "FN_N_MAT_NORM Y-axis conversion" RAT_FUNC "%10.5" "unitless" COEFFS 0 1 0 0 0 1 /end COMPU_METHOD
/begin CHARACTERISTIC FN_N_PEAK_FL_FLOW "Fuel flow at WOT and STP as a function of RPM" CURVE 0x467AC FD_FLOAT32_IEEE 0 FCY_FN_N_PEAK_FL_FLOW 0 500 /begin AXIS_DESCR STD_AXIS N FCX_FN_N_PEAK_FL_FLOW 14 0 6000 /end AXIS_DESCR /end CHARACTERISTIC
/begin COMPU_METHOD FCX_FN_N_PEAK_FL_FLOW "FN_N_PEAK_FL_FLOW X-axis conversion" RAT_FUNC "%10.5" "RPM" COEFFS 0 1 0 0 0 1 /end COMPU_METHOD
/begin COMPU_METHOD FCY_FN_N_PEAK_FL_FLOW "FN_N_PEAK_FL_FLOW Y-axis conversion" RAT_FUNC "%10.5" "unitless" COEFFS 0 1 0 0 0 1 /end COMPU_METHOD
/begin CHARACTERISTIC FN_P_ADV "X Norm=FN060DS, Y Norm=FN059DS, Pilot Advance Table" MAP 0x4AD28 TD_FLOAT32_IEEE 0 TCZ_FN_P_ADV -50 50
 /begin AXIS_DESCR FIX_AXIS NO_INPUT_QUANTITY TCX_FN_P_ADV 14 0 13 FIX_AXIS_PAR 0 0 14 /end AXIS_DESCR
 /begin AXIS_DESCR FIX_AXIS NO_INPUT_QUANTITY TCY_FN_P_ADV 14 0 13 FIX_AXIS_PAR 0 0 14 /end AXIS_DESCR
/end CHARACTERISTIC
/begin COMPU_METHOD TCZ_FN_P_ADV "FN_P_ADV Z-axis conversion" RAT_FUNC "%10.5" "unitless" COEFFS 0 1 0 0 0 1 /end COMPU_METHOD
/begin COMPU_METHOD TCX_FN_P_ADV "FN_P_ADV X-axis conversion" RAT_FUNC "%10.5" "unitless" COEFFS 0 1 0 0 0 1 /end COMPU_METHOD
/begin COMPU_METHOD TCY_FN_P_ADV "FN_P_ADV Y-axis conversion" RAT_FUNC "%10.5" "unitless" COEFFS 0 1 0 0 0 1 /end COMPU_METHOD
/begin MEASUREMENT FN_SPN "Max engine speed for pilot based on EOT" FLOAT32_IEEE MC_FN_SPN 0 0 0 0 ECU_ADDRESS 0x3FA8C4 /end MEASUREMENT
/begin COMPU_METHOD MC_FN_SPN "FN_SPN conversion" RAT_FUNC "%10.5" "Unitless" COEFFS 0 1 0 0 0 1 /end COMPU_METHOD
/begin CHARACTERISTIC FN_TOT_IDLE "Transmission fluid temp. idle speed setpoint" CURVE 0x44A5C FD_FLOAT32_IEEE 0 FCY_FN_TOT_IDLE 400 4000 /begin AXIS_DESCR STD_AXIS TOT_DEGC FCX_FN_TOT_IDLE 6 -40 150 /end AXIS_DESCR /end CHARACTERISTIC
/begin COMPU_METHOD FCX_FN_TOT_IDLE "FN_TOT_IDLE X-axis conversion" RAT_FUNC "%10.5" "degC" COEFFS 0 1 0 0 0 1 /end COMPU_METHOD
/begin COMPU_METHOD FCY_FN_TOT_IDLE "FN_TOT_IDLE Y-axis conversion" RAT_FUNC "%10.5" "RPM" COEFFS 0 1 0 0 0 1 /end COMPU_METHOD
/begin CHARACTERISTIC FN_TQ100 "Normalixed eot_c for fn2_tq_xxx_brk_cf table function" CURVE 0x4F6CC FD_FLOAT32_IEEE 0 FCY_FN_TQ100 0 13 /begin AXIS_DESCR STD_AXIS EOT_C FCX_FN_TQ100 14 -8000 8000 /end AXIS_DESCR /end CHARACTERISTIC
/begin COMPU_METHOD FCX_FN_TQ100 "FN_TQ100 X-axis conversion" RAT_FUNC "%10.5" "degC" COEFFS 0 1 0 0 0 1 /end COMPU_METHOD
/begin COMPU_METHOD FCY_FN_TQ100 "FN_TQ100 Y-axis conversion" RAT_FUNC "%10.5" "unitless" COEFFS 0 1 0 0 0 1 /end COMPU_METHOD
/begin CHARACTERISTIC FN_TQ102 "Normalising table gor fncur_n_max_tq" CURVE 0x4F65C FD_FLOAT32_IEEE 0 FCY_FN_TQ102 0 13 /begin AXIS_DESCR STD_AXIS NO_INPUT_QUANTITY FCX_FN_TQ102 14 -40 150 /end AXIS_DESCR /end CHARACTERISTIC
/begin COMPU_METHOD FCX_FN_TQ102 "FN_TQ102 X-axis conversion" RAT_FUNC "%10.5" "degC" COEFFS 0 1 0 0 0 1 /end COMPU_METHOD
/begin COMPU_METHOD FCY_FN_TQ102 "FN_TQ102 Y-axis conversion" RAT_FUNC "%10.5" "unitless" COEFFS 0 1 0 0 0 1 /end COMPU_METHOD
/begin CHARACTERISTIC FN_TQ104 "Output normalized tq_max_comb_trq" CURVE 0x4FB2C FD_FLOAT32_IEEE 0 FCY_FN_TQ104 0 13 /begin AXIS_DESCR STD_AXIS TQ_MAX_COMB_TRQ FCX_FN_TQ104 14 -400 1100 /end AXIS_DESCR /end CHARACTERISTIC
/begin COMPU_METHOD FCX_FN_TQ104 "FN_TQ104 X-axis conversion" RAT_FUNC "%10.5" "lbf*ft" COEFFS 0 1 0 0 0 1 /end COMPU_METHOD
/begin COMPU_METHOD FCY_FN_TQ104 "FN_TQ104 Y-axis conversion" RAT_FUNC "%10.5" "unitless" COEFFS 0 1 0 0 0 1 /end COMPU_METHOD
/begin CHARACTERISTIC FN_TQ109 "Normalized tq_max_brk_pps_req for fn1108x_copy" CURVE 0x4F96C FD_FLOAT32_IEEE 0 FCY_FN_TQ109 0 13 /begin AXIS_DESCR STD_AXIS NO_INPUT_QUANTITY FCX_FN_TQ109 14 0 1023 /end AXIS_DESCR /end CHARACTERISTIC
/begin COMPU_METHOD FCX_FN_TQ109 "FN_TQ109 X-axis conversion" RAT_FUNC "%10.5" "unitless" COEFFS 0 1 0 0 0 1 /end COMPU_METHOD
/begin COMPU_METHOD FCY_FN_TQ109 "FN_TQ109 Y-axis conversion" RAT_FUNC "%10.5" "unitless" COEFFS 0 1 0 0 0 1 /end COMPU_METHOD
/begin CHARACTERISTIC FN_TQ110 "Normalized tq_max_brk_req for fn1108x_copy table function" CURVE 0x4F9DC FD_FLOAT32_IEEE 0 FCY_FN_TQ110 0 13 /begin AXIS_DESCR STD_AXIS NO_INPUT_QUANTITY FCX_FN_TQ110 14 0 8000 /end AXIS_DESCR /end CHARACTERISTIC
/begin COMPU_METHOD FCX_FN_TQ110 "FN_TQ110 X-axis conversion" RAT_FUNC "%10.5" "unitless" COEFFS 0 1 0 0 0 1 /end COMPU_METHOD
/begin COMPU_METHOD FCY_FN_TQ110 "FN_TQ110 Y-axis conversion" RAT_FUNC "%10.5" "unitless" COEFFS 0 1 0 0 0 1 /end COMPU_METHOD
/begin CHARACTERISTIC FN_TQ112 "Normalised min of inp1_fntq112/inp2_fntq112 for fn_xxxx_mn_copy2 table function." CURVE 0x4FA4C FD_FLOAT32_IEEE 0 FCY_FN_TQ112 0 13 /begin AXIS_DESCR STD_AXIS NO_INPUT_QUANTITY FCX_FN_TQ112 14 -100 400 /end AXIS_DESCR /end CHARACTERISTIC
/begin COMPU_METHOD FCX_FN_TQ112 "FN_TQ112 X-axis conversion" RAT_FUNC "%10.5" "unitless" COEFFS 0 1 0 0 0 1 /end COMPU_METHOD
/begin COMPU_METHOD FCY_FN_TQ112 "FN_TQ112 Y-axis conversion" RAT_FUNC "%10.5" "unitless" COEFFS 0 1 0 0 0 1 /end COMPU_METHOD
/begin CHARACTERISTIC FN_TQ114 "Engine speed normalizing function" CURVE 0x4FB9C FD_FLOAT32_IEEE 0 FCY_FN_TQ114 0 14 /begin AXIS_DESCR STD_AXIS N FCX_FN_TQ114 14 0 8000 /end AXIS_DESCR /end CHARACTERISTIC
/begin COMPU_METHOD FCX_FN_TQ114 "FN_TQ114 X-axis conversion" RAT_FUNC "%10.5" "unitless" COEFFS 0 1 0 0 0 1 /end COMPU_METHOD
/begin COMPU_METHOD FCY_FN_TQ114 "FN_TQ114 Y-axis conversion" RAT_FUNC "%10.5" "unitless" COEFFS 0 1 0 0 0 1 /end COMPU_METHOD
/begin CHARACTERISTIC FN_TQ115 "Normalising function for fncur_n_max_tq  table" CURVE 0x4F73C FD_FLOAT32_IEEE 0 FCY_FN_TQ115 0 13 /begin AXIS_DESCR STD_AXIS N FCX_FN_TQ115 14 0 8000 /end AXIS_DESCR /end CHARACTERISTIC
/begin COMPU_METHOD FCX_FN_TQ115 "FN_TQ115 X-axis conversion" RAT_FUNC "%10.5" "RPM" COEFFS 0 1 0 0 0 1 /end COMPU_METHOD
/begin COMPU_METHOD FCY_FN_TQ115 "FN_TQ115 Y-axis conversion" RAT_FUNC "%10.5" "unitless" COEFFS 0 1 0 0 0 1 /end COMPU_METHOD
/begin CHARACTERISTIC FN_TQ116 "normalising function for fn1020xx_copy table" CURVE 0x4F7AC FD_FLOAT32_IEEE 0 FCY_FN_TQ116 0 13 /begin AXIS_DESCR STD_AXIS NO_INPUT_QUANTITY FCX_FN_TQ116 14 0 8000 /end AXIS_DESCR /end CHARACTERISTIC
/begin COMPU_METHOD FCX_FN_TQ116 "FN_TQ116 X-axis conversion" RAT_FUNC "%10.5" "unitless" COEFFS 0 1 0 0 0 1 /end COMPU_METHOD
/begin COMPU_METHOD FCY_FN_TQ116 "FN_TQ116 Y-axis conversion" RAT_FUNC "%10.5" "unitless" COEFFS 0 1 0 0 0 1 /end COMPU_METHOD
/begin CHARACTERISTIC FN_TQ117 "Normalized tq_max_brk_req for fn1020pxx_copy table function" CURVE 0x4F81C FD_FLOAT32_IEEE 0 FCY_FN_TQ117 0 13 /begin AXIS_DESCR STD_AXIS NO_INPUT_QUANTITY FCX_FN_TQ117 14 0 8000 /end AXIS_DESCR /end CHARACTERISTIC
/begin COMPU_METHOD FCX_FN_TQ117 "FN_TQ117 X-axis conversion" RAT_FUNC "%10.5" "unitless" COEFFS 0 1 0 0 0 1 /end COMPU_METHOD
/begin COMPU_METHOD FCY_FN_TQ117 "FN_TQ117 Y-axis conversion" RAT_FUNC "%10.5" "unitless" COEFFS 0 1 0 0 0 1 /end COMPU_METHOD
/begin CHARACTERISTIC FN_TQ118 "Normalised tq_max_brk_req for fn_friction_norm table" CURVE 0x4F88C FD_FLOAT32_IEEE 0 FCY_FN_TQ118 0 13 /begin AXIS_DESCR STD_AXIS NO_INPUT_QUANTITY FCX_FN_TQ118 14 0 8000 /end AXIS_DESCR /end CHARACTERISTIC
/begin COMPU_METHOD FCX_FN_TQ118 "FN_TQ118 X-axis conversion" RAT_FUNC "%10.5" "unitless" COEFFS 0 1 0 0 0 1 /end COMPU_METHOD
/begin COMPU_METHOD FCY_FN_TQ118 "FN_TQ118 Y-axis conversion" RAT_FUNC "%10.5" "unitless" COEFFS 0 1 0 0 0 1 /end COMPU_METHOD
/begin CHARACTERISTIC FN_TQ119 "Normalized tq_max_brk_req for fn_xxxx_mn_copy2 table function" CURVE 0x4F8FC FD_FLOAT32_IEEE 0 FCY_FN_TQ119 0 13 /begin AXIS_DESCR STD_AXIS NO_INPUT_QUANTITY FCX_FN_TQ119 14 0 8000 /end AXIS_DESCR /end CHARACTERISTIC
/begin COMPU_METHOD FCX_FN_TQ119 "FN_TQ119 X-axis conversion" RAT_FUNC "%10.5" "unitless" COEFFS 0 1 0 0 0 1 /end COMPU_METHOD
/begin COMPU_METHOD FCY_FN_TQ119 "FN_TQ119 Y-axis conversion" RAT_FUNC "%10.5" "unitless" COEFFS 0 1 0 0 0 1 /end COMPU_METHOD
/begin CHARACTERISTIC FN_TQ120 "Normalized mfgov_pi for fn_xxxx_mn_copy table function" CURVE 0x4FC0C FD_FLOAT32_IEEE 0 FCY_FN_TQ120 0 13 /begin AXIS_DESCR STD_AXIS NO_INPUT_QUANTITY FCX_FN_TQ120 14 0 250 /end AXIS_DESCR /end CHARACTERISTIC
/begin COMPU_METHOD FCX_FN_TQ120 "FN_TQ120 X-axis conversion" RAT_FUNC "%10.5" "unitless" COEFFS 0 1 0 0 0 1 /end COMPU_METHOD
/begin COMPU_METHOD FCY_FN_TQ120 "FN_TQ120 Y-axis conversion" RAT_FUNC "%10.5" "unitless" COEFFS 0 1 0 0 0 1 /end COMPU_METHOD
/begin CHARACTERISTIC FN_TQ121 "Normalized tq_min_brk_req for fnpred_min_tq function table" CURVE 0x4FC7C FD_FLOAT32_IEEE 0 FCY_FN_TQ121 0 13 /begin AXIS_DESCR STD_AXIS NO_INPUT_QUANTITY FCX_FN_TQ121 14 0 8000 /end AXIS_DESCR /end CHARACTERISTIC
/begin COMPU_METHOD FCX_FN_TQ121 "FN_TQ121 X-axis conversion" RAT_FUNC "%10.5" "unitless" COEFFS 0 1 0 0 0 1 /end COMPU_METHOD
/begin COMPU_METHOD FCY_FN_TQ121 "FN_TQ121 Y-axis conversion" RAT_FUNC "%10.5" "unitless" COEFFS 0 1 0 0 0 1 /end COMPU_METHOD
/begin CHARACTERISTIC FN_TQ122DS_ECT "Normalised ect_c for fn1020(hi/lo)_copy 3d table function" CURVE 0x4FCEC FD_FLOAT32_IEEE 0 FCY_FN_TQ122DS_ECT 0 13 /begin AXIS_DESCR STD_AXIS ECT_C FCX_FN_TQ122DS_ECT 14 -40 150 /end AXIS_DESCR /end CHARACTERISTIC
/begin COMPU_METHOD FCX_FN_TQ122DS_ECT "FN_TQ122DS_ECT X-axis conversion" RAT_FUNC "%10.5" "degC" COEFFS 0 1 0 0 0 1 /end COMPU_METHOD
/begin COMPU_METHOD FCY_FN_TQ122DS_ECT "FN_TQ122DS_ECT Y-axis conversion" RAT_FUNC "%10.5" "unitless" COEFFS 0 1 0 0 0 1 /end COMPU_METHOD
/begin CHARACTERISTIC FN_TQ122DS_EOT "Normalised eot_c for fn1020(hi/lo)_copy 3d table function" CURVE 0x4FD5C FD_FLOAT32_IEEE 0 FCY_FN_TQ122DS_EOT 0 13 /begin AXIS_DESCR STD_AXIS EOT_C FCX_FN_TQ122DS_EOT 14 -40 150 /end AXIS_DESCR /end CHARACTERISTIC
/begin COMPU_METHOD FCX_FN_TQ122DS_EOT "FN_TQ122DS_EOT X-axis conversion" RAT_FUNC "%10.5" "degC" COEFFS 0 1 0 0 0 1 /end COMPU_METHOD
/begin COMPU_METHOD FCY_FN_TQ122DS_EOT "FN_TQ122DS_EOT Y-axis conversion" RAT_FUNC "%10.5" "unitless" COEFFS 0 1 0 0 0 1 /end COMPU_METHOD
/begin CHARACTERISTIC FN_TQ122P_ECT "Normalised ect_c for fn1020plo_copy 3d table function" CURVE 0x4FDCC FD_FLOAT32_IEEE 0 FCY_FN_TQ122P_ECT 0 13 /begin AXIS_DESCR STD_AXIS ECT_C FCX_FN_TQ122P_ECT 14 -40 150 /end AXIS_DESCR /end CHARACTERISTIC
/begin COMPU_METHOD FCX_FN_TQ122P_ECT "FN_TQ122P_ECT X-axis conversion" RAT_FUNC "%10.5" "degC" COEFFS 0 1 0 0 0 1 /end COMPU_METHOD
/begin COMPU_METHOD FCY_FN_TQ122P_ECT "FN_TQ122P_ECT Y-axis conversion" RAT_FUNC "%10.5" "unitless" COEFFS 0 1 0 0 0 1 /end COMPU_METHOD
/begin CHARACTERISTIC FN_TQ122P_EOT "Normalised eot_c for fn1020plo_copy 3d table function" CURVE 0x4FE3C FD_FLOAT32_IEEE 0 FCY_FN_TQ122P_EOT 0 13 /begin AXIS_DESCR STD_AXIS EOT_C FCX_FN_TQ122P_EOT 14 -40 150 /end AXIS_DESCR /end CHARACTERISTIC
/begin COMPU_METHOD FCX_FN_TQ122P_EOT "FN_TQ122P_EOT X-axis conversion" RAT_FUNC "%10.5" "degC" COEFFS 0 1 0 0 0 1 /end COMPU_METHOD
/begin COMPU_METHOD FCY_FN_TQ122P_EOT "FN_TQ122P_EOT Y-axis conversion" RAT_FUNC "%10.5" "unitless" COEFFS 0 1 0 0 0 1 /end COMPU_METHOD
/begin CHARACTERISTIC FN_TQ123 "Normalized min mfgov_tbl/mfmtq for fn_xxxx_mn_copy table function" CURVE 0x4FABC FD_FLOAT32_IEEE 0 FCY_FN_TQ123 0 13 /begin AXIS_DESCR STD_AXIS NO_INPUT_QUANTITY FCX_FN_TQ123 14 -2048 2047 /end AXIS_DESCR /end CHARACTERISTIC
/begin COMPU_METHOD FCX_FN_TQ123 "FN_TQ123 X-axis conversion" RAT_FUNC "%10.5" "unitless" COEFFS 0 1 0 0 0 1 /end COMPU_METHOD
/begin COMPU_METHOD FCY_FN_TQ123 "FN_TQ123 Y-axis conversion" RAT_FUNC "%10.5" "unitless" COEFFS 0 1 0 0 0 1 /end COMPU_METHOD
/begin CHARACTERISTIC FN_TQ_ALTRNTR_TORQUE "Alternator torque table" CURVE 0x4D95C FD_FLOAT32_IEEE 0 FCY_FN_TQ_ALTRNTR_TORQUE -500 1000 /begin AXIS_DESCR STD_AXIS N FCX_FN_TQ_ALTRNTR_TORQUE 14 0 8000 /end AXIS_DESCR /end CHARACTERISTIC
/begin COMPU_METHOD FCX_FN_TQ_ALTRNTR_TORQUE "FN_TQ_ALTRNTR_TORQUE X-axis conversion" RAT_FUNC "%10.5" "RPM" COEFFS 0 1 0 0 0 1 /end COMPU_METHOD
/begin COMPU_METHOD FCY_FN_TQ_ALTRNTR_TORQUE "FN_TQ_ALTRNTR_TORQUE Y-axis conversion" RAT_FUNC "%10.5" "unitless" COEFFS 0 1 0 0 0 1 /end COMPU_METHOD
/begin CHARACTERISTIC FN_TQ_BRK_BOOST "Break boost torque table" CURVE 0x4D8EC FD_FLOAT32_IEEE 0 FCY_FN_TQ_BRK_BOOST -500 1000 /begin AXIS_DESCR STD_AXIS N FCX_FN_TQ_BRK_BOOST 14 0 8000 /end AXIS_DESCR /end CHARACTERISTIC
/begin COMPU_METHOD FCX_FN_TQ_BRK_BOOST "FN_TQ_BRK_BOOST X-axis conversion" RAT_FUNC "%10.5" "RPM" COEFFS 0 1 0 0 0 1 /end COMPU_METHOD
/begin COMPU_METHOD FCY_FN_TQ_BRK_BOOST "FN_TQ_BRK_BOOST Y-axis conversion" RAT_FUNC "%10.5" "unitless" COEFFS 0 1 0 0 0 1 /end COMPU_METHOD
/begin CHARACTERISTIC FN_TQ_PWR_STEER "Power steer torque table." CURVE 0x4D9CC FD_FLOAT32_IEEE 0 FCY_FN_TQ_PWR_STEER -500 1000 /begin AXIS_DESCR STD_AXIS N FCX_FN_TQ_PWR_STEER 14 0 8000 /end AXIS_DESCR /end CHARACTERISTIC
/begin COMPU_METHOD FCX_FN_TQ_PWR_STEER "FN_TQ_PWR_STEER X-axis conversion" RAT_FUNC "%10.5" "RPM" COEFFS 0 1 0 0 0 1 /end COMPU_METHOD
/begin COMPU_METHOD FCY_FN_TQ_PWR_STEER "FN_TQ_PWR_STEER Y-axis conversion" RAT_FUNC "%10.5" "unitless" COEFFS 0 1 0 0 0 1 /end COMPU_METHOD
/begin CHARACTERISTIC FN_VFDES_IPR_FLOW "Normalization function" CURVE 0x4B994 FD_FLOAT32_IEEE 0 FCY_FN_VFDES_IPR_FLOW 0 20 /begin AXIS_DESCR STD_AXIS VFDES FCX_FN_VFDES_IPR_FLOW 14 -15000 35000 /end AXIS_DESCR /end CHARACTERISTIC
/begin COMPU_METHOD FCX_FN_VFDES_IPR_FLOW "FN_VFDES_IPR_FLOW X-axis conversion" RAT_FUNC "%10.5" "unitless" COEFFS 0 1 0 0 0 1 /end COMPU_METHOD
/begin COMPU_METHOD FCY_FN_VFDES_IPR_FLOW "FN_VFDES_IPR_FLOW Y-axis conversion" RAT_FUNC "%10.5" "unitless" COEFFS 0 1 0 0 0 1 /end COMPU_METHOD
/begin CHARACTERISTIC FN_VGT_ACF "" CURVE 0x5791C FD_FLOAT32_IEEE 0 FCY_FN_VGT_ACF -2000 20000 /begin AXIS_DESCR STD_AXIS BP FCX_FN_VGT_ACF 14 0 255.992 /end AXIS_DESCR /end CHARACTERISTIC
/begin COMPU_METHOD FCX_FN_VGT_ACF "FN_VGT_ACF X-axis conversion" RAT_FUNC "%10.5" "unitless" COEFFS 0 1 0 0 0 1 /end COMPU_METHOD
/begin COMPU_METHOD FCY_FN_VGT_ACF "FN_VGT_ACF Y-axis conversion" RAT_FUNC "%10.5" "unitless" COEFFS 0 1 0 0 0 1 /end COMPU_METHOD
/begin CHARACTERISTIC FN_VGT_OSP "" CURVE 0x57ADC FD_FLOAT32_IEEE 0 FCY_FN_VGT_OSP 0 1 /begin AXIS_DESCR STD_AXIS VGT_TSP FCX_FN_VGT_OSP 14 0 200000 /end AXIS_DESCR /end CHARACTERISTIC
/begin COMPU_METHOD FCX_FN_VGT_OSP "FN_VGT_OSP X-axis conversion" RAT_FUNC "%10.5" "unitless" COEFFS 0 1 0 0 0 1 /end COMPU_METHOD
/begin COMPU_METHOD FCY_FN_VGT_OSP "FN_VGT_OSP Y-axis conversion" RAT_FUNC "%10.5" "unitless" COEFFS 0 1 0 0 0 1 /end COMPU_METHOD
/begin CHARACTERISTIC FN_VGT_SS_EBPG_ERR_LMT "VGT steady state error limit table based on engine rpm." CURVE 0x43A7C FD_FLOAT32_IEEE 0 FCY_FN_VGT_SS_EBPG_ERR_LMT 0 350 /begin AXIS_DESCR STD_AXIS N FCX_FN_VGT_SS_EBPG_ERR_LMT 14 0 16383.8 /end AXIS_DESCR /end CHARACTERISTIC
/begin COMPU_METHOD FCX_FN_VGT_SS_EBPG_ERR_LMT "FN_VGT_SS_EBPG_ERR_LMT X-axis conversion" RAT_FUNC "%10.5" "RPM" COEFFS 0 1 0 0 0 1 /end COMPU_METHOD
/begin COMPU_METHOD FCY_FN_VGT_SS_EBPG_ERR_LMT "FN_VGT_SS_EBPG_ERR_LMT Y-axis conversion" RAT_FUNC "%10.5" "unitless" COEFFS 0 1 0 0 0 1 /end COMPU_METHOD
/begin CHARACTERISTIC FN_VGT_SS_EBP_TM "VGT steady state error timer limit table." CURVE 0x43AEC FD_FLOAT32_IEEE 0 FCY_FN_VGT_SS_EBP_TM 0 1e+08 /begin AXIS_DESCR STD_AXIS N FCX_FN_VGT_SS_EBP_TM 14 0 16383.8 /end AXIS_DESCR /end CHARACTERISTIC
/begin COMPU_METHOD FCX_FN_VGT_SS_EBP_TM "FN_VGT_SS_EBP_TM X-axis conversion" RAT_FUNC "%10.5" "RPM" COEFFS 0 1 0 0 0 1 /end COMPU_METHOD
/begin COMPU_METHOD FCY_FN_VGT_SS_EBP_TM "FN_VGT_SS_EBP_TM Y-axis conversion" RAT_FUNC "%10.5" "s" COEFFS 0 1 0 0 0 1 /end COMPU_METHOD
/begin CHARACTERISTIC FN_VGT_TSP_HI "" CURVE 0x5798C FD_FLOAT32_IEEE 0 FCY_FN_VGT_TSP_HI 0 200000 /begin AXIS_DESCR STD_AXIS MAP_KPA FCX_FN_VGT_TSP_HI 14 0 1000 /end AXIS_DESCR /end CHARACTERISTIC
/begin COMPU_METHOD FCX_FN_VGT_TSP_HI "FN_VGT_TSP_HI X-axis conversion" RAT_FUNC "%10.5" "unitless" COEFFS 0 1 0 0 0 1 /end COMPU_METHOD
/begin COMPU_METHOD FCY_FN_VGT_TSP_HI "FN_VGT_TSP_HI Y-axis conversion" RAT_FUNC "%10.5" "unitless" COEFFS 0 1 0 0 0 1 /end COMPU_METHOD
/begin CHARACTERISTIC FN_VGT_TSP_LO "" CURVE 0x579FC FD_FLOAT32_IEEE 0 FCY_FN_VGT_TSP_LO 0 200000 /begin AXIS_DESCR STD_AXIS MAP_KPA FCX_FN_VGT_TSP_LO 14 0 1000 /end AXIS_DESCR /end CHARACTERISTIC
/begin COMPU_METHOD FCX_FN_VGT_TSP_LO "FN_VGT_TSP_LO X-axis conversion" RAT_FUNC "%10.5" "unitless" COEFFS 0 1 0 0 0 1 /end COMPU_METHOD
/begin COMPU_METHOD FCY_FN_VGT_TSP_LO "FN_VGT_TSP_LO Y-axis conversion" RAT_FUNC "%10.5" "unitless" COEFFS 0 1 0 0 0 1 /end COMPU_METHOD
/begin CHARACTERISTIC FN_VGT_TSP_MID "" CURVE 0x57A6C FD_FLOAT32_IEEE 0 FCY_FN_VGT_TSP_MID 0 200000 /begin AXIS_DESCR STD_AXIS MAP_KPA FCX_FN_VGT_TSP_MID 14 0 1000 /end AXIS_DESCR /end CHARACTERISTIC
/begin COMPU_METHOD FCX_FN_VGT_TSP_MID "FN_VGT_TSP_MID X-axis conversion" RAT_FUNC "%10.5" "unitless" COEFFS 0 1 0 0 0 1 /end COMPU_METHOD
/begin COMPU_METHOD FCY_FN_VGT_TSP_MID "FN_VGT_TSP_MID Y-axis conversion" RAT_FUNC "%10.5" "unitless" COEFFS 0 1 0 0 0 1 /end COMPU_METHOD
/begin CHARACTERISTIC FPMP_ON_TM "Maximum time for fuel pump to be on during engine off and OTM tests." VALUE 0x5EAA4 SD_FLOAT32_IEEE 0 SC_FPMP_ON_TM 0 31.875 /end CHARACTERISTIC
/begin COMPU_METHOD SC_FPMP_ON_TM "FPMP_ON_TM conversion" RAT_FUNC "%10.5" "s" COEFFS 0 1 0 0 0 1 /end COMPU_METHOD
/begin MEASUREMENT FPMP_ON_TMR "Timer to limit the on time during engine off testing and output test mode" FLOAT32_IEEE MC_FPMP_ON_TMR 0 0 0 0 ECU_ADDRESS 0x3FB198 /end MEASUREMENT
/begin COMPU_METHOD MC_FPMP_ON_TMR "FPMP_ON_TMR conversion" RAT_FUNC "%10.5" "Unitless" COEFFS 0 1 0 0 0 1 /end COMPU_METHOD
/begin MEASUREMENT FP_CMD "Fuel pump command (on/off)" UBYTE MC_FP_CMD 0 0 0 0 ECU_ADDRESS 0x3FB658 /end MEASUREMENT
/begin COMPU_METHOD MC_FP_CMD "FP_CMD conversion" RAT_FUNC "%3.0" "Unitless" COEFFS 0 1 0 0 0 1 /end COMPU_METHOD
/begin CHARACTERISTIC FP_EN_CON "Fuel pump control enable flag" VALUE 0x5EAA9 SD_UBYTE 0 SC_FP_EN_CON 0 1 /end CHARACTERISTIC
/begin COMPU_METHOD SC_FP_EN_CON "FP_EN_CON conversion" RAT_FUNC "%3.0" "unitless" COEFFS 0 1 0 0 0 1 /end COMPU_METHOD
/begin MEASUREMENT FP_SMON "fuel pump monitor" UBYTE MC_FP_SMON 0 0 0 0 ECU_ADDRESS 0x3F9830 /end MEASUREMENT
/begin COMPU_METHOD MC_FP_SMON "FP_SMON conversion" RAT_FUNC "%3.0" "Unitless" COEFFS 0 1 0 0 0 1 /end COMPU_METHOD
/begin MEASUREMENT FP_STATUS "Status of Fuel Pump high level driver ( 0 = ok )" UBYTE MC_FP_STATUS 0 0 0 0 ECU_ADDRESS 0x3F9831 /end MEASUREMENT
/begin COMPU_METHOD MC_FP_STATUS "FP_STATUS conversion" RAT_FUNC "%3.0" "Unitless" COEFFS 0 1 0 0 0 1 /end COMPU_METHOD
/begin MEASUREMENT FUEL_CAP_OFF_REQ "Fuel Cap Off lamp request" UBYTE MC_FUEL_CAP_OFF_REQ 0 0 0 0 ECU_ADDRESS 0x3F9CF7 /end MEASUREMENT
/begin COMPU_METHOD MC_FUEL_CAP_OFF_REQ "FUEL_CAP_OFF_REQ conversion" RAT_FUNC "%3.0" "Unitless" COEFFS 0 1 0 0 0 1 /end COMPU_METHOD
/begin MEASUREMENT FUEL_FMEM "FUEL system FMEM flag.  1 -> don't run FUEL monitor due to system FMEM." UBYTE MC_FUEL_FMEM 0 0 0 0 ECU_ADDRESS 0x3F9E59 /end MEASUREMENT
/begin COMPU_METHOD MC_FUEL_FMEM "FUEL_FMEM conversion" RAT_FUNC "%3.0" "Unitless" COEFFS 0 1 0 0 0 1 /end COMPU_METHOD
/begin MEASUREMENT FUEL_GOV_DTIME "Fuel governor timer delta time" ULONG MC_FUEL_GOV_DTIME 0 0 0 0 ECU_ADDRESS 0x3FA8F8 /end MEASUREMENT
/begin COMPU_METHOD MC_FUEL_GOV_DTIME "FUEL_GOV_DTIME conversion" RAT_FUNC "%10.0" "Unitless" COEFFS 0 1 0 0 0 1 /end COMPU_METHOD
/begin MEASUREMENT FUEL_GOV_MSEC "Fuel governor timer last time" ULONG MC_FUEL_GOV_MSEC 0 0 0 0 ECU_ADDRESS 0x3FA8F0 /end MEASUREMENT
/begin COMPU_METHOD MC_FUEL_GOV_MSEC "FUEL_GOV_MSEC conversion" RAT_FUNC "%10.0" "Unitless" COEFFS 0 1 0 0 0 1 /end COMPU_METHOD
/begin MEASUREMENT FUEL_MON "OBDII monitor flag for fuel system; 1=>all fuel faults been monitored since power-up" UBYTE MC_FUEL_MON 0 0 0 0 ECU_ADDRESS 0x3F9CDA /end MEASUREMENT
/begin COMPU_METHOD MC_FUEL_MON "FUEL_MON conversion" RAT_FUNC "%3.0" "Unitless" COEFFS 0 1 0 0 0 1 /end COMPU_METHOD
/begin MEASUREMENT FUEL_TST_ENA "OBD-II Fuel Test enable flag. (1 => test enabled)" UBYTE MC_FUEL_TST_ENA 0 0 0 0 ECU_ADDRESS 0x3F9E3B /end MEASUREMENT
/begin COMPU_METHOD MC_FUEL_TST_ENA "FUEL_TST_ENA conversion" RAT_FUNC "%3.0" "Unitless" COEFFS 0 1 0 0 0 1 /end COMPU_METHOD
/begin MEASUREMENT FULL_BOOST "DIT Full boost adder" FLOAT32_IEEE MC_FULL_BOOST 0 0 0 0 ECU_ADDRESS 0x3FA91C /end MEASUREMENT
/begin COMPU_METHOD MC_FULL_BOOST "FULL_BOOST conversion" RAT_FUNC "%10.5" "Unitless" COEFFS 0 1 0 0 0 1 /end COMPU_METHOD
/begin MEASUREMENT F_TO_N_DIFF "full_boodt -  no_boost" FLOAT32_IEEE MC_F_TO_N_DIFF 0 0 0 0 ECU_ADDRESS 0x3FA90C /end MEASUREMENT
/begin COMPU_METHOD MC_F_TO_N_DIFF "F_TO_N_DIFF conversion" RAT_FUNC "%10.5" "Unitless" COEFFS 0 1 0 0 0 1 /end COMPU_METHOD
/begin CHARACTERISTIC GAP_RATIO_V8 "Gap ratio for CKP noise filter in eng. pos. TPU driver" VALUE 0x5C480 SD_FLOAT32_IEEE 0 SC_GAP_RATIO_V8 0 100 /end CHARACTERISTIC
/begin COMPU_METHOD SC_GAP_RATIO_V8 "GAP_RATIO_V8 conversion" RAT_FUNC "%10.5" "unitless" COEFFS 0 1 0 0 0 1 /end COMPU_METHOD
/begin MEASUREMENT GC1_FLAG "i-line alternator system enable flag; 1-> enable alternator." UBYTE MC_GC1_FLAG 0 0 0 0 ECU_ADDRESS 0x3F9863 /end MEASUREMENT
/begin COMPU_METHOD MC_GC1_FLAG "GC1_FLAG conversion" RAT_FUNC "%3.0" "Unitless" COEFFS 0 1 0 0 0 1 /end COMPU_METHOD
/begin MEASUREMENT GC2_FLAG "i-line alternator system enable flag; 1-> enable alternator." UBYTE MC_GC2_FLAG 0 0 0 0 ECU_ADDRESS 0x3F9862 /end MEASUREMENT
/begin COMPU_METHOD MC_GC2_FLAG "GC2_FLAG conversion" RAT_FUNC "%3.0" "Unitless" COEFFS 0 1 0 0 0 1 /end COMPU_METHOD
/begin MEASUREMENT GEN2_MALF_SET "Generator 2  fault flag" UBYTE MC_GEN2_MALF_SET 0 0 0 0 ECU_ADDRESS 0x3FB282 /end MEASUREMENT
/begin COMPU_METHOD MC_GEN2_MALF_SET "GEN2_MALF_SET conversion" RAT_FUNC "%3.0" "Unitless" COEFFS 0 1 0 0 0 1 /end COMPU_METHOD
/begin MEASUREMENT GEN_MALF_SET "Alternator  fault flag" UBYTE MC_GEN_MALF_SET 0 0 0 0 ECU_ADDRESS 0x3FB283 /end MEASUREMENT
/begin COMPU_METHOD MC_GEN_MALF_SET "GEN_MALF_SET conversion" RAT_FUNC "%3.0" "Unitless" COEFFS 0 1 0 0 0 1 /end COMPU_METHOD
/begin MEASUREMENT GM1_FLAG "Alternator monitor flag" UBYTE MC_GM1_FLAG 0 0 0 0 ECU_ADDRESS 0x3F9861 /end MEASUREMENT
/begin COMPU_METHOD MC_GM1_FLAG "GM1_FLAG conversion" RAT_FUNC "%3.0" "Unitless" COEFFS 0 1 0 0 0 1 /end COMPU_METHOD
/begin MEASUREMENT GM2_FLAG "Alternator monitor flag" UBYTE MC_GM2_FLAG 0 0 0 0 ECU_ADDRESS 0x3F9860 /end MEASUREMENT
/begin COMPU_METHOD MC_GM2_FLAG "GM2_FLAG conversion" RAT_FUNC "%3.0" "Unitless" COEFFS 0 1 0 0 0 1 /end COMPU_METHOD
/begin CHARACTERISTIC GOVFLRMAXTM "Maximum time for mfgov_i seeding (msec.)" VALUE 0x5DBF8 SD_FLOAT32_IEEE 0 SC_GOVFLRMAXTM 0 63.999 /end CHARACTERISTIC
/begin COMPU_METHOD SC_GOVFLRMAXTM "GOVFLRMAXTM conversion" RAT_FUNC "%10.5" "unitless" COEFFS 0 1 0 0 0 1 /end COMPU_METHOD
/begin CHARACTERISTIC GOVFLRMINTM "Minimum time for mfgov_i seeding (msec.)" VALUE 0x5DBFC SD_FLOAT32_IEEE 0 SC_GOVFLRMINTM 0 63.999 /end CHARACTERISTIC
/begin COMPU_METHOD SC_GOVFLRMINTM "GOVFLRMINTM conversion" RAT_FUNC "%10.5" "unitless" COEFFS 0 1 0 0 0 1 /end COMPU_METHOD
/begin CHARACTERISTIC GOVFLRMPHMIN "Minimum MPH for mfgov_i seeding (auto only)" VALUE 0x5DC00 SD_FLOAT32_IEEE 0 SC_GOVFLRMPHMIN 0 20 /end CHARACTERISTIC
/begin COMPU_METHOD SC_GOVFLRMPHMIN "GOVFLRMPHMIN conversion" RAT_FUNC "%10.5" "unitless" COEFFS 0 1 0 0 0 1 /end COMPU_METHOD
/begin MEASUREMENT GOVFLRTMR "Governor Flair Timer" ULONG MC_GOVFLRTMR 0 0 0 0 ECU_ADDRESS 0x3FA8D8 /end MEASUREMENT
/begin COMPU_METHOD MC_GOVFLRTMR "GOVFLRTMR conversion" RAT_FUNC "%10.0" "Unitless" COEFFS 0 1 0 0 0 1 /end COMPU_METHOD
/begin MEASUREMENT GOV_CL "0=Open Loop 1=Closed Loop, Governor Control" UBYTE MC_GOV_CL 0 0 0 0 ECU_ADDRESS 0x3FA7B9 /end MEASUREMENT
/begin COMPU_METHOD MC_GOV_CL "GOV_CL conversion" RAT_FUNC "%3.0" "Unitless" COEFFS 0 1 0 0 0 1 /end COMPU_METHOD
/begin CHARACTERISTIC GOV_CLMP_SW1 "" VALUE 0x5DC0B SD_UBYTE 0 SC_GOV_CLMP_SW1 0 1 /end CHARACTERISTIC
/begin COMPU_METHOD SC_GOV_CLMP_SW1 "GOV_CLMP_SW1 conversion" RAT_FUNC "%3.0" "unitless" COEFFS 0 1 0 0 0 1 /end COMPU_METHOD
/begin CHARACTERISTIC GOV_CLMP_SW2 "" VALUE 0x5DC0A SD_UBYTE 0 SC_GOV_CLMP_SW2 0 1 /end CHARACTERISTIC
/begin COMPU_METHOD SC_GOV_CLMP_SW2 "GOV_CLMP_SW2 conversion" RAT_FUNC "%3.0" "unitless" COEFFS 0 1 0 0 0 1 /end COMPU_METHOD
/begin CHARACTERISTIC GOV_CLP_MULT "Governor integral clamp multiplier" VALUE 0x5DBC8 SD_FLOAT32_IEEE 0 SC_GOV_CLP_MULT 0 2 /end CHARACTERISTIC
/begin COMPU_METHOD SC_GOV_CLP_MULT "GOV_CLP_MULT conversion" RAT_FUNC "%10.5" "unitless" COEFFS 0 1 0 0 0 1 /end COMPU_METHOD
/begin CHARACTERISTIC GOV_CNER_SW "" VALUE 0x5DC06 SD_UBYTE 0 SC_GOV_CNER_SW 0 1 /end CHARACTERISTIC
/begin COMPU_METHOD SC_GOV_CNER_SW "GOV_CNER_SW conversion" RAT_FUNC "%3.0" "unitless" COEFFS 0 1 0 0 0 1 /end COMPU_METHOD
/begin CHARACTERISTIC GOV_CYL_SW "" VALUE 0x5DC08 SD_UBYTE 0 SC_GOV_CYL_SW 0 1 /end CHARACTERISTIC
/begin COMPU_METHOD SC_GOV_CYL_SW "GOV_CYL_SW conversion" RAT_FUNC "%3.0" "unitless" COEFFS 0 1 0 0 0 1 /end COMPU_METHOD
/begin MEASUREMENT GOV_I_CLAMP "MFGOV_I clamping logic (1=Clamp)" UBYTE MC_GOV_I_CLAMP 0 0 0 0 ECU_ADDRESS 0x3FA7BC /end MEASUREMENT
/begin COMPU_METHOD MC_GOV_I_CLAMP "GOV_I_CLAMP conversion" RAT_FUNC "%3.0" "Unitless" COEFFS 0 1 0 0 0 1 /end COMPU_METHOD
/begin MEASUREMENT GOV_KI "governor integral gain" FLOAT32_IEEE MC_GOV_KI 0 0 0 0 ECU_ADDRESS 0x3FA784 /end MEASUREMENT
/begin COMPU_METHOD MC_GOV_KI "GOV_KI conversion" RAT_FUNC "%10.5" "Unitless" COEFFS 0 1 0 0 0 1 /end COMPU_METHOD
/begin CHARACTERISTIC GOV_KI_CP "governor integral gain normal" VALUE 0x5DBA0 SD_FLOAT32_IEEE 0 SC_GOV_KI_CP 0 0.124996 /end CHARACTERISTIC
/begin COMPU_METHOD SC_GOV_KI_CP "GOV_KI_CP conversion" RAT_FUNC "%10.5" "unitless" COEFFS 0 1 0 0 0 1 /end COMPU_METHOD
/begin CHARACTERISTIC GOV_KI_CRU "governor integral gain normal" VALUE 0x5DBA8 SD_FLOAT32_IEEE 0 SC_GOV_KI_CRU 0 0.124996 /end CHARACTERISTIC
/begin COMPU_METHOD SC_GOV_KI_CRU "GOV_KI_CRU conversion" RAT_FUNC "%10.5" "unitless" COEFFS 0 1 0 0 0 1 /end COMPU_METHOD
/begin CHARACTERISTIC GOV_KI_FAST "governor integral gain normal" VALUE 0x5DB9C SD_FLOAT32_IEEE 0 SC_GOV_KI_FAST 0 0.124996 /end CHARACTERISTIC
/begin COMPU_METHOD SC_GOV_KI_FAST "GOV_KI_FAST conversion" RAT_FUNC "%10.5" "unitless" COEFFS 0 1 0 0 0 1 /end COMPU_METHOD
/begin CHARACTERISTIC GOV_KI_FCRU "governor integral gain normal" VALUE 0x5DBAC SD_FLOAT32_IEEE 0 SC_GOV_KI_FCRU 0 0.124996 /end CHARACTERISTIC
/begin COMPU_METHOD SC_GOV_KI_FCRU "GOV_KI_FCRU conversion" RAT_FUNC "%10.5" "unitless" COEFFS 0 1 0 0 0 1 /end COMPU_METHOD
/begin CHARACTERISTIC GOV_KI_NORM "governor integral gain normal" VALUE 0x5DBEC SD_FLOAT32_IEEE 0 SC_GOV_KI_NORM 0 3 /end CHARACTERISTIC
/begin COMPU_METHOD SC_GOV_KI_NORM "GOV_KI_NORM conversion" RAT_FUNC "%10.5" "unitless" COEFFS 0 1 0 0 0 1 /end COMPU_METHOD
/begin CHARACTERISTIC GOV_KI_NORM_P "governor integral gain - pilot mode" VALUE 0x5DBE8 SD_FLOAT32_IEEE 0 SC_GOV_KI_NORM_P 0 3 /end CHARACTERISTIC
/begin COMPU_METHOD SC_GOV_KI_NORM_P "GOV_KI_NORM_P conversion" RAT_FUNC "%10.5" "unitless" COEFFS 0 1 0 0 0 1 /end COMPU_METHOD
/begin CHARACTERISTIC GOV_KI_SRC "governor integral gain normal" VALUE 0x5DBA4 SD_FLOAT32_IEEE 0 SC_GOV_KI_SRC 0 0.124996 /end CHARACTERISTIC
/begin COMPU_METHOD SC_GOV_KI_SRC "GOV_KI_SRC conversion" RAT_FUNC "%10.5" "unitless" COEFFS 0 1 0 0 0 1 /end COMPU_METHOD
/begin MEASUREMENT GOV_KP "Isochronous governor proportional gain" FLOAT32_IEEE MC_GOV_KP 0 0 0 0 ECU_ADDRESS 0x3FA788 /end MEASUREMENT
/begin COMPU_METHOD MC_GOV_KP "GOV_KP conversion" RAT_FUNC "%10.5" "Unitless" COEFFS 0 1 0 0 0 1 /end COMPU_METHOD
/begin CHARACTERISTIC GOV_NERR_CLP "Engine speed error for integral clamping" VALUE 0x5DBD8 SD_FLOAT32_IEEE 0 SC_GOV_NERR_CLP -1000 1000 /end CHARACTERISTIC
/begin COMPU_METHOD SC_GOV_NERR_CLP "GOV_NERR_CLP conversion" RAT_FUNC "%10.5" "RPM" COEFFS 0 1 0 0 0 1 /end COMPU_METHOD
/begin MEASUREMENT GOV_ROC "Governer rate of change." FLOAT32_IEEE MC_GOV_ROC 0 0 0 0 ECU_ADDRESS 0x3FA73C /end MEASUREMENT
/begin COMPU_METHOD MC_GOV_ROC "GOV_ROC conversion" RAT_FUNC "%10.5" "Unitless" COEFFS 0 1 0 0 0 1 /end COMPU_METHOD
/begin MEASUREMENT GOV_ROC_CLP "Governer rate of change clipped_value" FLOAT32_IEEE MC_GOV_ROC_CLP 0 0 0 0 ECU_ADDRESS 0x3FA740 /end MEASUREMENT
/begin COMPU_METHOD MC_GOV_ROC_CLP "GOV_ROC_CLP conversion" RAT_FUNC "%10.5" "Unitless" COEFFS 0 1 0 0 0 1 /end COMPU_METHOD
/begin CHARACTERISTIC GOV_ROC_LMN "Governer rate of change." VALUE 0x5DB98 SD_FLOAT32_IEEE 0 SC_GOV_ROC_LMN -16384 16384 /end CHARACTERISTIC
/begin COMPU_METHOD SC_GOV_ROC_LMN "GOV_ROC_LMN conversion" RAT_FUNC "%10.5" "unitless" COEFFS 0 1 0 0 0 1 /end COMPU_METHOD
/begin CHARACTERISTIC GOV_ROC_LMX "Governer rate of change." VALUE 0x5DB94 SD_FLOAT32_IEEE 0 SC_GOV_ROC_LMX -16384 16384 /end CHARACTERISTIC
/begin COMPU_METHOD SC_GOV_ROC_LMX "GOV_ROC_LMX conversion" RAT_FUNC "%10.5" "unitless" COEFFS 0 1 0 0 0 1 /end COMPU_METHOD
/begin CHARACTERISTIC GOV_TBL_ROC "" VALUE 0x5DC05 SD_UBYTE 0 SC_GOV_TBL_ROC 0 1 /end CHARACTERISTIC
/begin COMPU_METHOD SC_GOV_TBL_ROC "GOV_TBL_ROC conversion" RAT_FUNC "%3.0" "unitless" COEFFS 0 1 0 0 0 1 /end COMPU_METHOD
/begin CHARACTERISTIC GPCEN_FLG "1= Glow Plug option ON" VALUE 0x5E211 SD_UBYTE 0 SC_GPCEN_FLG 0 1 /end CHARACTERISTIC
/begin COMPU_METHOD SC_GPCEN_FLG "GPCEN_FLG conversion" RAT_FUNC "%3.0" "unitless" COEFFS 0 1 0 0 0 1 /end COMPU_METHOD
/begin MEASUREMENT GPC_FLG "Glow plug output flag (to driver)" UBYTE MC_GPC_FLG 0 0 0 0 ECU_ADDRESS 0x3FABA2 /end MEASUREMENT
/begin COMPU_METHOD MC_GPC_FLG "GPC_FLG conversion" RAT_FUNC "%3.0" "Unitless" COEFFS 0 1 0 0 0 1 /end COMPU_METHOD
/begin MEASUREMENT GPC_TIMER "Glow plug coil timer" FLOAT32_IEEE MC_GPC_TIMER 0 0 0 0 ECU_ADDRESS 0x3FAB9C /end MEASUREMENT
/begin COMPU_METHOD MC_GPC_TIMER "GPC_TIMER conversion" RAT_FUNC "%10.5" "Unitless" COEFFS 0 1 0 0 0 1 /end COMPU_METHOD
/begin MEASUREMENT GPC_TM "Glow plugs activation time FINAL (sec)" FLOAT32_IEEE MC_GPC_TM 0 0 0 0 ECU_ADDRESS 0x3FAB98 /end MEASUREMENT
/begin COMPU_METHOD MC_GPC_TM "GPC_TM conversion" RAT_FUNC "%10.5" "Unitless" COEFFS 0 1 0 0 0 1 /end COMPU_METHOD
/begin CHARACTERISTIC GPC_TM_MAX "Glow plug control 'ON' time Maximum" VALUE 0x5E20C SD_FLOAT32_IEEE 0 SC_GPC_TM_MAX 0.125 120 /end CHARACTERISTIC
/begin COMPU_METHOD SC_GPC_TM_MAX "GPC_TM_MAX conversion" RAT_FUNC "%10.5" "s" COEFFS 0 1 0 0 0 1 /end COMPU_METHOD
/begin CHARACTERISTIC GPC_WAIT_TM "Glow plug control wait time (sec)" VALUE 0x5E208 SD_FLOAT32_IEEE 0 SC_GPC_WAIT_TM 0.125 10 /end CHARACTERISTIC
/begin COMPU_METHOD SC_GPC_WAIT_TM "GPC_WAIT_TM conversion" RAT_FUNC "%10.5" "s" COEFFS 0 1 0 0 0 1 /end COMPU_METHOD
/begin CHARACTERISTIC GPDC_FC_INC "Glow Plug Diagnostic invalid frame sequence count increment" VALUE 0x5E252 SD_UWORD 0 SC_GPDC_FC_INC 0 65535 /end CHARACTERISTIC
/begin COMPU_METHOD SC_GPDC_FC_INC "GPDC_FC_INC conversion" RAT_FUNC "%5.0" "unitless" COEFFS 0 1 0 0 0 1 /end COMPU_METHOD
/begin CHARACTERISTIC GPDC_FC_MAX "Glow Plug Diagnostic maximum communication retry counter" VALUE 0x5E250 SD_UWORD 0 SC_GPDC_FC_MAX 0 65535 /end CHARACTERISTIC
/begin COMPU_METHOD SC_GPDC_FC_MAX "GPDC_FC_MAX conversion" RAT_FUNC "%5.0" "unitless" COEFFS 0 1 0 0 0 1 /end COMPU_METHOD
/begin CHARACTERISTIC GPDC_SCN_INC "Glow Plug Diagnostic communication valid data search count increment" VALUE 0x5E24E SD_UWORD 0 SC_GPDC_SCN_INC 0 65535 /end CHARACTERISTIC
/begin COMPU_METHOD SC_GPDC_SCN_INC "GPDC_SCN_INC conversion" RAT_FUNC "%5.0" "unitless" COEFFS 0 1 0 0 0 1 /end COMPU_METHOD
/begin CHARACTERISTIC GPDC_SCN_MX "Glow Plug Diagnostic maximum communication valid data search limit count" VALUE 0x5E24C SD_UWORD 0 SC_GPDC_SCN_MX 0 65535 /end CHARACTERISTIC
/begin COMPU_METHOD SC_GPDC_SCN_MX "GPDC_SCN_MX conversion" RAT_FUNC "%5.0" "unitless" COEFFS 0 1 0 0 0 1 /end COMPU_METHOD
/begin MEASUREMENT GPDS_CCM_TMR "Glow plug comprehensive component monitor timer" FLOAT32_IEEE MC_GPDS_CCM_TMR 0 0 0 0 ECU_ADDRESS 0x3FAC24 /end MEASUREMENT
/begin COMPU_METHOD MC_GPDS_CCM_TMR "GPDS_CCM_TMR conversion" RAT_FUNC "%10.5" "Unitless" COEFFS 0 1 0 0 0 1 /end COMPU_METHOD
/begin MEASUREMENT GPDS_CCM_U_TIMER "Glow plug comprehensive component monitor update timer" FLOAT32_IEEE MC_GPDS_CCM_U_TIMER 0 0 0 0 ECU_ADDRESS 0x3FAC20 /end MEASUREMENT
/begin COMPU_METHOD MC_GPDS_CCM_U_TIMER "GPDS_CCM_U_TIMER conversion" RAT_FUNC "%10.5" "Unitless" COEFFS 0 1 0 0 0 1 /end COMPU_METHOD
/begin MEASUREMENT GPDS_COMM_F "Glow Plug Diagnostic signal communication failure logged" UBYTE MC_GPDS_COMM_F 0 0 0 0 ECU_ADDRESS 0x3FABB0 /end MEASUREMENT
/begin COMPU_METHOD MC_GPDS_COMM_F "GPDS_COMM_F conversion" RAT_FUNC "%3.0" "Unitless" COEFFS 0 1 0 0 0 1 /end COMPU_METHOD
/begin MEASUREMENT GPDS_COMM_FAULT "Glow Plug Diagnostic signal communication fault" UBYTE MC_GPDS_COMM_FAULT 0 0 0 0 ECU_ADDRESS 0x3FABB8 /end MEASUREMENT
/begin COMPU_METHOD MC_GPDS_COMM_FAULT "GPDS_COMM_FAULT conversion" RAT_FUNC "%3.0" "Unitless" COEFFS 0 1 0 0 0 1 /end COMPU_METHOD
/begin MEASUREMENT GPDS_CYL_CNTR "Glow Plug Diagnostic current cylinder counter" UBYTE MC_GPDS_CYL_CNTR 0 0 0 0 ECU_ADDRESS 0x3FABB1 /end MEASUREMENT
/begin COMPU_METHOD MC_GPDS_CYL_CNTR "GPDS_CYL_CNTR conversion" RAT_FUNC "%3.0" "Unitless" COEFFS 0 1 0 0 0 1 /end COMPU_METHOD
/begin MEASUREMENT GPDS_CYL_COMP1 "Glow Plug Diagnostic signal cylinder pulse detected" UBYTE MC_GPDS_CYL_COMP1 0 0 0 0 ECU_ADDRESS 0x3FABB3 /end MEASUREMENT
/begin COMPU_METHOD MC_GPDS_CYL_COMP1 "GPDS_CYL_COMP1 conversion" RAT_FUNC "%3.0" "Unitless" COEFFS 0 1 0 0 0 1 /end COMPU_METHOD
/begin MEASUREMENT GPDS_CYL_COMP2 "Glow Plug Diagnostic signal cylinder pulse detected" UBYTE MC_GPDS_CYL_COMP2 0 0 0 0 ECU_ADDRESS 0x3FABB2 /end MEASUREMENT
/begin COMPU_METHOD MC_GPDS_CYL_COMP2 "GPDS_CYL_COMP2 conversion" RAT_FUNC "%3.0" "Unitless" COEFFS 0 1 0 0 0 1 /end COMPU_METHOD
/begin MEASUREMENT GPDS_CYL_PASS "Glow Plug Diagnostic cylinder first pass data detected" UBYTE MC_GPDS_CYL_PASS 0 0 0 0 ECU_ADDRESS 0x3FABB5 /end MEASUREMENT
/begin COMPU_METHOD MC_GPDS_CYL_PASS "GPDS_CYL_PASS conversion" RAT_FUNC "%3.0" "Unitless" COEFFS 0 1 0 0 0 1 /end COMPU_METHOD
/begin MEASUREMENT GPDS_FAULTS "Glow plug diagnostic fault flags (1 bit for each glow plug)" UBYTE MC_GPDS_FAULTS 0 0 0 0 ECU_ADDRESS 0x3FABBE /end MEASUREMENT
/begin COMPU_METHOD MC_GPDS_FAULTS "GPDS_FAULTS conversion" RAT_FUNC "%3.0" "Unitless" COEFFS 0 1 0 0 0 1 /end COMPU_METHOD
/begin MEASUREMENT GPDS_FAULT_DET "Glow Plug Diagnostic system fault signal (start of pulse train) detected" UBYTE MC_GPDS_FAULT_DET 0 0 0 0 ECU_ADDRESS 0x3FABB6 /end MEASUREMENT
/begin COMPU_METHOD MC_GPDS_FAULT_DET "GPDS_FAULT_DET conversion" RAT_FUNC "%3.0" "Unitless" COEFFS 0 1 0 0 0 1 /end COMPU_METHOD
/begin MEASUREMENT GPDS_FSEQ_COUNT "Glow Plug Diagnostic signal communication fail retry counter" UWORD MC_GPDS_FSEQ_COUNT 0 0 0 0 ECU_ADDRESS 0x3FABAC /end MEASUREMENT
/begin COMPU_METHOD MC_GPDS_FSEQ_COUNT "GPDS_FSEQ_COUNT conversion" RAT_FUNC "%5.0" "Unitless" COEFFS 0 1 0 0 0 1 /end COMPU_METHOD
/begin MEASUREMENT GPDS_F_CNTR1 "Glow Plug monitor malfunction control for cylinder 1" SLONG MC_GPDS_F_CNTR1 0 0 0 0 ECU_ADDRESS 0x3FAC1C /end MEASUREMENT
/begin COMPU_METHOD MC_GPDS_F_CNTR1 "GPDS_F_CNTR1 conversion" RAT_FUNC "%10.0" "Unitless" COEFFS 0 1 0 0 0 1 /end COMPU_METHOD
/begin MEASUREMENT GPDS_F_CNTR2 "Glow plug monitor malfunction counter for cylinder 2" SLONG MC_GPDS_F_CNTR2 0 0 0 0 ECU_ADDRESS 0x3FAC18 /end MEASUREMENT
/begin COMPU_METHOD MC_GPDS_F_CNTR2 "GPDS_F_CNTR2 conversion" RAT_FUNC "%10.0" "Unitless" COEFFS 0 1 0 0 0 1 /end COMPU_METHOD
/begin MEASUREMENT GPDS_F_CNTR3 "Glow Plug monitor malfunction counter for cylinder 3" SLONG MC_GPDS_F_CNTR3 0 0 0 0 ECU_ADDRESS 0x3FAC14 /end MEASUREMENT
/begin COMPU_METHOD MC_GPDS_F_CNTR3 "GPDS_F_CNTR3 conversion" RAT_FUNC "%10.0" "Unitless" COEFFS 0 1 0 0 0 1 /end COMPU_METHOD
/begin MEASUREMENT GPDS_F_CNTR4 "Glow Plug monitor malfunction counter for cylinder 4" SLONG MC_GPDS_F_CNTR4 0 0 0 0 ECU_ADDRESS 0x3FAC10 /end MEASUREMENT
/begin COMPU_METHOD MC_GPDS_F_CNTR4 "GPDS_F_CNTR4 conversion" RAT_FUNC "%10.0" "Unitless" COEFFS 0 1 0 0 0 1 /end COMPU_METHOD
/begin MEASUREMENT GPDS_F_CNTR5 "Glow Plug monitor malfunction counter for cylinder 5" SLONG MC_GPDS_F_CNTR5 0 0 0 0 ECU_ADDRESS 0x3FAC0C /end MEASUREMENT
/begin COMPU_METHOD MC_GPDS_F_CNTR5 "GPDS_F_CNTR5 conversion" RAT_FUNC "%10.0" "Unitless" COEFFS 0 1 0 0 0 1 /end COMPU_METHOD
/begin MEASUREMENT GPDS_F_CNTR6 "Glow Plug monitor malfunction counter for cylinder 6" SLONG MC_GPDS_F_CNTR6 0 0 0 0 ECU_ADDRESS 0x3FAC08 /end MEASUREMENT
/begin COMPU_METHOD MC_GPDS_F_CNTR6 "GPDS_F_CNTR6 conversion" RAT_FUNC "%10.0" "Unitless" COEFFS 0 1 0 0 0 1 /end COMPU_METHOD
/begin MEASUREMENT GPDS_F_CNTR7 "Glow Plug monitor malfunction counter for cylinder 7" SLONG MC_GPDS_F_CNTR7 0 0 0 0 ECU_ADDRESS 0x3FAC04 /end MEASUREMENT
/begin COMPU_METHOD MC_GPDS_F_CNTR7 "GPDS_F_CNTR7 conversion" RAT_FUNC "%10.0" "Unitless" COEFFS 0 1 0 0 0 1 /end COMPU_METHOD
/begin MEASUREMENT GPDS_F_CNTR8 "Glow Plug monitor malfunction counter for cylinder 8" SLONG MC_GPDS_F_CNTR8 0 0 0 0 ECU_ADDRESS 0x3FAC00 /end MEASUREMENT
/begin COMPU_METHOD MC_GPDS_F_CNTR8 "GPDS_F_CNTR8 conversion" RAT_FUNC "%10.0" "Unitless" COEFFS 0 1 0 0 0 1 /end COMPU_METHOD
/begin MEASUREMENT GPDS_F_IA "Glow Plug Diagnostic signal inactive condition detected" UBYTE MC_GPDS_F_IA 0 0 0 0 ECU_ADDRESS 0x3FABBD /end MEASUREMENT
/begin COMPU_METHOD MC_GPDS_F_IA "GPDS_F_IA conversion" RAT_FUNC "%3.0" "Unitless" COEFFS 0 1 0 0 0 1 /end COMPU_METHOD
/begin CHARACTERISTIC GPDS_F_INC "Glow plug monitor out of range fault counter increment value" VALUE 0x5E28C SD_SLONG 0 SC_GPDS_F_INC 0 65535 /end CHARACTERISTIC
/begin COMPU_METHOD SC_GPDS_F_INC "GPDS_F_INC conversion" RAT_FUNC "%10.0" "unitless" COEFFS 0 1 0 0 0 1 /end COMPU_METHOD
/begin MEASUREMENT GPDS_F_NOI "Glow Plug Diagnostic signal noise condition detected" UBYTE MC_GPDS_F_NOI 0 0 0 0 ECU_ADDRESS 0x3FABBC /end MEASUREMENT
/begin COMPU_METHOD MC_GPDS_F_NOI "GPDS_F_NOI conversion" RAT_FUNC "%3.0" "Unitless" COEFFS 0 1 0 0 0 1 /end COMPU_METHOD
/begin MEASUREMENT GPDS_F_ORH "Glow Plug Diagnostic signal out of range high condition detected" UBYTE MC_GPDS_F_ORH 0 0 0 0 ECU_ADDRESS 0x3FABBA /end MEASUREMENT
/begin COMPU_METHOD MC_GPDS_F_ORH "GPDS_F_ORH conversion" RAT_FUNC "%3.0" "Unitless" COEFFS 0 1 0 0 0 1 /end COMPU_METHOD
/begin MEASUREMENT GPDS_F_ORL "Glow Plug Diagnostic signal out of range low condition detected" UBYTE MC_GPDS_F_ORL 0 0 0 0 ECU_ADDRESS 0x3FABBB /end MEASUREMENT
/begin COMPU_METHOD MC_GPDS_F_ORL "GPDS_F_ORL conversion" RAT_FUNC "%3.0" "Unitless" COEFFS 0 1 0 0 0 1 /end COMPU_METHOD
/begin MEASUREMENT GPDS_IA_TIMER "Glow plug fail inactive malfunction timer" FLOAT32_IEEE MC_GPDS_IA_TIMER 0 0 0 0 ECU_ADDRESS 0x3FABA8 /end MEASUREMENT
/begin COMPU_METHOD MC_GPDS_IA_TIMER "GPDS_IA_TIMER conversion" RAT_FUNC "%10.5" "Unitless" COEFFS 0 1 0 0 0 1 /end COMPU_METHOD
/begin CHARACTERISTIC GPDS_IA_TMR_MAX "Max timer between GPDS sig transition" VALUE 0x5E224 SD_FLOAT32_IEEE 0 SC_GPDS_IA_TMR_MAX 0.25 10 /end CHARACTERISTIC
/begin COMPU_METHOD SC_GPDS_IA_TMR_MAX "GPDS_IA_TMR_MAX conversion" RAT_FUNC "%10.5" "s" COEFFS 0 1 0 0 0 1 /end COMPU_METHOD
/begin MEASUREMENT GPDS_ID[0] "GPD edge buffer" UBYTE MC_GPDS_ID 0 0 0 200 ECU_ADDRESS 0x3FBE40 /end MEASUREMENT
/begin COMPU_METHOD MC_GPDS_ID "GPDS_ID conversion" RAT_FUNC "%3.0" "ms" COEFFS 0 1 0 0 0 1 /end COMPU_METHOD
/begin MEASUREMENT GPDS_ID[1] "GPD edge buffer" UBYTE MC_GPDS_ID 0 0 0 200 ECU_ADDRESS 0x3FBE41 /end MEASUREMENT
/begin MEASUREMENT GPDS_ID[2] "GPD edge buffer" UBYTE MC_GPDS_ID 0 0 0 200 ECU_ADDRESS 0x3FBE42 /end MEASUREMENT
/begin MEASUREMENT GPDS_ID[3] "GPD edge buffer" UBYTE MC_GPDS_ID 0 0 0 200 ECU_ADDRESS 0x3FBE43 /end MEASUREMENT
/begin MEASUREMENT GPDS_ID[4] "GPD edge buffer" UBYTE MC_GPDS_ID 0 0 0 200 ECU_ADDRESS 0x3FBE44 /end MEASUREMENT
/begin MEASUREMENT GPDS_ID[5] "GPD edge buffer" UBYTE MC_GPDS_ID 0 0 0 200 ECU_ADDRESS 0x3FBE45 /end MEASUREMENT
/begin MEASUREMENT GPDS_ID[6] "GPD edge buffer" UBYTE MC_GPDS_ID 0 0 0 200 ECU_ADDRESS 0x3FBE46 /end MEASUREMENT
/begin MEASUREMENT GPDS_ID[7] "GPD edge buffer" UBYTE MC_GPDS_ID 0 0 0 200 ECU_ADDRESS 0x3FBE47 /end MEASUREMENT
/begin MEASUREMENT GPDS_ID[8] "GPD edge buffer" UBYTE MC_GPDS_ID 0 0 0 200 ECU_ADDRESS 0x3FBE48 /end MEASUREMENT
/begin MEASUREMENT GPDS_ID[9] "GPD edge buffer" UBYTE MC_GPDS_ID 0 0 0 200 ECU_ADDRESS 0x3FBE49 /end MEASUREMENT
/begin MEASUREMENT GPDS_LIST_START "Glow Plug Diagnostic cylinder list started" UBYTE MC_GPDS_LIST_START 0 0 0 0 ECU_ADDRESS 0x3FABB4 /end MEASUREMENT
/begin COMPU_METHOD MC_GPDS_LIST_START "GPDS_LIST_START conversion" RAT_FUNC "%3.0" "Unitless" COEFFS 0 1 0 0 0 1 /end COMPU_METHOD
/begin CHARACTERISTIC GPDS_MODMAX "Max time before failure flags set if GPC module does not shut down for OBDII continuous monitor" VALUE 0x5E2B4 SD_FLOAT32_IEEE 0 SC_GPDS_MODMAX 0.25 10 /end CHARACTERISTIC
/begin COMPU_METHOD SC_GPDS_MODMAX "GPDS_MODMAX conversion" RAT_FUNC "%10.5" "s" COEFFS 0 1 0 0 0 1 /end COMPU_METHOD
/begin CHARACTERISTIC GPDS_NCYL "Number of cylinders for Glow Plug Diagnostic system" VALUE 0x5E254 SD_UBYTE 0 SC_GPDS_NCYL 0 8 /end CHARACTERISTIC
/begin COMPU_METHOD SC_GPDS_NCYL "GPDS_NCYL conversion" RAT_FUNC "%3.0" "unitless" COEFFS 0 1 0 0 0 1 /end COMPU_METHOD
/begin MEASUREMENT GPDS_NOI_CNTR "Glow Plug monitor noise malfunction counter" SLONG MC_GPDS_NOI_CNTR 0 0 0 0 ECU_ADDRESS 0x3FABFC /end MEASUREMENT
/begin COMPU_METHOD MC_GPDS_NOI_CNTR "GPDS_NOI_CNTR conversion" RAT_FUNC "%10.0" "Unitless" COEFFS 0 1 0 0 0 1 /end COMPU_METHOD
/begin CHARACTERISTIC GPDS_NOI_INC "Glow plug monitor noise fault counter increment value" VALUE 0x5E290 SD_SLONG 0 SC_GPDS_NOI_INC 0 65535 /end CHARACTERISTIC
/begin COMPU_METHOD SC_GPDS_NOI_INC "GPDS_NOI_INC conversion" RAT_FUNC "%10.0" "unitless" COEFFS 0 1 0 0 0 1 /end COMPU_METHOD
/begin MEASUREMENT GPDS_ORH_CNTR "Glow Plug monitor out of range high malfunction counter" SLONG MC_GPDS_ORH_CNTR 0 0 0 0 ECU_ADDRESS 0x3FABF8 /end MEASUREMENT
/begin COMPU_METHOD MC_GPDS_ORH_CNTR "GPDS_ORH_CNTR conversion" RAT_FUNC "%10.0" "Unitless" COEFFS 0 1 0 0 0 1 /end COMPU_METHOD
/begin MEASUREMENT GPDS_ORL_CNTR "Glow Plug monitor out of range low malfunction counter" SLONG MC_GPDS_ORL_CNTR 0 0 0 0 ECU_ADDRESS 0x3FABF4 /end MEASUREMENT
/begin COMPU_METHOD MC_GPDS_ORL_CNTR "GPDS_ORL_CNTR conversion" RAT_FUNC "%10.0" "Unitless" COEFFS 0 1 0 0 0 1 /end COMPU_METHOD
/begin CHARACTERISTIC GPDS_PRD_MAX "Maximum valid period on Glow Plug Diagnostic signal" VALUE 0x5E228 SD_FLOAT32_IEEE 0 SC_GPDS_PRD_MAX 0 65535 /end CHARACTERISTIC
/begin COMPU_METHOD SC_GPDS_PRD_MAX "GPDS_PRD_MAX conversion" RAT_FUNC "%10.5" "ms" COEFFS 0 1 0 0 0 1 /end COMPU_METHOD
/begin CHARACTERISTIC GPDS_PRD_MIN "Minimum valid period on Glow Plug Diagnostic signal" VALUE 0x5E22C SD_FLOAT32_IEEE 0 SC_GPDS_PRD_MIN 0 200 /end CHARACTERISTIC
/begin COMPU_METHOD SC_GPDS_PRD_MIN "GPDS_PRD_MIN conversion" RAT_FUNC "%10.5" "ms" COEFFS 0 1 0 0 0 1 /end COMPU_METHOD
/begin CHARACTERISTIC GPDS_R_DEC "Glow plug monitor out of range fault counter decrement value" VALUE 0x5E264 SD_SLONG 0 SC_GPDS_R_DEC 0 65535 /end CHARACTERISTIC
/begin COMPU_METHOD SC_GPDS_R_DEC "GPDS_R_DEC conversion" RAT_FUNC "%10.0" "unitless" COEFFS 0 1 0 0 0 1 /end COMPU_METHOD
/begin MEASUREMENT GPDS_SCAN_COUNT "Glow Plug Diagnostic signal period scan count search for valid data" UWORD MC_GPDS_SCAN_COUNT 0 0 0 0 ECU_ADDRESS 0x3FABAE /end MEASUREMENT
/begin COMPU_METHOD MC_GPDS_SCAN_COUNT "GPDS_SCAN_COUNT conversion" RAT_FUNC "%5.0" "Unitless" COEFFS 0 1 0 0 0 1 /end COMPU_METHOD
/begin MEASUREMENT GPDS_SEQ_FAULT "Glow Plug Diagnostic signal incorrect sequence fault" UBYTE MC_GPDS_SEQ_FAULT 0 0 0 0 ECU_ADDRESS 0x3FABB9 /end MEASUREMENT
/begin COMPU_METHOD MC_GPDS_SEQ_FAULT "GPDS_SEQ_FAULT conversion" RAT_FUNC "%3.0" "Unitless" COEFFS 0 1 0 0 0 1 /end COMPU_METHOD
/begin CHARACTERISTIC GPDS_SPK_MIN "Maximum noise spike on Glow Plug Diagnostic signal" VALUE 0x5E230 SD_FLOAT32_IEEE 0 SC_GPDS_SPK_MIN 0 200 /end CHARACTERISTIC
/begin COMPU_METHOD SC_GPDS_SPK_MIN "GPDS_SPK_MIN conversion" RAT_FUNC "%10.5" "ms" COEFFS 0 1 0 0 0 1 /end COMPU_METHOD
/begin MEASUREMENT GPDS_SYS_PASS "Glow Plug Diagnostic system ""ok"" signal detected" UBYTE MC_GPDS_SYS_PASS 0 0 0 0 ECU_ADDRESS 0x3FABB7 /end MEASUREMENT
/begin COMPU_METHOD MC_GPDS_SYS_PASS "GPDS_SYS_PASS conversion" RAT_FUNC "%3.0" "Unitless" COEFFS 0 1 0 0 0 1 /end COMPU_METHOD
/begin MEASUREMENT GPDS_TIMER "Glow plug fail inactive update timer" FLOAT32_IEEE MC_GPDS_TIMER 0 0 0 0 ECU_ADDRESS 0x3FAC28 /end MEASUREMENT
/begin COMPU_METHOD MC_GPDS_TIMER "GPDS_TIMER conversion" RAT_FUNC "%10.5" "Unitless" COEFFS 0 1 0 0 0 1 /end COMPU_METHOD
/begin CHARACTERISTIC GPDS_TMR_MAX "Max timer between GPDS sig transition" VALUE 0x5E2B8 SD_FLOAT32_IEEE 0 SC_GPDS_TMR_MAX 0.25 10 /end CHARACTERISTIC
/begin COMPU_METHOD SC_GPDS_TMR_MAX "GPDS_TMR_MAX conversion" RAT_FUNC "%10.5" "s" COEFFS 0 1 0 0 0 1 /end COMPU_METHOD
/begin MEASUREMENT GPDS_U_CNTR1 "Glow plug monitor update counter for cylinder 1" SLONG MC_GPDS_U_CNTR1 0 0 0 0 ECU_ADDRESS 0x3FABEC /end MEASUREMENT
/begin COMPU_METHOD MC_GPDS_U_CNTR1 "GPDS_U_CNTR1 conversion" RAT_FUNC "%10.0" "Unitless" COEFFS 0 1 0 0 0 1 /end COMPU_METHOD
/begin MEASUREMENT GPDS_U_CNTR2 "Glow plug monitor update counter for cylinder 2" SLONG MC_GPDS_U_CNTR2 0 0 0 0 ECU_ADDRESS 0x3FABE8 /end MEASUREMENT
/begin COMPU_METHOD MC_GPDS_U_CNTR2 "GPDS_U_CNTR2 conversion" RAT_FUNC "%10.0" "Unitless" COEFFS 0 1 0 0 0 1 /end COMPU_METHOD
/begin MEASUREMENT GPDS_U_CNTR3 "Glow plug monitor update counter for cylinder 3" SLONG MC_GPDS_U_CNTR3 0 0 0 0 ECU_ADDRESS 0x3FABE4 /end MEASUREMENT
/begin COMPU_METHOD MC_GPDS_U_CNTR3 "GPDS_U_CNTR3 conversion" RAT_FUNC "%10.0" "Unitless" COEFFS 0 1 0 0 0 1 /end COMPU_METHOD
/begin MEASUREMENT GPDS_U_CNTR4 "Glow plug monitor update counter for cylinder 4" SLONG MC_GPDS_U_CNTR4 0 0 0 0 ECU_ADDRESS 0x3FABE0 /end MEASUREMENT
/begin COMPU_METHOD MC_GPDS_U_CNTR4 "GPDS_U_CNTR4 conversion" RAT_FUNC "%10.0" "Unitless" COEFFS 0 1 0 0 0 1 /end COMPU_METHOD
/begin MEASUREMENT GPDS_U_CNTR5 "Glow plug monitor update counter for cylinder 5" SLONG MC_GPDS_U_CNTR5 0 0 0 0 ECU_ADDRESS 0x3FABDC /end MEASUREMENT
/begin COMPU_METHOD MC_GPDS_U_CNTR5 "GPDS_U_CNTR5 conversion" RAT_FUNC "%10.0" "Unitless" COEFFS 0 1 0 0 0 1 /end COMPU_METHOD
/begin MEASUREMENT GPDS_U_CNTR6 "Glow plug monitor update counter for cylinder 6" SLONG MC_GPDS_U_CNTR6 0 0 0 0 ECU_ADDRESS 0x3FABD8 /end MEASUREMENT
/begin COMPU_METHOD MC_GPDS_U_CNTR6 "GPDS_U_CNTR6 conversion" RAT_FUNC "%10.0" "Unitless" COEFFS 0 1 0 0 0 1 /end COMPU_METHOD
/begin MEASUREMENT GPDS_U_CNTR7 "Glow plug monitor update counter for cylinder 7" SLONG MC_GPDS_U_CNTR7 0 0 0 0 ECU_ADDRESS 0x3FABD4 /end MEASUREMENT
/begin COMPU_METHOD MC_GPDS_U_CNTR7 "GPDS_U_CNTR7 conversion" RAT_FUNC "%10.0" "Unitless" COEFFS 0 1 0 0 0 1 /end COMPU_METHOD
/begin MEASUREMENT GPDS_U_CNTR8 "Glow plug monitor update counter for cylinder 8" SLONG MC_GPDS_U_CNTR8 0 0 0 0 ECU_ADDRESS 0x3FABD0 /end MEASUREMENT
/begin COMPU_METHOD MC_GPDS_U_CNTR8 "GPDS_U_CNTR8 conversion" RAT_FUNC "%10.0" "Unitless" COEFFS 0 1 0 0 0 1 /end COMPU_METHOD
/begin MEASUREMENT GPDS_U_OR_CNTR "Glow plug monitor out of range update counter" SLONG MC_GPDS_U_OR_CNTR 0 0 0 0 ECU_ADDRESS 0x3FABCC /end MEASUREMENT
/begin COMPU_METHOD MC_GPDS_U_OR_CNTR "GPDS_U_OR_CNTR conversion" RAT_FUNC "%10.0" "Unitless" COEFFS 0 1 0 0 0 1 /end COMPU_METHOD
/begin MEASUREMENT GPD_BUFFER_RESET "Request to reset gpd edge buffer to beginning" UBYTE MC_GPD_BUFFER_RESET 0 0 0 0 ECU_ADDRESS 0x3FABBF /end MEASUREMENT
/begin COMPU_METHOD MC_GPD_BUFFER_RESET "GPD_BUFFER_RESET conversion" RAT_FUNC "%3.0" "Unitless" COEFFS 0 1 0 0 0 1 /end COMPU_METHOD
/begin MEASUREMENT GPD_EDGE_TIMER "Time since last edge received" FLOAT32_IEEE MC_GPD_EDGE_TIMER 0 0 0 0 ECU_ADDRESS 0x3F9A74 /end MEASUREMENT
/begin COMPU_METHOD MC_GPD_EDGE_TIMER "GPD_EDGE_TIMER conversion" RAT_FUNC "%10.5" "Unitless" COEFFS 0 1 0 0 0 1 /end COMPU_METHOD
/begin MEASUREMENT GPD_INACTIVE "GPD_INACTIVE_CAL time has been exceeded since we received an edge" UBYTE MC_GPD_INACTIVE 0 0 0 0 ECU_ADDRESS 0x3F9A80 /end MEASUREMENT
/begin COMPU_METHOD MC_GPD_INACTIVE "GPD_INACTIVE conversion" RAT_FUNC "%3.0" "Unitless" COEFFS 0 1 0 0 0 1 /end COMPU_METHOD
/begin CHARACTERISTIC GPD_INACTIVE_CAL "Max time between edges, after which gpd is reported as inactive" VALUE 0x5C870 SD_FLOAT32_IEEE 0 SC_GPD_INACTIVE_CAL 0 3 /end CHARACTERISTIC
/begin COMPU_METHOD SC_GPD_INACTIVE_CAL "GPD_INACTIVE_CAL conversion" RAT_FUNC "%10.5" "unitless" COEFFS 0 1 0 0 0 1 /end COMPU_METHOD
/begin MEASUREMENT GPD_LAST_WIN_TIMESTAMP "Timestamp of last edge's TPU call" ULONG MC_GPD_LAST_WIN_TIMESTAMP 0 0 0 0 ECU_ADDRESS 0x3F9A68 /end MEASUREMENT
/begin COMPU_METHOD MC_GPD_LAST_WIN_TIMESTAMP "GPD_LAST_WIN_TIMESTAMP conversion" RAT_FUNC "%10.0" "Unitless" COEFFS 0 1 0 0 0 1 /end COMPU_METHOD
/begin MEASUREMENT GPD_NUM_EDGES "Number of edges in gpd raw data buffer (99=buffer full)" UBYTE MC_GPD_NUM_EDGES 0 0 0 0 ECU_ADDRESS 0x3F9A81 /end MEASUREMENT
/begin COMPU_METHOD MC_GPD_NUM_EDGES "GPD_NUM_EDGES conversion" RAT_FUNC "%3.0" "Unitless" COEFFS 0 1 0 0 0 1 /end COMPU_METHOD
/begin MEASUREMENT GPD_RAW[0] "GPD edge buffer" FLOAT32_IEEE MC_GPD_RAW 0 0 0 1.67772e+07 ECU_ADDRESS 0x3FB980 /end MEASUREMENT
/begin COMPU_METHOD MC_GPD_RAW "GPD_RAW conversion" RAT_FUNC "%10.5" "ms" COEFFS 0 1 0 0 0 1 /end COMPU_METHOD
/begin MEASUREMENT GPD_RAW[1] "GPD edge buffer" FLOAT32_IEEE MC_GPD_RAW 0 0 0 1.67772e+07 ECU_ADDRESS 0x3FB984 /end MEASUREMENT
/begin MEASUREMENT GPD_RAW[2] "GPD edge buffer" FLOAT32_IEEE MC_GPD_RAW 0 0 0 1.67772e+07 ECU_ADDRESS 0x3FB988 /end MEASUREMENT
/begin MEASUREMENT GPD_RAW[3] "GPD edge buffer" FLOAT32_IEEE MC_GPD_RAW 0 0 0 1.67772e+07 ECU_ADDRESS 0x3FB98C /end MEASUREMENT
/begin MEASUREMENT GPD_RAW[4] "GPD edge buffer" FLOAT32_IEEE MC_GPD_RAW 0 0 0 1.67772e+07 ECU_ADDRESS 0x3FB990 /end MEASUREMENT
/begin MEASUREMENT GPD_RAW[5] "GPD edge buffer" FLOAT32_IEEE MC_GPD_RAW 0 0 0 1.67772e+07 ECU_ADDRESS 0x3FB994 /end MEASUREMENT
/begin MEASUREMENT GPD_RAW[6] "GPD edge buffer" FLOAT32_IEEE MC_GPD_RAW 0 0 0 1.67772e+07 ECU_ADDRESS 0x3FB998 /end MEASUREMENT
/begin MEASUREMENT GPD_RAW[7] "GPD edge buffer" FLOAT32_IEEE MC_GPD_RAW 0 0 0 1.67772e+07 ECU_ADDRESS 0x3FB99C /end MEASUREMENT
/begin MEASUREMENT GPD_RAW[8] "GPD edge buffer" FLOAT32_IEEE MC_GPD_RAW 0 0 0 1.67772e+07 ECU_ADDRESS 0x3FB9A0 /end MEASUREMENT
/begin MEASUREMENT GPD_RAW[9] "GPD edge buffer" FLOAT32_IEEE MC_GPD_RAW 0 0 0 1.67772e+07 ECU_ADDRESS 0x3FB9A4 /end MEASUREMENT
/begin MEASUREMENT GPD_STATUS "Status returned from TPU call" UBYTE MC_GPD_STATUS 0 0 0 0 ECU_ADDRESS 0x3F9A7F /end MEASUREMENT
/begin COMPU_METHOD MC_GPD_STATUS "GPD_STATUS conversion" RAT_FUNC "%3.0" "Unitless" COEFFS 0 1 0 0 0 1 /end COMPU_METHOD
/begin MEASUREMENT GPD_WIN_EDGE_COUNT "Number of edges received from TPU call" UWORD MC_GPD_WIN_EDGE_COUNT 0 0 0 0 ECU_ADDRESS 0x3F9A7C /end MEASUREMENT
/begin COMPU_METHOD MC_GPD_WIN_EDGE_COUNT "GPD_WIN_EDGE_COUNT conversion" RAT_FUNC "%5.0" "Unitless" COEFFS 0 1 0 0 0 1 /end COMPU_METHOD
/begin MEASUREMENT GPD_WIN_SPAN "Timespan of edges received from TPU call" ULONG MC_GPD_WIN_SPAN 0 0 0 0 ECU_ADDRESS 0x3F9A70 /end MEASUREMENT
/begin COMPU_METHOD MC_GPD_WIN_SPAN "GPD_WIN_SPAN conversion" RAT_FUNC "%10.0" "Unitless" COEFFS 0 1 0 0 0 1 /end COMPU_METHOD
/begin MEASUREMENT GPD_WIN_TIMESTAMP "Current timestamp of TPU call" ULONG MC_GPD_WIN_TIMESTAMP 0 0 0 0 ECU_ADDRESS 0x3F9A6C /end MEASUREMENT
/begin COMPU_METHOD MC_GPD_WIN_TIMESTAMP "GPD_WIN_TIMESTAMP conversion" RAT_FUNC "%10.0" "Unitless" COEFFS 0 1 0 0 0 1 /end COMPU_METHOD
/begin CHARACTERISTIC GPEM_F_DEC "" VALUE 0x5E260 SD_SLONG 0 SC_GPEM_F_DEC 0 65535 /end CHARACTERISTIC
/begin COMPU_METHOD SC_GPEM_F_DEC "GPEM_F_DEC conversion" RAT_FUNC "%10.0" "unitless" COEFFS 0 1 0 0 0 1 /end COMPU_METHOD
/begin CHARACTERISTIC GPEM_F_INC "" VALUE 0x5E288 SD_SLONG 0 SC_GPEM_F_INC 0 65535 /end CHARACTERISTIC
/begin COMPU_METHOD SC_GPEM_F_INC "GPEM_F_INC conversion" RAT_FUNC "%10.0" "unitless" COEFFS 0 1 0 0 0 1 /end COMPU_METHOD
/begin MEASUREMENT GPEM_ORH_CNTR "" SLONG MC_GPEM_ORH_CNTR 0 0 0 0 ECU_ADDRESS 0x3FABF0 /end MEASUREMENT
/begin COMPU_METHOD MC_GPEM_ORH_CNTR "GPEM_ORH_CNTR conversion" RAT_FUNC "%10.0" "Unitless" COEFFS 0 1 0 0 0 1 /end COMPU_METHOD
/begin MEASUREMENT GPEM_STATUS "" UBYTE MC_GPEM_STATUS 0 0 0 0 ECU_ADDRESS 0x3F9835 /end MEASUREMENT
/begin COMPU_METHOD MC_GPEM_STATUS "GPEM_STATUS conversion" RAT_FUNC "%3.0" "Unitless" COEFFS 0 1 0 0 0 1 /end COMPU_METHOD
/begin CHARACTERISTIC GPE_IVPMAX "Maximum IVPWR necessary to enable glow plugs" VALUE 0x5E200 SD_FLOAT32_IEEE 0 SC_GPE_IVPMAX 0 20 /end CHARACTERISTIC
/begin COMPU_METHOD SC_GPE_IVPMAX "GPE_IVPMAX conversion" RAT_FUNC "%10.5" "V" COEFFS 0 1 0 0 0 1 /end COMPU_METHOD
/begin CHARACTERISTIC GPE_IVPMIN "Minimum IVPWR necessary to enable glow plugs" VALUE 0x5E204 SD_FLOAT32_IEEE 0 SC_GPE_IVPMIN 0 20 /end CHARACTERISTIC
/begin COMPU_METHOD SC_GPE_IVPMIN "GPE_IVPMIN conversion" RAT_FUNC "%10.5" "V" COEFFS 0 1 0 0 0 1 /end COMPU_METHOD
/begin MEASUREMENT GPE_ON "Glow Plug Enable line status (1= GPE on)" UBYTE MC_GPE_ON 0 0 0 0 ECU_ADDRESS 0x3F9834 /end MEASUREMENT
/begin COMPU_METHOD MC_GPE_ON "GPE_ON conversion" RAT_FUNC "%3.0" "Unitless" COEFFS 0 1 0 0 0 1 /end COMPU_METHOD
/begin CHARACTERISTIC GPLM_F_DEC "" VALUE 0x5D684 SD_SLONG 0 SC_GPLM_F_DEC 0 65535 /end CHARACTERISTIC
/begin COMPU_METHOD SC_GPLM_F_DEC "GPLM_F_DEC conversion" RAT_FUNC "%10.0" "unitless" COEFFS 0 1 0 0 0 1 /end COMPU_METHOD
/begin CHARACTERISTIC GPLM_F_INC "" VALUE 0x5D680 SD_SLONG 0 SC_GPLM_F_INC 0 65535 /end CHARACTERISTIC
/begin COMPU_METHOD SC_GPLM_F_INC "GPLM_F_INC conversion" RAT_FUNC "%10.0" "unitless" COEFFS 0 1 0 0 0 1 /end COMPU_METHOD
/begin MEASUREMENT GPLM_ORH_CNTR "" SLONG MC_GPLM_ORH_CNTR 0 0 0 0 ECU_ADDRESS 0x3FA45C /end MEASUREMENT
/begin COMPU_METHOD MC_GPLM_ORH_CNTR "GPLM_ORH_CNTR conversion" RAT_FUNC "%10.0" "Unitless" COEFFS 0 1 0 0 0 1 /end COMPU_METHOD
/begin MEASUREMENT GPL_BP_TM "Glow plug lamp activation time based on BP (sec)" FLOAT32_IEEE MC_GPL_BP_TM 0 0 0 0 ECU_ADDRESS 0x3FAB94 /end MEASUREMENT
/begin COMPU_METHOD MC_GPL_BP_TM "GPL_BP_TM conversion" RAT_FUNC "%10.5" "Unitless" COEFFS 0 1 0 0 0 1 /end COMPU_METHOD
/begin MEASUREMENT GPL_FLG "Glow Plug lamp on/off flag" UBYTE MC_GPL_FLG 0 0 0 0 ECU_ADDRESS 0x3FABA1 /end MEASUREMENT
/begin COMPU_METHOD MC_GPL_FLG "GPL_FLG conversion" RAT_FUNC "%3.0" "Unitless" COEFFS 0 1 0 0 0 1 /end COMPU_METHOD
/begin MEASUREMENT GPL_F_FLAG "" UBYTE MC_GPL_F_FLAG 0 0 0 0 ECU_ADDRESS 0x3F9946 /end MEASUREMENT
/begin COMPU_METHOD MC_GPL_F_FLAG "GPL_F_FLAG conversion" RAT_FUNC "%3.0" "Unitless" COEFFS 0 1 0 0 0 1 /end COMPU_METHOD
/begin MEASUREMENT GPL_TM "Glow plug lamp activation time FINAL (sec)" FLOAT32_IEEE MC_GPL_TM 0 0 0 0 ECU_ADDRESS 0x3FAB90 /end MEASUREMENT
/begin COMPU_METHOD MC_GPL_TM "GPL_TM conversion" RAT_FUNC "%10.5" "Unitless" COEFFS 0 1 0 0 0 1 /end COMPU_METHOD
/begin CHARACTERISTIC GPL_TM_MAX "Glow plug lamp 'ON' time Maximum" VALUE 0x5E1F4 SD_FLOAT32_IEEE 0 SC_GPL_TM_MAX 0.125 30 /end CHARACTERISTIC
/begin COMPU_METHOD SC_GPL_TM_MAX "GPL_TM_MAX conversion" RAT_FUNC "%10.5" "s" COEFFS 0 1 0 0 0 1 /end COMPU_METHOD
/begin CHARACTERISTIC GPOFFDIAG_SW "1=P0684 will set for ""on when commanded off"" failure" VALUE 0x5E2C7 SD_UBYTE 0 SC_GPOFFDIAG_SW 0 1 /end CHARACTERISTIC
/begin COMPU_METHOD SC_GPOFFDIAG_SW "GPOFFDIAG_SW conversion" RAT_FUNC "%3.0" "unitless" COEFFS 0 1 0 0 0 1 /end COMPU_METHOD
/begin MEASUREMENT GP_COMP_FLG "Glow Plug cycle complete flag (1=complete)" UBYTE MC_GP_COMP_FLG 0 0 0 0 ECU_ADDRESS 0x3FABA0 /end MEASUREMENT
/begin COMPU_METHOD MC_GP_COMP_FLG "GP_COMP_FLG conversion" RAT_FUNC "%3.0" "Unitless" COEFFS 0 1 0 0 0 1 /end COMPU_METHOD
/begin CHARACTERISTIC GP_CON_SW "Glow plug control switch (0 = Glow Plug Relay [default]; 1 = Glow Plug Control Module [GPCM])" VALUE 0x5E255 SD_UBYTE 0 SC_GP_CON_SW 0 1 /end CHARACTERISTIC
/begin COMPU_METHOD SC_GP_CON_SW "GP_CON_SW conversion" RAT_FUNC "%3.0" "unitless" COEFFS 0 1 0 0 0 1 /end COMPU_METHOD
/begin MEASUREMENT GP_ENG_WAS_STALLED "Glow plug control-Engine was stalled indication flag" UBYTE MC_GP_ENG_WAS_STALLED 0 0 0 0 ECU_ADDRESS 0x3FAB8E /end MEASUREMENT
/begin COMPU_METHOD MC_GP_ENG_WAS_STALLED "GP_ENG_WAS_STALLED conversion" RAT_FUNC "%3.0" "Unitless" COEFFS 0 1 0 0 0 1 /end COMPU_METHOD
/begin CHARACTERISTIC GP_OSC_CHANNEL "Glow plug IO channel assignment" VALUE 0x5E210 SD_UBYTE 0 SC_GP_OSC_CHANNEL 0 255 /end CHARACTERISTIC
/begin COMPU_METHOD SC_GP_OSC_CHANNEL "GP_OSC_CHANNEL conversion" RAT_FUNC "%3.0" "unitless" COEFFS 0 1 0 0 0 1 /end COMPU_METHOD
/begin CHARACTERISTIC GP_STALL_SW "Allows Glow Plug reactivation on engine stall" VALUE 0x5E212 SD_UBYTE 0 SC_GP_STALL_SW 0 1 /end CHARACTERISTIC
/begin COMPU_METHOD SC_GP_STALL_SW "GP_STALL_SW conversion" RAT_FUNC "%3.0" "unitless" COEFFS 0 1 0 0 0 1 /end COMPU_METHOD
/begin MEASUREMENT HALF_PIP_RAW "unvalidated period between the last two PIP transitions." FLOAT32_IEEE MC_HALF_PIP_RAW 0 0 0 0 ECU_ADDRESS 0x3F9884 /end MEASUREMENT
/begin COMPU_METHOD MC_HALF_PIP_RAW "HALF_PIP_RAW conversion" RAT_FUNC "%10.5" "Unitless" COEFFS 0 1 0 0 0 1 /end COMPU_METHOD
/begin MEASUREMENT HBRIDGE_FLAG "HBRIDGE status" UBYTE MC_HBRIDGE_FLAG 0 0 0 0 ECU_ADDRESS 0x3FA3FC /end MEASUREMENT
/begin COMPU_METHOD MC_HBRIDGE_FLAG "HBRIDGE_FLAG conversion" RAT_FUNC "%3.0" "Unitless" COEFFS 0 1 0 0 0 1 /end COMPU_METHOD
/begin MEASUREMENT HEGO_FAULT "Flag indicating at least one EGO sensor is faulted." UBYTE MC_HEGO_FAULT 0 0 0 0 ECU_ADDRESS 0x3F9CE1 /end MEASUREMENT
/begin COMPU_METHOD MC_HEGO_FAULT "HEGO_FAULT conversion" RAT_FUNC "%3.0" "Unitless" COEFFS 0 1 0 0 0 1 /end COMPU_METHOD
/begin MEASUREMENT HEGO_FDBACK "Flag indicating normal closed loop operation." UBYTE MC_HEGO_FDBACK 0 0 0 0 ECU_ADDRESS 0x3F9CE2 /end MEASUREMENT
/begin COMPU_METHOD MC_HEGO_FDBACK "HEGO_FDBACK conversion" RAT_FUNC "%3.0" "Unitless" COEFFS 0 1 0 0 0 1 /end COMPU_METHOD
/begin MEASUREMENT HI_ALT_BP_MULT "High altitude barometric multiplier." FLOAT32_IEEE MC_HI_ALT_BP_MULT 0 0 0 0 ECU_ADDRESS 0x3F9ED0 /end MEASUREMENT
/begin COMPU_METHOD MC_HI_ALT_BP_MULT "HI_ALT_BP_MULT conversion" RAT_FUNC "%10.5" "Unitless" COEFFS 0 1 0 0 0 1 /end COMPU_METHOD
/begin MEASUREMENT HI_ALT_DITBP_MULT "High altitude barometric multiplier." FLOAT32_IEEE MC_HI_ALT_DITBP_MULT 0 0 0 0 ECU_ADDRESS 0x3FA924 /end MEASUREMENT
/begin COMPU_METHOD MC_HI_ALT_DITBP_MULT "HI_ALT_DITBP_MULT conversion" RAT_FUNC "%10.5" "Unitless" COEFFS 0 1 0 0 0 1 /end COMPU_METHOD
/begin MEASUREMENT HLD_AC_TMR_D "Timer to control how long to hold the A/C in its current state." FLOAT32_IEEE MC_HLD_AC_TMR_D 0 0 0 0 ECU_ADDRESS 0x3F9D40 /end MEASUREMENT
/begin COMPU_METHOD MC_HLD_AC_TMR_D "HLD_AC_TMR_D conversion" RAT_FUNC "%10.5" "Unitless" COEFFS 0 1 0 0 0 1 /end COMPU_METHOD
/begin CHARACTERISTIC HLD_AC_TM_D "Time to disallow A/C to change state during gear shifts" VALUE 0x5CBB0 SD_FLOAT32_IEEE 0 SC_HLD_AC_TM_D 0 65535 /end CHARACTERISTIC
/begin COMPU_METHOD SC_HLD_AC_TM_D "HLD_AC_TM_D conversion" RAT_FUNC "%10.5" "s" COEFFS 0 1 0 0 0 1 /end COMPU_METHOD
/begin CHARACTERISTIC HPDLCOT "Maximum time to disable A/C after high pedal" VALUE 0x5CBDC SD_FLOAT32_IEEE 0 SC_HPDLCOT 0 62 /end CHARACTERISTIC
/begin COMPU_METHOD SC_HPDLCOT "HPDLCOT conversion" RAT_FUNC "%10.5" "s" COEFFS 0 1 0 0 0 1 /end COMPU_METHOD
/begin MEASUREMENT HRDRV_MIN_TMR "Green engine delay minutes counter" UBYTE MC_HRDRV_MIN_TMR 0 0 0 0 ECU_ADDRESS 0x3FA0E7 /end MEASUREMENT
/begin COMPU_METHOD MC_HRDRV_MIN_TMR "HRDRV_MIN_TMR conversion" RAT_FUNC "%3.0" "Unitless" COEFFS 0 1 0 0 0 1 /end COMPU_METHOD
/begin MEASUREMENT HRDRV_MSEC_TMR "Green engine delay timer counter" FLOAT32_IEEE MC_HRDRV_MSEC_TMR 0 0 0 0 ECU_ADDRESS 0x3FA098 /end MEASUREMENT
/begin COMPU_METHOD MC_HRDRV_MSEC_TMR "HRDRV_MSEC_TMR conversion" RAT_FUNC "%10.5" "Unitless" COEFFS 0 1 0 0 0 1 /end COMPU_METHOD
/begin MEASUREMENT HRDVR_TMRFLG "Green engine delay hard drive flag" UBYTE MC_HRDVR_TMRFLG 0 0 0 0 ECU_ADDRESS 0x3FA0E6 /end MEASUREMENT
/begin COMPU_METHOD MC_HRDVR_TMRFLG "HRDVR_TMRFLG conversion" RAT_FUNC "%3.0" "Unitless" COEFFS 0 1 0 0 0 1 /end COMPU_METHOD
/begin CHARACTERISTIC HRD_DRV_EOT "EOT limit during crank SST" VALUE 0x5D1B8 SD_FLOAT32_IEEE 0 SC_HRD_DRV_EOT -8192 81920 /end CHARACTERISTIC
/begin COMPU_METHOD SC_HRD_DRV_EOT "HRD_DRV_EOT conversion" RAT_FUNC "%10.5" "degC" COEFFS 0 1 0 0 0 1 /end COMPU_METHOD
/begin CHARACTERISTIC HRD_DRV_ICP "ICP desired limit during crank SST" VALUE 0x5D1B4 SD_FLOAT32_IEEE 0 SC_HRD_DRV_ICP 0 255 /end CHARACTERISTIC
/begin COMPU_METHOD SC_HRD_DRV_ICP "HRD_DRV_ICP conversion" RAT_FUNC "%10.5" "MPa" COEFFS 0 1 0 0 0 1 /end COMPU_METHOD
/begin CHARACTERISTIC HRD_DRV_N "engine speed limit during crank SST" VALUE 0x5D1BC SD_FLOAT32_IEEE 0 SC_HRD_DRV_N 0 16383.8 /end CHARACTERISTIC
/begin COMPU_METHOD SC_HRD_DRV_N "HRD_DRV_N conversion" RAT_FUNC "%10.5" "RPM" COEFFS 0 1 0 0 0 1 /end COMPU_METHOD
/begin CHARACTERISTIC HRD_DRV_TM "Green engine delayminute timer limit" VALUE 0x5D1B0 SD_FLOAT32_IEEE 0 SC_HRD_DRV_TM 0 65535 /end CHARACTERISTIC
/begin COMPU_METHOD SC_HRD_DRV_TM "HRD_DRV_TM conversion" RAT_FUNC "%10.5" "unitless" COEFFS 0 1 0 0 0 1 /end COMPU_METHOD
/begin MEASUREMENT HYD_MULT_ACTV "" UBYTE MC_HYD_MULT_ACTV 0 0 0 0 ECU_ADDRESS 0x3FB6BA /end MEASUREMENT
/begin COMPU_METHOD MC_HYD_MULT_ACTV "HYD_MULT_ACTV conversion" RAT_FUNC "%3.0" "Unitless" COEFFS 0 1 0 0 0 1 /end COMPU_METHOD
/begin MEASUREMENT IAT " Alternator generation current" FLOAT32_IEEE MC_IAT 0 0 0 0 ECU_ADDRESS 0x3FA364 /end MEASUREMENT
/begin COMPU_METHOD MC_IAT "IAT conversion" RAT_FUNC "%10.5" "Unitless" COEFFS 0 1 0 0 0 1 /end COMPU_METHOD
/begin MEASUREMENT IATMAT_RAT_TMR "EO iat mat rationalee test timer" FLOAT32_IEEE MC_IATMAT_RAT_TMR 0 0 0 0 ECU_ADDRESS 0x3FA51C /end MEASUREMENT
/begin COMPU_METHOD MC_IATMAT_RAT_TMR "IATMAT_RAT_TMR conversion" RAT_FUNC "%10.5" "Unitless" COEFFS 0 1 0 0 0 1 /end COMPU_METHOD
/begin CHARACTERISTIC IAT_AD_TC "IAT filter time constant" VALUE 0x5D554 SD_FLOAT32_IEEE 0 SC_IAT_AD_TC 0 64 /end CHARACTERISTIC
/begin COMPU_METHOD SC_IAT_AD_TC "IAT_AD_TC conversion" RAT_FUNC "%10.5" "s" COEFFS 0 1 0 0 0 1 /end COMPU_METHOD
/begin MEASUREMENT IAT_CNTS "Intake air temperature sensor A/D counts" SLONG MC_IAT_CNTS 0 0 0 0 ECU_ADDRESS 0x3F99D0 /end MEASUREMENT
/begin COMPU_METHOD MC_IAT_CNTS "IAT_CNTS conversion" RAT_FUNC "%10.0" "Unitless" COEFFS 0 1 0 0 0 1 /end COMPU_METHOD
/begin CHARACTERISTIC IAT_DEF "Default FMEM value for intake air temperature" VALUE 0x5D55C SD_FLOAT32_IEEE 0 SC_IAT_DEF -40 150 /end CHARACTERISTIC
/begin COMPU_METHOD SC_IAT_DEF "IAT_DEF conversion" RAT_FUNC "%10.5" "degC" COEFFS 0 1 0 0 0 1 /end COMPU_METHOD
/begin MEASUREMENT IAT_ENG_C "Intake Air Temperature without FMEM substitutions, degree C" FLOAT32_IEEE MC_IAT_ENG_C 0 0 0 0 ECU_ADDRESS 0x3F99CC /end MEASUREMENT
/begin COMPU_METHOD MC_IAT_ENG_C "IAT_ENG_C conversion" RAT_FUNC "%10.5" "Unitless" COEFFS 0 1 0 0 0 1 /end COMPU_METHOD
/begin MEASUREMENT IAT_F "Intake air temperature in deg F" FLOAT32_IEEE MC_IAT_F 0 0 0 0 ECU_ADDRESS 0x3FA344 /end MEASUREMENT
/begin COMPU_METHOD MC_IAT_F "IAT_F conversion" RAT_FUNC "%10.5" "Unitless" COEFFS 0 1 0 0 0 1 /end COMPU_METHOD
/begin MEASUREMENT IAT_FILT_TIME_CONST "IAT  filter time constant" FLOAT32_IEEE MC_IAT_FILT_TIME_CONST 0 0 0 0 ECU_ADDRESS 0x3FA35C /end MEASUREMENT
/begin COMPU_METHOD MC_IAT_FILT_TIME_CONST "IAT_FILT_TIME_CONST conversion" RAT_FUNC "%10.5" "Unitless" COEFFS 0 1 0 0 0 1 /end COMPU_METHOD
/begin MEASUREMENT IAT_FLT_RECOVERY_CNTR "IAT fault recovery counter" SLONG MC_IAT_FLT_RECOVERY_CNTR 0 0 0 0 ECU_ADDRESS 0x3FA348 /end MEASUREMENT
/begin COMPU_METHOD MC_IAT_FLT_RECOVERY_CNTR "IAT_FLT_RECOVERY_CNTR conversion" RAT_FUNC "%10.0" "Unitless" COEFFS 0 1 0 0 0 1 /end COMPU_METHOD
/begin MEASUREMENT IAT_FLT_RECOVERY_FLG "1-> Indicates IAT fault recovery is occuring" UBYTE MC_IAT_FLT_RECOVERY_FLG 0 0 0 0 ECU_ADDRESS 0x3FA369 /end MEASUREMENT
/begin COMPU_METHOD MC_IAT_FLT_RECOVERY_FLG "IAT_FLT_RECOVERY_FLG conversion" RAT_FUNC "%3.0" "Unitless" COEFFS 0 1 0 0 0 1 /end COMPU_METHOD
/begin CHARACTERISTIC IAT_F_DEC "IAT malf failure/update counter decrement value" VALUE 0x5D57C SD_SLONG 0 SC_IAT_F_DEC 0 65535 /end CHARACTERISTIC
/begin COMPU_METHOD SC_IAT_F_DEC "IAT_F_DEC conversion" RAT_FUNC "%10.0" "unitless" COEFFS 0 1 0 0 0 1 /end COMPU_METHOD
/begin CHARACTERISTIC IAT_F_INC "IAT ORH/ORL failure counter increment value" VALUE 0x5D580 SD_SLONG 0 SC_IAT_F_INC 0 65535 /end CHARACTERISTIC
/begin COMPU_METHOD SC_IAT_F_INC "IAT_F_INC conversion" RAT_FUNC "%10.0" "unitless" COEFFS 0 1 0 0 0 1 /end COMPU_METHOD
/begin CHARACTERISTIC IAT_HI_VOLTS "Intake Air Temperature out of range high limit" VALUE 0x5C768 SD_FLOAT32_IEEE 0 SC_IAT_HI_VOLTS 0 5 /end CHARACTERISTIC
/begin COMPU_METHOD SC_IAT_HI_VOLTS "IAT_HI_VOLTS conversion" RAT_FUNC "%10.5" "V" COEFFS 0 1 0 0 0 1 /end COMPU_METHOD
/begin CHARACTERISTIC IAT_LO_VOLTS "Intake Air Temperature out of range low limit" VALUE 0x5C76C SD_FLOAT32_IEEE 0 SC_IAT_LO_VOLTS 0 5 /end CHARACTERISTIC
/begin COMPU_METHOD SC_IAT_LO_VOLTS "IAT_LO_VOLTS conversion" RAT_FUNC "%10.5" "V" COEFFS 0 1 0 0 0 1 /end COMPU_METHOD
/begin MEASUREMENT IAT_MALF_SET "Indicate IAT malf  high or low failure" UBYTE MC_IAT_MALF_SET 0 0 0 0 ECU_ADDRESS 0x3FA36B /end MEASUREMENT
/begin COMPU_METHOD MC_IAT_MALF_SET "IAT_MALF_SET conversion" RAT_FUNC "%3.0" "Unitless" COEFFS 0 1 0 0 0 1 /end COMPU_METHOD
/begin MEASUREMENT IAT_ORH_CNTR "Intake Air Temperature out of range high counter" SLONG MC_IAT_ORH_CNTR 0 0 0 0 ECU_ADDRESS 0x3FA358 /end MEASUREMENT
/begin COMPU_METHOD MC_IAT_ORH_CNTR "IAT_ORH_CNTR conversion" RAT_FUNC "%10.0" "Unitless" COEFFS 0 1 0 0 0 1 /end COMPU_METHOD
/begin MEASUREMENT IAT_ORL_CNTR "Intake Air Temperature out of range low counter" SLONG MC_IAT_ORL_CNTR 0 0 0 0 ECU_ADDRESS 0x3FA354 /end MEASUREMENT
/begin COMPU_METHOD MC_IAT_ORL_CNTR "IAT_ORL_CNTR conversion" RAT_FUNC "%10.0" "Unitless" COEFFS 0 1 0 0 0 1 /end COMPU_METHOD
/begin CHARACTERISTIC IAT_REC_INC "IAT  fault recovery counter increment value" VALUE 0x5D558 SD_SLONG 0 SC_IAT_REC_INC 0 65535 /end CHARACTERISTIC
/begin COMPU_METHOD SC_IAT_REC_INC "IAT_REC_INC conversion" RAT_FUNC "%10.0" "unitless" COEFFS 0 1 0 0 0 1 /end COMPU_METHOD
/begin MEASUREMENT IAT_STATUS "Status of Intake Air Temperature sensor,  0 = no error" UBYTE MC_IAT_STATUS 0 0 0 0 ECU_ADDRESS 0x3F99D4 /end MEASUREMENT
/begin COMPU_METHOD MC_IAT_STATUS "IAT_STATUS conversion" RAT_FUNC "%3.0" "Unitless" COEFFS 0 1 0 0 0 1 /end COMPU_METHOD
/begin CHARACTERISTIC IAT_TCREC_SEL "Switch to select IAT filter time constant during fault recovery and during fault occurance before malf is set" VALUE 0x5D560 SD_UBYTE 0 SC_IAT_TCREC_SEL 0 1 /end CHARACTERISTIC
/begin COMPU_METHOD SC_IAT_TCREC_SEL "IAT_TCREC_SEL conversion" RAT_FUNC "%3.0" "unitless" COEFFS 0 1 0 0 0 1 /end COMPU_METHOD
/begin CHARACTERISTIC IAT_TPLRN_MIN "" VALUE 0x5C804 SD_FLOAT32_IEEE 0 SC_IAT_TPLRN_MIN -50 150 /end CHARACTERISTIC
/begin COMPU_METHOD SC_IAT_TPLRN_MIN "IAT_TPLRN_MIN conversion" RAT_FUNC "%10.5" "degC" COEFFS 0 1 0 0 0 1 /end COMPU_METHOD
/begin CHARACTERISTIC ICLAMP_SEL "" VALUE 0x5DC0D SD_UBYTE 0 SC_ICLAMP_SEL 0 1 /end CHARACTERISTIC
/begin COMPU_METHOD SC_ICLAMP_SEL "ICLAMP_SEL conversion" RAT_FUNC "%3.0" "unitless" COEFFS 0 1 0 0 0 1 /end COMPU_METHOD
/begin MEASUREMENT ICPANEROID "ICP, limited fuel" FLOAT32_IEEE MC_ICPANEROID 0 0 0 0 ECU_ADDRESS 0x3FA7E8 /end MEASUREMENT
/begin COMPU_METHOD MC_ICPANEROID "ICPANEROID conversion" RAT_FUNC "%10.5" "Unitless" COEFFS 0 1 0 0 0 1 /end COMPU_METHOD
/begin MEASUREMENT ICPCORR_NORM "" FLOAT32_IEEE MC_ICPCORR_NORM 0 0 0 0 ECU_ADDRESS 0x3F990C /end MEASUREMENT
/begin COMPU_METHOD MC_ICPCORR_NORM "ICPCORR_NORM conversion" RAT_FUNC "%10.5" "Unitless" COEFFS 0 1 0 0 0 1 /end COMPU_METHOD
/begin CHARACTERISTIC ICPDES_OLLMN "Minimum ICP_DES during open loop control (MPa)" VALUE 0x5DFEC SD_FLOAT32_IEEE 0 SC_ICPDES_OLLMN 0 30 /end CHARACTERISTIC
/begin COMPU_METHOD SC_ICPDES_OLLMN "ICPDES_OLLMN conversion" RAT_FUNC "%10.5" "MPa" COEFFS 0 1 0 0 0 1 /end COMPU_METHOD
/begin CHARACTERISTIC ICPDES_OLLMX "Maximum ICP_DES during open loop control (MPa)" VALUE 0x5DFE8 SD_FLOAT32_IEEE 0 SC_ICPDES_OLLMX 0 30 /end CHARACTERISTIC
/begin COMPU_METHOD SC_ICPDES_OLLMX "ICPDES_OLLMX conversion" RAT_FUNC "%10.5" "MPa" COEFFS 0 1 0 0 0 1 /end COMPU_METHOD
/begin CHARACTERISTIC ICPDSHKF "" VALUE 0x5DFE4 SD_FLOAT32_IEEE 0 SC_ICPDSHKF -1 2 /end CHARACTERISTIC
/begin COMPU_METHOD SC_ICPDSHKF "ICPDSHKF conversion" RAT_FUNC "%10.5" "unitless" COEFFS 0 1 0 0 0 1 /end COMPU_METHOD
/begin MEASUREMENT ICPSP_MFDES_DIFF "Difference of filtered and unfiltered desired mass fuel quantity (mg/stroke)" FLOAT32_IEEE MC_ICPSP_MFDES_DIFF 0 0 0 0 ECU_ADDRESS 0x3FA084 /end MEASUREMENT
/begin COMPU_METHOD MC_ICPSP_MFDES_DIFF "ICPSP_MFDES_DIFF conversion" RAT_FUNC "%10.5" "Unitless" COEFFS 0 1 0 0 0 1 /end COMPU_METHOD
/begin MEASUREMENT ICPSP_MFDES_FILT "Filtered desired mass fuel quantity (mg/stroke)" FLOAT32_IEEE MC_ICPSP_MFDES_FILT 0 0 0 0 ECU_ADDRESS 0x3FA088 /end MEASUREMENT
/begin COMPU_METHOD MC_ICPSP_MFDES_FILT "ICPSP_MFDES_FILT conversion" RAT_FUNC "%10.5" "Unitless" COEFFS 0 1 0 0 0 1 /end COMPU_METHOD
/begin CHARACTERISTIC ICPSP_MF_TRNS_KF "MFDES filter gain constant" VALUE 0x5D198 SD_FLOAT32_IEEE 0 SC_ICPSP_MF_TRNS_KF 0 1 /end CHARACTERISTIC
/begin COMPU_METHOD SC_ICPSP_MF_TRNS_KF "ICPSP_MF_TRNS_KF conversion" RAT_FUNC "%10.5" "unitless" COEFFS 0 1 0 0 0 1 /end COMPU_METHOD
/begin MEASUREMENT ICPSS_CR_TMR "p1212 malfunction timer counter" FLOAT32_IEEE MC_ICPSS_CR_TMR 0 0 0 0 ECU_ADDRESS 0x3FA094 /end MEASUREMENT
/begin COMPU_METHOD MC_ICPSS_CR_TMR "ICPSS_CR_TMR conversion" RAT_FUNC "%10.5" "Unitless" COEFFS 0 1 0 0 0 1 /end COMPU_METHOD
/begin MEASUREMENT ICPSS_ERU_TIMER "ICP run steady state test malfunction timer counter" FLOAT32_IEEE MC_ICPSS_ERU_TIMER 0 0 0 0 ECU_ADDRESS 0x3FA0B0 /end MEASUREMENT
/begin COMPU_METHOD MC_ICPSS_ERU_TIMER "ICPSS_ERU_TIMER conversion" RAT_FUNC "%10.5" "Unitless" COEFFS 0 1 0 0 0 1 /end COMPU_METHOD
/begin CHARACTERISTIC ICPSS_ERU_TM "p1211 malfunction update timer limit" VALUE 0x5D1D4 SD_FLOAT32_IEEE 0 SC_ICPSS_ERU_TM 0 50000 /end CHARACTERISTIC
/begin COMPU_METHOD SC_ICPSS_ERU_TM "ICPSS_ERU_TM conversion" RAT_FUNC "%10.5" "unitless" COEFFS 0 1 0 0 0 1 /end COMPU_METHOD
/begin MEASUREMENT ICPSS_ERU_TMR "ICP run steady state test update timer counter" FLOAT32_IEEE MC_ICPSS_ERU_TMR 0 0 0 0 ECU_ADDRESS 0x3FA0AC /end MEASUREMENT
/begin COMPU_METHOD MC_ICPSS_ERU_TMR "ICPSS_ERU_TMR conversion" RAT_FUNC "%10.5" "Unitless" COEFFS 0 1 0 0 0 1 /end COMPU_METHOD
/begin CHARACTERISTIC ICPSS_ER_LN "p1211 malfunction timer limit" VALUE 0x5D1E0 SD_FLOAT32_IEEE 0 SC_ICPSS_ER_LN 0 50000 /end CHARACTERISTIC
/begin COMPU_METHOD SC_ICPSS_ER_LN "ICPSS_ER_LN conversion" RAT_FUNC "%10.5" "unitless" COEFFS 0 1 0 0 0 1 /end COMPU_METHOD
/begin CHARACTERISTIC ICPSS_ER_LX "p1329 malfunction timer limit" VALUE 0x5D1CC SD_FLOAT32_IEEE 0 SC_ICPSS_ER_LX 0 50000 /end CHARACTERISTIC
/begin COMPU_METHOD SC_ICPSS_ER_LX "ICPSS_ER_LX conversion" RAT_FUNC "%10.5" "unitless" COEFFS 0 1 0 0 0 1 /end COMPU_METHOD
/begin CHARACTERISTIC ICPSS_ER_MN "ICP steady state minimum error constant" VALUE 0x5D1E4 SD_FLOAT32_IEEE 0 SC_ICPSS_ER_MN -128 128 /end CHARACTERISTIC
/begin COMPU_METHOD SC_ICPSS_ER_MN "ICPSS_ER_MN conversion" RAT_FUNC "%10.5" "MPa" COEFFS 0 1 0 0 0 1 /end COMPU_METHOD
/begin CHARACTERISTIC ICPSS_ER_MX "ICP steady state maximun error constant" VALUE 0x5D1D0 SD_FLOAT32_IEEE 0 SC_ICPSS_ER_MX -128 128 /end CHARACTERISTIC
/begin COMPU_METHOD SC_ICPSS_ER_MX "ICPSS_ER_MX conversion" RAT_FUNC "%10.5" "MPa" COEFFS 0 1 0 0 0 1 /end COMPU_METHOD
/begin CHARACTERISTIC ICPSS_ER_TIME "p1329malfupdate timer limit" VALUE 0x5D1C0 SD_FLOAT32_IEEE 0 SC_ICPSS_ER_TIME 0 50000 /end CHARACTERISTIC
/begin COMPU_METHOD SC_ICPSS_ER_TIME "ICPSS_ER_TIME conversion" RAT_FUNC "%10.5" "unitless" COEFFS 0 1 0 0 0 1 /end COMPU_METHOD
/begin MEASUREMENT ICPSS_ER_TIMER "p1211 malf update timer counter" FLOAT32_IEEE MC_ICPSS_ER_TIMER 0 0 0 0 ECU_ADDRESS 0x3FA09C /end MEASUREMENT
/begin COMPU_METHOD MC_ICPSS_ER_TIMER "ICPSS_ER_TIMER conversion" RAT_FUNC "%10.5" "Unitless" COEFFS 0 1 0 0 0 1 /end COMPU_METHOD
/begin MEASUREMENT ICPSS_ER_TMR "ICP higher than desired malf timer counter" FLOAT32_IEEE MC_ICPSS_ER_TMR 0 0 0 0 ECU_ADDRESS 0x3FA0A4 /end MEASUREMENT
/begin COMPU_METHOD MC_ICPSS_ER_TMR "ICPSS_ER_TMR conversion" RAT_FUNC "%10.5" "Unitless" COEFFS 0 1 0 0 0 1 /end COMPU_METHOD
/begin CHARACTERISTIC ICPSS_RCV_LN "p1211 malfunction fault recovery timer limit" VALUE 0x5D1D8 SD_FLOAT32_IEEE 0 SC_ICPSS_RCV_LN 0 50000 /end CHARACTERISTIC
/begin COMPU_METHOD SC_ICPSS_RCV_LN "ICPSS_RCV_LN conversion" RAT_FUNC "%10.5" "unitless" COEFFS 0 1 0 0 0 1 /end COMPU_METHOD
/begin CHARACTERISTIC ICPSS_RCV_LX "p1329 malfunction recovery timer limit" VALUE 0x5D1C4 SD_FLOAT32_IEEE 0 SC_ICPSS_RCV_LX 0 50000 /end CHARACTERISTIC
/begin COMPU_METHOD SC_ICPSS_RCV_LX "ICPSS_RCV_LX conversion" RAT_FUNC "%10.5" "unitless" COEFFS 0 1 0 0 0 1 /end COMPU_METHOD
/begin CHARACTERISTIC ICPSS_RCV_MN "icp_des, icp_eng minimum difference constant during fault recovery" VALUE 0x5D1DC SD_FLOAT32_IEEE 0 SC_ICPSS_RCV_MN -30 30 /end CHARACTERISTIC
/begin COMPU_METHOD SC_ICPSS_RCV_MN "ICPSS_RCV_MN conversion" RAT_FUNC "%10.5" "MPa" COEFFS 0 1 0 0 0 1 /end COMPU_METHOD
/begin CHARACTERISTIC ICPSS_RCV_MX "icp_des, icp_eng maximum constant difference during recovery" VALUE 0x5D1C8 SD_FLOAT32_IEEE 0 SC_ICPSS_RCV_MX -30 30 /end CHARACTERISTIC
/begin COMPU_METHOD SC_ICPSS_RCV_MX "ICPSS_RCV_MX conversion" RAT_FUNC "%10.5" "MPa" COEFFS 0 1 0 0 0 1 /end COMPU_METHOD
/begin MEASUREMENT ICPSS_RCV_TMR "ICP higher than desired malf reset timer counter" FLOAT32_IEEE MC_ICPSS_RCV_TMR 0 0 0 0 ECU_ADDRESS 0x3FA0A0 /end MEASUREMENT
/begin COMPU_METHOD MC_ICPSS_RCV_TMR "ICPSS_RCV_TMR conversion" RAT_FUNC "%10.5" "Unitless" COEFFS 0 1 0 0 0 1 /end COMPU_METHOD
/begin MEASUREMENT ICPSS_RV_TMR "ICP run SST malf reset timer counter" FLOAT32_IEEE MC_ICPSS_RV_TMR 0 0 0 0 ECU_ADDRESS 0x3FA0A8 /end MEASUREMENT
/begin COMPU_METHOD MC_ICPSS_RV_TMR "ICPSS_RV_TMR conversion" RAT_FUNC "%10.5" "Unitless" COEFFS 0 1 0 0 0 1 /end COMPU_METHOD
/begin MEASUREMENT ICP_BP_DIFF_POST "" FLOAT32_IEEE MC_ICP_BP_DIFF_POST 0 0 0 0 ECU_ADDRESS 0x3FCC6C /end MEASUREMENT
/begin COMPU_METHOD MC_ICP_BP_DIFF_POST "ICP_BP_DIFF_POST conversion" RAT_FUNC "%10.5" "Unitless" COEFFS 0 1 0 0 0 1 /end COMPU_METHOD
/begin MEASUREMENT ICP_BP_DIFF_PRE "" FLOAT32_IEEE MC_ICP_BP_DIFF_PRE 0 0 0 0 ECU_ADDRESS 0x3F9914 /end MEASUREMENT
/begin COMPU_METHOD MC_ICP_BP_DIFF_PRE "ICP_BP_DIFF_PRE conversion" RAT_FUNC "%10.5" "Unitless" COEFFS 0 1 0 0 0 1 /end COMPU_METHOD
/begin CHARACTERISTIC ICP_BP_DLY_TM "" VALUE 0x5C5E8 SD_FLOAT32_IEEE 0 SC_ICP_BP_DLY_TM 0 10 /end CHARACTERISTIC
/begin COMPU_METHOD SC_ICP_BP_DLY_TM "ICP_BP_DLY_TM conversion" RAT_FUNC "%10.5" "unitless" COEFFS 0 1 0 0 0 1 /end COMPU_METHOD
/begin MEASUREMENT ICP_BP_DLY_TMR "" FLOAT32_IEEE MC_ICP_BP_DLY_TMR 0 0 0 0 ECU_ADDRESS 0x3F9918 /end MEASUREMENT
/begin COMPU_METHOD MC_ICP_BP_DLY_TMR "ICP_BP_DLY_TMR conversion" RAT_FUNC "%10.5" "Unitless" COEFFS 0 1 0 0 0 1 /end COMPU_METHOD
/begin CHARACTERISTIC ICP_BP_TC "" VALUE 0x5C5E4 SD_FLOAT32_IEEE 0 SC_ICP_BP_TC 0 1 /end CHARACTERISTIC
/begin COMPU_METHOD SC_ICP_BP_TC "ICP_BP_TC conversion" RAT_FUNC "%10.5" "unitless" COEFFS 0 1 0 0 0 1 /end COMPU_METHOD
/begin MEASUREMENT ICP_BP_V "" FLOAT32_IEEE MC_ICP_BP_V 0 0 0 0 ECU_ADDRESS 0x3F991C /end MEASUREMENT
/begin COMPU_METHOD MC_ICP_BP_V "ICP_BP_V conversion" RAT_FUNC "%10.5" "Unitless" COEFFS 0 1 0 0 0 1 /end COMPU_METHOD
/begin CHARACTERISTIC ICP_BUZZ_THR "Injection Control Pressure  threshold for buzz test" VALUE 0x5F0D4 SD_FLOAT32_IEEE 0 SC_ICP_BUZZ_THR 0 255 /end CHARACTERISTIC
/begin COMPU_METHOD SC_ICP_BUZZ_THR "ICP_BUZZ_THR conversion" RAT_FUNC "%10.5" "MPa" COEFFS 0 1 0 0 0 1 /end COMPU_METHOD
/begin CHARACTERISTIC ICP_CAL "Calibration value for desired ICP (MPa)" VALUE 0x5E030 SD_FLOAT32_IEEE 0 SC_ICP_CAL 0 30 /end CHARACTERISTIC
/begin COMPU_METHOD SC_ICP_CAL "ICP_CAL conversion" RAT_FUNC "%10.5" "MPa" COEFFS 0 1 0 0 0 1 /end COMPU_METHOD
/begin CHARACTERISTIC ICP_CRNKDEL "absolute value of icp error limit during green engine delay test" VALUE 0x5D1A8 SD_FLOAT32_IEEE 0 SC_ICP_CRNKDEL 0 128 /end CHARACTERISTIC
/begin COMPU_METHOD SC_ICP_CRNKDEL "ICP_CRNKDEL conversion" RAT_FUNC "%10.5" "MPa" COEFFS 0 1 0 0 0 1 /end COMPU_METHOD
/begin MEASUREMENT ICP_CRNKMIN "ICP crank timer value from the lookup table based on EOT_C input" FLOAT32_IEEE MC_ICP_CRNKMIN 0 0 0 0 ECU_ADDRESS 0x3FA08C /end MEASUREMENT
/begin COMPU_METHOD MC_ICP_CRNKMIN "ICP_CRNKMIN conversion" RAT_FUNC "%10.5" "Unitless" COEFFS 0 1 0 0 0 1 /end COMPU_METHOD
/begin CHARACTERISTIC ICP_CRNKMN "Minimum engine speed during green engine delay test" VALUE 0x5D1AC SD_FLOAT32_IEEE 0 SC_ICP_CRNKMN 0 16383.8 /end CHARACTERISTIC
/begin COMPU_METHOD SC_ICP_CRNKMN "ICP_CRNKMN conversion" RAT_FUNC "%10.5" "RPM" COEFFS 0 1 0 0 0 1 /end COMPU_METHOD
/begin CHARACTERISTIC ICP_CRNKRUN_TM "" VALUE 0x5E034 SD_FLOAT32_IEEE 0 SC_ICP_CRNKRUN_TM 0 1e+06 /end CHARACTERISTIC
/begin COMPU_METHOD SC_ICP_CRNKRUN_TM "ICP_CRNKRUN_TM conversion" RAT_FUNC "%10.5" "s" COEFFS 0 1 0 0 0 1 /end COMPU_METHOD
/begin MEASUREMENT ICP_CRNKRUN_TMR "" FLOAT32_IEEE MC_ICP_CRNKRUN_TMR 0 0 0 0 ECU_ADDRESS 0x3FAA48 /end MEASUREMENT
/begin COMPU_METHOD MC_ICP_CRNKRUN_TMR "ICP_CRNKRUN_TMR conversion" RAT_FUNC "%10.5" "Unitless" COEFFS 0 1 0 0 0 1 /end COMPU_METHOD
/begin CHARACTERISTIC ICP_CR_TM "p1212 malfunction update timer limit" VALUE 0x5D1A4 SD_FLOAT32_IEEE 0 SC_ICP_CR_TM 0 50000 /end CHARACTERISTIC
/begin COMPU_METHOD SC_ICP_CR_TM "ICP_CR_TM conversion" RAT_FUNC "%10.5" "unitless" COEFFS 0 1 0 0 0 1 /end COMPU_METHOD
/begin MEASUREMENT ICP_CR_TMR "p1212 malfunction update timer counter" FLOAT32_IEEE MC_ICP_CR_TMR 0 0 0 0 ECU_ADDRESS 0x3FA090 /end MEASUREMENT
/begin COMPU_METHOD MC_ICP_CR_TMR "ICP_CR_TMR conversion" RAT_FUNC "%10.5" "Unitless" COEFFS 0 1 0 0 0 1 /end COMPU_METHOD
/begin MEASUREMENT ICP_DASH_ADDR "" FLOAT32_IEEE MC_ICP_DASH_ADDR 0 0 0 0 ECU_ADDRESS 0x3FAA3C /end MEASUREMENT
/begin COMPU_METHOD MC_ICP_DASH_ADDR "ICP_DASH_ADDR conversion" RAT_FUNC "%10.5" "Unitless" COEFFS 0 1 0 0 0 1 /end COMPU_METHOD
/begin CHARACTERISTIC ICP_DASH_CAL "ICP Dashpot on/off switch" VALUE 0x5E053 SD_UBYTE 0 SC_ICP_DASH_CAL 0 1 /end CHARACTERISTIC
/begin COMPU_METHOD SC_ICP_DASH_CAL "ICP_DASH_CAL conversion" RAT_FUNC "%3.0" "unitless" COEFFS 0 1 0 0 0 1 /end COMPU_METHOD
/begin CHARACTERISTIC ICP_DASH_LMN "Minimum limit for ICP dashpot term (MPa)" VALUE 0x5E02C SD_FLOAT32_IEEE 0 SC_ICP_DASH_LMN -21 21 /end CHARACTERISTIC
/begin COMPU_METHOD SC_ICP_DASH_LMN "ICP_DASH_LMN conversion" RAT_FUNC "%10.5" "MPa" COEFFS 0 1 0 0 0 1 /end COMPU_METHOD
/begin CHARACTERISTIC ICP_DASH_LMX "Maximum limit for ICP dashpot term (MPa)" VALUE 0x5E028 SD_FLOAT32_IEEE 0 SC_ICP_DASH_LMX -21 21 /end CHARACTERISTIC
/begin COMPU_METHOD SC_ICP_DASH_LMX "ICP_DASH_LMX conversion" RAT_FUNC "%10.5" "MPa" COEFFS 0 1 0 0 0 1 /end COMPU_METHOD
/begin CHARACTERISTIC ICP_DASH_SW "" VALUE 0x5E052 SD_UBYTE 0 SC_ICP_DASH_SW 0 1 /end CHARACTERISTIC
/begin COMPU_METHOD SC_ICP_DASH_SW "ICP_DASH_SW conversion" RAT_FUNC "%3.0" "unitless" COEFFS 0 1 0 0 0 1 /end COMPU_METHOD
/begin MEASUREMENT ICP_DES "Desired Injection Control Pressure (in MPa)" FLOAT32_IEEE MC_ICP_DES 0 0 0 0 ECU_ADDRESS 0x3FAA38 /end MEASUREMENT
/begin COMPU_METHOD MC_ICP_DES "ICP_DES conversion" RAT_FUNC "%10.5" "Unitless" COEFFS 0 1 0 0 0 1 /end COMPU_METHOD
/begin MEASUREMENT ICP_DES_CRNK_BOOST "" FLOAT32_IEEE MC_ICP_DES_CRNK_BOOST 0 0 0 0 ECU_ADDRESS 0x3FAA34 /end MEASUREMENT
/begin COMPU_METHOD MC_ICP_DES_CRNK_BOOST "ICP_DES_CRNK_BOOST conversion" RAT_FUNC "%10.5" "Unitless" COEFFS 0 1 0 0 0 1 /end COMPU_METHOD
/begin CHARACTERISTIC ICP_DES_LMN "" VALUE 0x5E024 SD_FLOAT32_IEEE 0 SC_ICP_DES_LMN -100000 100000 /end CHARACTERISTIC
/begin COMPU_METHOD SC_ICP_DES_LMN "ICP_DES_LMN conversion" RAT_FUNC "%10.5" "unitless" COEFFS 0 1 0 0 0 1 /end COMPU_METHOD
/begin MEASUREMENT ICP_DES_LMT_LO "" FLOAT32_IEEE MC_ICP_DES_LMT_LO 0 0 0 0 ECU_ADDRESS 0x3FAA30 /end MEASUREMENT
/begin COMPU_METHOD MC_ICP_DES_LMT_LO "ICP_DES_LMT_LO conversion" RAT_FUNC "%10.5" "Unitless" COEFFS 0 1 0 0 0 1 /end COMPU_METHOD
/begin CHARACTERISTIC ICP_DES_LMX "Maximum limit for desired ICP (MPa)" VALUE 0x5E020 SD_FLOAT32_IEEE 0 SC_ICP_DES_LMX 0 35 /end CHARACTERISTIC
/begin COMPU_METHOD SC_ICP_DES_LMX "ICP_DES_LMX conversion" RAT_FUNC "%10.5" "MPa" COEFFS 0 1 0 0 0 1 /end COMPU_METHOD
/begin MEASUREMENT ICP_DES_OFST "Offset to ICP_DES based on viscosity (MPa)" FLOAT32_IEEE MC_ICP_DES_OFST 0 0 0 0 ECU_ADDRESS 0x3FAA2C /end MEASUREMENT
/begin COMPU_METHOD MC_ICP_DES_OFST "ICP_DES_OFST conversion" RAT_FUNC "%10.5" "Unitless" COEFFS 0 1 0 0 0 1 /end COMPU_METHOD
/begin MEASUREMENT ICP_DES_RAW "Desired Injection Control Pressure (in MPa)" FLOAT32_IEEE MC_ICP_DES_RAW 0 0 0 0 ECU_ADDRESS 0x3FAA28 /end MEASUREMENT
/begin COMPU_METHOD MC_ICP_DES_RAW "ICP_DES_RAW conversion" RAT_FUNC "%10.5" "Unitless" COEFFS 0 1 0 0 0 1 /end COMPU_METHOD
/begin CHARACTERISTIC ICP_DES_ROC "" VALUE 0x5E01C SD_FLOAT32_IEEE 0 SC_ICP_DES_ROC -100000 100000 /end CHARACTERISTIC
/begin COMPU_METHOD SC_ICP_DES_ROC "ICP_DES_ROC conversion" RAT_FUNC "%10.5" "unitless" COEFFS 0 1 0 0 0 1 /end COMPU_METHOD
/begin MEASUREMENT ICP_DES_TBL "Output of table FN1300P" FLOAT32_IEEE MC_ICP_DES_TBL 0 0 0 0 ECU_ADDRESS 0x3FAA24 /end MEASUREMENT
/begin COMPU_METHOD MC_ICP_DES_TBL "ICP_DES_TBL conversion" RAT_FUNC "%10.5" "Unitless" COEFFS 0 1 0 0 0 1 /end COMPU_METHOD
/begin MEASUREMENT ICP_DES_TBLP "Output of table FN1300P" FLOAT32_IEEE MC_ICP_DES_TBLP 0 0 0 0 ECU_ADDRESS 0x3FAA20 /end MEASUREMENT
/begin COMPU_METHOD MC_ICP_DES_TBLP "ICP_DES_TBLP conversion" RAT_FUNC "%10.5" "Unitless" COEFFS 0 1 0 0 0 1 /end COMPU_METHOD
/begin CHARACTERISTIC ICP_DES_TC "" VALUE 0x5E018 SD_FLOAT32_IEEE 0 SC_ICP_DES_TC 0 64 /end CHARACTERISTIC
/begin COMPU_METHOD SC_ICP_DES_TC "ICP_DES_TC conversion" RAT_FUNC "%10.5" "unitless" COEFFS 0 1 0 0 0 1 /end COMPU_METHOD
/begin MEASUREMENT ICP_DRV_ADD "Output Shaft Speed based ICP adder" FLOAT32_IEEE MC_ICP_DRV_ADD 0 0 0 0 ECU_ADDRESS 0x3FAA1C /end MEASUREMENT
/begin COMPU_METHOD MC_ICP_DRV_ADD "ICP_DRV_ADD conversion" RAT_FUNC "%10.5" "Unitless" COEFFS 0 1 0 0 0 1 /end COMPU_METHOD
/begin MEASUREMENT ICP_DRV_ADD_P "Output Shaft Speed based ICP adder - Pilot mode" FLOAT32_IEEE MC_ICP_DRV_ADD_P 0 0 0 0 ECU_ADDRESS 0x3FAA18 /end MEASUREMENT
/begin COMPU_METHOD MC_ICP_DRV_ADD_P "ICP_DRV_ADD_P conversion" RAT_FUNC "%10.5" "Unitless" COEFFS 0 1 0 0 0 1 /end COMPU_METHOD
/begin MEASUREMENT ICP_DTY "ICP valve duty cycle" FLOAT32_IEEE MC_ICP_DTY 0 0 0 0 ECU_ADDRESS 0x3FAA14 /end MEASUREMENT
/begin COMPU_METHOD MC_ICP_DTY "ICP_DTY conversion" RAT_FUNC "%10.5" "Unitless" COEFFS 0 1 0 0 0 1 /end COMPU_METHOD
/begin CHARACTERISTIC ICP_DTY_CAL "ICP valve duty cycle calibration constant" VALUE 0x5E014 SD_FLOAT32_IEEE 0 SC_ICP_DTY_CAL 0 0.999 /end CHARACTERISTIC
/begin COMPU_METHOD SC_ICP_DTY_CAL "ICP_DTY_CAL conversion" RAT_FUNC "%10.5" "unitless" COEFFS 0 1 0 0 0 1 /end COMPU_METHOD
/begin CHARACTERISTIC ICP_DTY_LMN "ICP valve duty cycle minimum limit" VALUE 0x5E010 SD_FLOAT32_IEEE 0 SC_ICP_DTY_LMN 0 0.999 /end CHARACTERISTIC
/begin COMPU_METHOD SC_ICP_DTY_LMN "ICP_DTY_LMN conversion" RAT_FUNC "%10.5" "unitless" COEFFS 0 1 0 0 0 1 /end COMPU_METHOD
/begin CHARACTERISTIC ICP_DTY_LMX "ICP valve duty cycle maximum limit" VALUE 0x5E00C SD_FLOAT32_IEEE 0 SC_ICP_DTY_LMX 0 0.999 /end CHARACTERISTIC
/begin COMPU_METHOD SC_ICP_DTY_LMX "ICP_DTY_LMX conversion" RAT_FUNC "%10.5" "unitless" COEFFS 0 1 0 0 0 1 /end COMPU_METHOD
/begin CHARACTERISTIC ICP_DTY_NST "ICP valve duty cycle during NO_START mode" VALUE 0x5E008 SD_FLOAT32_IEEE 0 SC_ICP_DTY_NST 0 0.5 /end CHARACTERISTIC
/begin COMPU_METHOD SC_ICP_DTY_NST "ICP_DTY_NST conversion" RAT_FUNC "%10.5" "unitless" COEFFS 0 1 0 0 0 1 /end COMPU_METHOD
/begin MEASUREMENT ICP_DTY_RAW "" FLOAT32_IEEE MC_ICP_DTY_RAW 0 0 0 0 ECU_ADDRESS 0x3FAA10 /end MEASUREMENT
/begin COMPU_METHOD MC_ICP_DTY_RAW "ICP_DTY_RAW conversion" RAT_FUNC "%10.5" "Unitless" COEFFS 0 1 0 0 0 1 /end COMPU_METHOD
/begin MEASUREMENT ICP_ENG "injection control pressure , MPA" FLOAT32_IEEE MC_ICP_ENG 0 0 0 0 ECU_ADDRESS 0x3F9928 /end MEASUREMENT
/begin COMPU_METHOD MC_ICP_ENG "ICP_ENG conversion" RAT_FUNC "%10.5" "Unitless" COEFFS 0 1 0 0 0 1 /end COMPU_METHOD
/begin MEASUREMENT ICP_ERR "Injection control pressure error (MPa)" FLOAT32_IEEE MC_ICP_ERR 0 0 0 0 ECU_ADDRESS 0x3FAA0C /end MEASUREMENT
/begin COMPU_METHOD MC_ICP_ERR "ICP_ERR conversion" RAT_FUNC "%10.5" "Unitless" COEFFS 0 1 0 0 0 1 /end COMPU_METHOD
/begin CHARACTERISTIC ICP_ERR_LMN "Minimum limit for ICP error (MPa)" VALUE 0x5E004 SD_FLOAT32_IEEE 0 SC_ICP_ERR_LMN -20 0 /end CHARACTERISTIC
/begin COMPU_METHOD SC_ICP_ERR_LMN "ICP_ERR_LMN conversion" RAT_FUNC "%10.5" "MPa" COEFFS 0 1 0 0 0 1 /end COMPU_METHOD
/begin CHARACTERISTIC ICP_ERR_LMX "Maximum limit for ICP error (MPa)" VALUE 0x5E000 SD_FLOAT32_IEEE 0 SC_ICP_ERR_LMX 0 20 /end CHARACTERISTIC
/begin COMPU_METHOD SC_ICP_ERR_LMX "ICP_ERR_LMX conversion" RAT_FUNC "%10.5" "MPa" COEFFS 0 1 0 0 0 1 /end COMPU_METHOD
/begin MEASUREMENT ICP_FF_DTY "Feed forward term of ICP duty cycle" FLOAT32_IEEE MC_ICP_FF_DTY 0 0 0 0 ECU_ADDRESS 0x3FAA08 /end MEASUREMENT
/begin COMPU_METHOD MC_ICP_FF_DTY "ICP_FF_DTY conversion" RAT_FUNC "%10.5" "Unitless" COEFFS 0 1 0 0 0 1 /end COMPU_METHOD
/begin MEASUREMENT ICP_FILT "filtered icp value" FLOAT32_IEEE MC_ICP_FILT 0 0 0 0 ECU_ADDRESS 0x3FCD3C /end MEASUREMENT
/begin COMPU_METHOD MC_ICP_FILT "ICP_FILT conversion" RAT_FUNC "%10.5" "Unitless" COEFFS 0 1 0 0 0 1 /end COMPU_METHOD
/begin MEASUREMENT ICP_FILT_TIME_CONST "icp filter time constant" FLOAT32_IEEE MC_ICP_FILT_TIME_CONST 0 0 0 0 ECU_ADDRESS 0x3FA0D8 /end MEASUREMENT
/begin COMPU_METHOD MC_ICP_FILT_TIME_CONST "ICP_FILT_TIME_CONST conversion" RAT_FUNC "%10.5" "Unitless" COEFFS 0 1 0 0 0 1 /end COMPU_METHOD
/begin MEASUREMENT ICP_FLT_RECOVERY_CNTR "icp fault recover counter" SLONG MC_ICP_FLT_RECOVERY_CNTR 0 0 0 0 ECU_ADDRESS 0x3FA0C4 /end MEASUREMENT
/begin COMPU_METHOD MC_ICP_FLT_RECOVERY_CNTR "ICP_FLT_RECOVERY_CNTR conversion" RAT_FUNC "%10.0" "Unitless" COEFFS 0 1 0 0 0 1 /end COMPU_METHOD
/begin MEASUREMENT ICP_FLT_RECOVERY_FLG "icp fault recovery flag" UBYTE MC_ICP_FLT_RECOVERY_FLG 0 0 0 0 ECU_ADDRESS 0x3FA0F1 /end MEASUREMENT
/begin COMPU_METHOD MC_ICP_FLT_RECOVERY_FLG "ICP_FLT_RECOVERY_FLG conversion" RAT_FUNC "%3.0" "Unitless" COEFFS 0 1 0 0 0 1 /end COMPU_METHOD
/begin CHARACTERISTIC ICP_F_DEC "ICP ORH/ORL failure counter decrement value" VALUE 0x5D21C SD_SLONG 0 SC_ICP_F_DEC 0 65535 /end CHARACTERISTIC
/begin COMPU_METHOD SC_ICP_F_DEC "ICP_F_DEC conversion" RAT_FUNC "%10.0" "unitless" COEFFS 0 1 0 0 0 1 /end COMPU_METHOD
/begin CHARACTERISTIC ICP_F_INC "ICP ORH/ORL failure counter increment value" VALUE 0x5D220 SD_SLONG 0 SC_ICP_F_INC 0 65535 /end CHARACTERISTIC
/begin COMPU_METHOD SC_ICP_F_INC "ICP_F_INC conversion" RAT_FUNC "%10.0" "unitless" COEFFS 0 1 0 0 0 1 /end COMPU_METHOD
/begin CHARACTERISTIC ICP_HI_VOLTS "Maximum acceptable voltage for icp (engine fuel pressure) sensor" VALUE 0x5C5EC SD_FLOAT32_IEEE 0 SC_ICP_HI_VOLTS 0 5 /end CHARACTERISTIC
/begin COMPU_METHOD SC_ICP_HI_VOLTS "ICP_HI_VOLTS conversion" RAT_FUNC "%10.5" "V" COEFFS 0 1 0 0 0 1 /end COMPU_METHOD
/begin CHARACTERISTIC ICP_IVPWR_MIN "" VALUE 0x5C5E0 SD_FLOAT32_IEEE 0 SC_ICP_IVPWR_MIN 0 30 /end CHARACTERISTIC
/begin COMPU_METHOD SC_ICP_IVPWR_MIN "ICP_IVPWR_MIN conversion" RAT_FUNC "%10.5" "V" COEFFS 0 1 0 0 0 1 /end COMPU_METHOD
/begin MEASUREMENT ICP_I_DTY "Integral term of ICP duty cycle" FLOAT32_IEEE MC_ICP_I_DTY 0 0 0 0 ECU_ADDRESS 0x3FAA04 /end MEASUREMENT
/begin COMPU_METHOD MC_ICP_I_DTY "ICP_I_DTY conversion" RAT_FUNC "%10.5" "Unitless" COEFFS 0 1 0 0 0 1 /end COMPU_METHOD
/begin MEASUREMENT ICP_KI_EOT "EOT-based ICP Integral term" FLOAT32_IEEE MC_ICP_KI_EOT 0 0 0 0 ECU_ADDRESS 0x3FAA00 /end MEASUREMENT
/begin COMPU_METHOD MC_ICP_KI_EOT "ICP_KI_EOT conversion" RAT_FUNC "%10.5" "Unitless" COEFFS 0 1 0 0 0 1 /end COMPU_METHOD
/begin MEASUREMENT ICP_KP_EOT "EOT-based ICP Proportional term" FLOAT32_IEEE MC_ICP_KP_EOT 0 0 0 0 ECU_ADDRESS 0x3FA9FC /end MEASUREMENT
/begin COMPU_METHOD MC_ICP_KP_EOT "ICP_KP_EOT conversion" RAT_FUNC "%10.5" "Unitless" COEFFS 0 1 0 0 0 1 /end COMPU_METHOD
/begin CHARACTERISTIC ICP_LO_VOLTS "Minimum acceptable voltage for icp (engine fuel pressure) sensor" VALUE 0x5C5F0 SD_FLOAT32_IEEE 0 SC_ICP_LO_VOLTS 0 5 /end CHARACTERISTIC
/begin COMPU_METHOD SC_ICP_LO_VOLTS "ICP_LO_VOLTS conversion" RAT_FUNC "%10.5" "V" COEFFS 0 1 0 0 0 1 /end COMPU_METHOD
/begin MEASUREMENT ICP_MALF_SET "indicates icp malf high or low failure" UBYTE MC_ICP_MALF_SET 0 0 0 0 ECU_ADDRESS 0x3FA0F3 /end MEASUREMENT
/begin COMPU_METHOD MC_ICP_MALF_SET "ICP_MALF_SET conversion" RAT_FUNC "%3.0" "Unitless" COEFFS 0 1 0 0 0 1 /end COMPU_METHOD
/begin MEASUREMENT ICP_MFDES_FILT "" FLOAT32_IEEE MC_ICP_MFDES_FILT 0 0 0 0 ECU_ADDRESS 0x3FA9EC /end MEASUREMENT
/begin COMPU_METHOD MC_ICP_MFDES_FILT "ICP_MFDES_FILT conversion" RAT_FUNC "%10.5" "Unitless" COEFFS 0 1 0 0 0 1 /end COMPU_METHOD
/begin CHARACTERISTIC ICP_MFDSHLMN "Minimum clip for ICP_DASH (MPa)" VALUE 0x5DFF8 SD_FLOAT32_IEEE 0 SC_ICP_MFDSHLMN -21 21 /end CHARACTERISTIC
/begin COMPU_METHOD SC_ICP_MFDSHLMN "ICP_MFDSHLMN conversion" RAT_FUNC "%10.5" "MPa" COEFFS 0 1 0 0 0 1 /end COMPU_METHOD
/begin CHARACTERISTIC ICP_MFDSHLMX "Maximum clip for ICP_DASH (MPa)" VALUE 0x5DFF4 SD_FLOAT32_IEEE 0 SC_ICP_MFDSHLMX -21 21 /end CHARACTERISTIC
/begin COMPU_METHOD SC_ICP_MFDSHLMX "ICP_MFDSHLMX conversion" RAT_FUNC "%10.5" "MPa" COEFFS 0 1 0 0 0 1 /end COMPU_METHOD
/begin MEASUREMENT ICP_MFD_MULT "" FLOAT32_IEEE MC_ICP_MFD_MULT 0 0 0 0 ECU_ADDRESS 0x3FA9F0 /end MEASUREMENT
/begin COMPU_METHOD MC_ICP_MFD_MULT "ICP_MFD_MULT conversion" RAT_FUNC "%10.5" "Unitless" COEFFS 0 1 0 0 0 1 /end COMPU_METHOD
/begin MEASUREMENT ICP_MF_DIFF_FILT "" FLOAT32_IEEE MC_ICP_MF_DIFF_FILT 0 0 0 0 ECU_ADDRESS 0x3FA9F8 /end MEASUREMENT
/begin COMPU_METHOD MC_ICP_MF_DIFF_FILT "ICP_MF_DIFF_FILT conversion" RAT_FUNC "%10.5" "Unitless" COEFFS 0 1 0 0 0 1 /end COMPU_METHOD
/begin MEASUREMENT ICP_MF_KDSH "Resultant multiplier from table FN1401" FLOAT32_IEEE MC_ICP_MF_KDSH 0 0 0 0 ECU_ADDRESS 0x3FA9F4 /end MEASUREMENT
/begin COMPU_METHOD MC_ICP_MF_KDSH "ICP_MF_KDSH conversion" RAT_FUNC "%10.5" "Unitless" COEFFS 0 1 0 0 0 1 /end COMPU_METHOD
/begin CHARACTERISTIC ICP_MIN "Minimum Injection Control Pressure (MPa)" VALUE 0x5DFE0 SD_FLOAT32_IEEE 0 SC_ICP_MIN 0 5 /end CHARACTERISTIC
/begin COMPU_METHOD SC_ICP_MIN "ICP_MIN conversion" RAT_FUNC "%10.5" "MPa" COEFFS 0 1 0 0 0 1 /end COMPU_METHOD
/begin MEASUREMENT ICP_MPA "Injection Control Pressure (in MPa)" FLOAT32_IEEE MC_ICP_MPA 0 0 0 0 ECU_ADDRESS 0x3FA0E0 /end MEASUREMENT
/begin COMPU_METHOD MC_ICP_MPA "ICP_MPA conversion" RAT_FUNC "%10.5" "Unitless" COEFFS 0 1 0 0 0 1 /end COMPU_METHOD
/begin CHARACTERISTIC ICP_NST_EO_MAX "ICP no-startfault max value constant  at a specific engine off time." VALUE 0x5D1A0 SD_FLOAT32_IEEE 0 SC_ICP_NST_EO_MAX 0 255 /end CHARACTERISTIC
/begin COMPU_METHOD SC_ICP_NST_EO_MAX "ICP_NST_EO_MAX conversion" RAT_FUNC "%10.5" "MPa" COEFFS 0 1 0 0 0 1 /end COMPU_METHOD
/begin CHARACTERISTIC ICP_NST_EO_TMR "Stored elapsed time of the most recent EEC module key-off powered-down period limit ." VALUE 0x5D19C SD_FLOAT32_IEEE 0 SC_ICP_NST_EO_TMR 0 1680 /end CHARACTERISTIC
/begin COMPU_METHOD SC_ICP_NST_EO_TMR "ICP_NST_EO_TMR conversion" RAT_FUNC "%10.5" "MINUTES" COEFFS 0 1 0 0 0 1 /end COMPU_METHOD
/begin CHARACTERISTIC ICP_NST_MAX "ICP no-startfault max value constant" VALUE 0x5D1EC SD_FLOAT32_IEEE 0 SC_ICP_NST_MAX 0 255 /end CHARACTERISTIC
/begin COMPU_METHOD SC_ICP_NST_MAX "ICP_NST_MAX conversion" RAT_FUNC "%10.5" "MPa" COEFFS 0 1 0 0 0 1 /end COMPU_METHOD
/begin CHARACTERISTIC ICP_NST_TM "p1210 malfunction timer limit" VALUE 0x5D1E8 SD_FLOAT32_IEEE 0 SC_ICP_NST_TM 0 50000 /end CHARACTERISTIC
/begin COMPU_METHOD SC_ICP_NST_TM "ICP_NST_TM conversion" RAT_FUNC "%10.5" "unitless" COEFFS 0 1 0 0 0 1 /end COMPU_METHOD
/begin MEASUREMENT ICP_NST_TMR "In range ICP no-start fault malfunction timer counter" FLOAT32_IEEE MC_ICP_NST_TMR 0 0 0 0 ECU_ADDRESS 0x3FA0B8 /end MEASUREMENT
/begin COMPU_METHOD MC_ICP_NST_TMR "ICP_NST_TMR conversion" RAT_FUNC "%10.5" "Unitless" COEFFS 0 1 0 0 0 1 /end COMPU_METHOD
/begin MEASUREMENT ICP_NSU_TMR "In range ICP no-start fault update timer counter" FLOAT32_IEEE MC_ICP_NSU_TMR 0 0 0 0 ECU_ADDRESS 0x3FA0B4 /end MEASUREMENT
/begin COMPU_METHOD MC_ICP_NSU_TMR "ICP_NSU_TMR conversion" RAT_FUNC "%10.5" "Unitless" COEFFS 0 1 0 0 0 1 /end COMPU_METHOD
/begin CHARACTERISTIC ICP_OFST "" VALUE 0x5DFF0 SD_FLOAT32_IEEE 0 SC_ICP_OFST 0 255 /end CHARACTERISTIC
/begin COMPU_METHOD SC_ICP_OFST "ICP_OFST conversion" RAT_FUNC "%10.5" "unitless" COEFFS 0 1 0 0 0 1 /end COMPU_METHOD
/begin MEASUREMENT ICP_OL_ENT_FLG "ICP open loop entry flag" UBYTE MC_ICP_OL_ENT_FLG 0 0 0 0 ECU_ADDRESS 0x3FA0EC /end MEASUREMENT
/begin COMPU_METHOD MC_ICP_OL_ENT_FLG "ICP_OL_ENT_FLG conversion" RAT_FUNC "%3.0" "Unitless" COEFFS 0 1 0 0 0 1 /end COMPU_METHOD
/begin MEASUREMENT ICP_ORH_CNTR "Injection Control Pressure out of range high counter" SLONG MC_ICP_ORH_CNTR 0 0 0 0 ECU_ADDRESS 0x3FA0D4 /end MEASUREMENT
/begin COMPU_METHOD MC_ICP_ORH_CNTR "ICP_ORH_CNTR conversion" RAT_FUNC "%10.0" "Unitless" COEFFS 0 1 0 0 0 1 /end COMPU_METHOD
/begin MEASUREMENT ICP_ORL_CNTR "Injection Control Pressure out of range low counter" SLONG MC_ICP_ORL_CNTR 0 0 0 0 ECU_ADDRESS 0x3FA0D0 /end MEASUREMENT
/begin COMPU_METHOD MC_ICP_ORL_CNTR "ICP_ORL_CNTR conversion" RAT_FUNC "%10.0" "Unitless" COEFFS 0 1 0 0 0 1 /end COMPU_METHOD
/begin CHARACTERISTIC ICP_OSC_CHANNEL "" VALUE 0x5E051 SD_UBYTE 0 SC_ICP_OSC_CHANNEL 0 255 /end CHARACTERISTIC
/begin COMPU_METHOD SC_ICP_OSC_CHANNEL "ICP_OSC_CHANNEL conversion" RAT_FUNC "%3.0" "unitless" COEFFS 0 1 0 0 0 1 /end COMPU_METHOD
/begin MEASUREMENT ICP_PRE_BUFFER[0] "" FLOAT32_IEEE MC_ICP_PRE_BUFFER 0 0 0 0 ECU_ADDRESS 0x3FB8D8 /end MEASUREMENT
/begin COMPU_METHOD MC_ICP_PRE_BUFFER "ICP_PRE_BUFFER conversion" RAT_FUNC "%10.5" "V" COEFFS 0 1 0 0 0 1 /end COMPU_METHOD
/begin MEASUREMENT ICP_PRE_BUFFER[1] "" FLOAT32_IEEE MC_ICP_PRE_BUFFER 0 0 0 0 ECU_ADDRESS 0x3FB8DC /end MEASUREMENT
/begin MEASUREMENT ICP_PRE_BUFFER[2] "" FLOAT32_IEEE MC_ICP_PRE_BUFFER 0 0 0 0 ECU_ADDRESS 0x3FB8E0 /end MEASUREMENT
/begin MEASUREMENT ICP_PRE_BUFFER[3] "" FLOAT32_IEEE MC_ICP_PRE_BUFFER 0 0 0 0 ECU_ADDRESS 0x3FB8E4 /end MEASUREMENT
/begin MEASUREMENT ICP_PRE_BUFFER[4] "" FLOAT32_IEEE MC_ICP_PRE_BUFFER 0 0 0 0 ECU_ADDRESS 0x3FB8E8 /end MEASUREMENT
/begin MEASUREMENT ICP_PRE_BUFFER[5] "" FLOAT32_IEEE MC_ICP_PRE_BUFFER 0 0 0 0 ECU_ADDRESS 0x3FB8EC /end MEASUREMENT
/begin CHARACTERISTIC ICP_PRE_INDEX "" VALUE 0x5C5F4 SD_UBYTE 0 SC_ICP_PRE_INDEX 0 5 /end CHARACTERISTIC
/begin COMPU_METHOD SC_ICP_PRE_INDEX "ICP_PRE_INDEX conversion" RAT_FUNC "%3.0" "unitless" COEFFS 0 1 0 0 0 1 /end COMPU_METHOD
/begin MEASUREMENT ICP_P_DTY "Proportional term of ICP duty cycle" FLOAT32_IEEE MC_ICP_P_DTY 0 0 0 0 ECU_ADDRESS 0x3FA9E8 /end MEASUREMENT
/begin COMPU_METHOD MC_ICP_P_DTY "ICP_P_DTY conversion" RAT_FUNC "%10.5" "Unitless" COEFFS 0 1 0 0 0 1 /end COMPU_METHOD
/begin CHARACTERISTIC ICP_REC_INC "ICP recovery counter increment value" VALUE 0x5D1FC SD_SLONG 0 SC_ICP_REC_INC 0 65535 /end CHARACTERISTIC
/begin COMPU_METHOD SC_ICP_REC_INC "ICP_REC_INC conversion" RAT_FUNC "%10.0" "unitless" COEFFS 0 1 0 0 0 1 /end COMPU_METHOD
/begin MEASUREMENT ICP_ROC_AD_TC "Injection control pressure rate of change filter time constant" FLOAT32_IEEE MC_ICP_ROC_AD_TC 0 0 0 0 ECU_ADDRESS 0x3FA080 /end MEASUREMENT
/begin COMPU_METHOD MC_ICP_ROC_AD_TC "ICP_ROC_AD_TC conversion" RAT_FUNC "%10.5" "Unitless" COEFFS 0 1 0 0 0 1 /end COMPU_METHOD
/begin CHARACTERISTIC ICP_RUN_LMN "injection control pressure , MPA limit when mode  = 0, under loss of crank signal" VALUE 0x5C888 SD_FLOAT32_IEEE 0 SC_ICP_RUN_LMN 0 40 /end CHARACTERISTIC
/begin COMPU_METHOD SC_ICP_RUN_LMN "ICP_RUN_LMN conversion" RAT_FUNC "%10.5" "MPa" COEFFS 0 1 0 0 0 1 /end COMPU_METHOD
/begin CHARACTERISTIC ICP_SEL "ICP control mode selection" VALUE 0x5E050 SD_UBYTE 0 SC_ICP_SEL 0 4 /end CHARACTERISTIC
/begin COMPU_METHOD SC_ICP_SEL "ICP_SEL conversion" RAT_FUNC "%3.0" "unitless" COEFFS 0 1 0 0 0 1 /end COMPU_METHOD
/begin MEASUREMENT ICP_SLIDE_BAR "I/O control slide bar value" FLOAT32_IEEE MC_ICP_SLIDE_BAR 0 0 0 0 ECU_ADDRESS 0x3FAA4C /end MEASUREMENT
/begin COMPU_METHOD MC_ICP_SLIDE_BAR "ICP_SLIDE_BAR conversion" RAT_FUNC "%10.5" "Unitless" COEFFS 0 1 0 0 0 1 /end COMPU_METHOD
/begin MEASUREMENT ICP_STATUS "Status of icp (engine fuel pressure ) sensor, 0 = no error" UBYTE MC_ICP_STATUS 0 0 0 0 ECU_ADDRESS 0x3F992C /end MEASUREMENT
/begin COMPU_METHOD MC_ICP_STATUS "ICP_STATUS conversion" RAT_FUNC "%3.0" "Unitless" COEFFS 0 1 0 0 0 1 /end COMPU_METHOD
/begin CHARACTERISTIC ICP_TCREC_SEL "switch to select ICP filter time constant" VALUE 0x5D200 SD_UBYTE 0 SC_ICP_TCREC_SEL 0 1 /end CHARACTERISTIC
/begin COMPU_METHOD SC_ICP_TCREC_SEL "ICP_TCREC_SEL conversion" RAT_FUNC "%3.0" "unitless" COEFFS 0 1 0 0 0 1 /end COMPU_METHOD
/begin MEASUREMENT ICP_VOLTAGE "ICP sensor voltage seen at A to D input channel" FLOAT32_IEEE MC_ICP_VOLTAGE 0 0 0 0 ECU_ADDRESS 0x3F9924 /end MEASUREMENT
/begin COMPU_METHOD MC_ICP_VOLTAGE "ICP_VOLTAGE conversion" RAT_FUNC "%10.5" "Unitless" COEFFS 0 1 0 0 0 1 /end COMPU_METHOD
/begin CHARACTERISTIC ICP_VOLTCORR_ENABLE "Icp voltage correction enable switch 1 = enable 0 = disable" VALUE 0x5C5F5 SD_UBYTE 0 SC_ICP_VOLTCORR_ENABLE 0 1 /end CHARACTERISTIC
/begin COMPU_METHOD SC_ICP_VOLTCORR_ENABLE "ICP_VOLTCORR_ENABLE conversion" RAT_FUNC "%3.0" "unitless" COEFFS 0 1 0 0 0 1 /end COMPU_METHOD
/begin MEASUREMENT ICP_VOLTS_CORR "" FLOAT32_IEEE MC_ICP_VOLTS_CORR 0 0 0 0 ECU_ADDRESS 0x3F9910 /end MEASUREMENT
/begin COMPU_METHOD MC_ICP_VOLTS_CORR "ICP_VOLTS_CORR conversion" RAT_FUNC "%10.5" "Unitless" COEFFS 0 1 0 0 0 1 /end COMPU_METHOD
/begin MEASUREMENT ICP_XSU_TMR "In range excessive fault update timer counter" FLOAT32_IEEE MC_ICP_XSU_TMR 0 0 0 0 ECU_ADDRESS 0x3FA0BC /end MEASUREMENT
/begin COMPU_METHOD MC_ICP_XSU_TMR "ICP_XSU_TMR conversion" RAT_FUNC "%10.5" "Unitless" COEFFS 0 1 0 0 0 1 /end COMPU_METHOD
/begin CHARACTERISTIC ICP_XS_MAX "ICP excessive fault max valu constant" VALUE 0x5D1F4 SD_FLOAT32_IEEE 0 SC_ICP_XS_MAX 0 255 /end CHARACTERISTIC
/begin COMPU_METHOD SC_ICP_XS_MAX "ICP_XS_MAX conversion" RAT_FUNC "%10.5" "MPa" COEFFS 0 1 0 0 0 1 /end COMPU_METHOD
/begin CHARACTERISTIC ICP_XS_TM "p1282 malf timer limit" VALUE 0x5D1F0 SD_FLOAT32_IEEE 0 SC_ICP_XS_TM 0 50000 /end CHARACTERISTIC
/begin COMPU_METHOD SC_ICP_XS_TM "ICP_XS_TM conversion" RAT_FUNC "%10.5" "unitless" COEFFS 0 1 0 0 0 1 /end COMPU_METHOD
/begin MEASUREMENT ICP_XS_TMR "In range ICP excessive fault malf timer counter" FLOAT32_IEEE MC_ICP_XS_TMR 0 0 0 0 ECU_ADDRESS 0x3FA0C0 /end MEASUREMENT
/begin COMPU_METHOD MC_ICP_XS_TMR "ICP_XS_TMR conversion" RAT_FUNC "%10.5" "Unitless" COEFFS 0 1 0 0 0 1 /end COMPU_METHOD
/begin MEASUREMENT IDMCANH_STATUS "" UBYTE MC_IDMCANH_STATUS 0 0 0 0 ECU_ADDRESS 0x3F9CF1 /end MEASUREMENT
/begin COMPU_METHOD MC_IDMCANH_STATUS "IDMCANH_STATUS conversion" RAT_FUNC "%3.0" "Unitless" COEFFS 0 1 0 0 0 1 /end COMPU_METHOD
/begin MEASUREMENT IDMCANL_STATUS "" UBYTE MC_IDMCANL_STATUS 0 0 0 0 ECU_ADDRESS 0x3F9CF0 /end MEASUREMENT
/begin COMPU_METHOD MC_IDMCANL_STATUS "IDMCANL_STATUS conversion" RAT_FUNC "%3.0" "Unitless" COEFFS 0 1 0 0 0 1 /end COMPU_METHOD
/begin MEASUREMENT IDMCAN_COMM_DIAG_TMR "Time since last periodic message received(IDM CAN)" FLOAT32_IEEE MC_IDMCAN_COMM_DIAG_TMR 0 0 0 0 ECU_ADDRESS 0x3F993C /end MEASUREMENT
/begin COMPU_METHOD MC_IDMCAN_COMM_DIAG_TMR "IDMCAN_COMM_DIAG_TMR conversion" RAT_FUNC "%10.5" "Unitless" COEFFS 0 1 0 0 0 1 /end COMPU_METHOD
/begin MEASUREMENT IDMCAN_DIAG_CNTR "IDM CAN Communication diagnostic counter" SLONG MC_IDMCAN_DIAG_CNTR 0 0 0 0 ECU_ADDRESS 0x3FA450 /end MEASUREMENT
/begin COMPU_METHOD MC_IDMCAN_DIAG_CNTR "IDMCAN_DIAG_CNTR conversion" RAT_FUNC "%10.0" "Unitless" COEFFS 0 1 0 0 0 1 /end COMPU_METHOD
/begin CHARACTERISTIC IDMCAN_F_DEC "IDM CAN Communication diagnosis counter decrement value" VALUE 0x5D66C SD_SLONG 0 SC_IDMCAN_F_DEC 0 65536 /end CHARACTERISTIC
/begin COMPU_METHOD SC_IDMCAN_F_DEC "IDMCAN_F_DEC conversion" RAT_FUNC "%10.0" "unitless" COEFFS 0 1 0 0 0 1 /end COMPU_METHOD
/begin CHARACTERISTIC IDMCAN_F_INC "IDM CAN Communication diagnosis counter increment value" VALUE 0x5D668 SD_SLONG 0 SC_IDMCAN_F_INC 0 65536 /end CHARACTERISTIC
/begin COMPU_METHOD SC_IDMCAN_F_INC "IDMCAN_F_INC conversion" RAT_FUNC "%10.0" "unitless" COEFFS 0 1 0 0 0 1 /end COMPU_METHOD
/begin CHARACTERISTIC IDMCAN_IDLE_MAX_TM "Maximum time to wait for periodic message before setting communication error(IDM CAN)" VALUE 0x5C684 SD_FLOAT32_IEEE 0 SC_IDMCAN_IDLE_MAX_TM 0 65535 /end CHARACTERISTIC
/begin COMPU_METHOD SC_IDMCAN_IDLE_MAX_TM "IDMCAN_IDLE_MAX_TM conversion" RAT_FUNC "%10.5" "s" COEFFS 0 1 0 0 0 1 /end COMPU_METHOD
/begin MEASUREMENT IDMCAN_STATUS "Bus off status of the IDM CAN link" UBYTE MC_IDMCAN_STATUS 0 0 0 0 ECU_ADDRESS 0x3F9943 /end MEASUREMENT
/begin COMPU_METHOD MC_IDMCAN_STATUS "IDMCAN_STATUS conversion" RAT_FUNC "%3.0" "Unitless" COEFFS 0 1 0 0 0 1 /end COMPU_METHOD
/begin MEASUREMENT IDM_DC48V "" FLOAT32_IEEE MC_IDM_DC48V 0 0 0 0 ECU_ADDRESS 0x3FB6E0 /end MEASUREMENT
/begin COMPU_METHOD MC_IDM_DC48V "IDM_DC48V conversion" RAT_FUNC "%10.5" "Unitless" COEFFS 0 1 0 0 0 1 /end COMPU_METHOD
/begin CHARACTERISTIC IDM_DEF_TEST_REQ "IDM test request (bits 1-4) and response (bits 5-8)" VALUE 0x5D44D SD_UBYTE 0 SC_IDM_DEF_TEST_REQ 0 255 /end CHARACTERISTIC
/begin COMPU_METHOD SC_IDM_DEF_TEST_REQ "IDM_DEF_TEST_REQ conversion" RAT_FUNC "%3.0" "unitless" COEFFS 0 1 0 0 0 1 /end COMPU_METHOD
/begin MEASUREMENT IDM_F_MEMORY "" UBYTE MC_IDM_F_MEMORY 0 0 0 0 ECU_ADDRESS 0x3FB6D5 /end MEASUREMENT
/begin COMPU_METHOD MC_IDM_F_MEMORY "IDM_F_MEMORY conversion" RAT_FUNC "%3.0" "Unitless" COEFFS 0 1 0 0 0 1 /end COMPU_METHOD
/begin MEASUREMENT IDM_KL15 "" FLOAT32_IEEE MC_IDM_KL15 0 0 0 0 ECU_ADDRESS 0x3FB6D8 /end MEASUREMENT
/begin COMPU_METHOD MC_IDM_KL15 "IDM_KL15 conversion" RAT_FUNC "%10.5" "Unitless" COEFFS 0 1 0 0 0 1 /end COMPU_METHOD
/begin MEASUREMENT IDM_KL87 "" FLOAT32_IEEE MC_IDM_KL87 0 0 0 0 ECU_ADDRESS 0x3FB6DC /end MEASUREMENT
/begin COMPU_METHOD MC_IDM_KL87 "IDM_KL87 conversion" RAT_FUNC "%10.5" "Unitless" COEFFS 0 1 0 0 0 1 /end COMPU_METHOD
/begin MEASUREMENT IDM_MEM_FLG_CNTR "IDM memory fault  - Counter" SLONG MC_IDM_MEM_FLG_CNTR 0 0 0 0 ECU_ADDRESS 0x3FA43C /end MEASUREMENT
/begin COMPU_METHOD MC_IDM_MEM_FLG_CNTR "IDM_MEM_FLG_CNTR conversion" RAT_FUNC "%10.0" "Unitless" COEFFS 0 1 0 0 0 1 /end COMPU_METHOD
/begin CHARACTERISTIC IDM_MEM_FLG_DEC "IDM memory  fault, malf failure/update counter decrement value" VALUE 0x5D640 SD_SLONG 0 SC_IDM_MEM_FLG_DEC 0 65535 /end CHARACTERISTIC
/begin COMPU_METHOD SC_IDM_MEM_FLG_DEC "IDM_MEM_FLG_DEC conversion" RAT_FUNC "%10.0" "unitless" COEFFS 0 1 0 0 0 1 /end COMPU_METHOD
/begin CHARACTERISTIC IDM_MEM_FLG_INC "IDM memory  fault, malf failure/update counter increment value" VALUE 0x5D644 SD_SLONG 0 SC_IDM_MEM_FLG_INC 0 65535 /end CHARACTERISTIC
/begin COMPU_METHOD SC_IDM_MEM_FLG_INC "IDM_MEM_FLG_INC conversion" RAT_FUNC "%10.0" "unitless" COEFFS 0 1 0 0 0 1 /end COMPU_METHOD
/begin MEASUREMENT IDM_RESET "" UBYTE MC_IDM_RESET 0 0 0 0 ECU_ADDRESS 0x3FB6B9 /end MEASUREMENT
/begin COMPU_METHOD MC_IDM_RESET "IDM_RESET conversion" RAT_FUNC "%3.0" "Unitless" COEFFS 0 1 0 0 0 1 /end COMPU_METHOD
/begin MEASUREMENT IDM_STATUS "IDM injector test status" UBYTE MC_IDM_STATUS 0 0 0 0 ECU_ADDRESS 0x3F995C /end MEASUREMENT
/begin COMPU_METHOD MC_IDM_STATUS "IDM_STATUS conversion" RAT_FUNC "%3.0" "Unitless" COEFFS 0 1 0 0 0 1 /end COMPU_METHOD
/begin MEASUREMENT IDM_TEST_IN_PROGRESS "IDM Test in Progress" UBYTE MC_IDM_TEST_IN_PROGRESS 0 0 0 0 ECU_ADDRESS 0x3F995B /end MEASUREMENT
/begin COMPU_METHOD MC_IDM_TEST_IN_PROGRESS "IDM_TEST_IN_PROGRESS conversion" RAT_FUNC "%3.0" "Unitless" COEFFS 0 1 0 0 0 1 /end COMPU_METHOD
/begin MEASUREMENT ID_BRAKE_SW "PTEC high level driver input indicating BRAKE ON" UBYTE MC_ID_BRAKE_SW 0 0 0 0 ECU_ADDRESS 0x3F9CBD /end MEASUREMENT
/begin COMPU_METHOD MC_ID_BRAKE_SW "ID_BRAKE_SW conversion" RAT_FUNC "%3.0" "Unitless" COEFFS 0 1 0 0 0 1 /end COMPU_METHOD
/begin MEASUREMENT IEGR "EGR SENSOR INPUT" FLOAT32_IEEE MC_IEGR 0 0 0 0 ECU_ADDRESS 0x3F9C6C /end MEASUREMENT
/begin COMPU_METHOD MC_IEGR "IEGR conversion" RAT_FUNC "%10.5" "Unitless" COEFFS 0 1 0 0 0 1 /end COMPU_METHOD
/begin CHARACTERISTIC IMAP_FK_HI "Inferred MAP filter constant" VALUE 0x5D378 SD_FLOAT32_IEEE 0 SC_IMAP_FK_HI 0 100 /end CHARACTERISTIC
/begin COMPU_METHOD SC_IMAP_FK_HI "IMAP_FK_HI conversion" RAT_FUNC "%10.5" "s" COEFFS 0 1 0 0 0 1 /end COMPU_METHOD
/begin CHARACTERISTIC IMAP_FK_LO "Inferred MAP filter constant" VALUE 0x5D37C SD_FLOAT32_IEEE 0 SC_IMAP_FK_LO 0 100 /end CHARACTERISTIC
/begin COMPU_METHOD SC_IMAP_FK_LO "IMAP_FK_LO conversion" RAT_FUNC "%10.5" "s" COEFFS 0 1 0 0 0 1 /end COMPU_METHOD
/begin MEASUREMENT INCD_CTR_K "Counter used to indicate how many attempts are allowed to enter correct incode, srored in KAM" UBYTE MC_INCD_CTR_K 0 0 0 0 ECU_ADDRESS 0x3FCC90 /end MEASUREMENT
/begin COMPU_METHOD MC_INCD_CTR_K "INCD_CTR_K conversion" RAT_FUNC "%3.0" "Unitless" COEFFS 0 1 0 0 0 1 /end COMPU_METHOD
/begin MEASUREMENT INCODE1 "First byte of incode." UBYTE MC_INCODE1 0 0 0 0 ECU_ADDRESS 0x3F9DEB /end MEASUREMENT
/begin COMPU_METHOD MC_INCODE1 "INCODE1 conversion" RAT_FUNC "%3.0" "Unitless" COEFFS 0 1 0 0 0 1 /end COMPU_METHOD
/begin MEASUREMENT INCODE2 "Second byte of incode." UBYTE MC_INCODE2 0 0 0 0 ECU_ADDRESS 0x3F9DEA /end MEASUREMENT
/begin COMPU_METHOD MC_INCODE2 "INCODE2 conversion" RAT_FUNC "%3.0" "Unitless" COEFFS 0 1 0 0 0 1 /end COMPU_METHOD
/begin CHARACTERISTIC INERTIA_ENG "Engine inertia." VALUE 0x5D8B0 SD_FLOAT32_IEEE 0 SC_INERTIA_ENG 0 1.99 /end CHARACTERISTIC
/begin COMPU_METHOD SC_INERTIA_ENG "INERTIA_ENG conversion" RAT_FUNC "%10.5" "FT-LB/RPM/S" COEFFS 0 1 0 0 0 1 /end COMPU_METHOD
/begin MEASUREMENT INFMP_UF "Unfiltered inferred MAP" FLOAT32_IEEE MC_INFMP_UF 0 0 0 0 ECU_ADDRESS 0x3FA1B0 /end MEASUREMENT
/begin COMPU_METHOD MC_INFMP_UF "INFMP_UF conversion" RAT_FUNC "%10.5" "Unitless" COEFFS 0 1 0 0 0 1 /end COMPU_METHOD
/begin MEASUREMENT INF_MAP_ADJ "Filtered inferred MAP adjusted" FLOAT32_IEEE MC_INF_MAP_ADJ 0 0 0 0 ECU_ADDRESS 0x3FA1A0 /end MEASUREMENT
/begin COMPU_METHOD MC_INF_MAP_ADJ "INF_MAP_ADJ conversion" RAT_FUNC "%10.5" "Unitless" COEFFS 0 1 0 0 0 1 /end COMPU_METHOD
/begin MEASUREMENT INF_MAP_KPA "Filtered low pass inferred MAP in kpa" FLOAT32_IEEE MC_INF_MAP_KPA 0 0 0 0 ECU_ADDRESS 0x3FA1AC /end MEASUREMENT
/begin COMPU_METHOD MC_INF_MAP_KPA "INF_MAP_KPA conversion" RAT_FUNC "%10.5" "Unitless" COEFFS 0 1 0 0 0 1 /end COMPU_METHOD
/begin MEASUREMENT INF_MAT "Inferred MAT" FLOAT32_IEEE MC_INF_MAT 0 0 0 0 ECU_ADDRESS 0x3FA208 /end MEASUREMENT
/begin COMPU_METHOD MC_INF_MAT "INF_MAT conversion" RAT_FUNC "%10.5" "Unitless" COEFFS 0 1 0 0 0 1 /end COMPU_METHOD
/begin CHARACTERISTIC INJ1_CB_F_DEC "Injector 1 cylinder balance  fault decrement count value" VALUE 0x5D7E8 SD_SLONG 0 SC_INJ1_CB_F_DEC 0 65535 /end CHARACTERISTIC
/begin COMPU_METHOD SC_INJ1_CB_F_DEC "INJ1_CB_F_DEC conversion" RAT_FUNC "%10.0" "unitless" COEFFS 0 1 0 0 0 1 /end COMPU_METHOD
/begin CHARACTERISTIC INJ1_CB_F_INC "Injector 1 cylinder balance fault increment count value" VALUE 0x5D808 SD_SLONG 0 SC_INJ1_CB_F_INC 0 65535 /end CHARACTERISTIC
/begin COMPU_METHOD SC_INJ1_CB_F_INC "INJ1_CB_F_INC conversion" RAT_FUNC "%10.0" "unitless" COEFFS 0 1 0 0 0 1 /end COMPU_METHOD
/begin MEASUREMENT INJ1_FAIL_CB_CNTR "Injector 1 cylinder balance fault fail counter" SLONG MC_INJ1_FAIL_CB_CNTR 0 0 0 0 ECU_ADDRESS 0x3FA580 /end MEASUREMENT
/begin COMPU_METHOD MC_INJ1_FAIL_CB_CNTR "INJ1_FAIL_CB_CNTR conversion" RAT_FUNC "%10.0" "Unitless" COEFFS 0 1 0 0 0 1 /end COMPU_METHOD
/begin MEASUREMENT INJ1_FAIL_CB_UPD_CNTR "Injector 1 cylinder balance  fault  update counter" SLONG MC_INJ1_FAIL_CB_UPD_CNTR 0 0 0 0 ECU_ADDRESS 0x3FA560 /end MEASUREMENT
/begin COMPU_METHOD MC_INJ1_FAIL_CB_UPD_CNTR "INJ1_FAIL_CB_UPD_CNTR conversion" RAT_FUNC "%10.0" "Unitless" COEFFS 0 1 0 0 0 1 /end COMPU_METHOD
/begin MEASUREMENT INJ1_FAIL_OPEN_CNTR "Injector 1 coil open fail counter" SLONG MC_INJ1_FAIL_OPEN_CNTR 0 0 0 0 ECU_ADDRESS 0x3FA600 /end MEASUREMENT
/begin COMPU_METHOD MC_INJ1_FAIL_OPEN_CNTR "INJ1_FAIL_OPEN_CNTR conversion" RAT_FUNC "%10.0" "Unitless" COEFFS 0 1 0 0 0 1 /end COMPU_METHOD
/begin MEASUREMENT INJ1_FAIL_OPEN_UPD_CNTR "Injector 1 coil open update counter" SLONG MC_INJ1_FAIL_OPEN_UPD_CNTR 0 0 0 0 ECU_ADDRESS 0x3FA5E0 /end MEASUREMENT
/begin COMPU_METHOD MC_INJ1_FAIL_OPEN_UPD_CNTR "INJ1_FAIL_OPEN_UPD_CNTR conversion" RAT_FUNC "%10.0" "Unitless" COEFFS 0 1 0 0 0 1 /end COMPU_METHOD
/begin MEASUREMENT INJ1_FAIL_S_SS_CNTR "Injector 1 coil  side and side short fail counter" SLONG MC_INJ1_FAIL_S_SS_CNTR 0 0 0 0 ECU_ADDRESS 0x3FA5C0 /end MEASUREMENT
/begin COMPU_METHOD MC_INJ1_FAIL_S_SS_CNTR "INJ1_FAIL_S_SS_CNTR conversion" RAT_FUNC "%10.0" "Unitless" COEFFS 0 1 0 0 0 1 /end COMPU_METHOD
/begin MEASUREMENT INJ1_FAIL_S_SS_UPD_CNTR "Injector 1 coil side and side short fail update counter" SLONG MC_INJ1_FAIL_S_SS_UPD_CNTR 0 0 0 0 ECU_ADDRESS 0x3FA5A0 /end MEASUREMENT
/begin COMPU_METHOD MC_INJ1_FAIL_S_SS_UPD_CNTR "INJ1_FAIL_S_SS_UPD_CNTR conversion" RAT_FUNC "%10.0" "Unitless" COEFFS 0 1 0 0 0 1 /end COMPU_METHOD
/begin CHARACTERISTIC INJ1_OPEN_F_DEC "Injector 1 coil open fault decrement count value" VALUE 0x5D868 SD_SLONG 0 SC_INJ1_OPEN_F_DEC 0 65535 /end CHARACTERISTIC
/begin COMPU_METHOD SC_INJ1_OPEN_F_DEC "INJ1_OPEN_F_DEC conversion" RAT_FUNC "%10.0" "unitless" COEFFS 0 1 0 0 0 1 /end COMPU_METHOD
/begin CHARACTERISTIC INJ1_OPEN_F_INC "Injector 1 coil open fault increment count value" VALUE 0x5D888 SD_SLONG 0 SC_INJ1_OPEN_F_INC 0 65535 /end CHARACTERISTIC
/begin COMPU_METHOD SC_INJ1_OPEN_F_INC "INJ1_OPEN_F_INC conversion" RAT_FUNC "%10.0" "unitless" COEFFS 0 1 0 0 0 1 /end COMPU_METHOD
/begin CHARACTERISTIC INJ1_S_SS_F_DEC "Injector 1 coil short and side short fault decrement value" VALUE 0x5D828 SD_SLONG 0 SC_INJ1_S_SS_F_DEC 0 65535 /end CHARACTERISTIC
/begin COMPU_METHOD SC_INJ1_S_SS_F_DEC "INJ1_S_SS_F_DEC conversion" RAT_FUNC "%10.0" "unitless" COEFFS 0 1 0 0 0 1 /end COMPU_METHOD
/begin CHARACTERISTIC INJ1_S_SS_F_INC "Injector 1 coil short and side short fault increment value" VALUE 0x5D848 SD_SLONG 0 SC_INJ1_S_SS_F_INC 0 65535 /end CHARACTERISTIC
/begin COMPU_METHOD SC_INJ1_S_SS_F_INC "INJ1_S_SS_F_INC conversion" RAT_FUNC "%10.0" "unitless" COEFFS 0 1 0 0 0 1 /end COMPU_METHOD
/begin CHARACTERISTIC INJ2_CB_F_DEC "Injector 2 cylinder balance  fault decrement count value" VALUE 0x5D7E4 SD_SLONG 0 SC_INJ2_CB_F_DEC 0 65535 /end CHARACTERISTIC
/begin COMPU_METHOD SC_INJ2_CB_F_DEC "INJ2_CB_F_DEC conversion" RAT_FUNC "%10.0" "unitless" COEFFS 0 1 0 0 0 1 /end COMPU_METHOD
/begin CHARACTERISTIC INJ2_CB_F_INC "Injector 2 cylinder balance fault increment count value" VALUE 0x5D804 SD_SLONG 0 SC_INJ2_CB_F_INC 0 65535 /end CHARACTERISTIC
/begin COMPU_METHOD SC_INJ2_CB_F_INC "INJ2_CB_F_INC conversion" RAT_FUNC "%10.0" "unitless" COEFFS 0 1 0 0 0 1 /end COMPU_METHOD
/begin MEASUREMENT INJ2_FAIL_CB_CNTR "Injector 2 cylinder balance fault fail counter" SLONG MC_INJ2_FAIL_CB_CNTR 0 0 0 0 ECU_ADDRESS 0x3FA57C /end MEASUREMENT
/begin COMPU_METHOD MC_INJ2_FAIL_CB_CNTR "INJ2_FAIL_CB_CNTR conversion" RAT_FUNC "%10.0" "Unitless" COEFFS 0 1 0 0 0 1 /end COMPU_METHOD
/begin MEASUREMENT INJ2_FAIL_CB_UPD_CNTR "Injector 2 cylinder balance  fault  update counter" SLONG MC_INJ2_FAIL_CB_UPD_CNTR 0 0 0 0 ECU_ADDRESS 0x3FA55C /end MEASUREMENT
/begin COMPU_METHOD MC_INJ2_FAIL_CB_UPD_CNTR "INJ2_FAIL_CB_UPD_CNTR conversion" RAT_FUNC "%10.0" "Unitless" COEFFS 0 1 0 0 0 1 /end COMPU_METHOD
/begin MEASUREMENT INJ2_FAIL_OPEN_CNTR "Injector 2 coil open fail counter" SLONG MC_INJ2_FAIL_OPEN_CNTR 0 0 0 0 ECU_ADDRESS 0x3FA5FC /end MEASUREMENT
/begin COMPU_METHOD MC_INJ2_FAIL_OPEN_CNTR "INJ2_FAIL_OPEN_CNTR conversion" RAT_FUNC "%10.0" "Unitless" COEFFS 0 1 0 0 0 1 /end COMPU_METHOD
/begin MEASUREMENT INJ2_FAIL_OPEN_UPD_CNTR "Injector 2 coil open update counter" SLONG MC_INJ2_FAIL_OPEN_UPD_CNTR 0 0 0 0 ECU_ADDRESS 0x3FA5DC /end MEASUREMENT
/begin COMPU_METHOD MC_INJ2_FAIL_OPEN_UPD_CNTR "INJ2_FAIL_OPEN_UPD_CNTR conversion" RAT_FUNC "%10.0" "Unitless" COEFFS 0 1 0 0 0 1 /end COMPU_METHOD
/begin MEASUREMENT INJ2_FAIL_S_SS_CNTR "Injector 2 coil  side and side short fail counter" SLONG MC_INJ2_FAIL_S_SS_CNTR 0 0 0 0 ECU_ADDRESS 0x3FA5BC /end MEASUREMENT
/begin COMPU_METHOD MC_INJ2_FAIL_S_SS_CNTR "INJ2_FAIL_S_SS_CNTR conversion" RAT_FUNC "%10.0" "Unitless" COEFFS 0 1 0 0 0 1 /end COMPU_METHOD
/begin MEASUREMENT INJ2_FAIL_S_SS_UPD_CNTR "Injector 2 coil side and side short fail update counter" SLONG MC_INJ2_FAIL_S_SS_UPD_CNTR 0 0 0 0 ECU_ADDRESS 0x3FA59C /end MEASUREMENT
/begin COMPU_METHOD MC_INJ2_FAIL_S_SS_UPD_CNTR "INJ2_FAIL_S_SS_UPD_CNTR conversion" RAT_FUNC "%10.0" "Unitless" COEFFS 0 1 0 0 0 1 /end COMPU_METHOD
/begin CHARACTERISTIC INJ2_OPEN_F_DEC "Injector 2 coil open fault decrement count value" VALUE 0x5D864 SD_SLONG 0 SC_INJ2_OPEN_F_DEC 0 65535 /end CHARACTERISTIC
/begin COMPU_METHOD SC_INJ2_OPEN_F_DEC "INJ2_OPEN_F_DEC conversion" RAT_FUNC "%10.0" "unitless" COEFFS 0 1 0 0 0 1 /end COMPU_METHOD
/begin CHARACTERISTIC INJ2_OPEN_F_INC "Injector 2 coil open fault increment count value" VALUE 0x5D884 SD_SLONG 0 SC_INJ2_OPEN_F_INC 0 65535 /end CHARACTERISTIC
/begin COMPU_METHOD SC_INJ2_OPEN_F_INC "INJ2_OPEN_F_INC conversion" RAT_FUNC "%10.0" "unitless" COEFFS 0 1 0 0 0 1 /end COMPU_METHOD
/begin CHARACTERISTIC INJ2_S_SS_F_DEC "Injector 2 coil short and side short fault decrement value" VALUE 0x5D824 SD_SLONG 0 SC_INJ2_S_SS_F_DEC 0 65535 /end CHARACTERISTIC
/begin COMPU_METHOD SC_INJ2_S_SS_F_DEC "INJ2_S_SS_F_DEC conversion" RAT_FUNC "%10.0" "unitless" COEFFS 0 1 0 0 0 1 /end COMPU_METHOD
/begin CHARACTERISTIC INJ2_S_SS_F_INC "Injector 2 coil short and side short fault increment value" VALUE 0x5D844 SD_SLONG 0 SC_INJ2_S_SS_F_INC 0 65535 /end CHARACTERISTIC
/begin COMPU_METHOD SC_INJ2_S_SS_F_INC "INJ2_S_SS_F_INC conversion" RAT_FUNC "%10.0" "unitless" COEFFS 0 1 0 0 0 1 /end COMPU_METHOD
/begin CHARACTERISTIC INJ3_CB_F_DEC "Injector 3 cylinder balance  fault decrement count value" VALUE 0x5D7E0 SD_SLONG 0 SC_INJ3_CB_F_DEC 0 65535 /end CHARACTERISTIC
/begin COMPU_METHOD SC_INJ3_CB_F_DEC "INJ3_CB_F_DEC conversion" RAT_FUNC "%10.0" "unitless" COEFFS 0 1 0 0 0 1 /end COMPU_METHOD
/begin CHARACTERISTIC INJ3_CB_F_INC "Injector 3 cylinder balance fault increment count value" VALUE 0x5D800 SD_SLONG 0 SC_INJ3_CB_F_INC 0 65535 /end CHARACTERISTIC
/begin COMPU_METHOD SC_INJ3_CB_F_INC "INJ3_CB_F_INC conversion" RAT_FUNC "%10.0" "unitless" COEFFS 0 1 0 0 0 1 /end COMPU_METHOD
/begin MEASUREMENT INJ3_FAIL_CB_CNTR "Injector 3 cylinder balance fault fail counter" SLONG MC_INJ3_FAIL_CB_CNTR 0 0 0 0 ECU_ADDRESS 0x3FA578 /end MEASUREMENT
/begin COMPU_METHOD MC_INJ3_FAIL_CB_CNTR "INJ3_FAIL_CB_CNTR conversion" RAT_FUNC "%10.0" "Unitless" COEFFS 0 1 0 0 0 1 /end COMPU_METHOD
/begin MEASUREMENT INJ3_FAIL_CB_UPD_CNTR "Injector 3 cylinder balance  fault  update counter" SLONG MC_INJ3_FAIL_CB_UPD_CNTR 0 0 0 0 ECU_ADDRESS 0x3FA558 /end MEASUREMENT
/begin COMPU_METHOD MC_INJ3_FAIL_CB_UPD_CNTR "INJ3_FAIL_CB_UPD_CNTR conversion" RAT_FUNC "%10.0" "Unitless" COEFFS 0 1 0 0 0 1 /end COMPU_METHOD
/begin MEASUREMENT INJ3_FAIL_OPEN_CNTR "Injector 3 coil open fail counter" SLONG MC_INJ3_FAIL_OPEN_CNTR 0 0 0 0 ECU_ADDRESS 0x3FA5F8 /end MEASUREMENT
/begin COMPU_METHOD MC_INJ3_FAIL_OPEN_CNTR "INJ3_FAIL_OPEN_CNTR conversion" RAT_FUNC "%10.0" "Unitless" COEFFS 0 1 0 0 0 1 /end COMPU_METHOD
/begin MEASUREMENT INJ3_FAIL_OPEN_UPD_CNTR "Injector 3 coil open update counter" SLONG MC_INJ3_FAIL_OPEN_UPD_CNTR 0 0 0 0 ECU_ADDRESS 0x3FA5D8 /end MEASUREMENT
/begin COMPU_METHOD MC_INJ3_FAIL_OPEN_UPD_CNTR "INJ3_FAIL_OPEN_UPD_CNTR conversion" RAT_FUNC "%10.0" "Unitless" COEFFS 0 1 0 0 0 1 /end COMPU_METHOD
/begin MEASUREMENT INJ3_FAIL_S_SS_CNTR "Injector 3 coil  side and side short fail counter" SLONG MC_INJ3_FAIL_S_SS_CNTR 0 0 0 0 ECU_ADDRESS 0x3FA5B8 /end MEASUREMENT
/begin COMPU_METHOD MC_INJ3_FAIL_S_SS_CNTR "INJ3_FAIL_S_SS_CNTR conversion" RAT_FUNC "%10.0" "Unitless" COEFFS 0 1 0 0 0 1 /end COMPU_METHOD
/begin MEASUREMENT INJ3_FAIL_S_SS_UPD_CNTR "Injector 3 coil side and side short fail update counter" SLONG MC_INJ3_FAIL_S_SS_UPD_CNTR 0 0 0 0 ECU_ADDRESS 0x3FA598 /end MEASUREMENT
/begin COMPU_METHOD MC_INJ3_FAIL_S_SS_UPD_CNTR "INJ3_FAIL_S_SS_UPD_CNTR conversion" RAT_FUNC "%10.0" "Unitless" COEFFS 0 1 0 0 0 1 /end COMPU_METHOD
/begin CHARACTERISTIC INJ3_OPEN_F_DEC "Injector 3 coil open fault decrement count value" VALUE 0x5D860 SD_SLONG 0 SC_INJ3_OPEN_F_DEC 0 65535 /end CHARACTERISTIC
/begin COMPU_METHOD SC_INJ3_OPEN_F_DEC "INJ3_OPEN_F_DEC conversion" RAT_FUNC "%10.0" "unitless" COEFFS 0 1 0 0 0 1 /end COMPU_METHOD
/begin CHARACTERISTIC INJ3_OPEN_F_INC "Injector 3 coil open fault increment count value" VALUE 0x5D880 SD_SLONG 0 SC_INJ3_OPEN_F_INC 0 65535 /end CHARACTERISTIC
/begin COMPU_METHOD SC_INJ3_OPEN_F_INC "INJ3_OPEN_F_INC conversion" RAT_FUNC "%10.0" "unitless" COEFFS 0 1 0 0 0 1 /end COMPU_METHOD
/begin CHARACTERISTIC INJ3_S_SS_F_DEC "Injector 3 coil short and side short fault decrement value" VALUE 0x5D820 SD_SLONG 0 SC_INJ3_S_SS_F_DEC 0 65535 /end CHARACTERISTIC
/begin COMPU_METHOD SC_INJ3_S_SS_F_DEC "INJ3_S_SS_F_DEC conversion" RAT_FUNC "%10.0" "unitless" COEFFS 0 1 0 0 0 1 /end COMPU_METHOD
/begin CHARACTERISTIC INJ3_S_SS_F_INC "Injector 3 coil short and side short fault increment value" VALUE 0x5D840 SD_SLONG 0 SC_INJ3_S_SS_F_INC 0 65535 /end CHARACTERISTIC
/begin COMPU_METHOD SC_INJ3_S_SS_F_INC "INJ3_S_SS_F_INC conversion" RAT_FUNC "%10.0" "unitless" COEFFS 0 1 0 0 0 1 /end COMPU_METHOD
/begin CHARACTERISTIC INJ4_CB_F_DEC "Injector 4 cylinder balance  fault decrement count value" VALUE 0x5D7DC SD_SLONG 0 SC_INJ4_CB_F_DEC 0 65535 /end CHARACTERISTIC
/begin COMPU_METHOD SC_INJ4_CB_F_DEC "INJ4_CB_F_DEC conversion" RAT_FUNC "%10.0" "unitless" COEFFS 0 1 0 0 0 1 /end COMPU_METHOD
/begin CHARACTERISTIC INJ4_CB_F_INC "Injector 4 cylinder balance fault increment count value" VALUE 0x5D7FC SD_SLONG 0 SC_INJ4_CB_F_INC 0 65535 /end CHARACTERISTIC
/begin COMPU_METHOD SC_INJ4_CB_F_INC "INJ4_CB_F_INC conversion" RAT_FUNC "%10.0" "unitless" COEFFS 0 1 0 0 0 1 /end COMPU_METHOD
/begin MEASUREMENT INJ4_FAIL_CB_CNTR "Injector 4 cylinder balance fault fail counter" SLONG MC_INJ4_FAIL_CB_CNTR 0 0 0 0 ECU_ADDRESS 0x3FA574 /end MEASUREMENT
/begin COMPU_METHOD MC_INJ4_FAIL_CB_CNTR "INJ4_FAIL_CB_CNTR conversion" RAT_FUNC "%10.0" "Unitless" COEFFS 0 1 0 0 0 1 /end COMPU_METHOD
/begin MEASUREMENT INJ4_FAIL_CB_UPD_CNTR "Injector 4 cylinder balance  fault  update counter" SLONG MC_INJ4_FAIL_CB_UPD_CNTR 0 0 0 0 ECU_ADDRESS 0x3FA554 /end MEASUREMENT
/begin COMPU_METHOD MC_INJ4_FAIL_CB_UPD_CNTR "INJ4_FAIL_CB_UPD_CNTR conversion" RAT_FUNC "%10.0" "Unitless" COEFFS 0 1 0 0 0 1 /end COMPU_METHOD
/begin MEASUREMENT INJ4_FAIL_OPEN_CNTR "Injector 4 coil open fail counter" SLONG MC_INJ4_FAIL_OPEN_CNTR 0 0 0 0 ECU_ADDRESS 0x3FA5F4 /end MEASUREMENT
/begin COMPU_METHOD MC_INJ4_FAIL_OPEN_CNTR "INJ4_FAIL_OPEN_CNTR conversion" RAT_FUNC "%10.0" "Unitless" COEFFS 0 1 0 0 0 1 /end COMPU_METHOD
/begin MEASUREMENT INJ4_FAIL_OPEN_UPD_CNTR "Injector 4 coil open update counter" SLONG MC_INJ4_FAIL_OPEN_UPD_CNTR 0 0 0 0 ECU_ADDRESS 0x3FA5D4 /end MEASUREMENT
/begin COMPU_METHOD MC_INJ4_FAIL_OPEN_UPD_CNTR "INJ4_FAIL_OPEN_UPD_CNTR conversion" RAT_FUNC "%10.0" "Unitless" COEFFS 0 1 0 0 0 1 /end COMPU_METHOD
/begin MEASUREMENT INJ4_FAIL_S_SS_CNTR "Injector 4 coil  side and side short fail counter" SLONG MC_INJ4_FAIL_S_SS_CNTR 0 0 0 0 ECU_ADDRESS 0x3FA5B4 /end MEASUREMENT
/begin COMPU_METHOD MC_INJ4_FAIL_S_SS_CNTR "INJ4_FAIL_S_SS_CNTR conversion" RAT_FUNC "%10.0" "Unitless" COEFFS 0 1 0 0 0 1 /end COMPU_METHOD
/begin MEASUREMENT INJ4_FAIL_S_SS_UPD_CNTR "Injector 4 coil side and side short fail update counter" SLONG MC_INJ4_FAIL_S_SS_UPD_CNTR 0 0 0 0 ECU_ADDRESS 0x3FA594 /end MEASUREMENT
/begin COMPU_METHOD MC_INJ4_FAIL_S_SS_UPD_CNTR "INJ4_FAIL_S_SS_UPD_CNTR conversion" RAT_FUNC "%10.0" "Unitless" COEFFS 0 1 0 0 0 1 /end COMPU_METHOD
/begin CHARACTERISTIC INJ4_OPEN_F_DEC "Injector 4 coil open fault decrement count value" VALUE 0x5D85C SD_SLONG 0 SC_INJ4_OPEN_F_DEC 0 65535 /end CHARACTERISTIC
/begin COMPU_METHOD SC_INJ4_OPEN_F_DEC "INJ4_OPEN_F_DEC conversion" RAT_FUNC "%10.0" "unitless" COEFFS 0 1 0 0 0 1 /end COMPU_METHOD
/begin CHARACTERISTIC INJ4_OPEN_F_INC "Injector 4 coil open fault increment count value" VALUE 0x5D87C SD_SLONG 0 SC_INJ4_OPEN_F_INC 0 65535 /end CHARACTERISTIC
/begin COMPU_METHOD SC_INJ4_OPEN_F_INC "INJ4_OPEN_F_INC conversion" RAT_FUNC "%10.0" "unitless" COEFFS 0 1 0 0 0 1 /end COMPU_METHOD
/begin CHARACTERISTIC INJ4_S_SS_F_DEC "Injector 4 coil short and side short fault decrement value" VALUE 0x5D81C SD_SLONG 0 SC_INJ4_S_SS_F_DEC 0 65535 /end CHARACTERISTIC
/begin COMPU_METHOD SC_INJ4_S_SS_F_DEC "INJ4_S_SS_F_DEC conversion" RAT_FUNC "%10.0" "unitless" COEFFS 0 1 0 0 0 1 /end COMPU_METHOD
/begin CHARACTERISTIC INJ4_S_SS_F_INC "Injector 4 coil short and side short fault increment value" VALUE 0x5D83C SD_SLONG 0 SC_INJ4_S_SS_F_INC 0 65535 /end CHARACTERISTIC
/begin COMPU_METHOD SC_INJ4_S_SS_F_INC "INJ4_S_SS_F_INC conversion" RAT_FUNC "%10.0" "unitless" COEFFS 0 1 0 0 0 1 /end COMPU_METHOD
/begin CHARACTERISTIC INJ5_CB_F_DEC "Injector 5 cylinder balance  fault decrement count value" VALUE 0x5D7D8 SD_SLONG 0 SC_INJ5_CB_F_DEC 0 65535 /end CHARACTERISTIC
/begin COMPU_METHOD SC_INJ5_CB_F_DEC "INJ5_CB_F_DEC conversion" RAT_FUNC "%10.0" "unitless" COEFFS 0 1 0 0 0 1 /end COMPU_METHOD
/begin CHARACTERISTIC INJ5_CB_F_INC "Injector 5 cylinder balance fault increment count value" VALUE 0x5D7F8 SD_SLONG 0 SC_INJ5_CB_F_INC 0 65535 /end CHARACTERISTIC
/begin COMPU_METHOD SC_INJ5_CB_F_INC "INJ5_CB_F_INC conversion" RAT_FUNC "%10.0" "unitless" COEFFS 0 1 0 0 0 1 /end COMPU_METHOD
/begin MEASUREMENT INJ5_FAIL_CB_CNTR "Injector 5 cylinder balance fault fail counter" SLONG MC_INJ5_FAIL_CB_CNTR 0 0 0 0 ECU_ADDRESS 0x3FA570 /end MEASUREMENT
/begin COMPU_METHOD MC_INJ5_FAIL_CB_CNTR "INJ5_FAIL_CB_CNTR conversion" RAT_FUNC "%10.0" "Unitless" COEFFS 0 1 0 0 0 1 /end COMPU_METHOD
/begin MEASUREMENT INJ5_FAIL_CB_UPD_CNTR "Injector 5 cylinder balance  fault  update counter" SLONG MC_INJ5_FAIL_CB_UPD_CNTR 0 0 0 0 ECU_ADDRESS 0x3FA550 /end MEASUREMENT
/begin COMPU_METHOD MC_INJ5_FAIL_CB_UPD_CNTR "INJ5_FAIL_CB_UPD_CNTR conversion" RAT_FUNC "%10.0" "Unitless" COEFFS 0 1 0 0 0 1 /end COMPU_METHOD
/begin MEASUREMENT INJ5_FAIL_OPEN_CNTR "Injector 5 coil open fail counter" SLONG MC_INJ5_FAIL_OPEN_CNTR 0 0 0 0 ECU_ADDRESS 0x3FA5F0 /end MEASUREMENT
/begin COMPU_METHOD MC_INJ5_FAIL_OPEN_CNTR "INJ5_FAIL_OPEN_CNTR conversion" RAT_FUNC "%10.0" "Unitless" COEFFS 0 1 0 0 0 1 /end COMPU_METHOD
/begin MEASUREMENT INJ5_FAIL_OPEN_UPD_CNTR "Injector 5 coil open update counter" SLONG MC_INJ5_FAIL_OPEN_UPD_CNTR 0 0 0 0 ECU_ADDRESS 0x3FA5D0 /end MEASUREMENT
/begin COMPU_METHOD MC_INJ5_FAIL_OPEN_UPD_CNTR "INJ5_FAIL_OPEN_UPD_CNTR conversion" RAT_FUNC "%10.0" "Unitless" COEFFS 0 1 0 0 0 1 /end COMPU_METHOD
/begin MEASUREMENT INJ5_FAIL_S_SS_CNTR "Injector 5 coil  side and side short fail counter" SLONG MC_INJ5_FAIL_S_SS_CNTR 0 0 0 0 ECU_ADDRESS 0x3FA5B0 /end MEASUREMENT
/begin COMPU_METHOD MC_INJ5_FAIL_S_SS_CNTR "INJ5_FAIL_S_SS_CNTR conversion" RAT_FUNC "%10.0" "Unitless" COEFFS 0 1 0 0 0 1 /end COMPU_METHOD
/begin MEASUREMENT INJ5_FAIL_S_SS_UPD_CNTR "Injector 5 coil side and side short fail update counter" SLONG MC_INJ5_FAIL_S_SS_UPD_CNTR 0 0 0 0 ECU_ADDRESS 0x3FA590 /end MEASUREMENT
/begin COMPU_METHOD MC_INJ5_FAIL_S_SS_UPD_CNTR "INJ5_FAIL_S_SS_UPD_CNTR conversion" RAT_FUNC "%10.0" "Unitless" COEFFS 0 1 0 0 0 1 /end COMPU_METHOD
/begin CHARACTERISTIC INJ5_OPEN_F_DEC "Injector 5 coil open fault decrement count value" VALUE 0x5D858 SD_SLONG 0 SC_INJ5_OPEN_F_DEC 0 65535 /end CHARACTERISTIC
/begin COMPU_METHOD SC_INJ5_OPEN_F_DEC "INJ5_OPEN_F_DEC conversion" RAT_FUNC "%10.0" "unitless" COEFFS 0 1 0 0 0 1 /end COMPU_METHOD
/begin CHARACTERISTIC INJ5_OPEN_F_INC "Injector 5 coil open fault increment count value" VALUE 0x5D878 SD_SLONG 0 SC_INJ5_OPEN_F_INC 0 65535 /end CHARACTERISTIC
/begin COMPU_METHOD SC_INJ5_OPEN_F_INC "INJ5_OPEN_F_INC conversion" RAT_FUNC "%10.0" "unitless" COEFFS 0 1 0 0 0 1 /end COMPU_METHOD
/begin CHARACTERISTIC INJ5_S_SS_F_DEC "Injector 5 coil short and side short fault decrement value" VALUE 0x5D818 SD_SLONG 0 SC_INJ5_S_SS_F_DEC 0 65535 /end CHARACTERISTIC
/begin COMPU_METHOD SC_INJ5_S_SS_F_DEC "INJ5_S_SS_F_DEC conversion" RAT_FUNC "%10.0" "unitless" COEFFS 0 1 0 0 0 1 /end COMPU_METHOD
/begin CHARACTERISTIC INJ5_S_SS_F_INC "Injector 5 coil short and side short fault increment value" VALUE 0x5D838 SD_SLONG 0 SC_INJ5_S_SS_F_INC 0 65535 /end CHARACTERISTIC
/begin COMPU_METHOD SC_INJ5_S_SS_F_INC "INJ5_S_SS_F_INC conversion" RAT_FUNC "%10.0" "unitless" COEFFS 0 1 0 0 0 1 /end COMPU_METHOD
/begin CHARACTERISTIC INJ6_CB_F_DEC "Injector 6 cylinder balance  fault decrement count value" VALUE 0x5D7D4 SD_SLONG 0 SC_INJ6_CB_F_DEC 0 65535 /end CHARACTERISTIC
/begin COMPU_METHOD SC_INJ6_CB_F_DEC "INJ6_CB_F_DEC conversion" RAT_FUNC "%10.0" "unitless" COEFFS 0 1 0 0 0 1 /end COMPU_METHOD
/begin CHARACTERISTIC INJ6_CB_F_INC "Injector 6 cylinder balance fault increment count value" VALUE 0x5D7F4 SD_SLONG 0 SC_INJ6_CB_F_INC 0 65535 /end CHARACTERISTIC
/begin COMPU_METHOD SC_INJ6_CB_F_INC "INJ6_CB_F_INC conversion" RAT_FUNC "%10.0" "unitless" COEFFS 0 1 0 0 0 1 /end COMPU_METHOD
/begin MEASUREMENT INJ6_FAIL_CB_CNTR "Injector 6 cylinder balance fault fail counter" SLONG MC_INJ6_FAIL_CB_CNTR 0 0 0 0 ECU_ADDRESS 0x3FA56C /end MEASUREMENT
/begin COMPU_METHOD MC_INJ6_FAIL_CB_CNTR "INJ6_FAIL_CB_CNTR conversion" RAT_FUNC "%10.0" "Unitless" COEFFS 0 1 0 0 0 1 /end COMPU_METHOD
/begin MEASUREMENT INJ6_FAIL_CB_UPD_CNTR "Injector 6 cylinder balance  fault  update counter" SLONG MC_INJ6_FAIL_CB_UPD_CNTR 0 0 0 0 ECU_ADDRESS 0x3FA54C /end MEASUREMENT
/begin COMPU_METHOD MC_INJ6_FAIL_CB_UPD_CNTR "INJ6_FAIL_CB_UPD_CNTR conversion" RAT_FUNC "%10.0" "Unitless" COEFFS 0 1 0 0 0 1 /end COMPU_METHOD
/begin MEASUREMENT INJ6_FAIL_OPEN_CNTR "Injector 6 coil open fail counter" SLONG MC_INJ6_FAIL_OPEN_CNTR 0 0 0 0 ECU_ADDRESS 0x3FA5EC /end MEASUREMENT
/begin COMPU_METHOD MC_INJ6_FAIL_OPEN_CNTR "INJ6_FAIL_OPEN_CNTR conversion" RAT_FUNC "%10.0" "Unitless" COEFFS 0 1 0 0 0 1 /end COMPU_METHOD
/begin MEASUREMENT INJ6_FAIL_OPEN_UPD_CNTR "Injector 6 coil open update counter" SLONG MC_INJ6_FAIL_OPEN_UPD_CNTR 0 0 0 0 ECU_ADDRESS 0x3FA5CC /end MEASUREMENT
/begin COMPU_METHOD MC_INJ6_FAIL_OPEN_UPD_CNTR "INJ6_FAIL_OPEN_UPD_CNTR conversion" RAT_FUNC "%10.0" "Unitless" COEFFS 0 1 0 0 0 1 /end COMPU_METHOD
/begin MEASUREMENT INJ6_FAIL_S_SS_CNTR "Injector 6 coil  side and side short fail counter" SLONG MC_INJ6_FAIL_S_SS_CNTR 0 0 0 0 ECU_ADDRESS 0x3FA5AC /end MEASUREMENT
/begin COMPU_METHOD MC_INJ6_FAIL_S_SS_CNTR "INJ6_FAIL_S_SS_CNTR conversion" RAT_FUNC "%10.0" "Unitless" COEFFS 0 1 0 0 0 1 /end COMPU_METHOD
/begin MEASUREMENT INJ6_FAIL_S_SS_UPD_CNTR "Injector 6 coil side and side short fail update counter" SLONG MC_INJ6_FAIL_S_SS_UPD_CNTR 0 0 0 0 ECU_ADDRESS 0x3FA58C /end MEASUREMENT
/begin COMPU_METHOD MC_INJ6_FAIL_S_SS_UPD_CNTR "INJ6_FAIL_S_SS_UPD_CNTR conversion" RAT_FUNC "%10.0" "Unitless" COEFFS 0 1 0 0 0 1 /end COMPU_METHOD
/begin CHARACTERISTIC INJ6_OPEN_F_DEC "Injector 6 coil open fault decrement count value" VALUE 0x5D854 SD_SLONG 0 SC_INJ6_OPEN_F_DEC 0 65535 /end CHARACTERISTIC
/begin COMPU_METHOD SC_INJ6_OPEN_F_DEC "INJ6_OPEN_F_DEC conversion" RAT_FUNC "%10.0" "unitless" COEFFS 0 1 0 0 0 1 /end COMPU_METHOD
/begin CHARACTERISTIC INJ6_OPEN_F_INC "Injector 6 coil open fault increment count value" VALUE 0x5D874 SD_SLONG 0 SC_INJ6_OPEN_F_INC 0 65535 /end CHARACTERISTIC
/begin COMPU_METHOD SC_INJ6_OPEN_F_INC "INJ6_OPEN_F_INC conversion" RAT_FUNC "%10.0" "unitless" COEFFS 0 1 0 0 0 1 /end COMPU_METHOD
/begin CHARACTERISTIC INJ6_S_SS_F_DEC "Injector 6 coil short and side short fault decrement value" VALUE 0x5D814 SD_SLONG 0 SC_INJ6_S_SS_F_DEC 0 65535 /end CHARACTERISTIC
/begin COMPU_METHOD SC_INJ6_S_SS_F_DEC "INJ6_S_SS_F_DEC conversion" RAT_FUNC "%10.0" "unitless" COEFFS 0 1 0 0 0 1 /end COMPU_METHOD
/begin CHARACTERISTIC INJ6_S_SS_F_INC "Injector 6 coil short and side short fault increment value" VALUE 0x5D834 SD_SLONG 0 SC_INJ6_S_SS_F_INC 0 65535 /end CHARACTERISTIC
/begin COMPU_METHOD SC_INJ6_S_SS_F_INC "INJ6_S_SS_F_INC conversion" RAT_FUNC "%10.0" "unitless" COEFFS 0 1 0 0 0 1 /end COMPU_METHOD
/begin CHARACTERISTIC INJ7_CB_F_DEC "Injector 7 cylinder balance  fault decrement count value" VALUE 0x5D7D0 SD_SLONG 0 SC_INJ7_CB_F_DEC 0 65535 /end CHARACTERISTIC
/begin COMPU_METHOD SC_INJ7_CB_F_DEC "INJ7_CB_F_DEC conversion" RAT_FUNC "%10.0" "unitless" COEFFS 0 1 0 0 0 1 /end COMPU_METHOD
/begin CHARACTERISTIC INJ7_CB_F_INC "Injector 7 cylinder balance fault increment count value" VALUE 0x5D7F0 SD_SLONG 0 SC_INJ7_CB_F_INC 0 65535 /end CHARACTERISTIC
/begin COMPU_METHOD SC_INJ7_CB_F_INC "INJ7_CB_F_INC conversion" RAT_FUNC "%10.0" "unitless" COEFFS 0 1 0 0 0 1 /end COMPU_METHOD
/begin MEASUREMENT INJ7_FAIL_CB_CNTR "Injector 7 cylinder balance fault fail counter" SLONG MC_INJ7_FAIL_CB_CNTR 0 0 0 0 ECU_ADDRESS 0x3FA568 /end MEASUREMENT
/begin COMPU_METHOD MC_INJ7_FAIL_CB_CNTR "INJ7_FAIL_CB_CNTR conversion" RAT_FUNC "%10.0" "Unitless" COEFFS 0 1 0 0 0 1 /end COMPU_METHOD
/begin MEASUREMENT INJ7_FAIL_CB_UPD_CNTR "Injector 7 cylinder balance  fault  update counter" SLONG MC_INJ7_FAIL_CB_UPD_CNTR 0 0 0 0 ECU_ADDRESS 0x3FA548 /end MEASUREMENT
/begin COMPU_METHOD MC_INJ7_FAIL_CB_UPD_CNTR "INJ7_FAIL_CB_UPD_CNTR conversion" RAT_FUNC "%10.0" "Unitless" COEFFS 0 1 0 0 0 1 /end COMPU_METHOD
/begin MEASUREMENT INJ7_FAIL_OPEN_CNTR "Injector 7 coil open fail counter" SLONG MC_INJ7_FAIL_OPEN_CNTR 0 0 0 0 ECU_ADDRESS 0x3FA5E8 /end MEASUREMENT
/begin COMPU_METHOD MC_INJ7_FAIL_OPEN_CNTR "INJ7_FAIL_OPEN_CNTR conversion" RAT_FUNC "%10.0" "Unitless" COEFFS 0 1 0 0 0 1 /end COMPU_METHOD
/begin MEASUREMENT INJ7_FAIL_OPEN_UPD_CNTR "Injector 7 coil open update counter" SLONG MC_INJ7_FAIL_OPEN_UPD_CNTR 0 0 0 0 ECU_ADDRESS 0x3FA5C8 /end MEASUREMENT
/begin COMPU_METHOD MC_INJ7_FAIL_OPEN_UPD_CNTR "INJ7_FAIL_OPEN_UPD_CNTR conversion" RAT_FUNC "%10.0" "Unitless" COEFFS 0 1 0 0 0 1 /end COMPU_METHOD
/begin MEASUREMENT INJ7_FAIL_S_SS_CNTR "Injector 7 coil  side and side short fail counter" SLONG MC_INJ7_FAIL_S_SS_CNTR 0 0 0 0 ECU_ADDRESS 0x3FA5A8 /end MEASUREMENT
/begin COMPU_METHOD MC_INJ7_FAIL_S_SS_CNTR "INJ7_FAIL_S_SS_CNTR conversion" RAT_FUNC "%10.0" "Unitless" COEFFS 0 1 0 0 0 1 /end COMPU_METHOD
/begin MEASUREMENT INJ7_FAIL_S_SS_UPD_CNTR "Injector 7 coil side and side short fail update counter" SLONG MC_INJ7_FAIL_S_SS_UPD_CNTR 0 0 0 0 ECU_ADDRESS 0x3FA588 /end MEASUREMENT
/begin COMPU_METHOD MC_INJ7_FAIL_S_SS_UPD_CNTR "INJ7_FAIL_S_SS_UPD_CNTR conversion" RAT_FUNC "%10.0" "Unitless" COEFFS 0 1 0 0 0 1 /end COMPU_METHOD
/begin CHARACTERISTIC INJ7_OPEN_F_DEC "Injector 7 coil open fault decrement count value" VALUE 0x5D850 SD_SLONG 0 SC_INJ7_OPEN_F_DEC 0 65535 /end CHARACTERISTIC
/begin COMPU_METHOD SC_INJ7_OPEN_F_DEC "INJ7_OPEN_F_DEC conversion" RAT_FUNC "%10.0" "unitless" COEFFS 0 1 0 0 0 1 /end COMPU_METHOD
/begin CHARACTERISTIC INJ7_OPEN_F_INC "Injector 7 coil open fault increment count value" VALUE 0x5D870 SD_SLONG 0 SC_INJ7_OPEN_F_INC 0 65535 /end CHARACTERISTIC
/begin COMPU_METHOD SC_INJ7_OPEN_F_INC "INJ7_OPEN_F_INC conversion" RAT_FUNC "%10.0" "unitless" COEFFS 0 1 0 0 0 1 /end COMPU_METHOD
/begin CHARACTERISTIC INJ7_S_SS_F_DEC "Injector 7 coil short and side short fault decrement value" VALUE 0x5D810 SD_SLONG 0 SC_INJ7_S_SS_F_DEC 0 65535 /end CHARACTERISTIC
/begin COMPU_METHOD SC_INJ7_S_SS_F_DEC "INJ7_S_SS_F_DEC conversion" RAT_FUNC "%10.0" "unitless" COEFFS 0 1 0 0 0 1 /end COMPU_METHOD
/begin CHARACTERISTIC INJ7_S_SS_F_INC "Injector 7 coil short and side short fault increment value" VALUE 0x5D830 SD_SLONG 0 SC_INJ7_S_SS_F_INC 0 65535 /end CHARACTERISTIC
/begin COMPU_METHOD SC_INJ7_S_SS_F_INC "INJ7_S_SS_F_INC conversion" RAT_FUNC "%10.0" "unitless" COEFFS 0 1 0 0 0 1 /end COMPU_METHOD
/begin CHARACTERISTIC INJ8_CB_F_DEC "Injector 8 cylinder balance  fault decrement count value" VALUE 0x5D7CC SD_SLONG 0 SC_INJ8_CB_F_DEC 0 65535 /end CHARACTERISTIC
/begin COMPU_METHOD SC_INJ8_CB_F_DEC "INJ8_CB_F_DEC conversion" RAT_FUNC "%10.0" "unitless" COEFFS 0 1 0 0 0 1 /end COMPU_METHOD
/begin CHARACTERISTIC INJ8_CB_F_INC "Injector 8 cylinder balance fault increment count value" VALUE 0x5D7EC SD_SLONG 0 SC_INJ8_CB_F_INC 0 65535 /end CHARACTERISTIC
/begin COMPU_METHOD SC_INJ8_CB_F_INC "INJ8_CB_F_INC conversion" RAT_FUNC "%10.0" "unitless" COEFFS 0 1 0 0 0 1 /end COMPU_METHOD
/begin MEASUREMENT INJ8_FAIL_CB_CNTR "Injector 8 cylinder balance fault fail counter" SLONG MC_INJ8_FAIL_CB_CNTR 0 0 0 0 ECU_ADDRESS 0x3FA564 /end MEASUREMENT
/begin COMPU_METHOD MC_INJ8_FAIL_CB_CNTR "INJ8_FAIL_CB_CNTR conversion" RAT_FUNC "%10.0" "Unitless" COEFFS 0 1 0 0 0 1 /end COMPU_METHOD
/begin MEASUREMENT INJ8_FAIL_CB_UPD_CNTR "Injector 8 cylinder balance  fault  update counter" SLONG MC_INJ8_FAIL_CB_UPD_CNTR 0 0 0 0 ECU_ADDRESS 0x3FA544 /end MEASUREMENT
/begin COMPU_METHOD MC_INJ8_FAIL_CB_UPD_CNTR "INJ8_FAIL_CB_UPD_CNTR conversion" RAT_FUNC "%10.0" "Unitless" COEFFS 0 1 0 0 0 1 /end COMPU_METHOD
/begin MEASUREMENT INJ8_FAIL_OPEN_CNTR "Injector 8 coil open fail counter" SLONG MC_INJ8_FAIL_OPEN_CNTR 0 0 0 0 ECU_ADDRESS 0x3FA5E4 /end MEASUREMENT
/begin COMPU_METHOD MC_INJ8_FAIL_OPEN_CNTR "INJ8_FAIL_OPEN_CNTR conversion" RAT_FUNC "%10.0" "Unitless" COEFFS 0 1 0 0 0 1 /end COMPU_METHOD
/begin MEASUREMENT INJ8_FAIL_OPEN_UPD_CNTR "Injector 8 coil open update counter" SLONG MC_INJ8_FAIL_OPEN_UPD_CNTR 0 0 0 0 ECU_ADDRESS 0x3FA5C4 /end MEASUREMENT
/begin COMPU_METHOD MC_INJ8_FAIL_OPEN_UPD_CNTR "INJ8_FAIL_OPEN_UPD_CNTR conversion" RAT_FUNC "%10.0" "Unitless" COEFFS 0 1 0 0 0 1 /end COMPU_METHOD
/begin MEASUREMENT INJ8_FAIL_S_SS_CNTR "Injector 8 coil  side and side short fail counter" SLONG MC_INJ8_FAIL_S_SS_CNTR 0 0 0 0 ECU_ADDRESS 0x3FA5A4 /end MEASUREMENT
/begin COMPU_METHOD MC_INJ8_FAIL_S_SS_CNTR "INJ8_FAIL_S_SS_CNTR conversion" RAT_FUNC "%10.0" "Unitless" COEFFS 0 1 0 0 0 1 /end COMPU_METHOD
/begin MEASUREMENT INJ8_FAIL_S_SS_UPD_CNTR "Injector 8 coil side and side short fail update counter" SLONG MC_INJ8_FAIL_S_SS_UPD_CNTR 0 0 0 0 ECU_ADDRESS 0x3FA584 /end MEASUREMENT
/begin COMPU_METHOD MC_INJ8_FAIL_S_SS_UPD_CNTR "INJ8_FAIL_S_SS_UPD_CNTR conversion" RAT_FUNC "%10.0" "Unitless" COEFFS 0 1 0 0 0 1 /end COMPU_METHOD
/begin CHARACTERISTIC INJ8_OPEN_F_DEC "Injector 8 coil open fault decrement count value" VALUE 0x5D84C SD_SLONG 0 SC_INJ8_OPEN_F_DEC 0 65535 /end CHARACTERISTIC
/begin COMPU_METHOD SC_INJ8_OPEN_F_DEC "INJ8_OPEN_F_DEC conversion" RAT_FUNC "%10.0" "unitless" COEFFS 0 1 0 0 0 1 /end COMPU_METHOD
/begin CHARACTERISTIC INJ8_OPEN_F_INC "Injector 8 coil open fault increment count value" VALUE 0x5D86C SD_SLONG 0 SC_INJ8_OPEN_F_INC 0 65535 /end CHARACTERISTIC
/begin COMPU_METHOD SC_INJ8_OPEN_F_INC "INJ8_OPEN_F_INC conversion" RAT_FUNC "%10.0" "unitless" COEFFS 0 1 0 0 0 1 /end COMPU_METHOD
/begin CHARACTERISTIC INJ8_S_SS_F_DEC "Injector 8 coil short and side short fault decrement value" VALUE 0x5D80C SD_SLONG 0 SC_INJ8_S_SS_F_DEC 0 65535 /end CHARACTERISTIC
/begin COMPU_METHOD SC_INJ8_S_SS_F_DEC "INJ8_S_SS_F_DEC conversion" RAT_FUNC "%10.0" "unitless" COEFFS 0 1 0 0 0 1 /end COMPU_METHOD
/begin CHARACTERISTIC INJ8_S_SS_F_INC "Injector 8 coil short and side short fault increment value" VALUE 0x5D82C SD_SLONG 0 SC_INJ8_S_SS_F_INC 0 65535 /end CHARACTERISTIC
/begin COMPU_METHOD SC_INJ8_S_SS_F_INC "INJ8_S_SS_F_INC conversion" RAT_FUNC "%10.0" "unitless" COEFFS 0 1 0 0 0 1 /end COMPU_METHOD
/begin MEASUREMENT INJECTOR_DISABLE_MASK "Mask to disable injectors for injector diagnostic tests (buzz test)" UBYTE MC_INJECTOR_DISABLE_MASK 0 0 0 0 ECU_ADDRESS 0x3FA29C /end MEASUREMENT
/begin COMPU_METHOD MC_INJECTOR_DISABLE_MASK "INJECTOR_DISABLE_MASK conversion" RAT_FUNC "%3.0" "Unitless" COEFFS 0 1 0 0 0 1 /end COMPU_METHOD
/begin MEASUREMENT INJECTOR_DISABLE_TEST_RX "IDM injector disable test status" UBYTE MC_INJECTOR_DISABLE_TEST_RX 0 0 0 0 ECU_ADDRESS 0x3F995E /end MEASUREMENT
/begin COMPU_METHOD MC_INJECTOR_DISABLE_TEST_RX "INJECTOR_DISABLE_TEST_RX conversion" RAT_FUNC "%3.0" "Unitless" COEFFS 0 1 0 0 0 1 /end COMPU_METHOD
/begin MEASUREMENT INJECTOR_ID_FAULT "Injector ID fault status  byte" UBYTE MC_INJECTOR_ID_FAULT 0 0 0 0 ECU_ADDRESS 0x3FB683 /end MEASUREMENT
/begin COMPU_METHOD MC_INJECTOR_ID_FAULT "INJECTOR_ID_FAULT conversion" RAT_FUNC "%3.0" "Unitless" COEFFS 0 1 0 0 0 1 /end COMPU_METHOD
/begin CHARACTERISTIC INJIOCTRL_MAXRPM "Engine RPM limit for injector OFF OSC" VALUE 0x5CEEC SD_FLOAT32_IEEE 0 SC_INJIOCTRL_MAXRPM 0 6000 /end CHARACTERISTIC
/begin COMPU_METHOD SC_INJIOCTRL_MAXRPM "INJIOCTRL_MAXRPM conversion" RAT_FUNC "%10.5" "RPM" COEFFS 0 1 0 0 0 1 /end COMPU_METHOD
/begin MEASUREMENT INJOFF_TEST_ABORTING "Injector off test is being aborted now" UBYTE MC_INJOFF_TEST_ABORTING 0 0 0 0 ECU_ADDRESS 0x3F9E92 /end MEASUREMENT
/begin COMPU_METHOD MC_INJOFF_TEST_ABORTING "INJOFF_TEST_ABORTING conversion" RAT_FUNC "%3.0" "Unitless" COEFFS 0 1 0 0 0 1 /end COMPU_METHOD
/begin MEASUREMENT INJOFF_TEST_ENG_CONDN "Indicates injector OFF test  engine enabling condition" UBYTE MC_INJOFF_TEST_ENG_CONDN 0 0 0 0 ECU_ADDRESS 0x3F9E95 /end MEASUREMENT
/begin COMPU_METHOD MC_INJOFF_TEST_ENG_CONDN "INJOFF_TEST_ENG_CONDN conversion" RAT_FUNC "%3.0" "Unitless" COEFFS 0 1 0 0 0 1 /end COMPU_METHOD
/begin MEASUREMENT INJX_STATUS_TEMP "Temporary injector fault status flag" UBYTE MC_INJX_STATUS_TEMP 0 0 0 0 ECU_ADDRESS 0x3FA604 /end MEASUREMENT
/begin COMPU_METHOD MC_INJX_STATUS_TEMP "INJX_STATUS_TEMP conversion" RAT_FUNC "%3.0" "Unitless" COEFFS 0 1 0 0 0 1 /end COMPU_METHOD
/begin MEASUREMENT INJ_1_CB_F "Injector #1 cylinder balance fault" UBYTE MC_INJ_1_CB_F 0 0 0 0 ECU_ADDRESS 0x3FB6F1 /end MEASUREMENT
/begin COMPU_METHOD MC_INJ_1_CB_F "INJ_1_CB_F conversion" RAT_FUNC "%3.0" "Unitless" COEFFS 0 1 0 0 0 1 /end COMPU_METHOD
/begin MEASUREMENT INJ_1_CC_O "Injector #1 Close Coil Open" UBYTE MC_INJ_1_CC_O 0 0 0 0 ECU_ADDRESS 0x3FB694 /end MEASUREMENT
/begin COMPU_METHOD MC_INJ_1_CC_O "INJ_1_CC_O conversion" RAT_FUNC "%3.0" "Unitless" COEFFS 0 1 0 0 0 1 /end COMPU_METHOD
/begin MEASUREMENT INJ_1_CC_S "Injector #1 Close Coil Short" UBYTE MC_INJ_1_CC_S 0 0 0 0 ECU_ADDRESS 0x3FB69C /end MEASUREMENT
/begin COMPU_METHOD MC_INJ_1_CC_S "INJ_1_CC_S conversion" RAT_FUNC "%3.0" "Unitless" COEFFS 0 1 0 0 0 1 /end COMPU_METHOD
/begin MEASUREMENT INJ_1_CC_SS "Injector #1 Close Coil Side Short" UBYTE MC_INJ_1_CC_SS 0 0 0 0 ECU_ADDRESS 0x3FB6AC /end MEASUREMENT
/begin COMPU_METHOD MC_INJ_1_CC_SS "INJ_1_CC_SS conversion" RAT_FUNC "%3.0" "Unitless" COEFFS 0 1 0 0 0 1 /end COMPU_METHOD
/begin MEASUREMENT INJ_1_ID_F "Injector #1 ID fault" UBYTE MC_INJ_1_ID_F 0 0 0 0 ECU_ADDRESS 0x3FB6BB /end MEASUREMENT
/begin COMPU_METHOD MC_INJ_1_ID_F "INJ_1_ID_F conversion" RAT_FUNC "%3.0" "Unitless" COEFFS 0 1 0 0 0 1 /end COMPU_METHOD
/begin MEASUREMENT INJ_1_OC_O "Injector #1 Open Coil Open" UBYTE MC_INJ_1_OC_O 0 0 0 0 ECU_ADDRESS 0x3FB684 /end MEASUREMENT
/begin COMPU_METHOD MC_INJ_1_OC_O "INJ_1_OC_O conversion" RAT_FUNC "%3.0" "Unitless" COEFFS 0 1 0 0 0 1 /end COMPU_METHOD
/begin MEASUREMENT INJ_1_OC_S "Injector #1 Open Coil Short" UBYTE MC_INJ_1_OC_S 0 0 0 0 ECU_ADDRESS 0x3FB68C /end MEASUREMENT
/begin COMPU_METHOD MC_INJ_1_OC_S "INJ_1_OC_S conversion" RAT_FUNC "%3.0" "Unitless" COEFFS 0 1 0 0 0 1 /end COMPU_METHOD
/begin MEASUREMENT INJ_1_OC_SS "Injector #1 Open Coil Side Short" UBYTE MC_INJ_1_OC_SS 0 0 0 0 ECU_ADDRESS 0x3FB6A4 /end MEASUREMENT
/begin COMPU_METHOD MC_INJ_1_OC_SS "INJ_1_OC_SS conversion" RAT_FUNC "%3.0" "Unitless" COEFFS 0 1 0 0 0 1 /end COMPU_METHOD
/begin MEASUREMENT INJ_1_STATUS "Injector status" UBYTE MC_INJ_1_STATUS 0 0 0 0 ECU_ADDRESS 0x3F995A /end MEASUREMENT
/begin COMPU_METHOD MC_INJ_1_STATUS "INJ_1_STATUS conversion" RAT_FUNC "%3.0" "Unitless" COEFFS 0 1 0 0 0 1 /end COMPU_METHOD
/begin MEASUREMENT INJ_2_CB_F "Injector #2 cylinder balance fault" UBYTE MC_INJ_2_CB_F 0 0 0 0 ECU_ADDRESS 0x3FB6F2 /end MEASUREMENT
/begin COMPU_METHOD MC_INJ_2_CB_F "INJ_2_CB_F conversion" RAT_FUNC "%3.0" "Unitless" COEFFS 0 1 0 0 0 1 /end COMPU_METHOD
/begin MEASUREMENT INJ_2_CC_O "Injector #2 Close Coil Open" UBYTE MC_INJ_2_CC_O 0 0 0 0 ECU_ADDRESS 0x3FB695 /end MEASUREMENT
/begin COMPU_METHOD MC_INJ_2_CC_O "INJ_2_CC_O conversion" RAT_FUNC "%3.0" "Unitless" COEFFS 0 1 0 0 0 1 /end COMPU_METHOD
/begin MEASUREMENT INJ_2_CC_S "Injector #2 Close Coil Short" UBYTE MC_INJ_2_CC_S 0 0 0 0 ECU_ADDRESS 0x3FB69D /end MEASUREMENT
/begin COMPU_METHOD MC_INJ_2_CC_S "INJ_2_CC_S conversion" RAT_FUNC "%3.0" "Unitless" COEFFS 0 1 0 0 0 1 /end COMPU_METHOD
/begin MEASUREMENT INJ_2_CC_SS "Injector #2 Close Coil Side Short" UBYTE MC_INJ_2_CC_SS 0 0 0 0 ECU_ADDRESS 0x3FB6AD /end MEASUREMENT
/begin COMPU_METHOD MC_INJ_2_CC_SS "INJ_2_CC_SS conversion" RAT_FUNC "%3.0" "Unitless" COEFFS 0 1 0 0 0 1 /end COMPU_METHOD
/begin MEASUREMENT INJ_2_ID_F "Injector #2 ID fault" UBYTE MC_INJ_2_ID_F 0 0 0 0 ECU_ADDRESS 0x3FB6BC /end MEASUREMENT
/begin COMPU_METHOD MC_INJ_2_ID_F "INJ_2_ID_F conversion" RAT_FUNC "%3.0" "Unitless" COEFFS 0 1 0 0 0 1 /end COMPU_METHOD
/begin MEASUREMENT INJ_2_OC_O "Injector #2 Open Coil Open" UBYTE MC_INJ_2_OC_O 0 0 0 0 ECU_ADDRESS 0x3FB685 /end MEASUREMENT
/begin COMPU_METHOD MC_INJ_2_OC_O "INJ_2_OC_O conversion" RAT_FUNC "%3.0" "Unitless" COEFFS 0 1 0 0 0 1 /end COMPU_METHOD
/begin MEASUREMENT INJ_2_OC_S "Injector #2 Open Coil Short" UBYTE MC_INJ_2_OC_S 0 0 0 0 ECU_ADDRESS 0x3FB68D /end MEASUREMENT
/begin COMPU_METHOD MC_INJ_2_OC_S "INJ_2_OC_S conversion" RAT_FUNC "%3.0" "Unitless" COEFFS 0 1 0 0 0 1 /end COMPU_METHOD
/begin MEASUREMENT INJ_2_OC_SS "Injector #2 Open Coil Side Short" UBYTE MC_INJ_2_OC_SS 0 0 0 0 ECU_ADDRESS 0x3FB6A5 /end MEASUREMENT
/begin COMPU_METHOD MC_INJ_2_OC_SS "INJ_2_OC_SS conversion" RAT_FUNC "%3.0" "Unitless" COEFFS 0 1 0 0 0 1 /end COMPU_METHOD
/begin MEASUREMENT INJ_2_STATUS "Injector status" UBYTE MC_INJ_2_STATUS 0 0 0 0 ECU_ADDRESS 0x3F9959 /end MEASUREMENT
/begin COMPU_METHOD MC_INJ_2_STATUS "INJ_2_STATUS conversion" RAT_FUNC "%3.0" "Unitless" COEFFS 0 1 0 0 0 1 /end COMPU_METHOD
/begin MEASUREMENT INJ_3_CB_F "Injector #3 cylinder balance fault" UBYTE MC_INJ_3_CB_F 0 0 0 0 ECU_ADDRESS 0x3FB6F3 /end MEASUREMENT
/begin COMPU_METHOD MC_INJ_3_CB_F "INJ_3_CB_F conversion" RAT_FUNC "%3.0" "Unitless" COEFFS 0 1 0 0 0 1 /end COMPU_METHOD
/begin MEASUREMENT INJ_3_CC_O "Injector #3 Close Coil Open" UBYTE MC_INJ_3_CC_O 0 0 0 0 ECU_ADDRESS 0x3FB696 /end MEASUREMENT
/begin COMPU_METHOD MC_INJ_3_CC_O "INJ_3_CC_O conversion" RAT_FUNC "%3.0" "Unitless" COEFFS 0 1 0 0 0 1 /end COMPU_METHOD
/begin MEASUREMENT INJ_3_CC_S "Injector #3 Close Coil Short" UBYTE MC_INJ_3_CC_S 0 0 0 0 ECU_ADDRESS 0x3FB69E /end MEASUREMENT
/begin COMPU_METHOD MC_INJ_3_CC_S "INJ_3_CC_S conversion" RAT_FUNC "%3.0" "Unitless" COEFFS 0 1 0 0 0 1 /end COMPU_METHOD
/begin MEASUREMENT INJ_3_CC_SS "Injector #3 Close Coil Side Short" UBYTE MC_INJ_3_CC_SS 0 0 0 0 ECU_ADDRESS 0x3FB6AE /end MEASUREMENT
/begin COMPU_METHOD MC_INJ_3_CC_SS "INJ_3_CC_SS conversion" RAT_FUNC "%3.0" "Unitless" COEFFS 0 1 0 0 0 1 /end COMPU_METHOD
/begin MEASUREMENT INJ_3_ID_F "Injector #3 ID fault" UBYTE MC_INJ_3_ID_F 0 0 0 0 ECU_ADDRESS 0x3FB6BD /end MEASUREMENT
/begin COMPU_METHOD MC_INJ_3_ID_F "INJ_3_ID_F conversion" RAT_FUNC "%3.0" "Unitless" COEFFS 0 1 0 0 0 1 /end COMPU_METHOD
/begin MEASUREMENT INJ_3_OC_O "Injector #3 Open Coil Open" UBYTE MC_INJ_3_OC_O 0 0 0 0 ECU_ADDRESS 0x3FB686 /end MEASUREMENT
/begin COMPU_METHOD MC_INJ_3_OC_O "INJ_3_OC_O conversion" RAT_FUNC "%3.0" "Unitless" COEFFS 0 1 0 0 0 1 /end COMPU_METHOD
/begin MEASUREMENT INJ_3_OC_S "Injector #3 Open Coil Short" UBYTE MC_INJ_3_OC_S 0 0 0 0 ECU_ADDRESS 0x3FB68E /end MEASUREMENT
/begin COMPU_METHOD MC_INJ_3_OC_S "INJ_3_OC_S conversion" RAT_FUNC "%3.0" "Unitless" COEFFS 0 1 0 0 0 1 /end COMPU_METHOD
/begin MEASUREMENT INJ_3_OC_SS "Injector #3 Open Coil Side Short" UBYTE MC_INJ_3_OC_SS 0 0 0 0 ECU_ADDRESS 0x3FB6A6 /end MEASUREMENT
/begin COMPU_METHOD MC_INJ_3_OC_SS "INJ_3_OC_SS conversion" RAT_FUNC "%3.0" "Unitless" COEFFS 0 1 0 0 0 1 /end COMPU_METHOD
/begin MEASUREMENT INJ_3_STATUS "Injector status" UBYTE MC_INJ_3_STATUS 0 0 0 0 ECU_ADDRESS 0x3F9958 /end MEASUREMENT
/begin COMPU_METHOD MC_INJ_3_STATUS "INJ_3_STATUS conversion" RAT_FUNC "%3.0" "Unitless" COEFFS 0 1 0 0 0 1 /end COMPU_METHOD
/begin MEASUREMENT INJ_4_CB_F "Injector #4 cylinder balance fault" UBYTE MC_INJ_4_CB_F 0 0 0 0 ECU_ADDRESS 0x3FB6F4 /end MEASUREMENT
/begin COMPU_METHOD MC_INJ_4_CB_F "INJ_4_CB_F conversion" RAT_FUNC "%3.0" "Unitless" COEFFS 0 1 0 0 0 1 /end COMPU_METHOD
/begin MEASUREMENT INJ_4_CC_O "Injector #4 Close Coil Open" UBYTE MC_INJ_4_CC_O 0 0 0 0 ECU_ADDRESS 0x3FB697 /end MEASUREMENT
/begin COMPU_METHOD MC_INJ_4_CC_O "INJ_4_CC_O conversion" RAT_FUNC "%3.0" "Unitless" COEFFS 0 1 0 0 0 1 /end COMPU_METHOD
/begin MEASUREMENT INJ_4_CC_S "Injector #4 Close Coil Short" UBYTE MC_INJ_4_CC_S 0 0 0 0 ECU_ADDRESS 0x3FB69F /end MEASUREMENT
/begin COMPU_METHOD MC_INJ_4_CC_S "INJ_4_CC_S conversion" RAT_FUNC "%3.0" "Unitless" COEFFS 0 1 0 0 0 1 /end COMPU_METHOD
/begin MEASUREMENT INJ_4_CC_SS "Injector #4 Close Coil Side Short" UBYTE MC_INJ_4_CC_SS 0 0 0 0 ECU_ADDRESS 0x3FB6AF /end MEASUREMENT
/begin COMPU_METHOD MC_INJ_4_CC_SS "INJ_4_CC_SS conversion" RAT_FUNC "%3.0" "Unitless" COEFFS 0 1 0 0 0 1 /end COMPU_METHOD
/begin MEASUREMENT INJ_4_ID_F "Injector #4 ID fault" UBYTE MC_INJ_4_ID_F 0 0 0 0 ECU_ADDRESS 0x3FB6BE /end MEASUREMENT
/begin COMPU_METHOD MC_INJ_4_ID_F "INJ_4_ID_F conversion" RAT_FUNC "%3.0" "Unitless" COEFFS 0 1 0 0 0 1 /end COMPU_METHOD
/begin MEASUREMENT INJ_4_OC_O "Injector #4 Open Coil Open" UBYTE MC_INJ_4_OC_O 0 0 0 0 ECU_ADDRESS 0x3FB687 /end MEASUREMENT
/begin COMPU_METHOD MC_INJ_4_OC_O "INJ_4_OC_O conversion" RAT_FUNC "%3.0" "Unitless" COEFFS 0 1 0 0 0 1 /end COMPU_METHOD
/begin MEASUREMENT INJ_4_OC_S "Injector #4 Open Coil Short" UBYTE MC_INJ_4_OC_S 0 0 0 0 ECU_ADDRESS 0x3FB68F /end MEASUREMENT
/begin COMPU_METHOD MC_INJ_4_OC_S "INJ_4_OC_S conversion" RAT_FUNC "%3.0" "Unitless" COEFFS 0 1 0 0 0 1 /end COMPU_METHOD
/begin MEASUREMENT INJ_4_OC_SS "Injector #4 Open Coil Side Short" UBYTE MC_INJ_4_OC_SS 0 0 0 0 ECU_ADDRESS 0x3FB6A7 /end MEASUREMENT
/begin COMPU_METHOD MC_INJ_4_OC_SS "INJ_4_OC_SS conversion" RAT_FUNC "%3.0" "Unitless" COEFFS 0 1 0 0 0 1 /end COMPU_METHOD
/begin MEASUREMENT INJ_4_STATUS "Injector status" UBYTE MC_INJ_4_STATUS 0 0 0 0 ECU_ADDRESS 0x3F9957 /end MEASUREMENT
/begin COMPU_METHOD MC_INJ_4_STATUS "INJ_4_STATUS conversion" RAT_FUNC "%3.0" "Unitless" COEFFS 0 1 0 0 0 1 /end COMPU_METHOD
/begin MEASUREMENT INJ_5_CB_F "Injector #5 cylinder balance fault" UBYTE MC_INJ_5_CB_F 0 0 0 0 ECU_ADDRESS 0x3FB6F5 /end MEASUREMENT
/begin COMPU_METHOD MC_INJ_5_CB_F "INJ_5_CB_F conversion" RAT_FUNC "%3.0" "Unitless" COEFFS 0 1 0 0 0 1 /end COMPU_METHOD
/begin MEASUREMENT INJ_5_CC_O "Injector #5 Close Coil Open" UBYTE MC_INJ_5_CC_O 0 0 0 0 ECU_ADDRESS 0x3FB698 /end MEASUREMENT
/begin COMPU_METHOD MC_INJ_5_CC_O "INJ_5_CC_O conversion" RAT_FUNC "%3.0" "Unitless" COEFFS 0 1 0 0 0 1 /end COMPU_METHOD
/begin MEASUREMENT INJ_5_CC_S "Injector #5 Close Coil Short" UBYTE MC_INJ_5_CC_S 0 0 0 0 ECU_ADDRESS 0x3FB6A0 /end MEASUREMENT
/begin COMPU_METHOD MC_INJ_5_CC_S "INJ_5_CC_S conversion" RAT_FUNC "%3.0" "Unitless" COEFFS 0 1 0 0 0 1 /end COMPU_METHOD
/begin MEASUREMENT INJ_5_CC_SS "Injector #5 Close Coil Side Short" UBYTE MC_INJ_5_CC_SS 0 0 0 0 ECU_ADDRESS 0x3FB6B0 /end MEASUREMENT
/begin COMPU_METHOD MC_INJ_5_CC_SS "INJ_5_CC_SS conversion" RAT_FUNC "%3.0" "Unitless" COEFFS 0 1 0 0 0 1 /end COMPU_METHOD
/begin MEASUREMENT INJ_5_ID_F "Injector #5 ID fault" UBYTE MC_INJ_5_ID_F 0 0 0 0 ECU_ADDRESS 0x3FB6BF /end MEASUREMENT
/begin COMPU_METHOD MC_INJ_5_ID_F "INJ_5_ID_F conversion" RAT_FUNC "%3.0" "Unitless" COEFFS 0 1 0 0 0 1 /end COMPU_METHOD
/begin MEASUREMENT INJ_5_OC_O "Injector #5 Open Coil Open" UBYTE MC_INJ_5_OC_O 0 0 0 0 ECU_ADDRESS 0x3FB688 /end MEASUREMENT
/begin COMPU_METHOD MC_INJ_5_OC_O "INJ_5_OC_O conversion" RAT_FUNC "%3.0" "Unitless" COEFFS 0 1 0 0 0 1 /end COMPU_METHOD
/begin MEASUREMENT INJ_5_OC_S "Injector #5 Open Coil Short" UBYTE MC_INJ_5_OC_S 0 0 0 0 ECU_ADDRESS 0x3FB690 /end MEASUREMENT
/begin COMPU_METHOD MC_INJ_5_OC_S "INJ_5_OC_S conversion" RAT_FUNC "%3.0" "Unitless" COEFFS 0 1 0 0 0 1 /end COMPU_METHOD
/begin MEASUREMENT INJ_5_OC_SS "Injector #5 Open Coil Side Short" UBYTE MC_INJ_5_OC_SS 0 0 0 0 ECU_ADDRESS 0x3FB6A8 /end MEASUREMENT
/begin COMPU_METHOD MC_INJ_5_OC_SS "INJ_5_OC_SS conversion" RAT_FUNC "%3.0" "Unitless" COEFFS 0 1 0 0 0 1 /end COMPU_METHOD
/begin MEASUREMENT INJ_5_STATUS "Injector status" UBYTE MC_INJ_5_STATUS 0 0 0 0 ECU_ADDRESS 0x3F9956 /end MEASUREMENT
/begin COMPU_METHOD MC_INJ_5_STATUS "INJ_5_STATUS conversion" RAT_FUNC "%3.0" "Unitless" COEFFS 0 1 0 0 0 1 /end COMPU_METHOD
/begin MEASUREMENT INJ_6_CB_F "Injector #6 cylinder balance fault" UBYTE MC_INJ_6_CB_F 0 0 0 0 ECU_ADDRESS 0x3FB6F6 /end MEASUREMENT
/begin COMPU_METHOD MC_INJ_6_CB_F "INJ_6_CB_F conversion" RAT_FUNC "%3.0" "Unitless" COEFFS 0 1 0 0 0 1 /end COMPU_METHOD
/begin MEASUREMENT INJ_6_CC_O "Injector #6 Close Coil Open" UBYTE MC_INJ_6_CC_O 0 0 0 0 ECU_ADDRESS 0x3FB699 /end MEASUREMENT
/begin COMPU_METHOD MC_INJ_6_CC_O "INJ_6_CC_O conversion" RAT_FUNC "%3.0" "Unitless" COEFFS 0 1 0 0 0 1 /end COMPU_METHOD
/begin MEASUREMENT INJ_6_CC_S "Injector #6 Close Coil Short" UBYTE MC_INJ_6_CC_S 0 0 0 0 ECU_ADDRESS 0x3FB6A1 /end MEASUREMENT
/begin COMPU_METHOD MC_INJ_6_CC_S "INJ_6_CC_S conversion" RAT_FUNC "%3.0" "Unitless" COEFFS 0 1 0 0 0 1 /end COMPU_METHOD
/begin MEASUREMENT INJ_6_CC_SS "Injector #6 Close Coil Side Short" UBYTE MC_INJ_6_CC_SS 0 0 0 0 ECU_ADDRESS 0x3FB6B1 /end MEASUREMENT
/begin COMPU_METHOD MC_INJ_6_CC_SS "INJ_6_CC_SS conversion" RAT_FUNC "%3.0" "Unitless" COEFFS 0 1 0 0 0 1 /end COMPU_METHOD
/begin MEASUREMENT INJ_6_ID_F "Injector #6 ID fault" UBYTE MC_INJ_6_ID_F 0 0 0 0 ECU_ADDRESS 0x3FB6C0 /end MEASUREMENT
/begin COMPU_METHOD MC_INJ_6_ID_F "INJ_6_ID_F conversion" RAT_FUNC "%3.0" "Unitless" COEFFS 0 1 0 0 0 1 /end COMPU_METHOD
/begin MEASUREMENT INJ_6_OC_O "Injector #6 Open Coil Open" UBYTE MC_INJ_6_OC_O 0 0 0 0 ECU_ADDRESS 0x3FB689 /end MEASUREMENT
/begin COMPU_METHOD MC_INJ_6_OC_O "INJ_6_OC_O conversion" RAT_FUNC "%3.0" "Unitless" COEFFS 0 1 0 0 0 1 /end COMPU_METHOD
/begin MEASUREMENT INJ_6_OC_S "Injector #6 Open Coil Short" UBYTE MC_INJ_6_OC_S 0 0 0 0 ECU_ADDRESS 0x3FB691 /end MEASUREMENT
/begin COMPU_METHOD MC_INJ_6_OC_S "INJ_6_OC_S conversion" RAT_FUNC "%3.0" "Unitless" COEFFS 0 1 0 0 0 1 /end COMPU_METHOD
/begin MEASUREMENT INJ_6_OC_SS "Injector #6 Open Coil Side Short" UBYTE MC_INJ_6_OC_SS 0 0 0 0 ECU_ADDRESS 0x3FB6A9 /end MEASUREMENT
/begin COMPU_METHOD MC_INJ_6_OC_SS "INJ_6_OC_SS conversion" RAT_FUNC "%3.0" "Unitless" COEFFS 0 1 0 0 0 1 /end COMPU_METHOD
/begin MEASUREMENT INJ_6_STATUS "Injector status" UBYTE MC_INJ_6_STATUS 0 0 0 0 ECU_ADDRESS 0x3F9955 /end MEASUREMENT
/begin COMPU_METHOD MC_INJ_6_STATUS "INJ_6_STATUS conversion" RAT_FUNC "%3.0" "Unitless" COEFFS 0 1 0 0 0 1 /end COMPU_METHOD
/begin MEASUREMENT INJ_7_CB_F "Injector #7 cylinder balance fault" UBYTE MC_INJ_7_CB_F 0 0 0 0 ECU_ADDRESS 0x3FB6F7 /end MEASUREMENT
/begin COMPU_METHOD MC_INJ_7_CB_F "INJ_7_CB_F conversion" RAT_FUNC "%3.0" "Unitless" COEFFS 0 1 0 0 0 1 /end COMPU_METHOD
/begin MEASUREMENT INJ_7_CC_O "Injector #7 Close Coil Open" UBYTE MC_INJ_7_CC_O 0 0 0 0 ECU_ADDRESS 0x3FB69A /end MEASUREMENT
/begin COMPU_METHOD MC_INJ_7_CC_O "INJ_7_CC_O conversion" RAT_FUNC "%3.0" "Unitless" COEFFS 0 1 0 0 0 1 /end COMPU_METHOD
/begin MEASUREMENT INJ_7_CC_S "Injector #7 Close Coil Short" UBYTE MC_INJ_7_CC_S 0 0 0 0 ECU_ADDRESS 0x3FB6A2 /end MEASUREMENT
/begin COMPU_METHOD MC_INJ_7_CC_S "INJ_7_CC_S conversion" RAT_FUNC "%3.0" "Unitless" COEFFS 0 1 0 0 0 1 /end COMPU_METHOD
/begin MEASUREMENT INJ_7_CC_SS "Injector #7 Close Coil Side Short" UBYTE MC_INJ_7_CC_SS 0 0 0 0 ECU_ADDRESS 0x3FB6B2 /end MEASUREMENT
/begin COMPU_METHOD MC_INJ_7_CC_SS "INJ_7_CC_SS conversion" RAT_FUNC "%3.0" "Unitless" COEFFS 0 1 0 0 0 1 /end COMPU_METHOD
/begin MEASUREMENT INJ_7_ID_F "Injector #7 ID fault" UBYTE MC_INJ_7_ID_F 0 0 0 0 ECU_ADDRESS 0x3FB6C1 /end MEASUREMENT
/begin COMPU_METHOD MC_INJ_7_ID_F "INJ_7_ID_F conversion" RAT_FUNC "%3.0" "Unitless" COEFFS 0 1 0 0 0 1 /end COMPU_METHOD
/begin MEASUREMENT INJ_7_OC_O "Injector #7 Open Coil Open" UBYTE MC_INJ_7_OC_O 0 0 0 0 ECU_ADDRESS 0x3FB68A /end MEASUREMENT
/begin COMPU_METHOD MC_INJ_7_OC_O "INJ_7_OC_O conversion" RAT_FUNC "%3.0" "Unitless" COEFFS 0 1 0 0 0 1 /end COMPU_METHOD
/begin MEASUREMENT INJ_7_OC_S "Injector #7 Open Coil Short" UBYTE MC_INJ_7_OC_S 0 0 0 0 ECU_ADDRESS 0x3FB692 /end MEASUREMENT
/begin COMPU_METHOD MC_INJ_7_OC_S "INJ_7_OC_S conversion" RAT_FUNC "%3.0" "Unitless" COEFFS 0 1 0 0 0 1 /end COMPU_METHOD
/begin MEASUREMENT INJ_7_OC_SS "Injector #7 Open Coil Side Short" UBYTE MC_INJ_7_OC_SS 0 0 0 0 ECU_ADDRESS 0x3FB6AA /end MEASUREMENT
/begin COMPU_METHOD MC_INJ_7_OC_SS "INJ_7_OC_SS conversion" RAT_FUNC "%3.0" "Unitless" COEFFS 0 1 0 0 0 1 /end COMPU_METHOD
/begin MEASUREMENT INJ_7_STATUS "Injector status" UBYTE MC_INJ_7_STATUS 0 0 0 0 ECU_ADDRESS 0x3F9954 /end MEASUREMENT
/begin COMPU_METHOD MC_INJ_7_STATUS "INJ_7_STATUS conversion" RAT_FUNC "%3.0" "Unitless" COEFFS 0 1 0 0 0 1 /end COMPU_METHOD
/begin MEASUREMENT INJ_8_CB_F "Injector #8 cylinder balance fault" UBYTE MC_INJ_8_CB_F 0 0 0 0 ECU_ADDRESS 0x3FB6F8 /end MEASUREMENT
/begin COMPU_METHOD MC_INJ_8_CB_F "INJ_8_CB_F conversion" RAT_FUNC "%3.0" "Unitless" COEFFS 0 1 0 0 0 1 /end COMPU_METHOD
/begin MEASUREMENT INJ_8_CC_O "Injector #8 Close Coil Open" UBYTE MC_INJ_8_CC_O 0 0 0 0 ECU_ADDRESS 0x3FB69B /end MEASUREMENT
/begin COMPU_METHOD MC_INJ_8_CC_O "INJ_8_CC_O conversion" RAT_FUNC "%3.0" "Unitless" COEFFS 0 1 0 0 0 1 /end COMPU_METHOD
/begin MEASUREMENT INJ_8_CC_S "Injector #8 Close Coil Short" UBYTE MC_INJ_8_CC_S 0 0 0 0 ECU_ADDRESS 0x3FB6A3 /end MEASUREMENT
/begin COMPU_METHOD MC_INJ_8_CC_S "INJ_8_CC_S conversion" RAT_FUNC "%3.0" "Unitless" COEFFS 0 1 0 0 0 1 /end COMPU_METHOD
/begin MEASUREMENT INJ_8_CC_SS "Injector #8 Close Coil Side Short" UBYTE MC_INJ_8_CC_SS 0 0 0 0 ECU_ADDRESS 0x3FB6B3 /end MEASUREMENT
/begin COMPU_METHOD MC_INJ_8_CC_SS "INJ_8_CC_SS conversion" RAT_FUNC "%3.0" "Unitless" COEFFS 0 1 0 0 0 1 /end COMPU_METHOD
/begin MEASUREMENT INJ_8_ID_F "Injector #8 ID fault" UBYTE MC_INJ_8_ID_F 0 0 0 0 ECU_ADDRESS 0x3FB6C2 /end MEASUREMENT
/begin COMPU_METHOD MC_INJ_8_ID_F "INJ_8_ID_F conversion" RAT_FUNC "%3.0" "Unitless" COEFFS 0 1 0 0 0 1 /end COMPU_METHOD
/begin MEASUREMENT INJ_8_OC_O "Injector #8 Open Coil Open" UBYTE MC_INJ_8_OC_O 0 0 0 0 ECU_ADDRESS 0x3FB68B /end MEASUREMENT
/begin COMPU_METHOD MC_INJ_8_OC_O "INJ_8_OC_O conversion" RAT_FUNC "%3.0" "Unitless" COEFFS 0 1 0 0 0 1 /end COMPU_METHOD
/begin MEASUREMENT INJ_8_OC_S "Injector #8 Open Coil Short" UBYTE MC_INJ_8_OC_S 0 0 0 0 ECU_ADDRESS 0x3FB693 /end MEASUREMENT
/begin COMPU_METHOD MC_INJ_8_OC_S "INJ_8_OC_S conversion" RAT_FUNC "%3.0" "Unitless" COEFFS 0 1 0 0 0 1 /end COMPU_METHOD
/begin MEASUREMENT INJ_8_OC_SS "Injector #8 Open Coil Side Short" UBYTE MC_INJ_8_OC_SS 0 0 0 0 ECU_ADDRESS 0x3FB6AB /end MEASUREMENT
/begin COMPU_METHOD MC_INJ_8_OC_SS "INJ_8_OC_SS conversion" RAT_FUNC "%3.0" "Unitless" COEFFS 0 1 0 0 0 1 /end COMPU_METHOD
/begin MEASUREMENT INJ_8_STATUS "Injector status" UBYTE MC_INJ_8_STATUS 0 0 0 0 ECU_ADDRESS 0x3F9953 /end MEASUREMENT
/begin COMPU_METHOD MC_INJ_8_STATUS "INJ_8_STATUS conversion" RAT_FUNC "%3.0" "Unitless" COEFFS 0 1 0 0 0 1 /end COMPU_METHOD
/begin MEASUREMENT INJ_ACTUAL "Word accounting for cylinder cutout in the foreground." UWORD MC_INJ_ACTUAL 0 0 0 0 ECU_ADDRESS 0x3F9CB6 /end MEASUREMENT
/begin COMPU_METHOD MC_INJ_ACTUAL "INJ_ACTUAL conversion" RAT_FUNC "%5.0" "Unitless" COEFFS 0 1 0 0 0 1 /end COMPU_METHOD
/begin CHARACTERISTIC INJ_OFF_OSC_CHANNEL "Injector OFF  IO channel assignment" VALUE 0x5CEF0 SD_UBYTE 0 SC_INJ_OFF_OSC_CHANNEL 0 255 /end CHARACTERISTIC
/begin COMPU_METHOD SC_INJ_OFF_OSC_CHANNEL "INJ_OFF_OSC_CHANNEL conversion" RAT_FUNC "%3.0" "unitless" COEFFS 0 1 0 0 0 1 /end COMPU_METHOD
/begin MEASUREMENT INJ_OFF_OSC_EN_1 "Injector off test is now being executed." UBYTE MC_INJ_OFF_OSC_EN_1 0 0 0 0 ECU_ADDRESS 0x3F9E91 /end MEASUREMENT
/begin COMPU_METHOD MC_INJ_OFF_OSC_EN_1 "INJ_OFF_OSC_EN_1 conversion" RAT_FUNC "%3.0" "Unitless" COEFFS 0 1 0 0 0 1 /end COMPU_METHOD
/begin MEASUREMENT INJ_OFF_OSC_EN_2 "inj. off test abort enable" UBYTE MC_INJ_OFF_OSC_EN_2 0 0 0 0 ECU_ADDRESS 0x3F9E90 /end MEASUREMENT
/begin COMPU_METHOD MC_INJ_OFF_OSC_EN_2 "INJ_OFF_OSC_EN_2 conversion" RAT_FUNC "%3.0" "Unitless" COEFFS 0 1 0 0 0 1 /end COMPU_METHOD
/begin CHARACTERISTIC INJ_OFF_TM "Injector  OFF time limit" VALUE 0x5CEE8 SD_FLOAT32_IEEE 0 SC_INJ_OFF_TM 0 255 /end CHARACTERISTIC
/begin COMPU_METHOD SC_INJ_OFF_TM "INJ_OFF_TM conversion" RAT_FUNC "%10.5" "s" COEFFS 0 1 0 0 0 1 /end COMPU_METHOD
/begin MEASUREMENT INJ_OFF_TMR "Injector turned OFF time for injector OFF test" FLOAT32_IEEE MC_INJ_OFF_TMR 0 0 0 0 ECU_ADDRESS 0x3F9E8C /end MEASUREMENT
/begin COMPU_METHOD MC_INJ_OFF_TMR "INJ_OFF_TMR conversion" RAT_FUNC "%10.5" "Unitless" COEFFS 0 1 0 0 0 1 /end COMPU_METHOD
/begin MEASUREMENT INP1_FNTQ112 "Input to fntq112" FLOAT32_IEEE MC_INP1_FNTQ112 0 0 0 0 ECU_ADDRESS 0x3FAB38 /end MEASUREMENT
/begin COMPU_METHOD MC_INP1_FNTQ112 "INP1_FNTQ112 conversion" RAT_FUNC "%10.5" "Unitless" COEFFS 0 1 0 0 0 1 /end COMPU_METHOD
/begin MEASUREMENT INP2_FNTQ112 "Input to fn_tq112" FLOAT32_IEEE MC_INP2_FNTQ112 0 0 0 0 ECU_ADDRESS 0x3FAB34 /end MEASUREMENT
/begin COMPU_METHOD MC_INP2_FNTQ112 "INP2_FNTQ112 conversion" RAT_FUNC "%10.5" "Unitless" COEFFS 0 1 0 0 0 1 /end COMPU_METHOD
/begin MEASUREMENT INTEGRATOR_ERROR "" FLOAT32_IEEE MC_INTEGRATOR_ERROR 0 0 0 0 ECU_ADDRESS 0x3FB108 /end MEASUREMENT
/begin COMPU_METHOD MC_INTEGRATOR_ERROR "INTEGRATOR_ERROR conversion" RAT_FUNC "%10.5" "Unitless" COEFFS 0 1 0 0 0 1 /end COMPU_METHOD
/begin MEASUREMENT INTEGRATOR_ERROR_OVER_TIME "" FLOAT32_IEEE MC_INTEGRATOR_ERROR_OVER_TIME 0 0 0 0 ECU_ADDRESS 0x3FB104 /end MEASUREMENT
/begin COMPU_METHOD MC_INTEGRATOR_ERROR_OVER_TIME "INTEGRATOR_ERROR_OVER_TIME conversion" RAT_FUNC "%10.5" "Unitless" COEFFS 0 1 0 0 0 1 /end COMPU_METHOD
/begin CHARACTERISTIC INVRT_CPP "Indicates weather read input is inverted,  planned option to cope with unknown PTEC circuit." VALUE 0x5C790 SD_UBYTE 0 SC_INVRT_CPP 0 1 /end CHARACTERISTIC
/begin COMPU_METHOD SC_INVRT_CPP "INVRT_CPP conversion" RAT_FUNC "%3.0" "unitless" COEFFS 0 1 0 0 0 1 /end COMPU_METHOD
/begin CHARACTERISTIC IOCNDESMN_MIN "" VALUE 0x5DA08 SD_FLOAT32_IEEE 0 SC_IOCNDESMN_MIN 0 6000 /end CHARACTERISTIC
/begin COMPU_METHOD SC_IOCNDESMN_MIN "IOCNDESMN_MIN conversion" RAT_FUNC "%10.5" "RPM" COEFFS 0 1 0 0 0 1 /end COMPU_METHOD
/begin CHARACTERISTIC IOCNDESMX_MAX "" VALUE 0x5DA04 SD_FLOAT32_IEEE 0 SC_IOCNDESMX_MAX 0 6000 /end CHARACTERISTIC
/begin COMPU_METHOD SC_IOCNDESMX_MAX "IOCNDESMX_MAX conversion" RAT_FUNC "%10.5" "RPM" COEFFS 0 1 0 0 0 1 /end COMPU_METHOD
/begin CHARACTERISTIC IOC_EGRMNNST "IOC slide bar limiter" VALUE 0x5E570 SD_FLOAT32_IEEE 0 SC_IOC_EGRMNNST 0 1 /end CHARACTERISTIC
/begin COMPU_METHOD SC_IOC_EGRMNNST "IOC_EGRMNNST conversion" RAT_FUNC "%10.5" "unitless" COEFFS 0 1 0 0 0 1 /end COMPU_METHOD
/begin CHARACTERISTIC IOC_EGRMNRUN "IOC slide bar limiter" VALUE 0x5E568 SD_FLOAT32_IEEE 0 SC_IOC_EGRMNRUN 0 1 /end CHARACTERISTIC
/begin COMPU_METHOD SC_IOC_EGRMNRUN "IOC_EGRMNRUN conversion" RAT_FUNC "%10.5" "unitless" COEFFS 0 1 0 0 0 1 /end COMPU_METHOD
/begin CHARACTERISTIC IOC_EGRMXNST "IOC slide bar limiter" VALUE 0x5E56C SD_FLOAT32_IEEE 0 SC_IOC_EGRMXNST 0 1 /end CHARACTERISTIC
/begin COMPU_METHOD SC_IOC_EGRMXNST "IOC_EGRMXNST conversion" RAT_FUNC "%10.5" "unitless" COEFFS 0 1 0 0 0 1 /end COMPU_METHOD
/begin CHARACTERISTIC IOC_EGRMXRUN "IOC slide bar limiter" VALUE 0x5E564 SD_FLOAT32_IEEE 0 SC_IOC_EGRMXRUN 0 1 /end CHARACTERISTIC
/begin COMPU_METHOD SC_IOC_EGRMXRUN "IOC_EGRMXRUN conversion" RAT_FUNC "%10.5" "unitless" COEFFS 0 1 0 0 0 1 /end COMPU_METHOD
/begin CHARACTERISTIC IOC_ICPMNNST "I/O control slide bar limiter." VALUE 0x5DFDC SD_FLOAT32_IEEE 0 SC_IOC_ICPMNNST 0 1 /end CHARACTERISTIC
/begin COMPU_METHOD SC_IOC_ICPMNNST "IOC_ICPMNNST conversion" RAT_FUNC "%10.5" "unitless" COEFFS 0 1 0 0 0 1 /end COMPU_METHOD
/begin CHARACTERISTIC IOC_ICPMNRUN "I/O control slide bar limiter." VALUE 0x5DFD4 SD_FLOAT32_IEEE 0 SC_IOC_ICPMNRUN 0 1 /end CHARACTERISTIC
/begin COMPU_METHOD SC_IOC_ICPMNRUN "IOC_ICPMNRUN conversion" RAT_FUNC "%10.5" "unitless" COEFFS 0 1 0 0 0 1 /end COMPU_METHOD
/begin CHARACTERISTIC IOC_ICPMXNST "I/O control slide bar limiter." VALUE 0x5DFD8 SD_FLOAT32_IEEE 0 SC_IOC_ICPMXNST 0 1 /end CHARACTERISTIC
/begin COMPU_METHOD SC_IOC_ICPMXNST "IOC_ICPMXNST conversion" RAT_FUNC "%10.5" "unitless" COEFFS 0 1 0 0 0 1 /end COMPU_METHOD
/begin CHARACTERISTIC IOC_ICPMXRUN "I/O control slide bar limiter." VALUE 0x5DFD0 SD_FLOAT32_IEEE 0 SC_IOC_ICPMXRUN 0 1 /end CHARACTERISTIC
/begin COMPU_METHOD SC_IOC_ICPMXRUN "IOC_ICPMXRUN conversion" RAT_FUNC "%10.5" "unitless" COEFFS 0 1 0 0 0 1 /end COMPU_METHOD
/begin MEASUREMENT IOC_MODE "Diesel input output control by common identifier mode control" UBYTE MC_IOC_MODE 0 0 0 0 ECU_ADDRESS 0x3FB518 /end MEASUREMENT
/begin COMPU_METHOD MC_IOC_MODE "IOC_MODE conversion" RAT_FUNC "%3.0" "Unitless" COEFFS 0 1 0 0 0 1 /end COMPU_METHOD
/begin CHARACTERISTIC IOC_VFDMNNST "" VALUE 0x5EBFC SD_FLOAT32_IEEE 0 SC_IOC_VFDMNNST 0 100 /end CHARACTERISTIC
/begin COMPU_METHOD SC_IOC_VFDMNNST "IOC_VFDMNNST conversion" RAT_FUNC "%10.5" "unitless" COEFFS 0 1 0 0 0 1 /end COMPU_METHOD
/begin CHARACTERISTIC IOC_VFDMNRUN "" VALUE 0x5EBF4 SD_FLOAT32_IEEE 0 SC_IOC_VFDMNRUN 0 100 /end CHARACTERISTIC
/begin COMPU_METHOD SC_IOC_VFDMNRUN "IOC_VFDMNRUN conversion" RAT_FUNC "%10.5" "unitless" COEFFS 0 1 0 0 0 1 /end COMPU_METHOD
/begin CHARACTERISTIC IOC_VFDMXNST "" VALUE 0x5EBF8 SD_FLOAT32_IEEE 0 SC_IOC_VFDMXNST 0 100 /end CHARACTERISTIC
/begin COMPU_METHOD SC_IOC_VFDMXNST "IOC_VFDMXNST conversion" RAT_FUNC "%10.5" "unitless" COEFFS 0 1 0 0 0 1 /end COMPU_METHOD
/begin CHARACTERISTIC IOC_VFDMXRUN "" VALUE 0x5EBF0 SD_FLOAT32_IEEE 0 SC_IOC_VFDMXRUN 0 100 /end CHARACTERISTIC
/begin COMPU_METHOD SC_IOC_VFDMXRUN "IOC_VFDMXRUN conversion" RAT_FUNC "%10.5" "unitless" COEFFS 0 1 0 0 0 1 /end COMPU_METHOD
/begin CHARACTERISTIC IOC_VGTMNNST "IOC slide bar limiter" VALUE 0x5E9B0 SD_FLOAT32_IEEE 0 SC_IOC_VGTMNNST 0 1 /end CHARACTERISTIC
/begin COMPU_METHOD SC_IOC_VGTMNNST "IOC_VGTMNNST conversion" RAT_FUNC "%10.5" "unitless" COEFFS 0 1 0 0 0 1 /end COMPU_METHOD
/begin CHARACTERISTIC IOC_VGTMNRUN "IOC slide bar limiter" VALUE 0x5E9AC SD_FLOAT32_IEEE 0 SC_IOC_VGTMNRUN 0 1 /end CHARACTERISTIC
/begin COMPU_METHOD SC_IOC_VGTMNRUN "IOC_VGTMNRUN conversion" RAT_FUNC "%10.5" "unitless" COEFFS 0 1 0 0 0 1 /end COMPU_METHOD
/begin CHARACTERISTIC IOC_VGTMXNST "IOC slide bar limiter" VALUE 0x5E9A8 SD_FLOAT32_IEEE 0 SC_IOC_VGTMXNST 0 1 /end CHARACTERISTIC
/begin COMPU_METHOD SC_IOC_VGTMXNST "IOC_VGTMXNST conversion" RAT_FUNC "%10.5" "unitless" COEFFS 0 1 0 0 0 1 /end COMPU_METHOD
/begin CHARACTERISTIC IOC_VGTMXRUN "IOC slide bar limiter" VALUE 0x5E9A4 SD_FLOAT32_IEEE 0 SC_IOC_VGTMXRUN 0 1 /end CHARACTERISTIC
/begin COMPU_METHOD SC_IOC_VGTMXRUN "IOC_VGTMXRUN conversion" RAT_FUNC "%10.5" "unitless" COEFFS 0 1 0 0 0 1 /end COMPU_METHOD
/begin MEASUREMENT IPP "filtered inferred pedal position" FLOAT32_IEEE MC_IPP 0 0 0 0 ECU_ADDRESS 0x3FA71C /end MEASUREMENT
/begin COMPU_METHOD MC_IPP "IPP conversion" RAT_FUNC "%10.5" "Unitless" COEFFS 0 1 0 0 0 1 /end COMPU_METHOD
/begin CHARACTERISTIC IPP_MAX "high limit for filtered inferred pedal position" VALUE 0x5DB88 SD_FLOAT32_IEEE 0 SC_IPP_MAX 0 524288 /end CHARACTERISTIC
/begin COMPU_METHOD SC_IPP_MAX "IPP_MAX conversion" RAT_FUNC "%10.5" "%" COEFFS 0 1 0 0 0 1 /end COMPU_METHOD
/begin CHARACTERISTIC IPP_MIN "Low limit for filtered inferred pedal position" VALUE 0x5DB8C SD_FLOAT32_IEEE 0 SC_IPP_MIN 0 524288 /end CHARACTERISTIC
/begin COMPU_METHOD SC_IPP_MIN "IPP_MIN conversion" RAT_FUNC "%10.5" "%" COEFFS 0 1 0 0 0 1 /end COMPU_METHOD
/begin MEASUREMENT IPP_UFILT "unfiltered inferred pedal position" FLOAT32_IEEE MC_IPP_UFILT 0 0 0 0 ECU_ADDRESS 0x3FA720 /end MEASUREMENT
/begin COMPU_METHOD MC_IPP_UFILT "IPP_UFILT conversion" RAT_FUNC "%10.5" "Unitless" COEFFS 0 1 0 0 0 1 /end COMPU_METHOD
/begin CHARACTERISTIC IPRAM_F_DEC "" VALUE 0x5D69C SD_SLONG 0 SC_IPRAM_F_DEC 0 65535 /end CHARACTERISTIC
/begin COMPU_METHOD SC_IPRAM_F_DEC "IPRAM_F_DEC conversion" RAT_FUNC "%10.0" "unitless" COEFFS 0 1 0 0 0 1 /end COMPU_METHOD
/begin CHARACTERISTIC IPRAM_F_INC "" VALUE 0x5D698 SD_SLONG 0 SC_IPRAM_F_INC 0 65535 /end CHARACTERISTIC
/begin COMPU_METHOD SC_IPRAM_F_INC "IPRAM_F_INC conversion" RAT_FUNC "%10.0" "unitless" COEFFS 0 1 0 0 0 1 /end COMPU_METHOD
/begin MEASUREMENT IPRAM_ORH_CNTR "" SLONG MC_IPRAM_ORH_CNTR 0 0 0 0 ECU_ADDRESS 0x3FA468 /end MEASUREMENT
/begin COMPU_METHOD MC_IPRAM_ORH_CNTR "IPRAM_ORH_CNTR conversion" RAT_FUNC "%10.0" "Unitless" COEFFS 0 1 0 0 0 1 /end COMPU_METHOD
/begin MEASUREMENT IPRAM_STATUS "" UBYTE MC_IPRAM_STATUS 0 0 0 0 ECU_ADDRESS 0x3F9CEE /end MEASUREMENT
/begin COMPU_METHOD MC_IPRAM_STATUS "IPRAM_STATUS conversion" RAT_FUNC "%3.0" "Unitless" COEFFS 0 1 0 0 0 1 /end COMPU_METHOD
/begin MEASUREMENT IPR_FLOW "Injection pressure regulator flow (l/m)" FLOAT32_IEEE MC_IPR_FLOW 0 0 0 0 ECU_ADDRESS 0x3FA9E4 /end MEASUREMENT
/begin COMPU_METHOD MC_IPR_FLOW "IPR_FLOW conversion" RAT_FUNC "%10.5" "Unitless" COEFFS 0 1 0 0 0 1 /end COMPU_METHOD
/begin CHARACTERISTIC IPR_FLW_KPMP "Oil pump gain (l/rev)" VALUE 0x5DFFC SD_FLOAT32_IEEE 0 SC_IPR_FLW_KPMP 0 0.009 /end CHARACTERISTIC
/begin COMPU_METHOD SC_IPR_FLW_KPMP "IPR_FLW_KPMP conversion" RAT_FUNC "%10.5" "unitless" COEFFS 0 1 0 0 0 1 /end COMPU_METHOD
/begin MEASUREMENT ISCFLG "ISC mode indicator flag; idle drive (-2), dashpot (-1), preposition (0), rpm control (1). Lock out mode, (2) is being thrifted." SBYTE MC_ISCFLG 0 0 0 0 ECU_ADDRESS 0x3F9CE7 /end MEASUREMENT
/begin COMPU_METHOD MC_ISCFLG "ISCFLG conversion" RAT_FUNC "%3.0" "Unitless" COEFFS 0 1 0 0 0 1 /end COMPU_METHOD
/begin MEASUREMENT ISC_ER_ENA "Enables Engine running on demand ISC test" UBYTE MC_ISC_ER_ENA 0 0 0 0 ECU_ADDRESS 0x3FB4FC /end MEASUREMENT
/begin COMPU_METHOD MC_ISC_ER_ENA "ISC_ER_ENA conversion" RAT_FUNC "%3.0" "Unitless" COEFFS 0 1 0 0 0 1 /end COMPU_METHOD
/begin CHARACTERISTIC ISC_HI_CHECK "Value for state of ER_STATUS when testing RPM during engine running high speed ISC test" VALUE 0x5F0C0 SD_UBYTE 0 SC_ISC_HI_CHECK 0 100 /end CHARACTERISTIC
/begin COMPU_METHOD SC_ISC_HI_CHECK "ISC_HI_CHECK conversion" RAT_FUNC "%3.0" "unitless" COEFFS 0 1 0 0 0 1 /end COMPU_METHOD
/begin CHARACTERISTIC ISC_HI_DONE "Value for state of ER_STATUS when ISC high rpm test is complete" VALUE 0x5F0BF SD_UBYTE 0 SC_ISC_HI_DONE 0 100 /end CHARACTERISTIC
/begin COMPU_METHOD SC_ISC_HI_DONE "ISC_HI_DONE conversion" RAT_FUNC "%3.0" "unitless" COEFFS 0 1 0 0 0 1 /end COMPU_METHOD
/begin CHARACTERISTIC ISC_HI_WAIT "Value for state of ER_STATUS while waiting for engine running high speed ISC test" VALUE 0x5F0C1 SD_UBYTE 0 SC_ISC_HI_WAIT 0 100 /end CHARACTERISTIC
/begin COMPU_METHOD SC_ISC_HI_WAIT "ISC_HI_WAIT conversion" RAT_FUNC "%3.0" "unitless" COEFFS 0 1 0 0 0 1 /end COMPU_METHOD
/begin CHARACTERISTIC ISC_LO_CHECK "Value for ER_STATUS when performing ISC low rpm test" VALUE 0x5F0BD SD_UBYTE 0 SC_ISC_LO_CHECK 0 100 /end CHARACTERISTIC
/begin COMPU_METHOD SC_ISC_LO_CHECK "ISC_LO_CHECK conversion" RAT_FUNC "%3.0" "unitless" COEFFS 0 1 0 0 0 1 /end COMPU_METHOD
/begin CHARACTERISTIC ISC_LO_DONE "Value for ER_STATUS to indicate that ISC low RPM test is complete" VALUE 0x5F0BC SD_UBYTE 0 SC_ISC_LO_DONE 0 100 /end CHARACTERISTIC
/begin COMPU_METHOD SC_ISC_LO_DONE "ISC_LO_DONE conversion" RAT_FUNC "%3.0" "unitless" COEFFS 0 1 0 0 0 1 /end COMPU_METHOD
/begin CHARACTERISTIC ISC_LO_WAIT "Value for ER_STATUS when waiting for ISC low rpm test" VALUE 0x5F0BE SD_UBYTE 0 SC_ISC_LO_WAIT 0 100 /end CHARACTERISTIC
/begin COMPU_METHOD SC_ISC_LO_WAIT "ISC_LO_WAIT conversion" RAT_FUNC "%3.0" "unitless" COEFFS 0 1 0 0 0 1 /end COMPU_METHOD
/begin CHARACTERISTIC ITHAM_F_DEC "" VALUE 0x5D694 SD_SLONG 0 SC_ITHAM_F_DEC 0 65535 /end CHARACTERISTIC
/begin COMPU_METHOD SC_ITHAM_F_DEC "ITHAM_F_DEC conversion" RAT_FUNC "%10.0" "unitless" COEFFS 0 1 0 0 0 1 /end COMPU_METHOD
/begin CHARACTERISTIC ITHAM_F_INC "" VALUE 0x5D690 SD_SLONG 0 SC_ITHAM_F_INC 0 65535 /end CHARACTERISTIC
/begin COMPU_METHOD SC_ITHAM_F_INC "ITHAM_F_INC conversion" RAT_FUNC "%10.0" "unitless" COEFFS 0 1 0 0 0 1 /end COMPU_METHOD
/begin MEASUREMENT ITHAM_ORH_CNTR "" SLONG MC_ITHAM_ORH_CNTR 0 0 0 0 ECU_ADDRESS 0x3FA464 /end MEASUREMENT
/begin COMPU_METHOD MC_ITHAM_ORH_CNTR "ITHAM_ORH_CNTR conversion" RAT_FUNC "%10.0" "Unitless" COEFFS 0 1 0 0 0 1 /end COMPU_METHOD
/begin MEASUREMENT ITHAM_STATUS "" UBYTE MC_ITHAM_STATUS 0 0 0 0 ECU_ADDRESS 0x3F9838 /end MEASUREMENT
/begin COMPU_METHOD MC_ITHAM_STATUS "ITHAM_STATUS conversion" RAT_FUNC "%3.0" "Unitless" COEFFS 0 1 0 0 0 1 /end COMPU_METHOD
/begin MEASUREMENT ITHP "Intake Throttle Position" FLOAT32_IEEE MC_ITHP 0 0 0 0 ECU_ADDRESS 0x3FA3F0 /end MEASUREMENT
/begin COMPU_METHOD MC_ITHP "ITHP conversion" RAT_FUNC "%10.5" "Unitless" COEFFS 0 1 0 0 0 1 /end COMPU_METHOD
/begin CHARACTERISTIC ITHPZ_CNTS_THLD "" VALUE 0x5C7DC SD_FLOAT32_IEEE 0 SC_ITHPZ_CNTS_THLD 0 1024 /end CHARACTERISTIC
/begin COMPU_METHOD SC_ITHPZ_CNTS_THLD "ITHPZ_CNTS_THLD conversion" RAT_FUNC "%10.5" "unitless" COEFFS 0 1 0 0 0 1 /end COMPU_METHOD
/begin CHARACTERISTIC ITHPZ_DTY_LMN "" VALUE 0x5C7D8 SD_FLOAT32_IEEE 0 SC_ITHPZ_DTY_LMN -1 1 /end CHARACTERISTIC
/begin COMPU_METHOD SC_ITHPZ_DTY_LMN "ITHPZ_DTY_LMN conversion" RAT_FUNC "%10.5" "unitless" COEFFS 0 1 0 0 0 1 /end COMPU_METHOD
/begin CHARACTERISTIC ITHPZ_DTY_LMX "" VALUE 0x5C7D4 SD_FLOAT32_IEEE 0 SC_ITHPZ_DTY_LMX -1 1 /end CHARACTERISTIC
/begin COMPU_METHOD SC_ITHPZ_DTY_LMX "ITHPZ_DTY_LMX conversion" RAT_FUNC "%10.5" "unitless" COEFFS 0 1 0 0 0 1 /end COMPU_METHOD
/begin MEASUREMENT ITHPZ_LRNCLS_C "" UBYTE MC_ITHPZ_LRNCLS_C 0 0 0 0 ECU_ADDRESS 0x3F9A45 /end MEASUREMENT
/begin COMPU_METHOD MC_ITHPZ_LRNCLS_C "ITHPZ_LRNCLS_C conversion" RAT_FUNC "%3.0" "Unitless" COEFFS 0 1 0 0 0 1 /end COMPU_METHOD
/begin MEASUREMENT ITHPZ_LRNOPN_C "" UBYTE MC_ITHPZ_LRNOPN_C 0 0 0 0 ECU_ADDRESS 0x3F9A44 /end MEASUREMENT
/begin COMPU_METHOD MC_ITHPZ_LRNOPN_C "ITHPZ_LRNOPN_C conversion" RAT_FUNC "%3.0" "Unitless" COEFFS 0 1 0 0 0 1 /end COMPU_METHOD
/begin MEASUREMENT ITHPZ_LRN_DTY "" FLOAT32_IEEE MC_ITHPZ_LRN_DTY 0 0 0 0 ECU_ADDRESS 0x3F9A1C /end MEASUREMENT
/begin COMPU_METHOD MC_ITHPZ_LRN_DTY "ITHPZ_LRN_DTY conversion" RAT_FUNC "%10.5" "Unitless" COEFFS 0 1 0 0 0 1 /end COMPU_METHOD
/begin CHARACTERISTIC ITHPZ_MF_MAX "" VALUE 0x5C7D0 SD_FLOAT32_IEEE 0 SC_ITHPZ_MF_MAX 0 350 /end CHARACTERISTIC
/begin COMPU_METHOD SC_ITHPZ_MF_MAX "ITHPZ_MF_MAX conversion" RAT_FUNC "%10.5" "unitless" COEFFS 0 1 0 0 0 1 /end COMPU_METHOD
/begin MEASUREMENT ITHPZ_ML_EN "" UBYTE MC_ITHPZ_ML_EN 0 0 0 0 ECU_ADDRESS 0x3F9A43 /end MEASUREMENT
/begin COMPU_METHOD MC_ITHPZ_ML_EN "ITHPZ_ML_EN conversion" RAT_FUNC "%3.0" "Unitless" COEFFS 0 1 0 0 0 1 /end COMPU_METHOD
/begin CHARACTERISTIC ITHPZ_N_MAX "" VALUE 0x5C7CC SD_FLOAT32_IEEE 0 SC_ITHPZ_N_MAX 0 5500 /end CHARACTERISTIC
/begin COMPU_METHOD SC_ITHPZ_N_MAX "ITHPZ_N_MAX conversion" RAT_FUNC "%10.5" "RPM" COEFFS 0 1 0 0 0 1 /end COMPU_METHOD
/begin CHARACTERISTIC ITHPZ_RUP_STP "" VALUE 0x5C7C8 SD_FLOAT32_IEEE 0 SC_ITHPZ_RUP_STP 0 1 /end CHARACTERISTIC
/begin COMPU_METHOD SC_ITHPZ_RUP_STP "ITHPZ_RUP_STP conversion" RAT_FUNC "%10.5" "unitless" COEFFS 0 1 0 0 0 1 /end COMPU_METHOD
/begin MEASUREMENT ITHPZ_SAMPLE "" UBYTE MC_ITHPZ_SAMPLE 0 0 0 0 ECU_ADDRESS 0x3F9A42 /end MEASUREMENT
/begin COMPU_METHOD MC_ITHPZ_SAMPLE "ITHPZ_SAMPLE conversion" RAT_FUNC "%3.0" "Unitless" COEFFS 0 1 0 0 0 1 /end COMPU_METHOD
/begin CHARACTERISTIC ITHPZ_STL_TM "" VALUE 0x5C7C4 SD_FLOAT32_IEEE 0 SC_ITHPZ_STL_TM 0 500 /end CHARACTERISTIC
/begin COMPU_METHOD SC_ITHPZ_STL_TM "ITHPZ_STL_TM conversion" RAT_FUNC "%10.5" "s" COEFFS 0 1 0 0 0 1 /end COMPU_METHOD
/begin MEASUREMENT ITHPZ_STL_TMR "" FLOAT32_IEEE MC_ITHPZ_STL_TMR 0 0 0 0 ECU_ADDRESS 0x3F9A18 /end MEASUREMENT
/begin COMPU_METHOD MC_ITHPZ_STL_TMR "ITHPZ_STL_TMR conversion" RAT_FUNC "%10.5" "Unitless" COEFFS 0 1 0 0 0 1 /end COMPU_METHOD
/begin CHARACTERISTIC ITHP_AD_TC "Intake Throttle Position filter time constant" VALUE 0x5D5E4 SD_FLOAT32_IEEE 0 SC_ITHP_AD_TC 0 64 /end CHARACTERISTIC
/begin COMPU_METHOD SC_ITHP_AD_TC "ITHP_AD_TC conversion" RAT_FUNC "%10.5" "s" COEFFS 0 1 0 0 0 1 /end COMPU_METHOD
/begin CHARACTERISTIC ITHP_CLSDTY_MN "" VALUE 0x5C7F4 SD_FLOAT32_IEEE 0 SC_ITHP_CLSDTY_MN 0 1 /end CHARACTERISTIC
/begin COMPU_METHOD SC_ITHP_CLSDTY_MN "ITHP_CLSDTY_MN conversion" RAT_FUNC "%10.5" "unitless" COEFFS 0 1 0 0 0 1 /end COMPU_METHOD
/begin MEASUREMENT ITHP_CLS_AVE "" FLOAT32_IEEE MC_ITHP_CLS_AVE 0 0 0 0 ECU_ADDRESS 0x3F9A3C /end MEASUREMENT
/begin COMPU_METHOD MC_ITHP_CLS_AVE "ITHP_CLS_AVE conversion" RAT_FUNC "%10.5" "Unitless" COEFFS 0 1 0 0 0 1 /end COMPU_METHOD
/begin CHARACTERISTIC ITHP_CLS_CNTMX "" VALUE 0x5C800 SD_FLOAT32_IEEE 0 SC_ITHP_CLS_CNTMX 0 500 /end CHARACTERISTIC
/begin COMPU_METHOD SC_ITHP_CLS_CNTMX "ITHP_CLS_CNTMX conversion" RAT_FUNC "%10.5" "unitless" COEFFS 0 1 0 0 0 1 /end COMPU_METHOD
/begin MEASUREMENT ITHP_CLS_CNTR "" FLOAT32_IEEE MC_ITHP_CLS_CNTR 0 0 0 0 ECU_ADDRESS 0x3F9A38 /end MEASUREMENT
/begin COMPU_METHOD MC_ITHP_CLS_CNTR "ITHP_CLS_CNTR conversion" RAT_FUNC "%10.5" "Unitless" COEFFS 0 1 0 0 0 1 /end COMPU_METHOD
/begin CHARACTERISTIC ITHP_CLS_MN "Limit for learned ITH close position" VALUE 0x5C7FC SD_FLOAT32_IEEE 0 SC_ITHP_CLS_MN 0 1023 /end CHARACTERISTIC
/begin COMPU_METHOD SC_ITHP_CLS_MN "ITHP_CLS_MN conversion" RAT_FUNC "%10.5" "unitless" COEFFS 0 1 0 0 0 1 /end COMPU_METHOD
/begin CHARACTERISTIC ITHP_CLS_MX "Limit for learned ITH close position" VALUE 0x5C7F8 SD_FLOAT32_IEEE 0 SC_ITHP_CLS_MX 0 1023 /end CHARACTERISTIC
/begin COMPU_METHOD SC_ITHP_CLS_MX "ITHP_CLS_MX conversion" RAT_FUNC "%10.5" "unitless" COEFFS 0 1 0 0 0 1 /end COMPU_METHOD
/begin MEASUREMENT ITHP_CLS_TOTAL "" FLOAT32_IEEE MC_ITHP_CLS_TOTAL 0 0 0 0 ECU_ADDRESS 0x3F9A34 /end MEASUREMENT
/begin COMPU_METHOD MC_ITHP_CLS_TOTAL "ITHP_CLS_TOTAL conversion" RAT_FUNC "%10.5" "Unitless" COEFFS 0 1 0 0 0 1 /end COMPU_METHOD
/begin MEASUREMENT ITHP_CNTS "" FLOAT32_IEEE MC_ITHP_CNTS 0 0 0 0 ECU_ADDRESS 0x3F9A30 /end MEASUREMENT
/begin COMPU_METHOD MC_ITHP_CNTS "ITHP_CNTS conversion" RAT_FUNC "%10.5" "Unitless" COEFFS 0 1 0 0 0 1 /end COMPU_METHOD
/begin MEASUREMENT ITHP_CNTS_ROC "" FLOAT32_IEEE MC_ITHP_CNTS_ROC 0 0 0 0 ECU_ADDRESS 0x3F9A2C /end MEASUREMENT
/begin COMPU_METHOD MC_ITHP_CNTS_ROC "ITHP_CNTS_ROC conversion" RAT_FUNC "%10.5" "Unitless" COEFFS 0 1 0 0 0 1 /end COMPU_METHOD
/begin CHARACTERISTIC ITHP_DEF "Default FMEM value for intake throttle position" VALUE 0x5D5EC SD_FLOAT32_IEEE 0 SC_ITHP_DEF 0 1 /end CHARACTERISTIC
/begin COMPU_METHOD SC_ITHP_DEF "ITHP_DEF conversion" RAT_FUNC "%10.5" "unitless" COEFFS 0 1 0 0 0 1 /end COMPU_METHOD
/begin MEASUREMENT ITHP_FILT_TIME_CONST "ITHP filter time constant" FLOAT32_IEEE MC_ITHP_FILT_TIME_CONST 0 0 0 0 ECU_ADDRESS 0x3FA3DC /end MEASUREMENT
/begin COMPU_METHOD MC_ITHP_FILT_TIME_CONST "ITHP_FILT_TIME_CONST conversion" RAT_FUNC "%10.5" "Unitless" COEFFS 0 1 0 0 0 1 /end COMPU_METHOD
/begin MEASUREMENT ITHP_FLT_RECOVERY_CNTR "ITHP fault recovery counter" SLONG MC_ITHP_FLT_RECOVERY_CNTR 0 0 0 0 ECU_ADDRESS 0x3FA3C8 /end MEASUREMENT
/begin COMPU_METHOD MC_ITHP_FLT_RECOVERY_CNTR "ITHP_FLT_RECOVERY_CNTR conversion" RAT_FUNC "%10.0" "Unitless" COEFFS 0 1 0 0 0 1 /end COMPU_METHOD
/begin MEASUREMENT ITHP_FLT_RECOVERY_FLG "1-> Indicates ITHP fault recovery is occuring" UBYTE MC_ITHP_FLT_RECOVERY_FLG 0 0 0 0 ECU_ADDRESS 0x3FA3FD /end MEASUREMENT
/begin COMPU_METHOD MC_ITHP_FLT_RECOVERY_FLG "ITHP_FLT_RECOVERY_FLG conversion" RAT_FUNC "%3.0" "Unitless" COEFFS 0 1 0 0 0 1 /end COMPU_METHOD
/begin CHARACTERISTIC ITHP_F_DEC "ITHP malf failure/update counter decrement value" VALUE 0x5D604 SD_SLONG 0 SC_ITHP_F_DEC 0 65535 /end CHARACTERISTIC
/begin COMPU_METHOD SC_ITHP_F_DEC "ITHP_F_DEC conversion" RAT_FUNC "%10.0" "unitless" COEFFS 0 1 0 0 0 1 /end COMPU_METHOD
/begin CHARACTERISTIC ITHP_F_INC "ITHP ORH/ORL failure counter increment value" VALUE 0x5D608 SD_SLONG 0 SC_ITHP_F_INC 0 65535 /end CHARACTERISTIC
/begin COMPU_METHOD SC_ITHP_F_INC "ITHP_F_INC conversion" RAT_FUNC "%10.0" "unitless" COEFFS 0 1 0 0 0 1 /end COMPU_METHOD
/begin MEASUREMENT ITHP_F_ORH "Intake Throttle Position Out of range high flag" UBYTE MC_ITHP_F_ORH 0 0 0 0 ECU_ADDRESS 0x3FA403 /end MEASUREMENT
/begin COMPU_METHOD MC_ITHP_F_ORH "ITHP_F_ORH conversion" RAT_FUNC "%3.0" "Unitless" COEFFS 0 1 0 0 0 1 /end COMPU_METHOD
/begin MEASUREMENT ITHP_F_ORL "Intake Throttle Position Out of range low flag" UBYTE MC_ITHP_F_ORL 0 0 0 0 ECU_ADDRESS 0x3FA402 /end MEASUREMENT
/begin COMPU_METHOD MC_ITHP_F_ORL "ITHP_F_ORL conversion" RAT_FUNC "%3.0" "Unitless" COEFFS 0 1 0 0 0 1 /end COMPU_METHOD
/begin MEASUREMENT ITHP_MALF_SET "Indicate ITHP malf  high or low failure" UBYTE MC_ITHP_MALF_SET 0 0 0 0 ECU_ADDRESS 0x3FA3FF /end MEASUREMENT
/begin COMPU_METHOD MC_ITHP_MALF_SET "ITHP_MALF_SET conversion" RAT_FUNC "%3.0" "Unitless" COEFFS 0 1 0 0 0 1 /end COMPU_METHOD
/begin CHARACTERISTIC ITHP_OPDTY_MN "" VALUE 0x5C7F0 SD_FLOAT32_IEEE 0 SC_ITHP_OPDTY_MN 0 1 /end CHARACTERISTIC
/begin COMPU_METHOD SC_ITHP_OPDTY_MN "ITHP_OPDTY_MN conversion" RAT_FUNC "%10.5" "unitless" COEFFS 0 1 0 0 0 1 /end COMPU_METHOD
/begin MEASUREMENT ITHP_OPN_AVE "" FLOAT32_IEEE MC_ITHP_OPN_AVE 0 0 0 0 ECU_ADDRESS 0x3F9A28 /end MEASUREMENT
/begin COMPU_METHOD MC_ITHP_OPN_AVE "ITHP_OPN_AVE conversion" RAT_FUNC "%10.5" "Unitless" COEFFS 0 1 0 0 0 1 /end COMPU_METHOD
/begin CHARACTERISTIC ITHP_OPN_CNTMX "" VALUE 0x5C7EC SD_FLOAT32_IEEE 0 SC_ITHP_OPN_CNTMX 0 500 /end CHARACTERISTIC
/begin COMPU_METHOD SC_ITHP_OPN_CNTMX "ITHP_OPN_CNTMX conversion" RAT_FUNC "%10.5" "unitless" COEFFS 0 1 0 0 0 1 /end COMPU_METHOD
/begin MEASUREMENT ITHP_OPN_CNTR "" FLOAT32_IEEE MC_ITHP_OPN_CNTR 0 0 0 0 ECU_ADDRESS 0x3F9A24 /end MEASUREMENT
/begin COMPU_METHOD MC_ITHP_OPN_CNTR "ITHP_OPN_CNTR conversion" RAT_FUNC "%10.5" "Unitless" COEFFS 0 1 0 0 0 1 /end COMPU_METHOD
/begin CHARACTERISTIC ITHP_OPN_MN "" VALUE 0x5C7E8 SD_FLOAT32_IEEE 0 SC_ITHP_OPN_MN 0 1023 /end CHARACTERISTIC
/begin COMPU_METHOD SC_ITHP_OPN_MN "ITHP_OPN_MN conversion" RAT_FUNC "%10.5" "unitless" COEFFS 0 1 0 0 0 1 /end COMPU_METHOD
/begin CHARACTERISTIC ITHP_OPN_MX "Learned ITHP limit" VALUE 0x5C7E4 SD_FLOAT32_IEEE 0 SC_ITHP_OPN_MX 0 1023 /end CHARACTERISTIC
/begin COMPU_METHOD SC_ITHP_OPN_MX "ITHP_OPN_MX conversion" RAT_FUNC "%10.5" "unitless" COEFFS 0 1 0 0 0 1 /end COMPU_METHOD
/begin RECORD_LAYOUT SD_UBYTE FNC_VALUES 1 UBYTE ROW_DIR DIRECT /end RECORD_LAYOUT
/begin RECORD_LAYOUT SD_UWORD FNC_VALUES 1 UWORD ROW_DIR DIRECT /end RECORD_LAYOUT
/begin RECORD_LAYOUT SD_SLONG FNC_VALUES 1 SLONG ROW_DIR DIRECT /end RECORD_LAYOUT
/begin RECORD_LAYOUT SD_FLOAT32_IEEE FNC_VALUES 1 FLOAT32_IEEE ROW_DIR DIRECT /end RECORD_LAYOUT
/begin RECORD_LAYOUT FD_FLOAT32_IEEE AXIS_PTS_X 1 FLOAT32_IEEE INDEX_INCR DIRECT FNC_VALUES 2 FLOAT32_IEEE ALTERNATE_WITH_X DIRECT /end RECORD_LAYOUT
/begin RECORD_LAYOUT TD_FLOAT32_IEEE FNC_VALUES 1 FLOAT32_IEEE ROW_DIR DIRECT /end RECORD_LAYOUT
/end MODULE
/end PROJECT
