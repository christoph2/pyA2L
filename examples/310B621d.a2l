/* Erstellt von DAMOS++ V1.13 */
ASAP2_VERSION 1 21
/begin PROJECT Brs_6Zylinder "310B6"
/begin HEADER "" VERSION "_310B621d" PROJECT_NO Brs_6Zylinder /end HEADER
/begin MODULE DIM ""
/begin MOD_PAR "310B6" VERSION "" ADDR_EPK 0x10002 EPK "38/1/MS3.1/31/00//310B621d/D310B621d//" CUSTOMER_NO "31" USER "K3/MSD1 Schnee" PHONE_NO "" CPU_TYPE "S80166" ECU "MS3.1"
 /begin MEMORY_LAYOUT PRG_CODE 0x0 0x10000 -1 -1 -1 -1 -1 /begin IF_DATA ASAP1B_KWP2000 DP_BLOB 0x0 0x10000 /end IF_DATA /begin IF_DATA ETK ADDR_MAPPING 0x0 0x0 0x10000 /end IF_DATA /end MEMORY_LAYOUT
 /begin MEMORY_LAYOUT PRG_CODE 0x18000 0x68000 -1 -1 -1 -1 -1 /begin IF_DATA ASAP1B_KWP2000 DP_BLOB 0x18000 0x68000 /end IF_DATA /begin IF_DATA ETK ADDR_MAPPING 0x18000 0x18000 0x68000 /end IF_DATA /end MEMORY_LAYOUT
 /begin MEMORY_LAYOUT PRG_DATA 0x10000 0x8000 -1 -1 -1 -1 -1 /begin IF_DATA ASAP1B_KWP2000 DP_BLOB 0x10000 0x8000 /end IF_DATA /begin IF_DATA ETK ADDR_MAPPING 0x10000 0x10000 0x8000 /end IF_DATA /end MEMORY_LAYOUT
 SYSTEM_CONSTANT "EPK_MAX_LEN" "50"
 SYSTEM_CONSTANT "FREQ_CPU" "20000"
 SYSTEM_CONSTANT "PRESCALER" "5"
 SYSTEM_CONSTANT "SWOFFDL_REQUEST_MASK" "44"
 SYSTEM_CONSTANT "SY_2SG" "0"
 SYSTEM_CONSTANT "SY_ASICRUNTIME" "1"
 SYSTEM_CONSTANT "SY_ASR" "0"
 SYSTEM_CONSTANT "SY_DFPMENV" "2"
 SYSTEM_CONSTANT "SY_DFPMTIM" "2"
 SYSTEM_CONSTANT "SY_DFPMVAR" "3"
 SYSTEM_CONSTANT "SY_EGFE" "8"
 SYSTEM_CONSTANT "SY_ENVBLOK" "2"
 SYSTEM_CONSTANT "SY_ERCOS_TIMER_INPUT_SEL" "5"
 SYSTEM_CONSTANT "SY_ERCOS_TIMER_PRESCALER" "256"
 SYSTEM_CONSTANT "SY_FCMSIZE" "10"
 SYSTEM_CONSTANT "SY_FFESIZE" "0"
 SYSTEM_CONSTANT "SY_FIAF3" "0"
 SYSTEM_CONSTANT "SY_FREQ_CPU" "20000"
 SYSTEM_CONSTANT "SY_GRUNDWERT" "78"
 SYSTEM_CONSTANT "SY_HYBRID" "1"
 SYSTEM_CONSTANT "SY_INGASOS" "8"
 SYSTEM_CONSTANT "SY_INJTIM_PRE" "64"
 SYSTEM_CONSTANT "SY_KORRZ" "1"
 SYSTEM_CONSTANT "SY_KRMFTIM_PRE" "64"
 SYSTEM_CONSTANT "SY_KS1" "0"
 SYSTEM_CONSTANT "SY_KS2" "1"
 SYSTEM_CONSTANT "SY_KS3" "5"
 SYSTEM_CONSTANT "SY_KS4" "5"
 SYSTEM_CONSTANT "SY_LAMBTS" "0"
 SYSTEM_CONSTANT "SY_MAX_EV" "6"
 SYSTEM_CONSTANT "SY_MEMORYEXT" "1"
 SYSTEM_CONSTANT "SY_MEMORYINT" "0"
 SYSTEM_CONSTANT "SY_NMOT" "0"
 SYSTEM_CONSTANT "SY_NWS" "0"
 SYSTEM_CONSTANT "SY_OVERSIZE" "2"
 SYSTEM_CONSTANT "SY_PH2OFST" "0"
 SYSTEM_CONSTANT "SY_PHTWIN" "0"
 SYSTEM_CONSTANT "SY_REDMX" "6"
 SYSTEM_CONSTANT "SY_REVTIM_PRE" "16"
 SYSTEM_CONSTANT "SY_STEREO" "1"
 SYSTEM_CONSTANT "SY_STERHK" "0"
 SYSTEM_CONSTANT "SY_STERVK" "1"
 SYSTEM_CONSTANT "SY_STETLR" "1"
 SYSTEM_CONSTANT "SY_SU" "0"
 SYSTEM_CONSTANT "SY_TEBF" "0"
 SYSTEM_CONSTANT "SY_TFA" "0"
 SYSTEM_CONSTANT "SY_TFMA" "1"
 SYSTEM_CONSTANT "SY_TFMAP" "0"
 SYSTEM_CONSTANT "SY_TFMO" "1"
 SYSTEM_CONSTANT "SY_TFWL" "0"
 SYSTEM_CONSTANT "SY_TIMER1_PRESCALER" "16"
 SYSTEM_CONSTANT "SY_TIMER8_PRESCALER" "64"
 SYSTEM_CONSTANT "SY_TN" "1"
 SYSTEM_CONSTANT "SY_TURBO" "0"
 SYSTEM_CONSTANT "SY_UB13V" "191"
 SYSTEM_CONSTANT "SY_USOFF" "204"
 SYSTEM_CONSTANT "SY_WMAX" "72"
 SYSTEM_CONSTANT "SY_WMIN" "-30"
 SYSTEM_CONSTANT "SY_WNBM" "6"
 SYSTEM_CONSTANT "SY_ZAS" "0"
 SYSTEM_CONSTANT "SY_ZYLZA" "6" /end MOD_PAR
/begin MOD_COMMON "" BYTE_ORDER MSB_LAST S_REC_LAYOUT DAMOS /end MOD_COMMON
/begin IF_DATA ASAP1B_KWP2000
 /begin SOURCE "timeslot" 0 0 QP_BLOB 0 BLOCKMODE 0xF0 0 20 /end SOURCE
 /begin TP_BLOB /* Blob version */ 0x100 /* ECU address on k line */ 0x11 /* requ. tester address */ 0xF1 /* ECU stimulation mode */ WuP /* byte order */ MSB_LAST 1 /* project base address */ 0x00000 SERAM /* SERAM_A */ 0x10000 /* SERAM_O */ 0x10000 /* SERAM_U */ 0x13FFF /* SERAM_E */ 0x17FFF /* Flash address */ 0x000000 /* RAM address */ 0x000000 /* Data Read */ 1 /* Code Verify */ 1 /* Code Read */ 1 /* Load mode */ 1 /begin CHECKSUM 0x010201 1 1 RequestRoutineResults RNC_RESULT 0x23 /end CHECKSUM
  /begin FLASH_COPY TOOLFLASHBACK 3 RequestRoutineResults RAM_InitByECU 0x86 COPY_FRAME 1 RNC_RESULT 0x23 0xFB 0xFC COPY_PARA 1 /end FLASH_COPY
  BAUD_DEF /* first entry: default for DAM */ 105600 0x86 0x81 BAUD_DEF 211200 0x86 0xA1 BAUD_DEF 156250 0x86 0x91 BAUD_DEF 125000 0x86 0x87 BAUD_DEF 10400 0x86 0x14 TIME_DEF /* p1Max */ 0x0001 /* p2Min */ 0x0000 /* p2Max */ 0x0032 /* p3Min */ 0x0003 /* p3Max */ 0x0200 /* p4Min */ 0x0000 TIME_DEF /* p1Max */ 0x0001 /* p2Min */ 0x0000 /* p2Max */ 0x0032 /* p3Min */ 0x0003 /* p3Max */ 0x0200 /* p4Min */ 0x0001 SECURITY_ACCESS /* access mode */ 1 /* calc. method */ 1 /* delaytime */ 0 /end TP_BLOB
/end IF_DATA
/* --- AgI-Objekt für ETK (ASAP V1.3B0), Stand 1.5 2.11.98 (Moser) --- */
/begin IF_DATA ETK
 /begin TP_BLOB /*version:*/ 0x1000001 /*pba:*/ 0x0 /*reset_cfg:*/ 0xFFFFFF07
  /begin DISTAB_CFG /*dsptab:*/ 0xC /*dat_mod:*/ 0x1 /*rfg:*/ 0x1 /*trgsegad:*/ 0x383F00 /*trg_cfg:*/ 0x1020100 TRG_MOD /*Id:*/ 0x0 /*trg_mod:*/ 0x27 0x0 0x0 0x0 /end DISTAB_CFG
  CODE_CHK /*prg_data:*/ 0x0 /*prg_length:*/ 0x0 /*prg_eram:*/ 0x0 /*prg_length:*/ 0x0 ETK_CFG 0x2 0xfe 0x6e 0xff 0xff 0x6e 0xff 0xff 0x6e 0xff 0xfb 0xfe 0xff 0xff 0xff 0xff 0xff 0xff 0xff 0xff 0x3 0xff 0xff 0xff /* EMU_RAM start_addr length CS offset >>>>> (multiple) */ /* EMU_DATA start_addr length CS offset >>>>> (multiple) */ /* EMU_CODE start_addr length CS offset >>>>> (multiple) */ /* RESERVED start_addr length CS offset >>>>> (multiple) */ RESERVED /*start_addr:*/ 0x17F60 0x64 EXTERN -1 -1 -1 -1 -1 ETK_MAILBOX /*pattern:*/ 0x55555555 /*page_ecu:*/ DATA /*ecu_adr:*/ 0x600000 /*..length:*/ 0x8000 /*page_am:*/ EXRAM /*am_adr:*/ 0x620000 /*..length:*/ 0x8000 /end TP_BLOB
 /begin SOURCE "Synchro" 103 1 QP_BLOB 1 0xC 0x17F60 0x380974 0x383F36 0 0 0 /end SOURCE
 /begin SOURCE "10ms" 4 1 QP_BLOB 2 0x1C 0x17F76 0x38097E 0x383F38 10 0 0 /end SOURCE
 /begin SOURCE "100ms" 5 1 QP_BLOB 3 0x24 0x17FAC 0x380998 0x383F3A 100 0 0 /end SOURCE
/end IF_DATA
/begin AXIS_PTS SNM08__UB "Stützstellenverteilung Drehzahl, 8 Sst." 0x1007F nmot SstAUbSstUb 10200 nmot_ub_q40 8 0 10200 DEPOSIT ABSOLUTE /end AXIS_PTS
/begin AXIS_PTS STM05SAUB "Stützstellenverteilung" 0x10072 tmot SstAUbSstUb 191.25 temp_ub_q0p75_o48 5 -48 143.25 DEPOSIT ABSOLUTE /end AXIS_PTS
/begin AXIS_PTS SNM16CIUB "Stützstellenverteilung Drehzahl, 16 Sst." 0x10095 nmot SstAUbSstUb 10200 nmot_ub_q40 16 0 10200 DEPOSIT ABSOLUTE /end AXIS_PTS
/begin AXIS_PTS SML07TMUW "Stützstellenverteilung, Luftmasse, 7 Stützstellen" 0x11BD8 ml_w SstAUwSstUw 6553.5 m_uw_b6553p5 7 0 6553.5 DEPOSIT ABSOLUTE /end AXIS_PTS
/begin CHARACTERISTIC CWDDU "Codewort für Freischalten der DDU" VALUE 0x1010D KwUb 255 dez 0 255 FORMAT "%5.1" /end CHARACTERISTIC
/begin CHARACTERISTIC CL30LINE "30. Linie der Klassentabelle" VAL_BLK 0x11DE0 KwbUb 255 dez 0 255 FORMAT "%5.1" NUMBER 13 /end CHARACTERISTIC
/begin CHARACTERISTIC CL31LINE "31. Linie der Klassentabelle" VAL_BLK 0x11DEE KwbUb 255 dez 0 255 FORMAT "%5.1" NUMBER 13 /end CHARACTERISTIC
/begin CHARACTERISTIC CL32LINE "32. Linie der Klassentabelle" VAL_BLK 0x11DFC KwbUb 255 dez 0 255 FORMAT "%5.1" NUMBER 13 /end CHARACTERISTIC
/begin CHARACTERISTIC CL33LINE "33. Linie der Klassentabelle" VAL_BLK 0x11E0A KwbUb 255 dez 0 255 FORMAT "%5.1" NUMBER 13 /end CHARACTERISTIC
/begin CHARACTERISTIC CL34LINE "34. Linie der Klassentabelle" VAL_BLK 0x11E18 KwbUb 255 dez 0 255 FORMAT "%5.1" NUMBER 13 /end CHARACTERISTIC
/begin CHARACTERISTIC CL35LINE "35. Linie der Klassentabelle" VAL_BLK 0x11E26 KwbUb 255 dez 0 255 FORMAT "%5.1" NUMBER 13 /end CHARACTERISTIC
/begin CHARACTERISTIC CL36LINE "36. Linie der Klassentabelle" VAL_BLK 0x11E34 KwbUb 255 dez 0 255 FORMAT "%5.1" NUMBER 13 /end CHARACTERISTIC
/begin CHARACTERISTIC CL37LINE "37. Linie der Klassentabelle" VAL_BLK 0x11E42 KwbUb 255 dez 0 255 FORMAT "%5.1" NUMBER 13 /end CHARACTERISTIC
/begin CHARACTERISTIC CL38LINE "38. Linie der Klassentabelle" VAL_BLK 0x11E50 KwbUb 255 dez 0 255 FORMAT "%5.1" NUMBER 13 /end CHARACTERISTIC
/begin CHARACTERISTIC CL39LINE "39. Linie der Klassentabelle" VAL_BLK 0x11E5E KwbUb 255 dez 0 255 FORMAT "%5.1" NUMBER 13 /end CHARACTERISTIC
/begin CHARACTERISTIC TWBDCY "Wartezeit für Erkennung Bedingung 'driving cycle'" VALUE 0x1010E KwUb 51 t200msxs_ub_b51 0 51 FORMAT "%5.2" /end CHARACTERISTIC
/begin CHARACTERISTIC CLRFSP "Löschen Fehlerspeicher" VALUE 0x1010F KwUb 255 dez 0 255 FORMAT "%5.1" /end CHARACTERISTIC
/begin CHARACTERISTIC NDDKST "DKG-Fehlererkennung; Drehzahlschwelle Start" VALUE 0x101CB KwUb 10200 nmot_ub_q40 0 10200 FORMAT "%5.0" /end CHARACTERISTIC
/begin CHARACTERISTIC TDDK "Entprellzeit DKG-(Nebenlastsignal-)Fehlererkennung" VALUE 0x101CC KwUb 25.5 t100msxs_ub_b25p5 0 25.5 FORMAT "%5.2" /end CHARACTERISTIC
/begin CHARACTERISTIC TDDKNF "Entprellzeit DKG-(Nebenlastsignal-)Diagnose mit i.O.-Meldung" VALUE 0x101CD KwUb 25.5 t100msxs_ub_b25p5 0 25.5 FORMAT "%5.2" /end CHARACTERISTIC
/begin CHARACTERISTIC TDDKST "Entprellzeit DKG-(Nebenlastsignal-)Fehlererkennung im Start" VALUE 0x101CE KwUb 25.5 t100msxs_ub_b25p5 0 25.5 FORMAT "%5.2" /end CHARACTERISTIC
/begin CHARACTERISTIC WDKDU "Winkel Drosselklappe Diagnose unten" VALUE 0x101D0 KwUb 100 relDK_ub_b100 0 100 FORMAT "%5.1" /end CHARACTERISTIC
/begin CHARACTERISTIC WDKDO "Winkel Drosselklappe Diagnose oben" VALUE 0x101CF KwUb 100 relDK_ub_b100 0 100 FORMAT "%5.1" /end CHARACTERISTIC
/begin CHARACTERISTIC CDTDK "Codewort Tester: DK - Potentiometer" VALUE 0x11EEC KwUw 65535 dez 0 65535 FORMAT "%8.2" /end CHARACTERISTIC
/begin CHARACTERISTIC CLADK "Fehlerklasse: DK- Potentiometer" VALUE 0x10114 KwUb 255 dez 0 255 FORMAT "%5.1" /end CHARACTERISTIC
/begin CHARACTERISTIC TSFDK "Fehlersummenzeit: DK - Potentiometer" VALUE 0x1019E KwUb 255 dez 0 255 FORMAT "%5.1" /end CHARACTERISTIC
/begin CHARACTERISTIC CDKDK "Codewort Kunde: DK - Potentiometer" VALUE 0x11E90 KwUw 65535 dez 0 65535 FORMAT "%8.2" /end CHARACTERISTIC
/begin CHARACTERISTIC FFTDK "Freeze Frame Tabelle: DK- Potentiometer" VAL_BLK 0x10146 KwbUb 255 dez 0 255 FORMAT "%5.1" NUMBER 2 /end CHARACTERISTIC
/begin CHARACTERISTIC ZNGFIL "Zeitkonstante für Drehzahlgradient-Filter" VALUE 0x11F70 KwUw 655.35 zk10msxs_uw_b655 0.0100002 655.36 FORMAT "%8.4" /end CHARACTERISTIC
/begin CHARACTERISTIC NMIN "Minimal Drehzahl" VALUE 0x11F72 KwUw 16383.8 nmot_uw_q0p25 0 16383.8 FORMAT "%8.2" /end CHARACTERISTIC
/begin CHARACTERISTIC PGFLWA "Anzahl PG-Flankenwechsel für DG-Fehler B_signal" VALUE 0x101FF KwUb 255 DEZ 0 255 FORMAT "%5.1" /end CHARACTERISTIC
/begin CHARACTERISTIC CDTN "Codewort Tester: Drehzahlsignalgeber" VALUE 0x11F28 KwUw 65535 dez 0 65535 FORMAT "%8.2" /end CHARACTERISTIC
/begin CHARACTERISTIC CLAN "Fehlerklasse: Drehzahlgeber" VALUE 0x10132 KwUb 255 dez 0 255 FORMAT "%5.1" /end CHARACTERISTIC
/begin CHARACTERISTIC TSFN "Fehlersummenzeit: Drehzahlgeber" VALUE 0x101BC KwUb 255 dez 0 255 FORMAT "%5.1" /end CHARACTERISTIC
/begin CHARACTERISTIC CDKN "Codewort Kunde: Drehzahlsignalgeber" VALUE 0x11ECC KwUw 65535 dez 0 65535 FORMAT "%8.2" /end CHARACTERISTIC
/begin CHARACTERISTIC FFTN "Freeze Frame Tabelle: Drehzahlgeber" VAL_BLK 0x10182 KwbUb 255 dez 0 255 FORMAT "%5.1" NUMBER 2 /end CHARACTERISTIC
/begin CHARACTERISTIC CDTBM "Codewort Tester: Bezugsmarkengeber" VALUE 0x11EEA KwUw 65535 dez 0 65535 FORMAT "%8.2" /end CHARACTERISTIC
/begin CHARACTERISTIC CLABM "Fehlerklasse: Bezugsmarkengeber" VALUE 0x10113 KwUb 255 dez 0 255 FORMAT "%5.1" /end CHARACTERISTIC
/begin CHARACTERISTIC TSFBM "Fehlersummenzeit: Bezugsmarkengeber" VALUE 0x1019D KwUb 255 dez 0 255 FORMAT "%5.1" /end CHARACTERISTIC
/begin CHARACTERISTIC CDKBM "Codewort Kunde: Bezugsmarkengeber" VALUE 0x11E8E KwUw 65535 dez 0 65535 FORMAT "%8.2" /end CHARACTERISTIC
/begin CHARACTERISTIC FFTBM "Freeze Frame Tabelle: Bezugsmarkengeber" VAL_BLK 0x10144 KwbUb 255 dez 0 255 FORMAT "%5.1" NUMBER 2 /end CHARACTERISTIC
/begin CHARACTERISTIC CWATM "Codewort für Abgastemperaturmodell" VALUE 0x1023A KwUb 255 dez 0 255 FORMAT "%5.1" /end CHARACTERISTIC
/begin CHARACTERISTIC TMATMTH "Motortemperaturschwelle, oberhalb Kattemperatur auf warm stellen (300 Grad C)" VALUE 0x10238 KwUb 191.25 temp_ub_q0p75_o48 -48 143.25 FORMAT "%5.1" /end CHARACTERISTIC
/begin CHARACTERISTIC TATMTH "Abgas- und Katalysatortemperatur bei Motor-Warmstart (TMOT > 85 Grad C)" VALUE 0x10234 KwUb 1275 temp_ub_q5_o50 -50 1225 FORMAT "%5.0" /end CHARACTERISTIC
/begin CHARACTERISTIC TATMTP "Abgastaupunkttemperatur" VALUE 0x10236 KwUb 1275 temp_ub_q5_o50 -50 1225 FORMAT "%5.0" /end CHARACTERISTIC
/begin CHARACTERISTIC TMATMTP "Motortemperaturschwelle, oberhalb Abschaltung Taupunktfunktion" VALUE 0x10239 KwUb 191.25 temp_ub_q0p75_o48 -48 143.25 FORMAT "%5.1" /end CHARACTERISTIC
/begin CHARACTERISTIC TATMSA "Abgastemperatur bei Schubabschneiden" VALUE 0x10233 KwUb 1275 temp_ub_q5_o50 -50 1225 FORMAT "%5.0" /end CHARACTERISTIC
/begin CHARACTERISTIC TATMWMK "Temperaturoffset  für Wärmemengenberechnung" VALUE 0x10237 KwSb 1275 temp_q5 -640 635 FORMAT "%5.1" /end CHARACTERISTIC
/begin CHARACTERISTIC TATMTMOT "Motortemperatur warmer Motor , für Temperaturkorrektur beim Kaltstart" VALUE 0x10235 KwUb 191.25 temp_ub_q0p75_o48 -48 143.25 FORMAT "%5.1" /end CHARACTERISTIC
/begin CHARACTERISTIC ATMTANS "Temperaturkorrektur der Abgas-Modell-Temperatur" CURVE 0x11F74 KlAUbSstUbWSb 1275 temp_q5 -640 635 FORMAT "%5.1"
 /begin AXIS_DESCR STD_AXIS tans temp_ub_q0p75_o48 3 -48 143.25 DEPOSIT ABSOLUTE /end AXIS_DESCR
/end CHARACTERISTIC
/begin CHARACTERISTIC ZATMAML "Zeitkonstante fuer Abgastemperaturmodell" CURVE 0x1200A GklWUw 13107 zk200msxs_uw_b13107 0.200003 13107.2 FORMAT "%10.4"
 /begin AXIS_DESCR COM_AXIS ml_w m_uw_b6553p5 7 0 6553.5 AXIS_PTS_REF SML07TMUW /end AXIS_DESCR
/end CHARACTERISTIC
/begin CHARACTERISTIC KFWMABG "Kennfeld für Wärmemengen-Schwellwert Taupunktende Abgas" MAP 0x11FAE KfAxUbAyUbSstxUbSstyUwWUw 3712 q_uw_q0p0566 0 3712 FORMAT "%8.3"
 /begin AXIS_DESCR STD_AXIS tans temp_ub_q0p75_o48 5 -48 143.25 DEPOSIT ABSOLUTE /end AXIS_DESCR
 /begin AXIS_DESCR STD_AXIS tmst temp_ub_q0p75_o48 7 -48 49103.3 DEPOSIT ABSOLUTE /end AXIS_DESCR
/end CHARACTERISTIC
/begin CHARACTERISTIC KFATMLA "Kennfeld Abgastemperatur-Korrektur = f(Lambda)" MAP 0x11F7C KfAxUbAyUbSstxUbSstyUbWSb 1275 temp_q5 -640 635 FORMAT "%5.1" /begin AXIS_DESCR STD_AXIS ml m_ub_b1020 6 0 1020 DEPOSIT ABSOLUTE /end AXIS_DESCR /begin AXIS_DESCR STD_AXIS lamsons8 fak_ub_b4 6 0 3.98438 DEPOSIT ABSOLUTE /end AXIS_DESCR /end CHARACTERISTIC
/begin CHARACTERISTIC KFTATM "Kennfeld Abgastemperatur   f(nmot,rl)" MAP 0x10201 KfAxUbAyUbSstxUbSstyUbWUb 1275 temp_ub_q5_o50 -50 1225 FORMAT "%5.0" /begin AXIS_DESCR STD_AXIS nmot nmot_ub_q40 6 0 10200 DEPOSIT ABSOLUTE /end AXIS_DESCR /begin AXIS_DESCR STD_AXIS rl rel_ub_q0p75 6 0 191.25 DEPOSIT ABSOLUTE /end AXIS_DESCR /end CHARACTERISTIC
/begin CHARACTERISTIC DTIABS "Dti-Schwellwert für ersten Nachspritzer" VALUE 0x12092 KwUw 209.712 tinjection_sy 0 209.712 FORMAT "%8.4" /end CHARACTERISTIC
/begin CHARACTERISTIC DTIREL "Dti-Schwellwert für zweiten Nachspritzer" VALUE 0x1025A KwUb 99.6094 rel_ub_b99p6 0 99.6094 FORMAT "%5.2" /end CHARACTERISTIC
/begin CHARACTERISTIC WESBM "Winkel Einlaß-schließt vor SW-Bezugsmarke (tR)" VALUE 0x1035D KwUb 717.188 kw_q2p8125 0 717.188 FORMAT "%5.1" /end CHARACTERISTIC
/begin CHARACTERISTIC WEESTS "Winkelgrenze Einspritzende für sim. Startauslösungen" VALUE 0x1035C KwUb 717.188 kw_q2p8125 0 717.188 FORMAT "%5.1" /end CHARACTERISTIC
/begin CHARACTERISTIC TVFZNW "Vezögerungszeit für Aktivierung der CIFI-Faktoren nach NoWe-Umschaltung" VALUE 0x1035B KwUb 2.55 t10msxs_ub_b2p55 0 2.55 FORMAT "%5.3" /end CHARACTERISTIC
/begin CHARACTERISTIC FZNWN1 "Zylinderindividueller Faktor bei aktiver NW-Stellung EV 1" CURVE 0x102DB GklWUb 0.498047 fak_ub_q0p0019_o0p75 0.75 1.24805 FORMAT "%5.3"
 /begin AXIS_DESCR COM_AXIS nmot nmot_ub_q40 16 0 10200 AXIS_PTS_REF SNM16CIUB /end AXIS_DESCR
/end CHARACTERISTIC
/begin CHARACTERISTIC FZNWN2 "Zylinderindividueller Faktor bei aktiver NW-Stellung EV 2" CURVE 0x102EB GklWUb 0.498047 fak_ub_q0p0019_o0p75 0.75 1.24805 FORMAT "%5.3"
 /begin AXIS_DESCR COM_AXIS nmot nmot_ub_q40 16 0 10200 AXIS_PTS_REF SNM16CIUB /end AXIS_DESCR
/end CHARACTERISTIC
/begin CHARACTERISTIC FZNWN3 "Zylinderindividueller Faktor bei aktiver NW-Stellung EV 3" CURVE 0x102FB GklWUb 0.498047 fak_ub_q0p0019_o0p75 0.75 1.24805 FORMAT "%5.3"
 /begin AXIS_DESCR COM_AXIS nmot nmot_ub_q40 16 0 10200 AXIS_PTS_REF SNM16CIUB /end AXIS_DESCR
/end CHARACTERISTIC
/begin CHARACTERISTIC FZNWN4 "Zylinderindividueller Faktor bei aktiver NW-Stellung EV 4" CURVE 0x1030B GklWUb 0.498047 fak_ub_q0p0019_o0p75 0.75 1.24805 FORMAT "%5.3"
 /begin AXIS_DESCR COM_AXIS nmot nmot_ub_q40 16 0 10200 AXIS_PTS_REF SNM16CIUB /end AXIS_DESCR
/end CHARACTERISTIC
/begin CHARACTERISTIC FZNWN5 "Zylinderindividueller Faktor bei aktiver NW-Stellung EV 5" CURVE 0x1031B GklWUb 0.498047 fak_ub_q0p0019_o0p75 0.75 1.24805 FORMAT "%5.3"
 /begin AXIS_DESCR COM_AXIS nmot nmot_ub_q40 16 0 10200 AXIS_PTS_REF SNM16CIUB /end AXIS_DESCR
/end CHARACTERISTIC
/begin CHARACTERISTIC FZNWN6 "Zylinderindividueller Faktor bei aktiver NW-Stellung EV 6" CURVE 0x1032B GklWUb 0.498047 fak_ub_q0p0019_o0p75 0.75 1.24805 FORMAT "%5.3"
 /begin AXIS_DESCR COM_AXIS nmot nmot_ub_q40 16 0 10200 AXIS_PTS_REF SNM16CIUB /end AXIS_DESCR
/end CHARACTERISTIC
/begin CHARACTERISTIC FZNWN7 "Zylinderindividueller Faktor bei aktiver NW-Stellung EV 7" CURVE 0x1033B GklWUb 0.498047 fak_ub_q0p0019_o0p75 0.75 1.24805 FORMAT "%5.3"
 /begin AXIS_DESCR COM_AXIS nmot nmot_ub_q40 16 0 10200 AXIS_PTS_REF SNM16CIUB /end AXIS_DESCR
/end CHARACTERISTIC
/begin CHARACTERISTIC FZNWN8 "Zylinderindividueller Faktor bei aktiver NW-Stellung EV 8" CURVE 0x1034B GklWUb 0.498047 fak_ub_q0p0019_o0p75 0.75 1.24805 FORMAT "%5.3"
 /begin AXIS_DESCR COM_AXIS nmot nmot_ub_q40 16 0 10200 AXIS_PTS_REF SNM16CIUB /end AXIS_DESCR
/end CHARACTERISTIC
/begin CHARACTERISTIC FZN1 "Zylinderindividueller Faktor bei neutraler NW-Stellung EV 1" CURVE 0x1025B GklWUb 0.498047 fak_ub_q0p0019_o0p75 0.75 1.24805 FORMAT "%5.3"
 /begin AXIS_DESCR COM_AXIS nmot nmot_ub_q40 16 0 10200 AXIS_PTS_REF SNM16CIUB /end AXIS_DESCR
/end CHARACTERISTIC
/begin CHARACTERISTIC FZN2 "Zylinderindividueller Faktor bei neutraler NW-Stellung EV 2" CURVE 0x1026B GklWUb 0.498047 fak_ub_q0p0019_o0p75 0.75 1.24805 FORMAT "%5.3"
 /begin AXIS_DESCR COM_AXIS nmot nmot_ub_q40 16 0 10200 AXIS_PTS_REF SNM16CIUB /end AXIS_DESCR
/end CHARACTERISTIC
/begin CHARACTERISTIC FZN3 "Zylinderindividueller Faktor bei neutraler NW-Stellung EV 3" CURVE 0x1027B GklWUb 0.498047 fak_ub_q0p0019_o0p75 0.75 1.24805 FORMAT "%5.3"
 /begin AXIS_DESCR COM_AXIS nmot nmot_ub_q40 16 0 10200 AXIS_PTS_REF SNM16CIUB /end AXIS_DESCR
/end CHARACTERISTIC
/begin CHARACTERISTIC FZN4 "Zylinderindividueller Faktor bei neutraler NW-Stellung EV 4" CURVE 0x1028B GklWUb 0.498047 fak_ub_q0p0019_o0p75 0.75 1.24805 FORMAT "%5.3"
 /begin AXIS_DESCR COM_AXIS nmot nmot_ub_q40 16 0 10200 AXIS_PTS_REF SNM16CIUB /end AXIS_DESCR
/end CHARACTERISTIC
/begin CHARACTERISTIC FZN5 "Zylinderindividueller Faktor bei neutraler NW-Stellung EV 5" CURVE 0x1029B GklWUb 0.498047 fak_ub_q0p0019_o0p75 0.75 1.24805 FORMAT "%5.3"
 /begin AXIS_DESCR COM_AXIS nmot nmot_ub_q40 16 0 10200 AXIS_PTS_REF SNM16CIUB /end AXIS_DESCR
/end CHARACTERISTIC
/begin CHARACTERISTIC FZN6 "Zylinderindividueller Faktor bei neutraler NW-Stellung EV 6" CURVE 0x102AB GklWUb 0.498047 fak_ub_q0p0019_o0p75 0.75 1.24805 FORMAT "%5.3"
 /begin AXIS_DESCR COM_AXIS nmot nmot_ub_q40 16 0 10200 AXIS_PTS_REF SNM16CIUB /end AXIS_DESCR
/end CHARACTERISTIC
/begin CHARACTERISTIC FZN7 "Zylinderindividueller Faktor bei neutraler NW-Stellung EV 7" CURVE 0x102BB GklWUb 0.498047 fak_ub_q0p0019_o0p75 0.75 1.24805 FORMAT "%5.3"
 /begin AXIS_DESCR COM_AXIS nmot nmot_ub_q40 16 0 10200 AXIS_PTS_REF SNM16CIUB /end AXIS_DESCR
/end CHARACTERISTIC
/begin CHARACTERISTIC FZN8 "Zylinderindividueller Faktor bei neutraler NW-Stellung EV 8" CURVE 0x102CB GklWUb 0.498047 fak_ub_q0p0019_o0p75 0.75 1.24805 FORMAT "%5.3"
 /begin AXIS_DESCR COM_AXIS nmot nmot_ub_q40 16 0 10200 AXIS_PTS_REF SNM16CIUB /end AXIS_DESCR
/end CHARACTERISTIC
/begin CHARACTERISTIC ESKONF_A "Kodierung Endstufendiagnose-Hardware Variante A" VAL_BLK 0x1035E KwbUb 255 dez 0 255 FORMAT "%5.1" NUMBER 7 /end CHARACTERISTIC
/begin CHARACTERISTIC ESKONF_B "Kodierung Endstufendiagnose-Hardware Variante B" VAL_BLK 0x10365 KwbUb 255 dez 0 255 FORMAT "%5.1" NUMBER 7 /end CHARACTERISTIC
/begin CHARACTERISTIC MLFKMSDK "Luftmassenstromschwelle für multipl. Abgleich von HFM- und DK-Massenstrom" VALUE 0x122DC KwUw 6553.5 m_uw_b6553p5 0 6553.5 FORMAT "%8.3" /end CHARACTERISTIC
/begin CHARACTERISTIC RLNOT "Notlauf rl bei E_DK und E_LM" CURVE 0x10371 KlAUbSstUbWUb 191.25 rel_ub_q0p75 0 191.25 FORMAT "%5.1" /begin AXIS_DESCR STD_AXIS nmot nmot_ub_q40 6 0 10200 DEPOSIT ABSOLUTE /end AXIS_DESCR /end CHARACTERISTIC
/begin CHARACTERISTIC FKMSDKMX "max.Korrekturfaktor schneller Massenstromabgleich" VALUE 0x1036D KwUb 3.98438 fak_ub_b4 0 3.98438 FORMAT "%5.3" /end CHARACTERISTIC
/begin CHARACTERISTIC FKMSDKMN "min.Korrekturfaktor schneller Massenstromabgleich" VALUE 0x1036C KwUb 3.98438 fak_ub_b4 0 3.98438 FORMAT "%5.3" /end CHARACTERISTIC
/begin CHARACTERISTIC FKPVDKMX "Maximaler Korrekturfaktor langsamer Massenstomabgleich" VALUE 0x1036F KwUb 3.98438 fak_ub_b4 0 3.98438 FORMAT "%5.3" /end CHARACTERISTIC
/begin CHARACTERISTIC FKPVDKMN "Minimaler Korrekturfaktor langsamer Massenstomabgleich" VALUE 0x1036E KwUb 3.98438 fak_ub_b4 0 3.98438 FORMAT "%5.3" /end CHARACTERISTIC
/begin CHARACTERISTIC KUMSRL "Umrechnungskonstante von Massenstrom in relative Luftfüllung" VALUE 0x10370 KwUb 0.00199219 kumsrl_ub_b0p002 0 0.00199219 FORMAT "%7.5" /end CHARACTERISTIC
/begin CHARACTERISTIC TDFKMSDK "Zeitverzögerung für die Freigabe der Massenstromadaption nach B_stend" VALUE 0x1037E KwUb 255 dez 0 255 FORMAT "%5.1" /end CHARACTERISTIC
/begin CHARACTERISTIC ZKPVDK "Zeitkonstante für langsame Massenstromadaption" CURVE 0x12300 KlAUwSstUwWUw 15.9998 fak_uw_b16 0 15.9998 FORMAT "%8.5" /begin AXIS_DESCR STD_AXIS pspvds_w fak_uw_b2 8 0 1.99997 DEPOSIT ABSOLUTE /end AXIS_DESCR /end CHARACTERISTIC
/begin CHARACTERISTIC ZKMSDK "Zeitkonstante schnelle Massenstromadaption" CURVE 0x122DE KlAUwSstUwWUw 15.9998 fak_uw_b16 0 15.9998 FORMAT "%8.5" /begin AXIS_DESCR STD_AXIS pspvds_w fak_uw_b2 8 0 1.99997 DEPOSIT ABSOLUTE /end AXIS_DESCR /end CHARACTERISTIC
/begin CHARACTERISTIC KFMSNWDK "Kennfeld normierter Massenstrom über DK" MAP 0x120A0 KfAxUwAyUwSstxUwSstyUwWUw 6553.5 m_uw_b6553p5 0 6553.5 FORMAT "%8.3"
 /begin AXIS_DESCR STD_AXIS wdkba_w relDK_q0p02441 14 0 1599.98 DEPOSIT ABSOLUTE /end AXIS_DESCR
 /begin AXIS_DESCR STD_AXIS nmot_w nmot_uw_q0p25 18 0 16383.8 DEPOSIT ABSOLUTE /end AXIS_DESCR
/end CHARACTERISTIC
/begin CHARACTERISTIC KFURL "Umrechnungsfaktor von ps->rl abhängig von NW-Verstellung bei sumode=0" MAP 0x125D0 KfAxUbAyUbSstxUbSstyUwWUw 0.299995 rel_uw_b0p3 0 0.299995 FORMAT "%8.6" /begin AXIS_DESCR STD_AXIS wnwue kw_ub_q0p5 10 0 127.5 DEPOSIT ABSOLUTE /end AXIS_DESCR
 /begin AXIS_DESCR STD_AXIS nmot_w nmot_uw_q0p25 14 0 16383.8 DEPOSIT ABSOLUTE /end AXIS_DESCR
/end CHARACTERISTIC
/begin CHARACTERISTIC KFPRG "interner Abgaspartialdruck abhängig von NW-Verstellung bei sumode=0" MAP 0x1233C KfAxUbAyUbSstxUbSstyUwWUw 2559.96 p_uw_q0p039 0 2559.96 FORMAT "%8.3" /begin AXIS_DESCR STD_AXIS wnwue kw_ub_q0p5 10 0 127.5 DEPOSIT ABSOLUTE /end AXIS_DESCR
 /begin AXIS_DESCR STD_AXIS nmot_w nmot_uw_q0p25 14 0 16383.8 DEPOSIT ABSOLUTE /end AXIS_DESCR
/end CHARACTERISTIC
/begin CHARACTERISTIC KFPSDSSK "Korrigierter Saugrohrdruck" MAP 0x1247C KfAxUwAyUwSstxSwSstyUwWUw 1.99997 fak_uw_b2 0 1.99997 FORMAT "%8.6"
 /begin AXIS_DESCR STD_AXIS wdkba_w relDK_q0p02441 12 -800 799.976 DEPOSIT ABSOLUTE /end AXIS_DESCR
 /begin AXIS_DESCR STD_AXIS nmot_w nmot_uw_q0p25 12 0 16383.8 DEPOSIT ABSOLUTE /end AXIS_DESCR
/end CHARACTERISTIC
/begin CHARACTERISTIC FPVMOMXN "Faktor maximales Druckverhältnis für modellierten Saugrohrdruck" CURVE 0x12322 KlAUwSstUwWUw 1.99997 fak_uw_b2 0 1.99997 FORMAT "%8.6" /begin AXIS_DESCR STD_AXIS nmot_w nmot_uw_q0p25 6 0 16383.8 DEPOSIT ABSOLUTE /end AXIS_DESCR /end CHARACTERISTIC
/begin CHARACTERISTIC KISRM "Integratorbeiwert für Saugrohrmodell (Dynamik)" VALUE 0x12710 KwUw 0.999985 fak_uw_b1 0 0.999985 FORMAT "%8.6" /end CHARACTERISTIC
/begin CHARACTERISTIC ZVTPRGSU "Zeitkonstante Tiefpaßfilterung bei Saugrohrklappendynamik" VALUE 0x1037F KwUb 12.7498 zk50msxs_ub_b12p8 0.0501961 12.8 FORMAT "%5.2" /end CHARACTERISTIC
/begin CHARACTERISTIC FDVANS "Temperaturfaktor für Drosselventildurchfluß" CURVE 0x1039A KlAUbSstUbWUb 1.99219 fak_ub_b2 0 1.99219 FORMAT "%5.3"
 /begin AXIS_DESCR STD_AXIS tans temp_ub_q0p75_o48 8 -48 143.25 DEPOSIT ABSOLUTE /end AXIS_DESCR
/end CHARACTERISTIC
/begin CHARACTERISTIC FWFTBRTA "Wichtung ftbr in Abhängigkeit von tans" CURVE 0x103AB KlAUbSstUbWUb 1.99219 fak_ub_b2 0 1.99219 FORMAT "%5.3"
 /begin AXIS_DESCR STD_AXIS tempin temp_ub_q0p75_o48 14 -48 143.25 DEPOSIT ABSOLUTE /end AXIS_DESCR
/end CHARACTERISTIC
/begin CHARACTERISTIC EVTMODO "Offset für evtmod abhängig von gefilterter Motortemperatur" CURVE 0x10381 KlAUbSstUbWUb 191.25 temp_ub_q0p75_o48 -48 143.25 FORMAT "%5.1"
 /begin AXIS_DESCR STD_AXIS tmotfil temp_ub_q0p75_o48 12 -48 143.25 DEPOSIT ABSOLUTE /end AXIS_DESCR
/end CHARACTERISTIC
/begin CHARACTERISTIC KFFWTBR "Wichtungsfaktor Tans/Tmot für Brennraumtemperaturmodell" MAP 0x103C8 KfAxUbAyUbSstxUbSstyUbWUb 0.996094 fak_ub_b1 0 0.996094 FORMAT "%5.3" /begin AXIS_DESCR STD_AXIS rl rel_ub_q0p75 3 0 191.25 DEPOSIT ABSOLUTE /end AXIS_DESCR /begin AXIS_DESCR STD_AXIS nmot nmot_ub_q40 3 0 10200 DEPOSIT ABSOLUTE /end AXIS_DESCR /end CHARACTERISTIC
/begin CHARACTERISTIC ZBRT "Zeitkonstante für Brennraumtempmodell" VALUE 0x103D9 KwUb 25.4996 zk100msxs_ub_b25p5 0.100392 25.6 FORMAT "%5.2" /end CHARACTERISTIC
/begin CHARACTERISTIC ZTMMBR "Zeitkonstante Motortemperatur für Brennraumtempmodell" VALUE 0x12712 KwUw 6553.5 zk100msxs_uw_b6553 0.100002 6553.6 FORMAT "%8.3" /end CHARACTERISTIC
/begin CHARACTERISTIC CWTEMPK "Codeword für Adressierung FWFTBRTA (tans/evtmod)" VALUE 0x10380 KwUb 255 dez 0 255 FORMAT "%5.1" /end CHARACTERISTIC
/begin CHARACTERISTIC DPDDF "Delta Druck für Diagnose Drucksensor (Aktivitätsnachweis)" VALUE 0x12714 KwUw 2559.96 p_uw_q0p039 0 2559.96 FORMAT "%8.3" /end CHARACTERISTIC
/begin CHARACTERISTIC NDDFA "Drehzahlschwelle für Diagnose Drucksensor (Schlauchabfall vor/bei Start)" VALUE 0x103DA KwUb 10200 nmot_ub_q40 0 10200 FORMAT "%5.0" /end CHARACTERISTIC
/begin CHARACTERISTIC TDDF "Entprellzeit DF-Fehlererkennung" VALUE 0x103DB KwUb 25.5 t100msxs_ub_b25p5 0 25.5 FORMAT "%5.2" /end CHARACTERISTIC
/begin CHARACTERISTIC TDDFZ "Wartezeit nach Startende bis DF-kein-Fehler gültig" VALUE 0x103DC KwUb 25.5 t100msxs_ub_b25p5 0 25.5 FORMAT "%5.2" /end CHARACTERISTIC
/begin CHARACTERISTIC UADPSMN "min. Spannungswert für Diagnose Drucksensor" VALUE 0x103DD KwUb 5 spg_ub_b5 0 5 FORMAT "%5.3" /end CHARACTERISTIC
/begin CHARACTERISTIC UADPSMX "max. Spannungswert für Diagnose Drucksensor" VALUE 0x103DE KwUb 5 spg_ub_b5 0 5 FORMAT "%5.3" /end CHARACTERISTIC
/begin CHARACTERISTIC PSINIPL "Wert für Prüfung Saugrohr Initialisierungsdruck" VALUE 0x12716 KwUw 2559.96 p_uw_q0p039 0 2559.96 FORMAT "%8.3" /end CHARACTERISTIC
/begin CHARACTERISTIC CDTLM "Codewort Tester: LMM/HLM/HFM" VALUE 0x11F1E KwUw 65535 dez 0 65535 FORMAT "%8.2" /end CHARACTERISTIC
/begin CHARACTERISTIC CLALM "Fehlerklasse: Hauptfüllungssignal" VALUE 0x1012D KwUb 255 dez 0 255 FORMAT "%5.1" /end CHARACTERISTIC
/begin CHARACTERISTIC TSFLM "Fehlersummenzeit: LMM/HLM/HFM" VALUE 0x101B7 KwUb 255 dez 0 255 FORMAT "%5.1" /end CHARACTERISTIC
/begin CHARACTERISTIC CDKLM "Codewort Kunde:	LMM/HLM/HFM" VALUE 0x11EC2 KwUw 65535 dez 0 65535 FORMAT "%8.2" /end CHARACTERISTIC
/begin CHARACTERISTIC FFTLM "Freeze Frame Tabelle: Hauptfüllungssensor" VAL_BLK 0x10178 KwbUb 255 dez 0 255 FORMAT "%5.1" NUMBER 2 /end CHARACTERISTIC
/begin CHARACTERISTIC TDKPV "Praediktionszeit Drosselklappe" VALUE 0x103F3 KwUb 2.55 t10msxs_ub_b2p55 0 2.55 FORMAT "%5.3" /end CHARACTERISTIC
/begin CHARACTERISTIC DWDKPU "dwdk-Untergrenze für Praediktion Dk-Winkel" VALUE 0x12760 KwUw 99.9985 rel_uw_b100 0 99.9985 FORMAT "%8.5" /end CHARACTERISTIC
/begin CHARACTERISTIC CBGRLP "Codewort Konfiguration Funktion BGRLP" VALUE 0x103F4 KwUb 255 dez 0 255 FORMAT "%5.1" /end CHARACTERISTIC
/begin CHARACTERISTIC DRLMIN "Min. Füllungsänderung zur Auslösung eines Nachspritzers" VALUE 0x12764 KwSw 1535.98 rel_sw_q0p0234 -768 767.977 FORMAT "%8.4" /end CHARACTERISTIC
/begin CHARACTERISTIC DRLDYNU "drl-Schwellwert für te-Nachspritzer/Reduktion" VALUE 0x12762 KwSw 767.953 rel_sw_q0p0234 0.0234375 767.977 FORMAT "%8.4" /end CHARACTERISTIC
/begin CHARACTERISTIC DWPR "Delta Prädiktionswinkel ohne Nachspritzer/ti-Reduktion" VALUE 0x103F5 KwSb 1530 kw_q6 -768 762 FORMAT "%5.1" /end CHARACTERISTIC
/begin CHARACTERISTIC DWPRNSP "Delta Prädiktionswinkel bei Nachspritzerfreigabe" VALUE 0x103F6 KwSb 1530 kw_q6 -768 762 FORMAT "%5.1" /end CHARACTERISTIC
/begin CHARACTERISTIC DTEPRU "delta-te-Schwelle fuer Nachspritzer-/ti-Reduktion erkannt" VALUE 0x12766 KwUw 209.712 tinjection_sy 0 209.712 FORMAT "%8.4" /end CHARACTERISTIC
/begin CHARACTERISTIC TNSURLP "Zeit rl-Praediktions-Unterdrueckung im Nachstart" VALUE 0x103F7 KwUb 25.5 t100msxs_ub_b25p5 0 25.5 FORMAT "%5.2" /end CHARACTERISTIC
/begin CHARACTERISTIC KRKTE "Umrechnung relative Kraftstoffmasse rk in effektive Einspritzzeit te" VALUE 0x1278E KwUw 0.546125 rktiw_sy 0 0.546125 FORMAT "%8.6" /end CHARACTERISTIC
/begin CHARACTERISTIC TVUB "Spannungskorrektur" CURVE 0x12792 KlAUbSstUbWUw 209.712 tinjection_sy 0 209.712 FORMAT "%8.4" /begin AXIS_DESCR STD_AXIS ub spg_ubatt 5 0 17.3655 DEPOSIT ABSOLUTE /end AXIS_DESCR /end CHARACTERISTIC
/begin CHARACTERISTIC FRLFSDP "Einspritzkorrektur bei RLFS" CURVE 0x12768 KlAUwSstSwWUw 0.999939 fak_uw_b2 0.499969 1.49991 FORMAT "%8.6"
 /begin AXIS_DESCR STD_AXIS dpus_w p_sw_q0p078 9 -2560 2559.92 DEPOSIT ABSOLUTE /end AXIS_DESCR
/end CHARACTERISTIC
/begin CHARACTERISTIC CWPKAPP "Codewort Applikation Druckreferenz für Kraftstoffdruckregler" VALUE 0x103F8 KwUb 255 dez 0 255 FORMAT "%5.1" /end CHARACTERISTIC
/begin CHARACTERISTIC PSAPES "Saugrohrdruck für Applikation Einspritzung" VALUE 0x12790 KwUw 2559.96 p_uw_q0p039 0 2559.96 FORMAT "%8.3" /end CHARACTERISTIC
/begin CHARACTERISTIC CWZZBANK "Codewort Zylinderzuordnung Bank1 u. Bank2, Binärzahl: 0 = Bank1, 1 = Bank 2" VALUE 0x127A2 KwSw 65535 dez -32768 32767 FORMAT "%8.2" /end CHARACTERISTIC
/begin CHARACTERISTIC EVOFFAPP "EV-Abschaltmuster für Applikationszwecke" VALUE 0x103F9 KwUb 255 dez 0 255 FORMAT "%5.1" /end CHARACTERISTIC
/begin CHARACTERISTIC REDABM "Ev-Abschaltmuster für Momentenreduzierung" MAP 0x103FA FkfNoShNoOffWUb 255 dez 0 255 FORMAT "%5.1" /begin AXIS_DESCR FIX_AXIS evrbgn_one dez 8 0 7 FIX_AXIS_PAR 0 0 8 /end AXIS_DESCR /begin AXIS_DESCR FIX_AXIS redsol_one dez 8 0 7 FIX_AXIS_PAR 0 0 8 /end AXIS_DESCR /end CHARACTERISTIC
/begin CHARACTERISTIC DNSAH "Delta n SA high bezogen auf nWE" VALUE 0x10F04 KwUb 5080 nmot_ub_q40 0 5080 FORMAT "%5.0" /end CHARACTERISTIC
/begin CHARACTERISTIC DNSAL "Delta n SA low bezogen auf nWE" VALUE 0x10F05 KwUb 5080 nmot_ub_q40 0 5080 FORMAT "%5.0" /end CHARACTERISTIC
/begin CHARACTERISTIC DNVSA "Schubabschaltedrehzahlanhebung bei kleiner Geschwindigkeit" VALUE 0x10F07 KwUb 10200 nmot_ub_q40 0 10200 FORMAT "%5.0" /end CHARACTERISTIC
/begin CHARACTERISTIC DNSLL "Schubabschalte-Hysterese bei WE im Leerlauf" VALUE 0x10F06 KwUb 10200 nmot_ub_q40 0 10200 FORMAT "%5.0" /end CHARACTERISTIC
/begin CHARACTERISTIC DVSA "delta Geschwindigkeitsschwelle für SA-Drehzahlanhebung" VALUE 0x10F08 KwUb 318.75 vfzg_ub_q1p25 0 318.75 FORMAT "%5.1" /end CHARACTERISTIC
/begin CHARACTERISTIC VSAA "Geschwindigkeitsschwelle für SA-Drehzahlanhebung" VALUE 0x10F0A KwUb 318.75 vfzg_ub_q1p25 0 318.75 FORMAT "%5.1" /end CHARACTERISTIC
/begin CHARACTERISTIC NGDNSA "Drehzahlgradient beim Absteuern der Schubabschalthysterese" VALUE 0x12E02 KwSw 10239.8 nmotg_sw_q0p15625 -5120 5119.84 FORMAT "%8.3" /end CHARACTERISTIC
/begin CHARACTERISTIC NWEM "Wiedereinsetzdrehzahl" CURVE 0x10EFA GklWUb 10200 nmot_ub_q40 0 10200 FORMAT "%5.0"
 /begin AXIS_DESCR COM_AXIS tmot temp_ub_q0p75_o48 5 -48 143.25 AXIS_PTS_REF STM05SAUB /end AXIS_DESCR
/end CHARACTERISTIC
/begin CHARACTERISTIC NWENG "Wiedereinsetzdrehzahl" CURVE 0x12E04 KlAUbSstSbWUb 10200 nmot_ub_q40 0 10200 FORMAT "%5.0"
 /begin AXIS_DESCR STD_AXIS ngfil nmotg_sb_q100 5 -12800 12700 DEPOSIT ABSOLUTE /end AXIS_DESCR
/end CHARACTERISTIC
/begin CHARACTERISTIC TVSATM "Sperrzeit Schubabschalten nach Startende" CURVE 0x10EFF GklWUb 255 t1sxs_ub_b255 0 255 FORMAT "%5.1"
 /begin AXIS_DESCR COM_AXIS tmot temp_ub_q0p75_o48 5 -48 143.25 AXIS_PTS_REF STM05SAUB /end AXIS_DESCR
/end CHARACTERISTIC
/begin CHARACTERISTIC KFTVSA "Verzögerungszeit für Schubabschalten" MAP 0x10ED2 GkfWUb 2.55 t10msxs_ub_b2p55 0 2.55 FORMAT "%5.3"
 /begin AXIS_DESCR COM_AXIS tmot temp_ub_q0p75_o48 5 -48 143.25 AXIS_PTS_REF STM05SAUB /end AXIS_DESCR
 /begin AXIS_DESCR COM_AXIS nmot nmot_ub_q40 8 0 10200 AXIS_PTS_REF SNM08__UB /end AXIS_DESCR
/end CHARACTERISTIC
/begin CHARACTERISTIC ENASAG "Freigabe SA gangabhaengig" VALUE 0x10F09 KwUb 255 dez 0 255 FORMAT "%5.1" /end CHARACTERISTIC
/begin CHARACTERISTIC UVGANG01 "Schwelle Übersetzungsverhältnis Gang 0 - Gang 1" VALUE 0x11089 KwUb 0.051 fak_b0p051 0 0.051 FORMAT "%6.4" /end CHARACTERISTIC
/begin CHARACTERISTIC UVGANG12 "Schwelle Übersetzungsverhältnis Gang 1 - Gang 2" VALUE 0x1108A KwUb 0.051 fak_b0p051 0 0.051 FORMAT "%6.4" /end CHARACTERISTIC
/begin CHARACTERISTIC UVGANG23 "Schwelle Übersetzungsverhältnis Gang 2 - Gang 3" VALUE 0x1108B KwUb 0.051 fak_b0p051 0 0.051 FORMAT "%6.4" /end CHARACTERISTIC
/begin CHARACTERISTIC UVGANG34 "Schwelle Übersetzungsverhältnis Gang 3 - Gang 4" VALUE 0x1108C KwUb 0.051 fak_b0p051 0 0.051 FORMAT "%6.4" /end CHARACTERISTIC
/begin CHARACTERISTIC UVGANG45 "Schwelle Übersetzungsverhältnis Gang 4 - Gang 5" VALUE 0x1108D KwUb 0.051 fak_b0p051 0 0.051 FORMAT "%6.4" /end CHARACTERISTIC
/begin CHARACTERISTIC UVGANG56 "Schwelle Übersetzungsverhältnis Gang 5 - Gang 6" VALUE 0x1108E KwUb 0.051 fak_b0p051 0 0.051 FORMAT "%6.4" /end CHARACTERISTIC
/begin CHARACTERISTIC UVGANG67 "Schwelle Übersetzungsverhältnis Gang 6 - Gang 7" VALUE 0x1108F KwUb 0.051 fak_b0p051 0 0.051 FORMAT "%6.4" /end CHARACTERISTIC
/begin CHARACTERISTIC POELLAMPN "Öldruckschwelle für Einschalten der Ölwarnlampe" CURVE 0x1344E KlAUwSstUwWUw 4112 msd_poil_ub_0 0 4112 FORMAT "%8.3" /begin AXIS_DESCR STD_AXIS nmot_w nmot_uw_q0p25 6 0 16383.8 DEPOSIT ABSOLUTE /end AXIS_DESCR /end CHARACTERISTIC
/begin CHARACTERISTIC NSHLEDG "Drehzahlschwelle für Einschalten der obersten Schalt-LED" CURVE 0x13438 FklWUw 16383.8 nmot_uw_q0p25 0 16383.8 FORMAT "%8.2" /begin AXIS_DESCR FIX_AXIS gangi dez 7 0 6 FIX_AXIS_PAR 0 0 7 /end AXIS_DESCR /end CHARACTERISTIC
/begin CHARACTERISTIC NSHLEDO4 "Offset für Einschalten der vierten Schalt-LED" VALUE 0x1344C KwUw 16383.8 nmot_uw_q0p25 0 16383.8 FORMAT "%8.2" /end CHARACTERISTIC
/begin CHARACTERISTIC NSHLEDO3 "Offset für Einschalten der dritten Schalt-LED" VALUE 0x1344A KwUw 16383.8 nmot_uw_q0p25 0 16383.8 FORMAT "%8.2" /end CHARACTERISTIC
/begin CHARACTERISTIC NSHLEDO2 "Offset für Einschalten der zweiten Schalt-LED" VALUE 0x13448 KwUw 16383.8 nmot_uw_q0p25 0 16383.8 FORMAT "%8.2" /end CHARACTERISTIC
/begin CHARACTERISTIC NSHLEDO1 "Offset für Einschalten der ersten Schalt-LED" VALUE 0x13446 KwUw 16383.8 nmot_uw_q0p25 0 16383.8 FORMAT "%8.2" /end CHARACTERISTIC
/begin CHARACTERISTIC DDU2LEDT "Testbyte für DDU2-Lampen" VALUE 0x13428 KwUw 65535 default 0 65535 FORMAT "%8.2" /end CHARACTERISTIC
/begin CHARACTERISTIC VFZLAMPU "Untere Fahrzeuggeschwindigkeits-Schwelle für Warnlampe" VALUE 0x1346A KwUw 511.992 vfzg_uw_q0p00781 0 511.992 FORMAT "%8.4" /end CHARACTERISTIC
/begin CHARACTERISTIC VFZLAMPO "Obere Fahrzeuggeschwindigkeits-Schwelle für Warnlampe" VALUE 0x13468 KwUw 511.992 vfzg_uw_q0p00781 0 511.992 FORMAT "%8.4" /end CHARACTERISTIC
/begin CHARACTERISTIC NSHLAMPG "Drehzahlschwelle für Einschalten der Schaltlampe" CURVE 0x1342A FklWUw 16383.8 nmot_uw_q0p25 0 16383.8 FORMAT "%8.2" /begin AXIS_DESCR FIX_AXIS gangi dez 7 0 6 FIX_AXIS_PAR 0 0 7 /end AXIS_DESCR /end CHARACTERISTIC
/begin CHARACTERISTIC TMOTSPECMN "Untere Plausibilitätsschwelle Motortemperatur für kundenspezifische Fehlerlampe" VALUE 0x11121 KwUb 191.25 temp_ub_q0p75_o48 -48 143.25 FORMAT "%5.1" /end CHARACTERISTIC
/begin CHARACTERISTIC TMOTSPECMX "Obere Plausibilitätsschwelle Motortemperatur für kundenspezifische Fehlerlampe" VALUE 0x11122 KwUb 191.25 temp_ub_q0p75_o48 -48 143.25 FORMAT "%5.1" /end CHARACTERISTIC
/begin CHARACTERISTIC TOELSPECMN "Untere Plausibilitätsschwelle Motoröltemp. für kundenspezifische Fehlerlampe" VALUE 0x11123 KwUb 255 temp_ub_q1_o40 -40 215 FORMAT "%5.1" /end CHARACTERISTIC
/begin CHARACTERISTIC TOELSPECMX "Obere Plausibilitätsschwelle Motoröltemp. für kundenspezifische Fehlerlampe" VALUE 0x11124 KwUb 255 temp_ub_q1_o40 -40 215 FORMAT "%5.1" /end CHARACTERISTIC
/begin CHARACTERISTIC PFUESPECMN "Untere Plausibilitätsschwelle Kraftstoffdruck für kundenspezifische Fehlerlampe" VALUE 0x1111F KwUb 16 msd_poil_ub_0 0 16 FORMAT "%5.2" /end CHARACTERISTIC
/begin CHARACTERISTIC PFUESPECMX "Obere Plausibilitätsschwelle Kraftstoffdruck für kundenspezifische Fehlerlampe" VALUE 0x11120 KwUb 16 msd_poil_ub_0 0 16 FORMAT "%5.2" /end CHARACTERISTIC
/begin CHARACTERISTIC TLAED "Wartezeit bis Fehlerlampe aus nach Start" VALUE 0x11125 KwUb 51 t200msxs_ub_b51 0 51 FORMAT "%5.2" /end CHARACTERISTIC
/begin CHARACTERISTIC NNSTA "Drehzahlübergang Normal -> Start" CURVE 0x1124A KlAUbSstUbWUb 10200 nmot_ub_q40 0 10200 FORMAT "%5.0"
 /begin AXIS_DESCR STD_AXIS tans temp_ub_q0p75_o48 3 -48 143.25 DEPOSIT ABSOLUTE /end AXIS_DESCR
/end CHARACTERISTIC
/begin CHARACTERISTIC NSTNM "Übergang Start -> Normal" CURVE 0x11251 KlAUbSstUbWUb 10200 nmot_ub_q40 0 10200 FORMAT "%5.0"
 /begin AXIS_DESCR STD_AXIS tmot temp_ub_q0p75_o48 3 -48 143.25 DEPOSIT ABSOLUTE /end AXIS_DESCR
/end CHARACTERISTIC
/begin CHARACTERISTIC CWZNDAUS "Codewort Zündausgabe (Einzel- oder Doppelfunken), 1:Einzel, 0:Doppel" VALUE 0x1125D KwUb 255 dez 0 255 FORMAT "%5.1" /end CHARACTERISTIC
/begin CHARACTERISTIC TPVL "Zeit für Pumpenvorlauf" VALUE 0x115DE KwUb 2.55 t10msxs_ub_b2p55 0 2.55 FORMAT "%5.3" /end CHARACTERISTIC
/begin CHARACTERISTIC TZMIN "Zeitfenster für Zahnerkennung nach UBatt-Einbruch" VALUE 0x115DF KwUb 2.55 t10msxs_ub_b2p55 0 2.55 FORMAT "%5.3" /end CHARACTERISTIC
/begin CHARACTERISTIC TEBF "EKP Einschaltzeit für Erstbefüllung Kraftstoffsystems" VALUE 0x115DC KwUb 255 t1sxs_ub_b255 0 255 FORMAT "%5.1" /end CHARACTERISTIC
/begin CHARACTERISTIC ZNOSTMX "Anzahl Zündung=ein ohne Erreichen von Startende für kein EKP-Vorlauf" VALUE 0x115E1 KwUb 255 dez 0 255 FORMAT "%5.1" /end CHARACTERISTIC
/begin CHARACTERISTIC UBSTS "Schwelle zur Erkennung UBatt-Einbruch im Start" VALUE 0x115E0 KwUb 17.3655 spg_ubatt 0 17.3655 FORMAT "%5.2" /end CHARACTERISTIC
/begin CHARACTERISTIC TNLEKPVL "Schwelle SG-Nachlaufzeit für EKP-Vorlauf" VALUE 0x115DD KwUb 255 t1sxs_ub_b255 0 255 FORMAT "%5.1" /end CHARACTERISTIC
/begin CHARACTERISTIC TAPVLTM "Schwelle Abstellzeit für EKP-Vorlauf" CURVE 0x13BE8 KlAUbSstUbWUw 65535 t1sxs_uw_b65535 0 65535 FORMAT "%8.2"
 /begin AXIS_DESCR STD_AXIS tmotab temp_ub_q0p75_o48 12 -48 143.25 DEPOSIT ABSOLUTE /end AXIS_DESCR
/end CHARACTERISTIC
/begin MEASUREMENT abmf "Festeinspritzausblendmuster" UBYTE dez 1 100 0 255 FORMAT "%5.1" /begin IF_DATA ASAP1B_KWP2000 KP_BLOB 0x38037D EXTERN 0x1 /end IF_DATA /begin IF_DATA ETK KP_BLOB 0x38037D EXTERN 0x1 /end IF_DATA /end MEASUREMENT
/begin MEASUREMENT AEKPintbits "" UBYTE dez 1 100 0 255 FORMAT "%5.1" /begin IF_DATA ASAP1B_KWP2000 KP_BLOB 0x38294E EXTERN 0x1 /end IF_DATA /begin IF_DATA ETK KP_BLOB 0x38294E EXTERN 0x1 /end IF_DATA /end MEASUREMENT
/begin MEASUREMENT anzti "ti-Einspritzzähler" UBYTE dez 1 100 0 255 FORMAT "%5.1" /begin IF_DATA ASAP1B_KWP2000 KP_BLOB 0xF7FA INTERN 0x1 /end IF_DATA /begin IF_DATA ETK KP_BLOB 0xF7FA INTERN 0x1 /end IF_DATA /end MEASUREMENT
/begin MEASUREMENT anzti_w "ti-Einspritzzähler" UWORD dez 1 100 0 65535 FORMAT "%8.2" /begin IF_DATA ASAP1B_KWP2000 KP_BLOB 0xF80C INTERN 0x2 /end IF_DATA /begin IF_DATA ETK KP_BLOB 0xF80C INTERN 0x2 /end IF_DATA /end MEASUREMENT
/begin MEASUREMENT bbdcy "Byte für Bedingung B_dcy als Triggerevent in DCLA" UBYTE dez 1 100 0 255 FORMAT "%5.1" /begin IF_DATA ASAP1B_KWP2000 KP_BLOB 0x380340 EXTERN 0x1 /end IF_DATA /begin IF_DATA ETK KP_BLOB 0x380340 EXTERN 0x1 /end IF_DATA /end MEASUREMENT
/begin MEASUREMENT BBSAWElokbits "" UBYTE dez 1 100 0 255 FORMAT "%5.1" /begin IF_DATA ASAP1B_KWP2000 KP_BLOB 0x38041C EXTERN 0x1 /end IF_DATA /begin IF_DATA ETK KP_BLOB 0x38041C EXTERN 0x1 /end IF_DATA /end MEASUREMENT
/begin MEASUREMENT bbsp3 "Byte für Bedingung B_sp3 als Triggerevent in DCLA" UBYTE dez 1 100 0 255 FORMAT "%5.1" /begin IF_DATA ASAP1B_KWP2000 KP_BLOB 0x382820 EXTERN 0x1 /end IF_DATA /begin IF_DATA ETK KP_BLOB 0x382820 EXTERN 0x1 /end IF_DATA /end MEASUREMENT
/begin MEASUREMENT bbtim "Byte für Bedingung B_tim als Triggerevent in DCLA" UBYTE dez 1 100 0 255 FORMAT "%5.1" /begin IF_DATA ASAP1B_KWP2000 KP_BLOB 0x380341 EXTERN 0x1 /end IF_DATA /begin IF_DATA ETK KP_BLOB 0x380341 EXTERN 0x1 /end IF_DATA /end MEASUREMENT
/begin MEASUREMENT B_atmth "Abgastemperaturmodell Heißstart ->Filter für TABGM setzen auf TATMTH" UWORD B_TRUE 1 100 0 1 BIT_MASK 0x2000 FORMAT "%5.3" /begin IF_DATA ASAP1B_KWP2000 KP_BLOB 0xFD1A INTERN 0x2 /end IF_DATA /begin IF_DATA ETK KP_BLOB 0xFD1A INTERN 0x2 /end IF_DATA /end MEASUREMENT
/begin MEASUREMENT B_atmtpa "Bedingung Taupunkt vor Kat ueberschritten" UWORD B_TRUE 1 100 0 1 BIT_MASK 0x4000 FORMAT "%5.3" /begin IF_DATA ASAP1B_KWP2000 KP_BLOB 0xFD1A INTERN 0x2 /end IF_DATA /begin IF_DATA ETK KP_BLOB 0xFD1A INTERN 0x2 /end IF_DATA /end MEASUREMENT
/begin MEASUREMENT B_atmtpa2 "Bedingung Taupunkt2 vor Kat ueberschritten" UWORD B_TRUE 1 100 0 1 BIT_MASK 0x8000 FORMAT "%5.3" /begin IF_DATA ASAP1B_KWP2000 KP_BLOB 0xFD1A INTERN 0x2 /end IF_DATA /begin IF_DATA ETK KP_BLOB 0xFD1A INTERN 0x2 /end IF_DATA /end MEASUREMENT
/begin MEASUREMENT B_bevab "Bedingung EV-Abschaltung auf Bank/Bank1" UWORD B_TRUE 1 100 0 1 BIT_MASK 0x4000 FORMAT "%5.3" /begin IF_DATA ASAP1B_KWP2000 KP_BLOB 0xFD24 INTERN 0x2 /end IF_DATA /begin IF_DATA ETK KP_BLOB 0xFD24 INTERN 0x2 /end IF_DATA /end MEASUREMENT
/begin MEASUREMENT B_bevab2 "Bedingung EV-Abschaltung auf Bank2" UWORD B_TRUE 1 100 0 1 BIT_MASK 0x8000 FORMAT "%5.3" /begin IF_DATA ASAP1B_KWP2000 KP_BLOB 0xFD24 INTERN 0x2 /end IF_DATA /begin IF_DATA ETK KP_BLOB 0xFD24 INTERN 0x2 /end IF_DATA /end MEASUREMENT
/begin MEASUREMENT B_blkeb "MIL-Ansteuerung blinkend eigenbestimmt" UBYTE B_TRUE 1 100 0 1 BIT_MASK 0x4 FORMAT "%5.3" /begin IF_DATA ASAP1B_KWP2000 KP_BLOB 0x380440 EXTERN 0x1 /end IF_DATA /begin IF_DATA ETK KP_BLOB 0x380440 EXTERN 0x1 /end IF_DATA /end MEASUREMENT
/begin MEASUREMENT B_cldk "Bedingung Fehlerpfad DK (Drosselklappen-Poti) löschen" UWORD B_TRUE 1 100 0 1 BIT_MASK 0x80 FORMAT "%5.3" /begin IF_DATA ASAP1B_KWP2000 KP_BLOB 0x382A8C EXTERN 0x2 /end IF_DATA /begin IF_DATA ETK KP_BLOB 0x382A8C EXTERN 0x2 /end IF_DATA /end MEASUREMENT
/begin MEASUREMENT B_cllm "Bedingung: Fehlerpfad Hauptfüllungssensor löschen" UWORD B_TRUE 1 100 0 1 BIT_MASK 0x80 FORMAT "%5.3" /begin IF_DATA ASAP1B_KWP2000 KP_BLOB 0x382ABE EXTERN 0x2 /end IF_DATA /begin IF_DATA ETK KP_BLOB 0x382ABE EXTERN 0x2 /end IF_DATA /end MEASUREMENT
/begin MEASUREMENT B_cln "Bedingung Fehlerpfad Drehzahlgeber löschen" UWORD B_TRUE 1 100 0 1 BIT_MASK 0x80 FORMAT "%5.3" /begin IF_DATA ASAP1B_KWP2000 KP_BLOB 0x382AC8 EXTERN 0x2 /end IF_DATA /begin IF_DATA ETK KP_BLOB 0x382AC8 EXTERN 0x2 /end IF_DATA /end MEASUREMENT
/begin MEASUREMENT B_dcy "Bedingung 'driving cycle' erkannt" UBYTE B_TRUE 1 100 0 1 BIT_MASK 0x1 FORMAT "%5.3" /begin IF_DATA ASAP1B_KWP2000 KP_BLOB 0x380340 EXTERN 0x1 /end IF_DATA /begin IF_DATA ETK KP_BLOB 0x380340 EXTERN 0x1 /end IF_DATA /end MEASUREMENT
/begin MEASUREMENT B_ddu2pres "Bedingung DDU2 erkannt" UWORD B_TRUE 1 100 0 1 BIT_MASK 0x100 FORMAT "%5.3" /begin IF_DATA ASAP1B_KWP2000 KP_BLOB 0xFD18 INTERN 0x2 /end IF_DATA /begin IF_DATA ETK KP_BLOB 0xFD18 INTERN 0x2 /end IF_DATA /end MEASUREMENT
/begin MEASUREMENT B_desee "Diagnose Endstufe: Eingangsbedingungen erfüllt" UWORD B_TRUE 1 100 0 1 BIT_MASK 0x2 FORMAT "%5.3" /begin IF_DATA ASAP1B_KWP2000 KP_BLOB 0xFD24 INTERN 0x2 /end IF_DATA /begin IF_DATA ETK KP_BLOB 0xFD24 INTERN 0x2 /end IF_DATA /end MEASUREMENT
/begin MEASUREMENT B_dnsll "Bedingung SA-Drehzahl-Hysterese DNSLL" UBYTE B_TRUE 1 100 0 1 BIT_MASK 0x1 FORMAT "%5.3" /begin IF_DATA ASAP1B_KWP2000 KP_BLOB 0x38041C EXTERN 0x1 /end IF_DATA /begin IF_DATA ETK KP_BLOB 0x38041C EXTERN 0x1 /end IF_DATA /end MEASUREMENT
/begin MEASUREMENT B_eev "Bedingung Endstufenfehler EV" UWORD B_TRUE 1 100 0 1 BIT_MASK 0x8 FORMAT "%5.3" /begin IF_DATA ASAP1B_KWP2000 KP_BLOB 0xFD24 INTERN 0x2 /end IF_DATA /begin IF_DATA ETK KP_BLOB 0xFD24 INTERN 0x2 /end IF_DATA /end MEASUREMENT
/begin MEASUREMENT B_ehfs "Bedingung Ersatzwert Hauptfüllungssensor" UWORD B_TRUE 1 100 0 1 BIT_MASK 0x100 FORMAT "%5.3" /begin IF_DATA ASAP1B_KWP2000 KP_BLOB 0xFD24 INTERN 0x2 /end IF_DATA /begin IF_DATA ETK KP_BLOB 0xFD24 INTERN 0x2 /end IF_DATA /end MEASUREMENT
/begin MEASUREMENT B_ekp "Freigabe der EKP-Versorgung" UWORD B_TRUE 1 100 0 1 BIT_MASK 0x100 FORMAT "%5.3" /begin IF_DATA ASAP1B_KWP2000 KP_BLOB 0xFD46 INTERN 0x2 /end IF_DATA /begin IF_DATA ETK KP_BLOB 0xFD46 INTERN 0x2 /end IF_DATA /end MEASUREMENT
/begin MEASUREMENT B_ekpd "Bedingung EKP Dauerbetrieb" UBYTE B_TRUE 1 100 0 1 BIT_MASK 0x8 FORMAT "%5.3" /begin IF_DATA ASAP1B_KWP2000 KP_BLOB 0x380480 EXTERN 0x1 /end IF_DATA /begin IF_DATA ETK KP_BLOB 0x380480 EXTERN 0x1 /end IF_DATA /end MEASUREMENT
/begin MEASUREMENT B_ekpn "Bedingung EKP-Einschaltbedingung Drehzahl erfüllt" UBYTE B_TRUE 1 100 0 1 BIT_MASK 0x10 FORMAT "%5.3" /begin IF_DATA ASAP1B_KWP2000 KP_BLOB 0x380480 EXTERN 0x1 /end IF_DATA /begin IF_DATA ETK KP_BLOB 0x380480 EXTERN 0x1 /end IF_DATA /end MEASUREMENT
/begin MEASUREMENT B_ekpubn "Bedingung EKP-Einschaltbedingung UBatt-Einbruch und Zahnsignal erfüllt" UBYTE B_TRUE 1 100 0 1 BIT_MASK 0x20 FORMAT "%5.3" /begin IF_DATA ASAP1B_KWP2000 KP_BLOB 0x380480 EXTERN 0x1 /end IF_DATA /begin IF_DATA ETK KP_BLOB 0x380480 EXTERN 0x1 /end IF_DATA /end MEASUREMENT
/begin MEASUREMENT B_ekpvl "Bedingung EKP-Vorlauf" UBYTE B_TRUE 1 100 0 1 BIT_MASK 0x40 FORMAT "%5.3" /begin IF_DATA ASAP1B_KWP2000 KP_BLOB 0x380480 EXTERN 0x1 /end IF_DATA /begin IF_DATA ETK KP_BLOB 0x380480 EXTERN 0x1 /end IF_DATA /end MEASUREMENT
/begin MEASUREMENT B_encifi "Enable cylinder individual fuel injektion" UWORD B_TRUE 1 100 0 1 BIT_MASK 0x2000 FORMAT "%5.3" /begin IF_DATA ASAP1B_KWP2000 KP_BLOB 0xFD1E INTERN 0x2 /end IF_DATA /begin IF_DATA ETK KP_BLOB 0xFD1E INTERN 0x2 /end IF_DATA /end MEASUREMENT
/begin MEASUREMENT B_esdia "Endstufendiagnose aktiv" UWORD B_TRUE 1 100 0 1 BIT_MASK 0x4 FORMAT "%5.3" /begin IF_DATA ASAP1B_KWP2000 KP_BLOB 0xFD24 INTERN 0x2 /end IF_DATA /begin IF_DATA ETK KP_BLOB 0xFD24 INTERN 0x2 /end IF_DATA /end MEASUREMENT
/begin MEASUREMENT B_evloc "Status: alle lokalen Einspritzventile werden angesteuert, = B_EVTOT bei einem SG" UWORD B_TRUE 1 100 0 1 BIT_MASK 0x1 FORMAT "%5.3" /begin IF_DATA ASAP1B_KWP2000 KP_BLOB 0xFD26 INTERN 0x2 /end IF_DATA /begin IF_DATA ETK KP_BLOB 0xFD26 INTERN 0x2 /end IF_DATA /end MEASUREMENT
/begin MEASUREMENT B_fkpvdk "Bedingung für die Freigabe des langsamen multiplikativen Füllungsabgleichs" UWORD B_TRUE 1 100 0 1 BIT_MASK 0x10 FORMAT "%5.3" /begin IF_DATA ASAP1B_KWP2000 KP_BLOB 0xFD24 INTERN 0x2 /end IF_DATA /begin IF_DATA ETK KP_BLOB 0xFD24 INTERN 0x2 /end IF_DATA /end MEASUREMENT
/begin MEASUREMENT B_klineok "Bedingung Kommunikation zur MS3 via K-Leitung ist aktiv" UWORD B_TRUE 1 100 0 1 BIT_MASK 0x40 FORMAT "%5.3" /begin IF_DATA ASAP1B_KWP2000 KP_BLOB 0xFD18 INTERN 0x2 /end IF_DATA /begin IF_DATA ETK KP_BLOB 0xFD18 INTERN 0x2 /end IF_DATA /end MEASUREMENT
/begin MEASUREMENT B_kstebfa "" UWORD B_TRUE 1 100 0 1 BIT_MASK 0x200 FORMAT "%5.3" /begin IF_DATA ASAP1B_KWP2000 KP_BLOB 0xFD46 INTERN 0x2 /end IF_DATA /begin IF_DATA ETK KP_BLOB 0xFD46 INTERN 0x2 /end IF_DATA /end MEASUREMENT
/begin MEASUREMENT B_mil "MIL-Ansteuerung" UWORD B_TRUE 1 100 0 1 BIT_MASK 0x800 FORMAT "%5.3" /begin IF_DATA ASAP1B_KWP2000 KP_BLOB 0xFD3A INTERN 0x2 /end IF_DATA /begin IF_DATA ETK KP_BLOB 0xFD3A INTERN 0x2 /end IF_DATA /end MEASUREMENT
/begin MEASUREMENT B_milblk "MIL-Ansteuerung blinkend" UBYTE B_TRUE 1 100 0 1 BIT_MASK 0x8 FORMAT "%5.3" /begin IF_DATA ASAP1B_KWP2000 KP_BLOB 0x380440 EXTERN 0x1 /end IF_DATA /begin IF_DATA ETK KP_BLOB 0x380440 EXTERN 0x1 /end IF_DATA /end MEASUREMENT
/begin MEASUREMENT B_mileb "MIL-Ansteuerung eigenbestimmt" UBYTE B_TRUE 1 100 0 1 BIT_MASK 0x2 FORMAT "%5.3" /begin IF_DATA ASAP1B_KWP2000 KP_BLOB 0x380440 EXTERN 0x1 /end IF_DATA /begin IF_DATA ETK KP_BLOB 0x380440 EXTERN 0x1 /end IF_DATA /end MEASUREMENT
/begin MEASUREMENT B_milspec "Bedingung kundenspezifische Fehlerlampe ein" UWORD B_TRUE 1 100 0 1 BIT_MASK 0x1000 FORMAT "%5.3" /begin IF_DATA ASAP1B_KWP2000 KP_BLOB 0xFD3A INTERN 0x2 /end IF_DATA /begin IF_DATA ETK KP_BLOB 0xFD3A INTERN 0x2 /end IF_DATA /end MEASUREMENT
/begin MEASUREMENT B_milst "MIL-Ansteuerung Prueffunktion bei Start" UBYTE B_TRUE 1 100 0 1 BIT_MASK 0x1 FORMAT "%5.3" /begin IF_DATA ASAP1B_KWP2000 KP_BLOB 0x380440 EXTERN 0x1 /end IF_DATA /begin IF_DATA ETK KP_BLOB 0x380440 EXTERN 0x1 /end IF_DATA /end MEASUREMENT
/begin MEASUREMENT B_mnbm "Fehlertyp: häufige Korrektur bei einem Zahn zuwenig" UWORD B_TRUE 1 100 0 1 BIT_MASK 0x200 FORMAT "%5.3" /begin IF_DATA ASAP1B_KWP2000 KP_BLOB 0x382A8A EXTERN 0x2 /end IF_DATA /begin IF_DATA ETK KP_BLOB 0x382A8A EXTERN 0x2 /end IF_DATA /end MEASUREMENT
/begin MEASUREMENT B_mndk "Fehlertype: Kurzschluß nach Masse Drosselklappenpoti" UWORD B_TRUE 1 100 0 1 BIT_MASK 0x200 FORMAT "%5.3" /begin IF_DATA ASAP1B_KWP2000 KP_BLOB 0x382A8C EXTERN 0x2 /end IF_DATA /begin IF_DATA ETK KP_BLOB 0x382A8C EXTERN 0x2 /end IF_DATA /end MEASUREMENT
/begin MEASUREMENT B_mnlm "Bedingung: min-Fehler Hauptfüllungssensor" UWORD B_TRUE 1 100 0 1 BIT_MASK 0x200 FORMAT "%5.3" /begin IF_DATA ASAP1B_KWP2000 KP_BLOB 0x382ABE EXTERN 0x2 /end IF_DATA /begin IF_DATA ETK KP_BLOB 0x382ABE EXTERN 0x2 /end IF_DATA /end MEASUREMENT
/begin MEASUREMENT B_mnn "Fehlerart: Synchronisationsmarke häufig nicht gefunden" UWORD B_TRUE 1 100 0 1 BIT_MASK 0x200 FORMAT "%5.3" /begin IF_DATA ASAP1B_KWP2000 KP_BLOB 0x382AC8 EXTERN 0x2 /end IF_DATA /begin IF_DATA ETK KP_BLOB 0x382AC8 EXTERN 0x2 /end IF_DATA /end MEASUREMENT
/begin MEASUREMENT B_mxbm "Fehlertyp: häufige Korrektur bei einem Zahn zuviel" UWORD B_TRUE 1 100 0 1 BIT_MASK 0x100 FORMAT "%5.3" /begin IF_DATA ASAP1B_KWP2000 KP_BLOB 0x382A8A EXTERN 0x2 /end IF_DATA /begin IF_DATA ETK KP_BLOB 0x382A8A EXTERN 0x2 /end IF_DATA /end MEASUREMENT
/begin MEASUREMENT B_mxdk "Fehlertype: Kurzschluß nach Ubat Drosselklappenpoti" UWORD B_TRUE 1 100 0 1 BIT_MASK 0x100 FORMAT "%5.3" /begin IF_DATA ASAP1B_KWP2000 KP_BLOB 0x382A8C EXTERN 0x2 /end IF_DATA /begin IF_DATA ETK KP_BLOB 0x382A8C EXTERN 0x2 /end IF_DATA /end MEASUREMENT
/begin MEASUREMENT B_mxlm "Bedingung: max-Fehler Hauptfüllungssensor" UWORD B_TRUE 1 100 0 1 BIT_MASK 0x100 FORMAT "%5.3" /begin IF_DATA ASAP1B_KWP2000 KP_BLOB 0x382ABE EXTERN 0x2 /end IF_DATA /begin IF_DATA ETK KP_BLOB 0x382ABE EXTERN 0x2 /end IF_DATA /end MEASUREMENT
/begin MEASUREMENT B_mxn "Fehlerart: häufiger Lückenverlust beim Lückencheck" UWORD B_TRUE 1 100 0 1 BIT_MASK 0x100 FORMAT "%5.3" /begin IF_DATA ASAP1B_KWP2000 KP_BLOB 0x382AC8 EXTERN 0x2 /end IF_DATA /begin IF_DATA ETK KP_BLOB 0x382AC8 EXTERN 0x2 /end IF_DATA /end MEASUREMENT
/begin MEASUREMENT B_ngasok "Bedingung Ringspeicher für ngas-Berechnung ok" UWORD B_TRUE 1 100 0 1 BIT_MASK 0x1 FORMAT "%5.3" /begin IF_DATA ASAP1B_KWP2000 KP_BLOB 0xFD1A INTERN 0x2 /end IF_DATA /begin IF_DATA ETK KP_BLOB 0xFD1A INTERN 0x2 /end IF_DATA /end MEASUREMENT
/begin MEASUREMENT B_nmin "Bedingung Unterdrehzahl: n < NMIN" UWORD B_TRUE 1 100 0 1 BIT_MASK 0x4 FORMAT "%5.3" /begin IF_DATA ASAP1B_KWP2000 KP_BLOB 0xFD1A INTERN 0x2 /end IF_DATA /begin IF_DATA ETK KP_BLOB 0xFD1A INTERN 0x2 /end IF_DATA /end MEASUREMENT
/begin MEASUREMENT B_nmot "Bedingung Motordrehzahl: n > NMIN" UWORD B_TRUE 1 100 0 1 BIT_MASK 0x8 FORMAT "%5.3" /begin IF_DATA ASAP1B_KWP2000 KP_BLOB 0xFD1A INTERN 0x2 /end IF_DATA /begin IF_DATA ETK KP_BLOB 0xFD1A INTERN 0x2 /end IF_DATA /end MEASUREMENT
/begin MEASUREMENT B_npbm "Fehlertyp: Bezugsmarkenfehler beim Lückencheck" UWORD B_TRUE 1 100 0 1 BIT_MASK 0x800 FORMAT "%5.3" /begin IF_DATA ASAP1B_KWP2000 KP_BLOB 0x382A8A EXTERN 0x2 /end IF_DATA /begin IF_DATA ETK KP_BLOB 0x382A8A EXTERN 0x2 /end IF_DATA /end MEASUREMENT
/begin MEASUREMENT B_npdk "Bedingung unplausible Potisignale von der Drosselklappe" UWORD B_TRUE 1 100 0 1 BIT_MASK 0x800 FORMAT "%5.3" /begin IF_DATA ASAP1B_KWP2000 KP_BLOB 0x382A8C EXTERN 0x2 /end IF_DATA /begin IF_DATA ETK KP_BLOB 0x382A8C EXTERN 0x2 /end IF_DATA /end MEASUREMENT
/begin MEASUREMENT B_nplm "Bedingung Plausfehler Hauptfüllungssensor" UWORD B_TRUE 1 100 0 1 BIT_MASK 0x800 FORMAT "%5.3" /begin IF_DATA ASAP1B_KWP2000 KP_BLOB 0x382ABE EXTERN 0x2 /end IF_DATA /begin IF_DATA ETK KP_BLOB 0x382ABE EXTERN 0x2 /end IF_DATA /end MEASUREMENT
/begin MEASUREMENT B_npn "Fehlerart: häufiger Bezugsmarkenfehler beim Lückencheck" UWORD B_TRUE 1 100 0 1 BIT_MASK 0x800 FORMAT "%5.3" /begin IF_DATA ASAP1B_KWP2000 KP_BLOB 0x382AC8 EXTERN 0x2 /end IF_DATA /begin IF_DATA ETK KP_BLOB 0x382AC8 EXTERN 0x2 /end IF_DATA /end MEASUREMENT
/begin MEASUREMENT B_nsp "Bedingung Nachspritzer" UWORD B_TRUE 1 100 0 1 BIT_MASK 0x800 FORMAT "%5.3" /begin IF_DATA ASAP1B_KWP2000 KP_BLOB 0xFD24 INTERN 0x2 /end IF_DATA /begin IF_DATA ETK KP_BLOB 0xFD24 INTERN 0x2 /end IF_DATA /end MEASUREMENT
/begin MEASUREMENT B_nwsaktiv "" UWORD B_TRUE 1 100 0 1 BIT_MASK 0x4000 FORMAT "%5.3" /begin IF_DATA ASAP1B_KWP2000 KP_BLOB 0xFD1E INTERN 0x2 /end IF_DATA /begin IF_DATA ETK KP_BLOB 0xFD1E INTERN 0x2 /end IF_DATA /end MEASUREMENT
/begin MEASUREMENT B_nwsalt "" UWORD B_TRUE 1 100 0 1 BIT_MASK 0x8000 FORMAT "%5.3" /begin IF_DATA ASAP1B_KWP2000 KP_BLOB 0xFD1E INTERN 0x2 /end IF_DATA /begin IF_DATA ETK KP_BLOB 0xFD1E INTERN 0x2 /end IF_DATA /end MEASUREMENT
/begin MEASUREMENT B_oellamp "Bedingung Ölwarnlampe ein" UWORD B_TRUE 1 100 0 1 BIT_MASK 0x2000 FORMAT "%5.3" /begin IF_DATA ASAP1B_KWP2000 KP_BLOB 0xFD3A INTERN 0x2 /end IF_DATA /begin IF_DATA ETK KP_BLOB 0xFD3A INTERN 0x2 /end IF_DATA /end MEASUREMENT
/begin MEASUREMENT B_pvl1 "Bedingung Pumpenvorlauf bei Systemen mit Uhr" UBYTE B_TRUE 1 100 0 1 BIT_MASK 0x1 FORMAT "%5.3" /begin IF_DATA ASAP1B_KWP2000 KP_BLOB 0x380480 EXTERN 0x1 /end IF_DATA /begin IF_DATA ETK KP_BLOB 0x380480 EXTERN 0x1 /end IF_DATA /end MEASUREMENT
/begin MEASUREMENT B_pvl2 "Bedingung Pumpenvorlauf bei Systemen ohne Uhr" UBYTE B_TRUE 1 100 0 1 BIT_MASK 0x2 FORMAT "%5.3" /begin IF_DATA ASAP1B_KWP2000 KP_BLOB 0x380480 EXTERN 0x1 /end IF_DATA /begin IF_DATA ETK KP_BLOB 0x380480 EXTERN 0x1 /end IF_DATA /end MEASUREMENT
/begin MEASUREMENT B_pvlnl "Bedingung EKP-Vorlauf aus Nachlaufzeitüberschreitung" UBYTE B_TRUE 1 100 0 1 BIT_MASK 0x1 FORMAT "%5.3" /begin IF_DATA ASAP1B_KWP2000 KP_BLOB 0x38294E EXTERN 0x1 /end IF_DATA /begin IF_DATA ETK KP_BLOB 0x38294E EXTERN 0x1 /end IF_DATA /end MEASUREMENT
/begin MEASUREMENT B_rlp "Bedingung Lastpraediktion aktiv" UWORD B_TRUE 1 100 0 1 BIT_MASK 0x1000 FORMAT "%5.3" /begin IF_DATA ASAP1B_KWP2000 KP_BLOB 0xFD24 INTERN 0x2 /end IF_DATA /begin IF_DATA ETK KP_BLOB 0xFD24 INTERN 0x2 /end IF_DATA /end MEASUREMENT
/begin MEASUREMENT B_rlpns "Einschaltbedingung Lastpraediktion nach Start" UWORD B_TRUE 1 100 0 1 BIT_MASK 0x2000 FORMAT "%5.3" /begin IF_DATA ASAP1B_KWP2000 KP_BLOB 0xFD24 INTERN 0x2 /end IF_DATA /begin IF_DATA ETK KP_BLOB 0xFD24 INTERN 0x2 /end IF_DATA /end MEASUREMENT
/begin MEASUREMENT B_sab "Bedingung Schubabschaltebereitschaft" UWORD B_TRUE 1 100 0 1 BIT_MASK 0x80 FORMAT "%5.3" /begin IF_DATA ASAP1B_KWP2000 KP_BLOB 0xFD2E INTERN 0x2 /end IF_DATA /begin IF_DATA ETK KP_BLOB 0xFD2E INTERN 0x2 /end IF_DATA /end MEASUREMENT
/begin MEASUREMENT B_sabt "Bedingung Schubabschaltebereitschaft" UBYTE B_TRUE 1 100 0 1 BIT_MASK 0x2 FORMAT "%5.3" /begin IF_DATA ASAP1B_KWP2000 KP_BLOB 0x38041C EXTERN 0x1 /end IF_DATA /begin IF_DATA ETK KP_BLOB 0x38041C EXTERN 0x1 /end IF_DATA /end MEASUREMENT
/begin MEASUREMENT B_shlamp "Bedingung Schaltlampe ein" UWORD B_TRUE 1 100 0 1 BIT_MASK 0x4000 FORMAT "%5.3" /begin IF_DATA ASAP1B_KWP2000 KP_BLOB 0xFD3A INTERN 0x2 /end IF_DATA /begin IF_DATA ETK KP_BLOB 0xFD3A INTERN 0x2 /end IF_DATA /end MEASUREMENT
/begin MEASUREMENT B_shled1 "Bedingung erste Schalt-LED ein" UWORD B_TRUE 1 100 0 1 BIT_MASK 0x8000 FORMAT "%5.3" /begin IF_DATA ASAP1B_KWP2000 KP_BLOB 0xFD3A INTERN 0x2 /end IF_DATA /begin IF_DATA ETK KP_BLOB 0xFD3A INTERN 0x2 /end IF_DATA /end MEASUREMENT
/begin MEASUREMENT B_shled2 "Bedingung zweite Schalt-LED ein" UWORD B_TRUE 1 100 0 1 BIT_MASK 0x1 FORMAT "%5.3" /begin IF_DATA ASAP1B_KWP2000 KP_BLOB 0xFD3C INTERN 0x2 /end IF_DATA /begin IF_DATA ETK KP_BLOB 0xFD3C INTERN 0x2 /end IF_DATA /end MEASUREMENT
/begin MEASUREMENT B_shled3 "Bedingung dritte Schalt-LED ein" UWORD B_TRUE 1 100 0 1 BIT_MASK 0x2 FORMAT "%5.3" /begin IF_DATA ASAP1B_KWP2000 KP_BLOB 0xFD3C INTERN 0x2 /end IF_DATA /begin IF_DATA ETK KP_BLOB 0xFD3C INTERN 0x2 /end IF_DATA /end MEASUREMENT
/begin MEASUREMENT B_shled4 "Bedingung vierte Schalt-LED ein" UWORD B_TRUE 1 100 0 1 BIT_MASK 0x4 FORMAT "%5.3" /begin IF_DATA ASAP1B_KWP2000 KP_BLOB 0xFD3C INTERN 0x2 /end IF_DATA /begin IF_DATA ETK KP_BLOB 0xFD3C INTERN 0x2 /end IF_DATA /end MEASUREMENT
/begin MEASUREMENT B_shled5 "Bedingung fünfte Schalt-LED ein" UWORD B_TRUE 1 100 0 1 BIT_MASK 0x8 FORMAT "%5.3" /begin IF_DATA ASAP1B_KWP2000 KP_BLOB 0xFD3C INTERN 0x2 /end IF_DATA /begin IF_DATA ETK KP_BLOB 0xFD3C INTERN 0x2 /end IF_DATA /end MEASUREMENT
/begin MEASUREMENT B_sibm "Fehlertyp: keine Bezugsmarke im Start gefunden" UWORD B_TRUE 1 100 0 1 BIT_MASK 0x400 FORMAT "%5.3" /begin IF_DATA ASAP1B_KWP2000 KP_BLOB 0x382A8A EXTERN 0x2 /end IF_DATA /begin IF_DATA ETK KP_BLOB 0x382A8A EXTERN 0x2 /end IF_DATA /end MEASUREMENT
/begin MEASUREMENT B_sidk "Fehlertyp signal: Drosselklappenpoti" UWORD B_TRUE 1 100 0 1 BIT_MASK 0x400 FORMAT "%5.3" /begin IF_DATA ASAP1B_KWP2000 KP_BLOB 0x382A8C EXTERN 0x2 /end IF_DATA /begin IF_DATA ETK KP_BLOB 0x382A8C EXTERN 0x2 /end IF_DATA /end MEASUREMENT
/begin MEASUREMENT B_silm "Bedingung Signalfehler Hauptfüllungssensor" UWORD B_TRUE 1 100 0 1 BIT_MASK 0x400 FORMAT "%5.3" /begin IF_DATA ASAP1B_KWP2000 KP_BLOB 0x382ABE EXTERN 0x2 /end IF_DATA /begin IF_DATA ETK KP_BLOB 0x382ABE EXTERN 0x2 /end IF_DATA /end MEASUREMENT
/begin MEASUREMENT B_sin "Fehlertyp: kein Drehzahlsignal vorhanden" UWORD B_TRUE 1 100 0 1 BIT_MASK 0x400 FORMAT "%5.3" /begin IF_DATA ASAP1B_KWP2000 KP_BLOB 0x382AC8 EXTERN 0x2 /end IF_DATA /begin IF_DATA ETK KP_BLOB 0x382AC8 EXTERN 0x2 /end IF_DATA /end MEASUREMENT
/begin MEASUREMENT B_sp3 "Spezial-Bereichs-Trigger der Diagnose Kraftstoffversorgungssystem" UBYTE B_TRUE 1 100 0 1 BIT_MASK 0x1 FORMAT "%5.3" /begin IF_DATA ASAP1B_KWP2000 KP_BLOB 0x382820 EXTERN 0x1 /end IF_DATA /begin IF_DATA ETK KP_BLOB 0x382820 EXTERN 0x1 /end IF_DATA /end MEASUREMENT
/begin MEASUREMENT B_spontan0 "" UWORD B_TRUE 1 100 0 1 BIT_MASK 0x1 FORMAT "%5.3" /begin IF_DATA ASAP1B_KWP2000 KP_BLOB 0xFD20 INTERN 0x2 /end IF_DATA /begin IF_DATA ETK KP_BLOB 0xFD20 INTERN 0x2 /end IF_DATA /end MEASUREMENT
/begin MEASUREMENT B_spontan1 "" UWORD B_TRUE 1 100 0 1 BIT_MASK 0x2 FORMAT "%5.3" /begin IF_DATA ASAP1B_KWP2000 KP_BLOB 0xFD20 INTERN 0x2 /end IF_DATA /begin IF_DATA ETK KP_BLOB 0xFD20 INTERN 0x2 /end IF_DATA /end MEASUREMENT
/begin MEASUREMENT B_spontan2 "" UWORD B_TRUE 1 100 0 1 BIT_MASK 0x4 FORMAT "%5.3" /begin IF_DATA ASAP1B_KWP2000 KP_BLOB 0xFD20 INTERN 0x2 /end IF_DATA /begin IF_DATA ETK KP_BLOB 0xFD20 INTERN 0x2 /end IF_DATA /end MEASUREMENT
/begin MEASUREMENT B_spontan3 "" UWORD B_TRUE 1 100 0 1 BIT_MASK 0x8 FORMAT "%5.3" /begin IF_DATA ASAP1B_KWP2000 KP_BLOB 0xFD20 INTERN 0x2 /end IF_DATA /begin IF_DATA ETK KP_BLOB 0xFD20 INTERN 0x2 /end IF_DATA /end MEASUREMENT
/begin MEASUREMENT B_spontan4 "" UWORD B_TRUE 1 100 0 1 BIT_MASK 0x10 FORMAT "%5.3" /begin IF_DATA ASAP1B_KWP2000 KP_BLOB 0xFD20 INTERN 0x2 /end IF_DATA /begin IF_DATA ETK KP_BLOB 0xFD20 INTERN 0x2 /end IF_DATA /end MEASUREMENT
/begin MEASUREMENT B_spontan5 "" UWORD B_TRUE 1 100 0 1 BIT_MASK 0x20 FORMAT "%5.3" /begin IF_DATA ASAP1B_KWP2000 KP_BLOB 0xFD20 INTERN 0x2 /end IF_DATA /begin IF_DATA ETK KP_BLOB 0xFD20 INTERN 0x2 /end IF_DATA /end MEASUREMENT
/begin MEASUREMENT B_spontan6 "" UWORD B_TRUE 1 100 0 1 BIT_MASK 0x40 FORMAT "%5.3" /begin IF_DATA ASAP1B_KWP2000 KP_BLOB 0xFD20 INTERN 0x2 /end IF_DATA /begin IF_DATA ETK KP_BLOB 0xFD20 INTERN 0x2 /end IF_DATA /end MEASUREMENT
/begin MEASUREMENT B_spontan7 "" UWORD B_TRUE 1 100 0 1 BIT_MASK 0x80 FORMAT "%5.3" /begin IF_DATA ASAP1B_KWP2000 KP_BLOB 0xFD20 INTERN 0x2 /end IF_DATA /begin IF_DATA ETK KP_BLOB 0xFD20 INTERN 0x2 /end IF_DATA /end MEASUREMENT
/begin MEASUREMENT B_st "Bedingung Start" UWORD B_TRUE 1 100 0 1 BIT_MASK 0x8 FORMAT "%5.3" /begin IF_DATA ASAP1B_KWP2000 KP_BLOB 0xFD46 INTERN 0x2 /end IF_DATA /begin IF_DATA ETK KP_BLOB 0xFD46 INTERN 0x2 /end IF_DATA /end MEASUREMENT
/begin MEASUREMENT B_stend "Bedingung Startende erreicht" UWORD B_TRUE 1 100 0 1 BIT_MASK 0x10 FORMAT "%5.3" /begin IF_DATA ASAP1B_KWP2000 KP_BLOB 0xFD46 INTERN 0x2 /end IF_DATA /begin IF_DATA ETK KP_BLOB 0xFD46 INTERN 0x2 /end IF_DATA /end MEASUREMENT
/begin MEASUREMENT B_sumod1 "Bedingung Saugrohrumschaltung sumode=1" UWORD B_TRUE 1 100 0 1 BIT_MASK 0x20 FORMAT "%5.3" /begin IF_DATA ASAP1B_KWP2000 KP_BLOB 0xFD24 INTERN 0x2 /end IF_DATA /begin IF_DATA ETK KP_BLOB 0xFD24 INTERN 0x2 /end IF_DATA /end MEASUREMENT
/begin MEASUREMENT B_sumod2 "Bedingung Saugrohrumschaltung sumode=2" UWORD B_TRUE 1 100 0 1 BIT_MASK 0x40 FORMAT "%5.3" /begin IF_DATA ASAP1B_KWP2000 KP_BLOB 0xFD24 INTERN 0x2 /end IF_DATA /begin IF_DATA ETK KP_BLOB 0xFD24 INTERN 0x2 /end IF_DATA /end MEASUREMENT
/begin MEASUREMENT B_sumod3 "Bedingung Saugrohrumschaltung sumode=3" UWORD B_TRUE 1 100 0 1 BIT_MASK 0x80 FORMAT "%5.3" /begin IF_DATA ASAP1B_KWP2000 KP_BLOB 0xFD24 INTERN 0x2 /end IF_DATA /begin IF_DATA ETK KP_BLOB 0xFD24 INTERN 0x2 /end IF_DATA /end MEASUREMENT
/begin MEASUREMENT B_syn2nd "" UWORD B_TRUE 1 100 0 1 BIT_MASK 0x2 FORMAT "%5.3" /begin IF_DATA ASAP1B_KWP2000 KP_BLOB 0xFD1A INTERN 0x2 /end IF_DATA /begin IF_DATA ETK KP_BLOB 0xFD1A INTERN 0x2 /end IF_DATA /end MEASUREMENT
/begin MEASUREMENT B_synti "" UWORD B_TRUE 1 100 0 1 BIT_MASK 0x100 FORMAT "%5.3" /begin IF_DATA ASAP1B_KWP2000 KP_BLOB 0xFD20 INTERN 0x2 /end IF_DATA /begin IF_DATA ETK KP_BLOB 0xFD20 INTERN 0x2 /end IF_DATA /end MEASUREMENT
/begin MEASUREMENT B_tim "Zeit-Trigger für Fehlerpfadmanagement" UBYTE B_TRUE 1 100 0 1 BIT_MASK 0x1 FORMAT "%5.3" /begin IF_DATA ASAP1B_KWP2000 KP_BLOB 0x380341 EXTERN 0x1 /end IF_DATA /begin IF_DATA ETK KP_BLOB 0x380341 EXTERN 0x1 /end IF_DATA /end MEASUREMENT
/begin MEASUREMENT B_ti_cha0 "" UWORD B_TRUE 1 100 0 1 BIT_MASK 0x200 FORMAT "%5.3" /begin IF_DATA ASAP1B_KWP2000 KP_BLOB 0xFD20 INTERN 0x2 /end IF_DATA /begin IF_DATA ETK KP_BLOB 0xFD20 INTERN 0x2 /end IF_DATA /end MEASUREMENT
/begin MEASUREMENT B_ti_cha1 "" UWORD B_TRUE 1 100 0 1 BIT_MASK 0x400 FORMAT "%5.3" /begin IF_DATA ASAP1B_KWP2000 KP_BLOB 0xFD20 INTERN 0x2 /end IF_DATA /begin IF_DATA ETK KP_BLOB 0xFD20 INTERN 0x2 /end IF_DATA /end MEASUREMENT
/begin MEASUREMENT B_ti_cha2 "" UWORD B_TRUE 1 100 0 1 BIT_MASK 0x800 FORMAT "%5.3" /begin IF_DATA ASAP1B_KWP2000 KP_BLOB 0xFD20 INTERN 0x2 /end IF_DATA /begin IF_DATA ETK KP_BLOB 0xFD20 INTERN 0x2 /end IF_DATA /end MEASUREMENT
/begin MEASUREMENT B_ti_cha3 "" UWORD B_TRUE 1 100 0 1 BIT_MASK 0x1000 FORMAT "%5.3" /begin IF_DATA ASAP1B_KWP2000 KP_BLOB 0xFD20 INTERN 0x2 /end IF_DATA /begin IF_DATA ETK KP_BLOB 0xFD20 INTERN 0x2 /end IF_DATA /end MEASUREMENT
/begin MEASUREMENT B_ti_cha4 "" UWORD B_TRUE 1 100 0 1 BIT_MASK 0x2000 FORMAT "%5.3" /begin IF_DATA ASAP1B_KWP2000 KP_BLOB 0xFD20 INTERN 0x2 /end IF_DATA /begin IF_DATA ETK KP_BLOB 0xFD20 INTERN 0x2 /end IF_DATA /end MEASUREMENT
/begin MEASUREMENT B_ti_cha5 "" UWORD B_TRUE 1 100 0 1 BIT_MASK 0x4000 FORMAT "%5.3" /begin IF_DATA ASAP1B_KWP2000 KP_BLOB 0xFD20 INTERN 0x2 /end IF_DATA /begin IF_DATA ETK KP_BLOB 0xFD20 INTERN 0x2 /end IF_DATA /end MEASUREMENT
/begin MEASUREMENT B_ti_cha6 "" UWORD B_TRUE 1 100 0 1 BIT_MASK 0x8000 FORMAT "%5.3" /begin IF_DATA ASAP1B_KWP2000 KP_BLOB 0xFD20 INTERN 0x2 /end IF_DATA /begin IF_DATA ETK KP_BLOB 0xFD20 INTERN 0x2 /end IF_DATA /end MEASUREMENT
/begin MEASUREMENT B_ti_cha7 "" UWORD B_TRUE 1 100 0 1 BIT_MASK 0x1 FORMAT "%5.3" /begin IF_DATA ASAP1B_KWP2000 KP_BLOB 0xFD22 INTERN 0x2 /end IF_DATA /begin IF_DATA ETK KP_BLOB 0xFD22 INTERN 0x2 /end IF_DATA /end MEASUREMENT
/begin MEASUREMENT B_ti_out0 "" UWORD B_TRUE 1 100 0 1 BIT_MASK 0x2 FORMAT "%5.3" /begin IF_DATA ASAP1B_KWP2000 KP_BLOB 0xFD22 INTERN 0x2 /end IF_DATA /begin IF_DATA ETK KP_BLOB 0xFD22 INTERN 0x2 /end IF_DATA /end MEASUREMENT
/begin MEASUREMENT B_ti_out1 "" UWORD B_TRUE 1 100 0 1 BIT_MASK 0x4 FORMAT "%5.3" /begin IF_DATA ASAP1B_KWP2000 KP_BLOB 0xFD22 INTERN 0x2 /end IF_DATA /begin IF_DATA ETK KP_BLOB 0xFD22 INTERN 0x2 /end IF_DATA /end MEASUREMENT
/begin MEASUREMENT B_ti_out2 "" UWORD B_TRUE 1 100 0 1 BIT_MASK 0x8 FORMAT "%5.3" /begin IF_DATA ASAP1B_KWP2000 KP_BLOB 0xFD22 INTERN 0x2 /end IF_DATA /begin IF_DATA ETK KP_BLOB 0xFD22 INTERN 0x2 /end IF_DATA /end MEASUREMENT
/begin MEASUREMENT B_ti_out3 "" UWORD B_TRUE 1 100 0 1 BIT_MASK 0x10 FORMAT "%5.3" /begin IF_DATA ASAP1B_KWP2000 KP_BLOB 0xFD22 INTERN 0x2 /end IF_DATA /begin IF_DATA ETK KP_BLOB 0xFD22 INTERN 0x2 /end IF_DATA /end MEASUREMENT
/begin MEASUREMENT B_ti_out4 "" UWORD B_TRUE 1 100 0 1 BIT_MASK 0x20 FORMAT "%5.3" /begin IF_DATA ASAP1B_KWP2000 KP_BLOB 0xFD22 INTERN 0x2 /end IF_DATA /begin IF_DATA ETK KP_BLOB 0xFD22 INTERN 0x2 /end IF_DATA /end MEASUREMENT
/begin MEASUREMENT B_ti_out5 "" UWORD B_TRUE 1 100 0 1 BIT_MASK 0x40 FORMAT "%5.3" /begin IF_DATA ASAP1B_KWP2000 KP_BLOB 0xFD22 INTERN 0x2 /end IF_DATA /begin IF_DATA ETK KP_BLOB 0xFD22 INTERN 0x2 /end IF_DATA /end MEASUREMENT
/begin MEASUREMENT B_ti_out6 "" UWORD B_TRUE 1 100 0 1 BIT_MASK 0x80 FORMAT "%5.3" /begin IF_DATA ASAP1B_KWP2000 KP_BLOB 0xFD22 INTERN 0x2 /end IF_DATA /begin IF_DATA ETK KP_BLOB 0xFD22 INTERN 0x2 /end IF_DATA /end MEASUREMENT
/begin MEASUREMENT B_ti_out7 "" UWORD B_TRUE 1 100 0 1 BIT_MASK 0x100 FORMAT "%5.3" /begin IF_DATA ASAP1B_KWP2000 KP_BLOB 0xFD22 INTERN 0x2 /end IF_DATA /begin IF_DATA ETK KP_BLOB 0xFD22 INTERN 0x2 /end IF_DATA /end MEASUREMENT
/begin MEASUREMENT B_ti_wai0 "" UWORD B_TRUE 1 100 0 1 BIT_MASK 0x200 FORMAT "%5.3" /begin IF_DATA ASAP1B_KWP2000 KP_BLOB 0xFD22 INTERN 0x2 /end IF_DATA /begin IF_DATA ETK KP_BLOB 0xFD22 INTERN 0x2 /end IF_DATA /end MEASUREMENT
/begin MEASUREMENT B_ti_wai1 "" UWORD B_TRUE 1 100 0 1 BIT_MASK 0x400 FORMAT "%5.3" /begin IF_DATA ASAP1B_KWP2000 KP_BLOB 0xFD22 INTERN 0x2 /end IF_DATA /begin IF_DATA ETK KP_BLOB 0xFD22 INTERN 0x2 /end IF_DATA /end MEASUREMENT
/begin MEASUREMENT B_ti_wai2 "" UWORD B_TRUE 1 100 0 1 BIT_MASK 0x800 FORMAT "%5.3" /begin IF_DATA ASAP1B_KWP2000 KP_BLOB 0xFD22 INTERN 0x2 /end IF_DATA /begin IF_DATA ETK KP_BLOB 0xFD22 INTERN 0x2 /end IF_DATA /end MEASUREMENT
/begin MEASUREMENT B_ti_wai3 "" UWORD B_TRUE 1 100 0 1 BIT_MASK 0x1000 FORMAT "%5.3" /begin IF_DATA ASAP1B_KWP2000 KP_BLOB 0xFD22 INTERN 0x2 /end IF_DATA /begin IF_DATA ETK KP_BLOB 0xFD22 INTERN 0x2 /end IF_DATA /end MEASUREMENT
/begin MEASUREMENT B_ti_wai4 "" UWORD B_TRUE 1 100 0 1 BIT_MASK 0x2000 FORMAT "%5.3" /begin IF_DATA ASAP1B_KWP2000 KP_BLOB 0xFD22 INTERN 0x2 /end IF_DATA /begin IF_DATA ETK KP_BLOB 0xFD22 INTERN 0x2 /end IF_DATA /end MEASUREMENT
/begin MEASUREMENT B_ti_wai5 "" UWORD B_TRUE 1 100 0 1 BIT_MASK 0x4000 FORMAT "%5.3" /begin IF_DATA ASAP1B_KWP2000 KP_BLOB 0xFD22 INTERN 0x2 /end IF_DATA /begin IF_DATA ETK KP_BLOB 0xFD22 INTERN 0x2 /end IF_DATA /end MEASUREMENT
/begin MEASUREMENT B_ti_wai6 "" UWORD B_TRUE 1 100 0 1 BIT_MASK 0x8000 FORMAT "%5.3" /begin IF_DATA ASAP1B_KWP2000 KP_BLOB 0xFD22 INTERN 0x2 /end IF_DATA /begin IF_DATA ETK KP_BLOB 0xFD22 INTERN 0x2 /end IF_DATA /end MEASUREMENT
/begin MEASUREMENT B_ti_wai7 "" UWORD B_TRUE 1 100 0 1 BIT_MASK 0x1 FORMAT "%5.3" /begin IF_DATA ASAP1B_KWP2000 KP_BLOB 0xFD24 INTERN 0x2 /end IF_DATA /begin IF_DATA ETK KP_BLOB 0xFD24 INTERN 0x2 /end IF_DATA /end MEASUREMENT
/begin MEASUREMENT B_tpvl "Bedingung Pumpenvorlauf der Länge TPVL Sekunden" UBYTE B_TRUE 1 100 0 1 BIT_MASK 0x4 FORMAT "%5.3" /begin IF_DATA ASAP1B_KWP2000 KP_BLOB 0x380480 EXTERN 0x1 /end IF_DATA /begin IF_DATA ETK KP_BLOB 0x380480 EXTERN 0x1 /end IF_DATA /end MEASUREMENT
/begin MEASUREMENT B_wdkp "Bedingung Dk-Praediktion aktiv" UWORD B_TRUE 1 100 0 1 BIT_MASK 0x400 FORMAT "%5.3" /begin IF_DATA ASAP1B_KWP2000 KP_BLOB 0xFD24 INTERN 0x2 /end IF_DATA /begin IF_DATA ETK KP_BLOB 0xFD24 INTERN 0x2 /end IF_DATA /end MEASUREMENT
/begin MEASUREMENT cc_cha_0 "" UWORD dez 1 100 0 65535 FORMAT "%8.2" /begin IF_DATA ASAP1B_KWP2000 KP_BLOB 0xF80E INTERN 0x2 /end IF_DATA /begin IF_DATA ETK KP_BLOB 0xF80E INTERN 0x2 /end IF_DATA /end MEASUREMENT
/begin MEASUREMENT cc_cha_1 "" UWORD dez 1 100 0 65535 FORMAT "%8.2" /begin IF_DATA ASAP1B_KWP2000 KP_BLOB 0xF810 INTERN 0x2 /end IF_DATA /begin IF_DATA ETK KP_BLOB 0xF810 INTERN 0x2 /end IF_DATA /end MEASUREMENT
/begin MEASUREMENT cc_cha_2 "" UWORD dez 1 100 0 65535 FORMAT "%8.2" /begin IF_DATA ASAP1B_KWP2000 KP_BLOB 0xF812 INTERN 0x2 /end IF_DATA /begin IF_DATA ETK KP_BLOB 0xF812 INTERN 0x2 /end IF_DATA /end MEASUREMENT
/begin MEASUREMENT cc_cha_3 "" UWORD dez 1 100 0 65535 FORMAT "%8.2" /begin IF_DATA ASAP1B_KWP2000 KP_BLOB 0xF814 INTERN 0x2 /end IF_DATA /begin IF_DATA ETK KP_BLOB 0xF814 INTERN 0x2 /end IF_DATA /end MEASUREMENT
/begin MEASUREMENT cc_cha_4 "" UWORD dez 1 100 0 65535 FORMAT "%8.2" /begin IF_DATA ASAP1B_KWP2000 KP_BLOB 0xF816 INTERN 0x2 /end IF_DATA /begin IF_DATA ETK KP_BLOB 0xF816 INTERN 0x2 /end IF_DATA /end MEASUREMENT
/begin MEASUREMENT cc_cha_5 "" UWORD dez 1 100 0 65535 FORMAT "%8.2" /begin IF_DATA ASAP1B_KWP2000 KP_BLOB 0xF818 INTERN 0x2 /end IF_DATA /begin IF_DATA ETK KP_BLOB 0xF818 INTERN 0x2 /end IF_DATA /end MEASUREMENT
/begin MEASUREMENT cc_cha_6 "" UWORD dez 1 100 0 65535 FORMAT "%8.2" /begin IF_DATA ASAP1B_KWP2000 KP_BLOB 0xF81A INTERN 0x2 /end IF_DATA /begin IF_DATA ETK KP_BLOB 0xF81A INTERN 0x2 /end IF_DATA /end MEASUREMENT
/begin MEASUREMENT cc_cha_7 "" UWORD dez 1 100 0 65535 FORMAT "%8.2" /begin IF_DATA ASAP1B_KWP2000 KP_BLOB 0xF81C INTERN 0x2 /end IF_DATA /begin IF_DATA ETK KP_BLOB 0xF81C INTERN 0x2 /end IF_DATA /end MEASUREMENT
/begin MEASUREMENT DDU2Data "" UBYTE dez 1 100 0 255 FORMAT "%5.1" ARRAY_SIZE 25 /begin IF_DATA ASAP1B_KWP2000 KP_BLOB 0x382807 EXTERN 0x1 /end IF_DATA /begin IF_DATA ETK KP_BLOB 0x382807 EXTERN 0x1 /end IF_DATA /end MEASUREMENT
/begin MEASUREMENT ddu2leds "Ausgabebyte für DDU2-Lampen" UBYTE default 1 100 0 255 FORMAT "%5.1" /begin IF_DATA ASAP1B_KWP2000 KP_BLOB 0x38043F EXTERN 0x1 /end IF_DATA /begin IF_DATA ETK KP_BLOB 0x38043F EXTERN 0x1 /end IF_DATA /end MEASUREMENT
/begin MEASUREMENT ddwdkba_w "Aenderung Gradient des Drosselklappen-Istwinkels" SWORD rel_sw_b50 1 100 -50 49.9985 FORMAT "%8.5" /begin IF_DATA ASAP1B_KWP2000 KP_BLOB 0x380BC6 EXTERN 0x2 /end IF_DATA /begin IF_DATA ETK KP_BLOB 0x380BC6 EXTERN 0x2 /end IF_DATA /end MEASUREMENT
/begin MEASUREMENT dekpub "Differenz der Batteriespannung zwischen zwei Messungen bis EKP-Dauerbetrieb" UBYTE spg_ubatt 1 100 0 17.3655 FORMAT "%5.2" /begin IF_DATA ASAP1B_KWP2000 KP_BLOB 0x380481 EXTERN 0x1 /end IF_DATA /begin IF_DATA ETK KP_BLOB 0x380481 EXTERN 0x1 /end IF_DATA /end MEASUREMENT
/begin MEASUREMENT dfcmFcm "" UBYTE dez 1 100 0 255 FORMAT "%5.1" /begin IF_DATA ASAP1B_KWP2000 KP_BLOB 0x382821 EXTERN 0x1 /end IF_DATA /begin IF_DATA ETK KP_BLOB 0x382821 EXTERN 0x1 /end IF_DATA /end MEASUREMENT
/begin MEASUREMENT dfcmNo "" UBYTE dez 1 100 0 255 FORMAT "%5.1" /begin IF_DATA ASAP1B_KWP2000 KP_BLOB 0x382822 EXTERN 0x1 /end IF_DATA /begin IF_DATA ETK KP_BLOB 0x382822 EXTERN 0x1 /end IF_DATA /end MEASUREMENT
/begin MEASUREMENT dfcmSfp "" UBYTE dez 1 100 0 255 FORMAT "%5.1" /begin IF_DATA ASAP1B_KWP2000 KP_BLOB 0x382823 EXTERN 0x1 /end IF_DATA /begin IF_DATA ETK KP_BLOB 0x382823 EXTERN 0x1 /end IF_DATA /end MEASUREMENT
/begin MEASUREMENT dfpmEpclState "" UWORD dez 1 100 0 65535 FORMAT "%8.2" /begin IF_DATA ASAP1B_KWP2000 KP_BLOB 0x382956 EXTERN 0x2 /end IF_DATA /begin IF_DATA ETK KP_BLOB 0x382956 EXTERN 0x2 /end IF_DATA /end MEASUREMENT
/begin MEASUREMENT dfpmMilState "" UWORD dez 1 100 0 65535 FORMAT "%8.2" /begin IF_DATA ASAP1B_KWP2000 KP_BLOB 0x382957 EXTERN 0x2 /end IF_DATA /begin IF_DATA ETK KP_BLOB 0x382957 EXTERN 0x2 /end IF_DATA /end MEASUREMENT
/begin MEASUREMENT dfp_ap "" UBYTE dez 1 100 0 255 FORMAT "%5.1" /begin IF_DATA ASAP1B_KWP2000 KP_BLOB 0x382824 EXTERN 0x1 /end IF_DATA /begin IF_DATA ETK KP_BLOB 0x382824 EXTERN 0x1 /end IF_DATA /end MEASUREMENT
/begin MEASUREMENT dfuelsan_w "Delta Füllungssensor zu Alpha/n-System" SWORD fak_sw_b1 1 100 -1 0.999969 FORMAT "%8.6" /begin IF_DATA ASAP1B_KWP2000 KP_BLOB 0x380B1A EXTERN 0x2 /end IF_DATA /begin IF_DATA ETK KP_BLOB 0x380B1A EXTERN 0x2 /end IF_DATA /end MEASUREMENT
/begin MEASUREMENT dnmotas_w "Differenzdrehzahl über ein Arbeitsspiel" SWORD nmot_sw_q0p25 1 100 -8192 8191.75 FORMAT "%8.3" /begin IF_DATA ASAP1B_KWP2000 KP_BLOB 0x3809F6 EXTERN 0x2 /end IF_DATA /begin IF_DATA ETK KP_BLOB 0x3809F6 EXTERN 0x2 /end IF_DATA /end MEASUREMENT
/begin MEASUREMENT dnmot_w "Differenzdrehzahl zwischen zwei folgenden Segmenten" SWORD nmot_sw_q0p25 1 100 -8192 8191.75 FORMAT "%8.3" /begin IF_DATA ASAP1B_KWP2000 KP_BLOB 0x3809F8 EXTERN 0x2 /end IF_DATA /begin IF_DATA ETK KP_BLOB 0x3809F8 EXTERN 0x2 /end IF_DATA /end MEASUREMENT
/begin MEASUREMENT dnsa "Zeitabhängige Schubhysterese" UBYTE nmot_ub_q40 1 100 0 10200 FORMAT "%5.0" /begin IF_DATA ASAP1B_KWP2000 KP_BLOB 0x38041D EXTERN 0x1 /end IF_DATA /begin IF_DATA ETK KP_BLOB 0x38041D EXTERN 0x1 /end IF_DATA /end MEASUREMENT
/begin MEASUREMENT dpsdvs_w "delta Saugrohrdruck aus Drosselventilen (Word)" SWORD p_sw_q0p039 1 100 -1280 1279.96 FORMAT "%8.3" /begin IF_DATA ASAP1B_KWP2000 KP_BLOB 0x380BCC EXTERN 0x2 /end IF_DATA /begin IF_DATA ETK KP_BLOB 0x380BCC EXTERN 0x2 /end IF_DATA /end MEASUREMENT
/begin MEASUREMENT dpsfgm_w "delta-Frischgaspartialdruck im Saugrohr" SWORD p_sw_q0p039 1 100 -1280 1279.96 FORMAT "%8.3" /begin IF_DATA ASAP1B_KWP2000 KP_BLOB 0x380B4A EXTERN 0x2 /end IF_DATA /begin IF_DATA ETK KP_BLOB 0x380B4A EXTERN 0x2 /end IF_DATA /end MEASUREMENT
/begin MEASUREMENT dpsfg_w "delta-Frischgaspartialdruck im Saugrohr" SWORD p_sw_q0p039 1 100 -1280 1279.96 FORMAT "%8.3" /begin IF_DATA ASAP1B_KWP2000 KP_BLOB 0x380B4C EXTERN 0x2 /end IF_DATA /begin IF_DATA ETK KP_BLOB 0x380B4C EXTERN 0x2 /end IF_DATA /end MEASUREMENT
/begin MEASUREMENT dpsmp_w "delta extrapolierter Saugrohrdruck (Word)" SWORD p_sw_q0p039 1 100 -1280 1279.96 FORMAT "%8.3" /begin IF_DATA ASAP1B_KWP2000 KP_BLOB 0x380BCE EXTERN 0x2 /end IF_DATA /begin IF_DATA ETK KP_BLOB 0x380BCE EXTERN 0x2 /end IF_DATA /end MEASUREMENT
/begin MEASUREMENT dpus_w "Delta Druck Umgebung Saugrohr" SWORD p_sw_q0p078 1 100 -2560 2559.92 FORMAT "%8.3" /begin IF_DATA ASAP1B_KWP2000 KP_BLOB 0x380BE0 EXTERN 0x2 /end IF_DATA /begin IF_DATA ETK KP_BLOB 0x380BE0 EXTERN 0x2 /end IF_DATA /end MEASUREMENT
/begin MEASUREMENT drlp_w "delta-Einspritzberechnungs-Last aus Praediktion (Word)" SWORD rel_sw_q0p0234 1 100 -768 767.977 FORMAT "%8.4" /begin IF_DATA ASAP1B_KWP2000 KP_BLOB 0xF878 INTERN 0x2 /end IF_DATA /begin IF_DATA ETK KP_BLOB 0xF878 INTERN 0x2 /end IF_DATA /end MEASUREMENT
/begin MEASUREMENT drl_w "Füllungsänderung (Word)" SWORD rel_sw_q0p0234 1 100 -768 767.977 FORMAT "%8.4" /begin IF_DATA ASAP1B_KWP2000 KP_BLOB 0x380B4E EXTERN 0x2 /end IF_DATA /begin IF_DATA ETK KP_BLOB 0x380B4E EXTERN 0x2 /end IF_DATA /end MEASUREMENT
/begin MEASUREMENT eevx "EV Fehlerbyte" UBYTE dez 1 100 0 255 FORMAT "%5.1" /begin IF_DATA ASAP1B_KWP2000 KP_BLOB 0x38037E EXTERN 0x1 /end IF_DATA /begin IF_DATA ETK KP_BLOB 0x38037E EXTERN 0x1 /end IF_DATA /end MEASUREMENT
/begin MEASUREMENT evrbgn "Ev Nr. bei Beginn der Ev-Abschaltung über Momentenreduzierung" UBYTE dez 1 100 0 255 FORMAT "%5.1" /begin IF_DATA ASAP1B_KWP2000 KP_BLOB 0x38037F EXTERN 0x1 /end IF_DATA /begin IF_DATA ETK KP_BLOB 0x38037F EXTERN 0x1 /end IF_DATA /end MEASUREMENT
/begin MEASUREMENT evrbgn_one "Ev Nr -1 bei Beginn der Ev-Abschaltung zur Adressierung von REDABM" UBYTE dez 1 100 0 255 FORMAT "%5.1" /begin IF_DATA ASAP1B_KWP2000 KP_BLOB 0x380380 EXTERN 0x1 /end IF_DATA /begin IF_DATA ETK KP_BLOB 0x380380 EXTERN 0x1 /end IF_DATA /end MEASUREMENT
/begin MEASUREMENT evtmod "Einlaßventiltemperatur modelliert (Temperaturmodell)" UBYTE temp_ub_q0p75_o48 1 100 -48 143.25 FORMAT "%5.1" /begin IF_DATA ASAP1B_KWP2000 KP_BLOB 0x38036C EXTERN 0x1 /end IF_DATA /begin IF_DATA ETK KP_BLOB 0x38036C EXTERN 0x1 /end IF_DATA /end MEASUREMENT
/begin MEASUREMENT evz_ags "Einspritzausblendmuster gesamt von einem oder 2 SG" UBYTE dez 1 100 0 255 FORMAT "%5.1" /begin IF_DATA ASAP1B_KWP2000 KP_BLOB 0x380381 EXTERN 0x1 /end IF_DATA /begin IF_DATA ETK KP_BLOB 0x380381 EXTERN 0x1 /end IF_DATA /end MEASUREMENT
/begin MEASUREMENT evz_aus "Einspritzausblendmuster" UBYTE dez 1 100 0 255 FORMAT "%5.1" /begin IF_DATA ASAP1B_KWP2000 KP_BLOB 0x380382 EXTERN 0x1 /end IF_DATA /begin IF_DATA ETK KP_BLOB 0x380382 EXTERN 0x1 /end IF_DATA /end MEASUREMENT
/begin MEASUREMENT evz_austot "Einspritzausblendmuster total" UBYTE dez 1 100 0 255 FORMAT "%5.1" /begin IF_DATA ASAP1B_KWP2000 KP_BLOB 0x380383 EXTERN 0x1 /end IF_DATA /begin IF_DATA ETK KP_BLOB 0x380383 EXTERN 0x1 /end IF_DATA /end MEASUREMENT
/begin MEASUREMENT E_bm "Errorflag: Bezugsmarkengeber" UWORD B_TRUE 1 100 0 1 BIT_MASK 0x1 FORMAT "%5.3" /begin IF_DATA ASAP1B_KWP2000 KP_BLOB 0x382A8A EXTERN 0x2 /end IF_DATA /begin IF_DATA ETK KP_BLOB 0x382A8A EXTERN 0x2 /end IF_DATA /end MEASUREMENT
/begin MEASUREMENT E_dk "Errorflag: DK - Potentiometer" UWORD B_TRUE 1 100 0 1 BIT_MASK 0x1 FORMAT "%5.3" /begin IF_DATA ASAP1B_KWP2000 KP_BLOB 0x382A8C EXTERN 0x2 /end IF_DATA /begin IF_DATA ETK KP_BLOB 0x382A8C EXTERN 0x2 /end IF_DATA /end MEASUREMENT
/begin MEASUREMENT E_lm "Errorflag: Hauptlastsensor" UWORD B_TRUE 1 100 0 1 BIT_MASK 0x1 FORMAT "%5.3" /begin IF_DATA ASAP1B_KWP2000 KP_BLOB 0x382ABE EXTERN 0x2 /end IF_DATA /begin IF_DATA ETK KP_BLOB 0x382ABE EXTERN 0x2 /end IF_DATA /end MEASUREMENT
/begin MEASUREMENT E_n "Errorflag: Drehzahlsignalgeber" UWORD B_TRUE 1 100 0 1 BIT_MASK 0x1 FORMAT "%5.3" /begin IF_DATA ASAP1B_KWP2000 KP_BLOB 0x382AC8 EXTERN 0x2 /end IF_DATA /begin IF_DATA ETK KP_BLOB 0x382AC8 EXTERN 0x2 /end IF_DATA /end MEASUREMENT
/begin MEASUREMENT fcmEnd "Anzahl Einträge im Fehlerspeicher" UBYTE dez 1 100 0 255 FORMAT "%5.1" /begin IF_DATA ASAP1B_KWP2000 KP_BLOB 0x382825 EXTERN 0x1 /end IF_DATA /begin IF_DATA ETK KP_BLOB 0x382825 EXTERN 0x1 /end IF_DATA /end MEASUREMENT
/begin MEASUREMENT FCMTab "" UWORD dez 1 100 0 65535 FORMAT "%8.2" /begin IF_DATA ASAP1B_KWP2000 KP_BLOB 0x382958 EXTERN 0x2 /end IF_DATA /begin IF_DATA ETK KP_BLOB 0x382958 EXTERN 0x2 /end IF_DATA /end MEASUREMENT
/begin MEASUREMENT fgezs1 "" UBYTE fak_ub_q0p0019_o0p75 1 100 0.75 1.24805 FORMAT "%5.3" /begin IF_DATA ASAP1B_KWP2000 KP_BLOB 0x380363 EXTERN 0x1 /end IF_DATA /begin IF_DATA ETK KP_BLOB 0x380363 EXTERN 0x1 /end IF_DATA /end MEASUREMENT
/begin MEASUREMENT fgezs2 "" UBYTE fak_ub_q0p0019_o0p75 1 100 0.75 1.24805 FORMAT "%5.3" /begin IF_DATA ASAP1B_KWP2000 KP_BLOB 0x380364 EXTERN 0x1 /end IF_DATA /begin IF_DATA ETK KP_BLOB 0x380364 EXTERN 0x1 /end IF_DATA /end MEASUREMENT
/begin MEASUREMENT fgezs3 "" UBYTE fak_ub_q0p0019_o0p75 1 100 0.75 1.24805 FORMAT "%5.3" /begin IF_DATA ASAP1B_KWP2000 KP_BLOB 0x380365 EXTERN 0x1 /end IF_DATA /begin IF_DATA ETK KP_BLOB 0x380365 EXTERN 0x1 /end IF_DATA /end MEASUREMENT
/begin MEASUREMENT fgezs4 "" UBYTE fak_ub_q0p0019_o0p75 1 100 0.75 1.24805 FORMAT "%5.3" /begin IF_DATA ASAP1B_KWP2000 KP_BLOB 0x380366 EXTERN 0x1 /end IF_DATA /begin IF_DATA ETK KP_BLOB 0x380366 EXTERN 0x1 /end IF_DATA /end MEASUREMENT
/begin MEASUREMENT fgezs5 "" UBYTE fak_ub_q0p0019_o0p75 1 100 0.75 1.24805 FORMAT "%5.3" /begin IF_DATA ASAP1B_KWP2000 KP_BLOB 0x380367 EXTERN 0x1 /end IF_DATA /begin IF_DATA ETK KP_BLOB 0x380367 EXTERN 0x1 /end IF_DATA /end MEASUREMENT
/begin MEASUREMENT fgezs6 "" UBYTE fak_ub_q0p0019_o0p75 1 100 0.75 1.24805 FORMAT "%5.3" /begin IF_DATA ASAP1B_KWP2000 KP_BLOB 0x380368 EXTERN 0x1 /end IF_DATA /begin IF_DATA ETK KP_BLOB 0x380368 EXTERN 0x1 /end IF_DATA /end MEASUREMENT
/begin MEASUREMENT fgezs7 "" UBYTE fak_ub_q0p0019_o0p75 1 100 0.75 1.24805 FORMAT "%5.3" /begin IF_DATA ASAP1B_KWP2000 KP_BLOB 0x380369 EXTERN 0x1 /end IF_DATA /begin IF_DATA ETK KP_BLOB 0x380369 EXTERN 0x1 /end IF_DATA /end MEASUREMENT
/begin MEASUREMENT fgezs8 "" UBYTE fak_ub_q0p0019_o0p75 1 100 0.75 1.24805 FORMAT "%5.3" /begin IF_DATA ASAP1B_KWP2000 KP_BLOB 0x38036A EXTERN 0x1 /end IF_DATA /begin IF_DATA ETK KP_BLOB 0x38036A EXTERN 0x1 /end IF_DATA /end MEASUREMENT
/begin MEASUREMENT fkmsdks_w "Korrekturfaktor schneller Massenstromabgleich" UWORD fak_uw_b4 1 100 0 3.99994 FORMAT "%8.6" /begin IF_DATA ASAP1B_KWP2000 KP_BLOB 0x380B1C EXTERN 0x2 /end IF_DATA /begin IF_DATA ETK KP_BLOB 0x380B1C EXTERN 0x2 /end IF_DATA /end MEASUREMENT
/begin MEASUREMENT fkmsdk_w "Korrekturfaktor Massenstrom Nebenfüllungssignal" UWORD fak_uw_b4 1 100 0 3.99994 FORMAT "%8.6" /begin IF_DATA ASAP1B_KWP2000 KP_BLOB 0x380B1E EXTERN 0x2 /end IF_DATA /begin IF_DATA ETK KP_BLOB 0x380B1E EXTERN 0x2 /end IF_DATA /end MEASUREMENT
/begin MEASUREMENT fkpvdk_w "Korrekturfaktor langsamer Massenstromabgleich" UWORD fak_uw_b4 1 100 0 3.99994 FORMAT "%8.6" /begin IF_DATA ASAP1B_KWP2000 KP_BLOB 0x382AFC EXTERN 0x2 /end IF_DATA /begin IF_DATA ETK KP_BLOB 0x382AFC EXTERN 0x2 /end IF_DATA /end MEASUREMENT
/begin MEASUREMENT fpvdk_w "Korrekturfaktor Druck vor Drosselklappe 16-Bit" UWORD fak_uw_b4 1 100 0 3.99994 FORMAT "%8.6" /begin IF_DATA ASAP1B_KWP2000 KP_BLOB 0x380B20 EXTERN 0x2 /end IF_DATA /begin IF_DATA ETK KP_BLOB 0x380B20 EXTERN 0x2 /end IF_DATA /end MEASUREMENT
/begin MEASUREMENT frhodk_w "Faktor Luftdichtekorrektur für DK-Durchfluß f(Ansauglufttemp.,Höhe) 16 Bit" UWORD fak_uw_b2 1 100 0 1.99997 FORMAT "%8.6" /begin IF_DATA ASAP1B_KWP2000 KP_BLOB 0x380B22 EXTERN 0x2 /end IF_DATA /begin IF_DATA ETK KP_BLOB 0x380B22 EXTERN 0x2 /end IF_DATA /end MEASUREMENT
/begin MEASUREMENT frkte_w "Faktor Umrechnung rel. Kraftstoffmasse rk in effekt. Einspritzzeit te" UWORD rktiw_sy 1 100 0 0.546125 FORMAT "%8.6" /begin IF_DATA ASAP1B_KWP2000 KP_BLOB 0x380BE2 EXTERN 0x2 /end IF_DATA /begin IF_DATA ETK KP_BLOB 0x380BE2 EXTERN 0x2 /end IF_DATA /end MEASUREMENT
/begin MEASUREMENT fs1_cla "Fehlerpfad - Klasse, 1. Fehler" UBYTE dez 1 100 0 255 FORMAT "%5.1" /begin IF_DATA ASAP1B_KWP2000 KP_BLOB 0x382826 EXTERN 0x1 /end IF_DATA /begin IF_DATA ETK KP_BLOB 0x382826 EXTERN 0x1 /end IF_DATA /end MEASUREMENT
/begin MEASUREMENT fs1_dfp "Fehlerpfadidentifier 1. Fehler" UBYTE dez 1 100 0 255 FORMAT "%5.1" /begin IF_DATA ASAP1B_KWP2000 KP_BLOB 0x382827 EXTERN 0x1 /end IF_DATA /begin IF_DATA ETK KP_BLOB 0x382827 EXTERN 0x1 /end IF_DATA /end MEASUREMENT
/begin MEASUREMENT fs1_dlc "Fehlerlöschzähler, 1. Fehler" UBYTE dez 1 100 0 255 FORMAT "%5.1" /begin IF_DATA ASAP1B_KWP2000 KP_BLOB 0x382828 EXTERN 0x1 /end IF_DATA /begin IF_DATA ETK KP_BLOB 0x382828 EXTERN 0x1 /end IF_DATA /end MEASUREMENT
/begin MEASUREMENT fs1_fes "Fehlerpfad - Eintragsstatus, 1. Fehler" UBYTE dez 1 100 0 255 FORMAT "%5.1" /begin IF_DATA ASAP1B_KWP2000 KP_BLOB 0x382829 EXTERN 0x1 /end IF_DATA /begin IF_DATA ETK KP_BLOB 0x382829 EXTERN 0x1 /end IF_DATA /end MEASUREMENT
/begin MEASUREMENT fs1_flc "Fehlerentprellzähler, 1. Fehler" UBYTE dez 1 100 0 255 FORMAT "%5.1" /begin IF_DATA ASAP1B_KWP2000 KP_BLOB 0x38282A EXTERN 0x1 /end IF_DATA /begin IF_DATA ETK KP_BLOB 0x38282A EXTERN 0x1 /end IF_DATA /end MEASUREMENT
/begin MEASUREMENT fs1_fps "Fehlerpfadstatus aktuell, 1. Fehler" UBYTE dez 1 100 0 255 FORMAT "%5.1" /begin IF_DATA ASAP1B_KWP2000 KP_BLOB 0x38282B EXTERN 0x1 /end IF_DATA /begin IF_DATA ETK KP_BLOB 0x38282B EXTERN 0x1 /end IF_DATA /end MEASUREMENT
/begin MEASUREMENT fs1_frz1 "FreezeFrame - Wert 1, 1. Fehler" UBYTE dez 1 100 0 255 FORMAT "%5.1" /begin IF_DATA ASAP1B_KWP2000 KP_BLOB 0x38282C EXTERN 0x1 /end IF_DATA /begin IF_DATA ETK KP_BLOB 0x38282C EXTERN 0x1 /end IF_DATA /end MEASUREMENT
/begin MEASUREMENT fs1_frz10 "FreezeFrame - Wert 10, 1. Fehler" UBYTE dez 1 100 0 255 FORMAT "%5.1" /begin IF_DATA ASAP1B_KWP2000 KP_BLOB 0x38282D EXTERN 0x1 /end IF_DATA /begin IF_DATA ETK KP_BLOB 0x38282D EXTERN 0x1 /end IF_DATA /end MEASUREMENT
/begin MEASUREMENT fs1_frz11 "FreezeFrame - Wert 11, 1. Fehler" UBYTE dez 1 100 0 255 FORMAT "%5.1" /begin IF_DATA ASAP1B_KWP2000 KP_BLOB 0x38282E EXTERN 0x1 /end IF_DATA /begin IF_DATA ETK KP_BLOB 0x38282E EXTERN 0x1 /end IF_DATA /end MEASUREMENT
/begin MEASUREMENT fs1_frz2 "FreezeFrame - Wert 2, 1. Fehler" UBYTE dez 1 100 0 255 FORMAT "%5.1" /begin IF_DATA ASAP1B_KWP2000 KP_BLOB 0x38282F EXTERN 0x1 /end IF_DATA /begin IF_DATA ETK KP_BLOB 0x38282F EXTERN 0x1 /end IF_DATA /end MEASUREMENT
/begin MEASUREMENT fs1_frz3 "FreezeFrame - Wert 3, 1. Fehler" UBYTE dez 1 100 0 255 FORMAT "%5.1" /begin IF_DATA ASAP1B_KWP2000 KP_BLOB 0x382830 EXTERN 0x1 /end IF_DATA /begin IF_DATA ETK KP_BLOB 0x382830 EXTERN 0x1 /end IF_DATA /end MEASUREMENT
/begin MEASUREMENT fs1_frz4 "FreezeFrame - Wert 4, 1. Fehler" UBYTE dez 1 100 0 255 FORMAT "%5.1" /begin IF_DATA ASAP1B_KWP2000 KP_BLOB 0x382831 EXTERN 0x1 /end IF_DATA /begin IF_DATA ETK KP_BLOB 0x382831 EXTERN 0x1 /end IF_DATA /end MEASUREMENT
/begin MEASUREMENT fs1_frz5 "FreezeFrame - Wert 5, 1. Fehler" UBYTE dez 1 100 0 255 FORMAT "%5.1" /begin IF_DATA ASAP1B_KWP2000 KP_BLOB 0x382832 EXTERN 0x1 /end IF_DATA /begin IF_DATA ETK KP_BLOB 0x382832 EXTERN 0x1 /end IF_DATA /end MEASUREMENT
/begin MEASUREMENT fs1_frz6 "FreezeFrame - Wert 6, 1. Fehler" UBYTE dez 1 100 0 255 FORMAT "%5.1" /begin IF_DATA ASAP1B_KWP2000 KP_BLOB 0x382833 EXTERN 0x1 /end IF_DATA /begin IF_DATA ETK KP_BLOB 0x382833 EXTERN 0x1 /end IF_DATA /end MEASUREMENT
/begin MEASUREMENT fs1_frz7 "FreezeFrame - Wert 7, 1. Fehler" UBYTE dez 1 100 0 255 FORMAT "%5.1" /begin IF_DATA ASAP1B_KWP2000 KP_BLOB 0x382834 EXTERN 0x1 /end IF_DATA /begin IF_DATA ETK KP_BLOB 0x382834 EXTERN 0x1 /end IF_DATA /end MEASUREMENT
/begin MEASUREMENT fs1_frz8 "FreezeFrame - Wert 8, 1. Fehler" UBYTE dez 1 100 0 255 FORMAT "%5.1" /begin IF_DATA ASAP1B_KWP2000 KP_BLOB 0x382835 EXTERN 0x1 /end IF_DATA /begin IF_DATA ETK KP_BLOB 0x382835 EXTERN 0x1 /end IF_DATA /end MEASUREMENT
/begin MEASUREMENT fs1_frz9 "FreezeFrame - Wert 9, 1. Fehler" UBYTE dez 1 100 0 255 FORMAT "%5.1" /begin IF_DATA ASAP1B_KWP2000 KP_BLOB 0x382836 EXTERN 0x1 /end IF_DATA /begin IF_DATA ETK KP_BLOB 0x382836 EXTERN 0x1 /end IF_DATA /end MEASUREMENT
/begin MEASUREMENT fs1_hlc "Fehlerheilzähler, 1. Fehler" UBYTE dez 1 100 0 255 FORMAT "%5.1" /begin IF_DATA ASAP1B_KWP2000 KP_BLOB 0x382837 EXTERN 0x1 /end IF_DATA /begin IF_DATA ETK KP_BLOB 0x382837 EXTERN 0x1 /end IF_DATA /end MEASUREMENT
/begin MEASUREMENT fs1_hz "Fehlerhäufigkeitszähler 1. Fehler" UBYTE dez 1 100 0 255 FORMAT "%5.1" /begin IF_DATA ASAP1B_KWP2000 KP_BLOB 0x382838 EXTERN 0x1 /end IF_DATA /begin IF_DATA ETK KP_BLOB 0x382838 EXTERN 0x1 /end IF_DATA /end MEASUREMENT
/begin MEASUREMENT fs1_tsf "Fehlerschwerezähler 1. Fehler" UBYTE dez 1 100 0 255 FORMAT "%5.1" /begin IF_DATA ASAP1B_KWP2000 KP_BLOB 0x382839 EXTERN 0x1 /end IF_DATA /begin IF_DATA ETK KP_BLOB 0x382839 EXTERN 0x1 /end IF_DATA /end MEASUREMENT
/begin MEASUREMENT fs1_typ "Fehlerpfadtyp, 1. Fehler" UBYTE dez 1 100 0 255 FORMAT "%5.1" /begin IF_DATA ASAP1B_KWP2000 KP_BLOB 0x38283A EXTERN 0x1 /end IF_DATA /begin IF_DATA ETK KP_BLOB 0x38283A EXTERN 0x1 /end IF_DATA /end MEASUREMENT
/begin MEASUREMENT fs2_cla "Fehlerpfad - Klasse, 2. Fehler" UBYTE dez 1 100 0 255 FORMAT "%5.1" /begin IF_DATA ASAP1B_KWP2000 KP_BLOB 0x38283B EXTERN 0x1 /end IF_DATA /begin IF_DATA ETK KP_BLOB 0x38283B EXTERN 0x1 /end IF_DATA /end MEASUREMENT
/begin MEASUREMENT fs2_dfp "Fehlerpfadidentifier 2. Fehler" UBYTE dez 1 100 0 255 FORMAT "%5.1" /begin IF_DATA ASAP1B_KWP2000 KP_BLOB 0x38283C EXTERN 0x1 /end IF_DATA /begin IF_DATA ETK KP_BLOB 0x38283C EXTERN 0x1 /end IF_DATA /end MEASUREMENT
/begin MEASUREMENT fs2_dlc "Fehlerlöschzähler, 2. Fehler" UBYTE dez 1 100 0 255 FORMAT "%5.1" /begin IF_DATA ASAP1B_KWP2000 KP_BLOB 0x38283D EXTERN 0x1 /end IF_DATA /begin IF_DATA ETK KP_BLOB 0x38283D EXTERN 0x1 /end IF_DATA /end MEASUREMENT
/begin MEASUREMENT fs2_fes "Fehlerpfad - Eintragsstatus, 2. Fehler" UBYTE dez 1 100 0 255 FORMAT "%5.1" /begin IF_DATA ASAP1B_KWP2000 KP_BLOB 0x38283E EXTERN 0x1 /end IF_DATA /begin IF_DATA ETK KP_BLOB 0x38283E EXTERN 0x1 /end IF_DATA /end MEASUREMENT
/begin MEASUREMENT fs2_flc "Fehlerentprellzähler, 2. Fehler" UBYTE dez 1 100 0 255 FORMAT "%5.1" /begin IF_DATA ASAP1B_KWP2000 KP_BLOB 0x38283F EXTERN 0x1 /end IF_DATA /begin IF_DATA ETK KP_BLOB 0x38283F EXTERN 0x1 /end IF_DATA /end MEASUREMENT
/begin MEASUREMENT fs2_fps "Fehlerpfadstatus aktuell, 2. Fehler" UBYTE dez 1 100 0 255 FORMAT "%5.1" /begin IF_DATA ASAP1B_KWP2000 KP_BLOB 0x382840 EXTERN 0x1 /end IF_DATA /begin IF_DATA ETK KP_BLOB 0x382840 EXTERN 0x1 /end IF_DATA /end MEASUREMENT
/begin MEASUREMENT fs2_frz1 "FreezeFrame - Wert 1, 2. Fehler" UBYTE dez 1 100 0 255 FORMAT "%5.1" /begin IF_DATA ASAP1B_KWP2000 KP_BLOB 0x382841 EXTERN 0x1 /end IF_DATA /begin IF_DATA ETK KP_BLOB 0x382841 EXTERN 0x1 /end IF_DATA /end MEASUREMENT
/begin MEASUREMENT fs2_frz10 "FreezeFrame - Wert 10, 2. Fehler" UBYTE dez 1 100 0 255 FORMAT "%5.1" /begin IF_DATA ASAP1B_KWP2000 KP_BLOB 0x382842 EXTERN 0x1 /end IF_DATA /begin IF_DATA ETK KP_BLOB 0x382842 EXTERN 0x1 /end IF_DATA /end MEASUREMENT
/begin MEASUREMENT fs2_frz11 "FreezeFrame - Wert 11, 2. Fehler" UBYTE dez 1 100 0 255 FORMAT "%5.1" /begin IF_DATA ASAP1B_KWP2000 KP_BLOB 0x382843 EXTERN 0x1 /end IF_DATA /begin IF_DATA ETK KP_BLOB 0x382843 EXTERN 0x1 /end IF_DATA /end MEASUREMENT
/begin MEASUREMENT fs2_frz2 "FreezeFrame - Wert 2, 2. Fehler" UBYTE dez 1 100 0 255 FORMAT "%5.1" /begin IF_DATA ASAP1B_KWP2000 KP_BLOB 0x382844 EXTERN 0x1 /end IF_DATA /begin IF_DATA ETK KP_BLOB 0x382844 EXTERN 0x1 /end IF_DATA /end MEASUREMENT
/begin MEASUREMENT fs2_frz3 "FreezeFrame - Wert 3, 2. Fehler" UBYTE dez 1 100 0 255 FORMAT "%5.1" /begin IF_DATA ASAP1B_KWP2000 KP_BLOB 0x382845 EXTERN 0x1 /end IF_DATA /begin IF_DATA ETK KP_BLOB 0x382845 EXTERN 0x1 /end IF_DATA /end MEASUREMENT
/begin MEASUREMENT fs2_frz4 "FreezeFrame - Wert 4, 2. Fehler" UBYTE dez 1 100 0 255 FORMAT "%5.1" /begin IF_DATA ASAP1B_KWP2000 KP_BLOB 0x382846 EXTERN 0x1 /end IF_DATA /begin IF_DATA ETK KP_BLOB 0x382846 EXTERN 0x1 /end IF_DATA /end MEASUREMENT
/begin MEASUREMENT fs2_frz5 "FreezeFrame - Wert 5, 2. Fehler" UBYTE dez 1 100 0 255 FORMAT "%5.1" /begin IF_DATA ASAP1B_KWP2000 KP_BLOB 0x382847 EXTERN 0x1 /end IF_DATA /begin IF_DATA ETK KP_BLOB 0x382847 EXTERN 0x1 /end IF_DATA /end MEASUREMENT
/begin MEASUREMENT fs2_frz6 "FreezeFrame - Wert 6, 2. Fehler" UBYTE dez 1 100 0 255 FORMAT "%5.1" /begin IF_DATA ASAP1B_KWP2000 KP_BLOB 0x382848 EXTERN 0x1 /end IF_DATA /begin IF_DATA ETK KP_BLOB 0x382848 EXTERN 0x1 /end IF_DATA /end MEASUREMENT
/begin MEASUREMENT fs2_frz7 "Freezeframe - Wert 7, 2. Fehler" UBYTE dez 1 100 0 255 FORMAT "%5.1" /begin IF_DATA ASAP1B_KWP2000 KP_BLOB 0x382849 EXTERN 0x1 /end IF_DATA /begin IF_DATA ETK KP_BLOB 0x382849 EXTERN 0x1 /end IF_DATA /end MEASUREMENT
/begin MEASUREMENT fs2_frz8 "FreezeFrame - Wert 8, 2. Fehler" UBYTE dez 1 100 0 255 FORMAT "%5.1" /begin IF_DATA ASAP1B_KWP2000 KP_BLOB 0x38284A EXTERN 0x1 /end IF_DATA /begin IF_DATA ETK KP_BLOB 0x38284A EXTERN 0x1 /end IF_DATA /end MEASUREMENT
/begin MEASUREMENT fs2_frz9 "FreezeFrame - Wert 9, 2. Fehler" UBYTE dez 1 100 0 255 FORMAT "%5.1" /begin IF_DATA ASAP1B_KWP2000 KP_BLOB 0x38284B EXTERN 0x1 /end IF_DATA /begin IF_DATA ETK KP_BLOB 0x38284B EXTERN 0x1 /end IF_DATA /end MEASUREMENT
/begin MEASUREMENT fs2_hlc "Fehlerheilzähler, 2. Fehler" UBYTE dez 1 100 0 255 FORMAT "%5.1" /begin IF_DATA ASAP1B_KWP2000 KP_BLOB 0x38284C EXTERN 0x1 /end IF_DATA /begin IF_DATA ETK KP_BLOB 0x38284C EXTERN 0x1 /end IF_DATA /end MEASUREMENT
/begin MEASUREMENT fs2_hz "Fehlerhäufigkeitszähler 2. Fehler" UBYTE dez 1 100 0 255 FORMAT "%5.1" /begin IF_DATA ASAP1B_KWP2000 KP_BLOB 0x38284D EXTERN 0x1 /end IF_DATA /begin IF_DATA ETK KP_BLOB 0x38284D EXTERN 0x1 /end IF_DATA /end MEASUREMENT
/begin MEASUREMENT fs2_tsf "Fehlerschwerezähler 2. Fehler" UBYTE dez 1 100 0 255 FORMAT "%5.1" /begin IF_DATA ASAP1B_KWP2000 KP_BLOB 0x38284E EXTERN 0x1 /end IF_DATA /begin IF_DATA ETK KP_BLOB 0x38284E EXTERN 0x1 /end IF_DATA /end MEASUREMENT
/begin MEASUREMENT fs2_typ "Fehlerpfadtyp, 2. Fehler" UBYTE dez 1 100 0 255 FORMAT "%5.1" /begin IF_DATA ASAP1B_KWP2000 KP_BLOB 0x38284F EXTERN 0x1 /end IF_DATA /begin IF_DATA ETK KP_BLOB 0x38284F EXTERN 0x1 /end IF_DATA /end MEASUREMENT
/begin MEASUREMENT ftbr "Faktor Temperaturkorrektur im Brennraum" UBYTE fak_ub_b2 1 100 0 1.99219 FORMAT "%5.3" /begin IF_DATA ASAP1B_KWP2000 KP_BLOB 0x38036D EXTERN 0x1 /end IF_DATA /begin IF_DATA ETK KP_BLOB 0x38036D EXTERN 0x1 /end IF_DATA /end MEASUREMENT
/begin MEASUREMENT ftbr_w "Faktor Temperaturkorrektur im Brennraum" UWORD fak_uw_b2 1 100 0 1.99997 FORMAT "%8.6" /begin IF_DATA ASAP1B_KWP2000 KP_BLOB 0x380B78 EXTERN 0x2 /end IF_DATA /begin IF_DATA ETK KP_BLOB 0x380B78 EXTERN 0x2 /end IF_DATA /end MEASUREMENT
/begin MEASUREMENT ftsr "Korrekturfaktor Lufttemperatur im Saugrohr" UBYTE fak_ub_b2 1 100 0 1.99219 FORMAT "%5.3" /begin IF_DATA ASAP1B_KWP2000 KP_BLOB 0xF868 INTERN 0x1 /end IF_DATA /begin IF_DATA ETK KP_BLOB 0xF868 INTERN 0x1 /end IF_DATA /end MEASUREMENT
/begin MEASUREMENT ftu "Faktor Temperatur Umgebung" UBYTE fak_ub_b2 1 100 0 1.99219 FORMAT "%5.3" /begin IF_DATA ASAP1B_KWP2000 KP_BLOB 0x38036E EXTERN 0x1 /end IF_DATA /begin IF_DATA ETK KP_BLOB 0x38036E EXTERN 0x1 /end IF_DATA /end MEASUREMENT
/begin MEASUREMENT ftvdk "Korrekturfaktor Temperatur vor Drosselklappe" UBYTE fak_ub_b2 1 100 0 1.99219 FORMAT "%5.3" /begin IF_DATA ASAP1B_KWP2000 KP_BLOB 0xF869 INTERN 0x1 /end IF_DATA /begin IF_DATA ETK KP_BLOB 0xF869 INTERN 0x1 /end IF_DATA /end MEASUREMENT
/begin MEASUREMENT ftw "Faktor Temperaturgewichtung tmot, tans" UBYTE fak_ub_b1 1 100 0 0.996094 FORMAT "%5.3" /begin IF_DATA ASAP1B_KWP2000 KP_BLOB 0x38036F EXTERN 0x1 /end IF_DATA /begin IF_DATA ETK KP_BLOB 0x38036F EXTERN 0x1 /end IF_DATA /end MEASUREMENT
/begin MEASUREMENT fupsrl_w "Faktor systembezogene Umrechnung Druck auf Füllung (16-Bit)" UWORD rel_uw_b0p3 1 100 0 0.299995 FORMAT "%8.6" /begin IF_DATA ASAP1B_KWP2000 KP_BLOB 0x380B40 EXTERN 0x2 /end IF_DATA /begin IF_DATA ETK KP_BLOB 0x380B40 EXTERN 0x2 /end IF_DATA /end MEASUREMENT
/begin MEASUREMENT fvisrm_w "Faktor Verstärkung Integrator Saugrohrmodell" UWORD p_uw_b32 1 100 0 31.9995 FORMAT "%8.5" /begin IF_DATA ASAP1B_KWP2000 KP_BLOB 0x380B42 EXTERN 0x2 /end IF_DATA /begin IF_DATA ETK KP_BLOB 0x380B42 EXTERN 0x2 /end IF_DATA /end MEASUREMENT
/begin MEASUREMENT fwprs_w "Faktor Preadiktionswinkel bezogen auf Segment" UWORD fak_uw_b32 1 100 0 31.9995 FORMAT "%8.5" /begin IF_DATA ASAP1B_KWP2000 KP_BLOB 0x380BD0 EXTERN 0x2 /end IF_DATA /begin IF_DATA ETK KP_BLOB 0x380BD0 EXTERN 0x2 /end IF_DATA /end MEASUREMENT
/begin MEASUREMENT gangi "Ist-Gang" UBYTE dez 1 100 0 255 FORMAT "%5.1" /begin IF_DATA ASAP1B_KWP2000 KP_BLOB 0x38043D EXTERN 0x1 /end IF_DATA /begin IF_DATA ETK KP_BLOB 0x38043D EXTERN 0x1 /end IF_DATA /end MEASUREMENT
/begin MEASUREMENT imlatm "integr. Luftmassenfluss ab Motorstart bis Max.wert" UBYTE m_ub_b23p3 1 100 0 23.2107 FORMAT "%5.2" /begin IF_DATA ASAP1B_KWP2000 KP_BLOB 0x380351 EXTERN 0x1 /end IF_DATA /begin IF_DATA ETK KP_BLOB 0x380351 EXTERN 0x1 /end IF_DATA /end MEASUREMENT
/begin MEASUREMENT imlatm_w "integr. Luftmassenfluss ab Startende bis max. Wert, (Word)" UWORD m_uw_b23p3 1 100 0 23.3013 FORMAT "%8.5" /begin IF_DATA ASAP1B_KWP2000 KP_BLOB 0x380A0C EXTERN 0x2 /end IF_DATA /begin IF_DATA ETK KP_BLOB 0x380A0C EXTERN 0x2 /end IF_DATA /end MEASUREMENT
/begin MEASUREMENT irspsyn "Index für Ringspeicheradressierung tsegrsp_w, nmotrsp_w, rlrsp_w" UBYTE dez 1 100 0 255 FORMAT "%5.1" /begin IF_DATA ASAP1B_KWP2000 KP_BLOB 0x380347 EXTERN 0x1 /end IF_DATA /begin IF_DATA ETK KP_BLOB 0x380347 EXTERN 0x1 /end IF_DATA /end MEASUREMENT
/begin MEASUREMENT iwmatm_w "Wärmemenge für Kondenswasser-Taupunktende Abgas/Kat (word)" UWORD q_uw_q0p0566 1 100 0 3712 FORMAT "%8.3" /begin IF_DATA ASAP1B_KWP2000 KP_BLOB 0x380A0E EXTERN 0x2 /end IF_DATA /begin IF_DATA ETK KP_BLOB 0x380A0E EXTERN 0x2 /end IF_DATA /end MEASUREMENT
/begin MEASUREMENT lamsons8 "" UBYTE fak_ub_b4 1 100 0 3.98438 FORMAT "%5.3" /begin IF_DATA ASAP1B_KWP2000 KP_BLOB 0x380356 EXTERN 0x1 /end IF_DATA /begin IF_DATA ETK KP_BLOB 0x380356 EXTERN 0x1 /end IF_DATA /end MEASUREMENT
/begin MEASUREMENT lapctrcan "" UBYTE default 1 100 0 255 FORMAT "%5.1" /begin IF_DATA ASAP1B_KWP2000 KP_BLOB 0x38033F EXTERN 0x1 /end IF_DATA /begin IF_DATA ETK KP_BLOB 0x38033F EXTERN 0x1 /end IF_DATA /end MEASUREMENT
/begin MEASUREMENT lokBits_Aekp "" UBYTE dez 1 100 0 255 FORMAT "%5.1" /begin IF_DATA ASAP1B_KWP2000 KP_BLOB 0x380480 EXTERN 0x1 /end IF_DATA /begin IF_DATA ETK KP_BLOB 0x380480 EXTERN 0x1 /end IF_DATA /end MEASUREMENT
/begin MEASUREMENT milstat "" UBYTE dez 1 100 0 255 FORMAT "%5.1" /begin IF_DATA ASAP1B_KWP2000 KP_BLOB 0x380440 EXTERN 0x1 /end IF_DATA /begin IF_DATA ETK KP_BLOB 0x380440 EXTERN 0x1 /end IF_DATA /end MEASUREMENT
/begin MEASUREMENT ml "Luftmassenfluß" UBYTE m_ub_b1020 1 100 0 1020 FORMAT "%5.0" /begin IF_DATA ASAP1B_KWP2000 KP_BLOB 0xF85E INTERN 0x1 /end IF_DATA /begin IF_DATA ETK KP_BLOB 0xF85E INTERN 0x1 /end IF_DATA /end MEASUREMENT
/begin MEASUREMENT ml_w "Luftmassenfluß gefiltert (Word)" UWORD m_uw_b6553p5 1 100 0 6553.5 FORMAT "%8.3" /begin IF_DATA ASAP1B_KWP2000 KP_BLOB 0xF862 INTERN 0x2 /end IF_DATA /begin IF_DATA ETK KP_BLOB 0xF862 INTERN 0x2 /end IF_DATA /end MEASUREMENT
/begin MEASUREMENT msdkue_w "Massenstrom über Drosselklappe überkritisch (word)" UWORD m_uw_b6553p5 1 100 0 6553.5 FORMAT "%8.3" /begin IF_DATA ASAP1B_KWP2000 KP_BLOB 0x380B24 EXTERN 0x2 /end IF_DATA /begin IF_DATA ETK KP_BLOB 0x380B24 EXTERN 0x2 /end IF_DATA /end MEASUREMENT
/begin MEASUREMENT msdk_w "Massenstrom über Drosselklappe (word)" UWORD m_uw_b6553p5 1 100 0 6553.5 FORMAT "%8.3" /begin IF_DATA ASAP1B_KWP2000 KP_BLOB 0x380B26 EXTERN 0x2 /end IF_DATA /begin IF_DATA ETK KP_BLOB 0x380B26 EXTERN 0x2 /end IF_DATA /end MEASUREMENT
/begin MEASUREMENT msndkpk_w "normierter praedizierter korrig. Massenstrom ueber Drosselklappe (word)" UWORD m_uw_b6553p5 1 100 0 6553.5 FORMAT "%8.3" /begin IF_DATA ASAP1B_KWP2000 KP_BLOB 0x380BD2 EXTERN 0x2 /end IF_DATA /begin IF_DATA ETK KP_BLOB 0x380BD2 EXTERN 0x2 /end IF_DATA /end MEASUREMENT
/begin MEASUREMENT msndk_w "normierter Massenstrom über Drosselklappe (word)" UWORD m_uw_b6553p5 1 100 0 6553.5 FORMAT "%8.3" /begin IF_DATA ASAP1B_KWP2000 KP_BLOB 0x380B28 EXTERN 0x2 /end IF_DATA /begin IF_DATA ETK KP_BLOB 0x380B28 EXTERN 0x2 /end IF_DATA /end MEASUREMENT
/begin MEASUREMENT na_abs_c "" UBYTE dez 1 100 0 255 FORMAT "%5.1" /begin IF_DATA ASAP1B_KWP2000 KP_BLOB 0xF7FB INTERN 0x1 /end IF_DATA /begin IF_DATA ETK KP_BLOB 0xF7FB INTERN 0x1 /end IF_DATA /end MEASUREMENT
/begin MEASUREMENT na_rel_c "" UBYTE dez 1 100 0 255 FORMAT "%5.1" /begin IF_DATA ASAP1B_KWP2000 KP_BLOB 0xF7FC INTERN 0x1 /end IF_DATA /begin IF_DATA ETK KP_BLOB 0xF7FC INTERN 0x1 /end IF_DATA /end MEASUREMENT
/begin MEASUREMENT ngas_w "Drehzahlgradient über ein Arbeitsspiel" SWORD nmotg_sw_q0p39 1 100 -12800.2 12799.8 FORMAT "%8.2" /begin IF_DATA ASAP1B_KWP2000 KP_BLOB 0x3809FA EXTERN 0x2 /end IF_DATA /begin IF_DATA ETK KP_BLOB 0x3809FA EXTERN 0x2 /end IF_DATA /end MEASUREMENT
/begin MEASUREMENT ngfil "gefilterter Drehzahlgradient" SBYTE nmotg_sb_q100 1 100 -12800 12700 FORMAT "%5.0" /begin IF_DATA ASAP1B_KWP2000 KP_BLOB 0x380348 EXTERN 0x1 /end IF_DATA /begin IF_DATA ETK KP_BLOB 0x380348 EXTERN 0x1 /end IF_DATA /end MEASUREMENT
/begin MEASUREMENT ngfil_w "gefilterter Drehzahlgradient" SWORD nmotg_sw_q0p39 1 100 -12800.2 12799.8 FORMAT "%8.2" /begin IF_DATA ASAP1B_KWP2000 KP_BLOB 0x3809FC EXTERN 0x2 /end IF_DATA /begin IF_DATA ETK KP_BLOB 0x3809FC EXTERN 0x2 /end IF_DATA /end MEASUREMENT
/begin MEASUREMENT nmitt4_w "Gemittelte Drehzahl über die vier letzten R_t10" UWORD nmot_uw_q0p25 1 100 0 16383.8 FORMAT "%8.2" /begin IF_DATA ASAP1B_KWP2000 KP_BLOB 0x381330 EXTERN 0x2 /end IF_DATA /begin IF_DATA ETK KP_BLOB 0x381330 EXTERN 0x2 /end IF_DATA /end MEASUREMENT
/begin MEASUREMENT nmot "Motordrehzahl" UBYTE nmot_ub_q40 1 100 0 10200 FORMAT "%5.0" /begin IF_DATA ASAP1B_KWP2000 KP_BLOB 0x380349 EXTERN 0x1 /end IF_DATA /begin IF_DATA ETK KP_BLOB 0x380349 EXTERN 0x1 /end IF_DATA /end MEASUREMENT
/begin MEASUREMENT nmotas_w "Motordrehzahl von 2 Umdrehungen (1 Arbeitsspiel) zuvor" UWORD nmot_uw_q0p25 1 100 0 16383.8 FORMAT "%8.2" /begin IF_DATA ASAP1B_KWP2000 KP_BLOB 0x3809FE EXTERN 0x2 /end IF_DATA /begin IF_DATA ETK KP_BLOB 0x3809FE EXTERN 0x2 /end IF_DATA /end MEASUREMENT
/begin MEASUREMENT nmotrsp_w "Beginn Ringspeicher für Drehzahl" UWORD nmot_uw_q0p25 1 100 0 16383.8 FORMAT "%8.2" ARRAY_SIZE 8 /begin IF_DATA ASAP1B_KWP2000 KP_BLOB 0xF7DA INTERN 0x2 /end IF_DATA /begin IF_DATA ETK KP_BLOB 0xF7DA INTERN 0x2 /end IF_DATA /end MEASUREMENT
/begin MEASUREMENT nmot_w "Motordrehzahl" UWORD nmot_uw_q0p25 1 100 0 16383.8 FORMAT "%8.2" /begin IF_DATA ASAP1B_KWP2000 KP_BLOB 0x380A08 EXTERN 0x2 /end IF_DATA /begin IF_DATA ETK KP_BLOB 0x380A08 EXTERN 0x2 /end IF_DATA /end MEASUREMENT
/begin MEASUREMENT nsa "Drehzahl Schub" UBYTE nmot_ub_q40 1 100 0 10200 FORMAT "%5.0" /begin IF_DATA ASAP1B_KWP2000 KP_BLOB 0x38041E EXTERN 0x1 /end IF_DATA /begin IF_DATA ETK KP_BLOB 0x38041E EXTERN 0x1 /end IF_DATA /end MEASUREMENT
/begin MEASUREMENT nwe "Wiedereinsetzdrehzahl" UBYTE nmot_ub_q40 1 100 0 10200 FORMAT "%5.0" /begin IF_DATA ASAP1B_KWP2000 KP_BLOB 0x38041F EXTERN 0x1 /end IF_DATA /begin IF_DATA ETK KP_BLOB 0x38041F EXTERN 0x1 /end IF_DATA /end MEASUREMENT
/begin MEASUREMENT pd_we_zy "" UWORD dez 1 100 0 65535 FORMAT "%8.2" /begin IF_DATA ASAP1B_KWP2000 KP_BLOB 0xF81E INTERN 0x2 /end IF_DATA /begin IF_DATA ETK KP_BLOB 0xF81E INTERN 0x2 /end IF_DATA /end MEASUREMENT
/begin MEASUREMENT pirgro_w "Rohwert Partialdruck Restgas internes AGR" UWORD p_uw_q0p039 1 100 0 2559.96 FORMAT "%8.3" /begin IF_DATA ASAP1B_KWP2000 KP_BLOB 0x380B44 EXTERN 0x2 /end IF_DATA /begin IF_DATA ETK KP_BLOB 0x380B44 EXTERN 0x2 /end IF_DATA /end MEASUREMENT
/begin MEASUREMENT pirg_w "Partialdruck Restgas interne AGR (16-Bit)" UWORD p_uw_q0p039 1 100 0 2559.96 FORMAT "%8.3" /begin IF_DATA ASAP1B_KWP2000 KP_BLOB 0x380B46 EXTERN 0x2 /end IF_DATA /begin IF_DATA ETK KP_BLOB 0x380B46 EXTERN 0x2 /end IF_DATA /end MEASUREMENT
/begin MEASUREMENT ps "gemessener Saugrohr-Absolutdruck" UBYTE p_ub_q10 1 100 0 2550 FORMAT "%5.0" /begin IF_DATA ASAP1B_KWP2000 KP_BLOB 0xF85F INTERN 0x1 /end IF_DATA /begin IF_DATA ETK KP_BLOB 0xF85F INTERN 0x1 /end IF_DATA /end MEASUREMENT
/begin MEASUREMENT psdssk_w "korrigierter Saugrohrdruck gemessen mit Drucksensor am Saugrohr (DS-S)" UWORD p_uw_q0p039 1 100 0 2559.96 FORMAT "%8.3" /begin IF_DATA ASAP1B_KWP2000 KP_BLOB 0x380B50 EXTERN 0x2 /end IF_DATA /begin IF_DATA ETK KP_BLOB 0x380B50 EXTERN 0x2 /end IF_DATA /end MEASUREMENT
/begin MEASUREMENT pses_w "Saugrohrdruck über Verstellsystem korrigiert" UWORD p_uw_q0p039 1 100 0 2559.96 FORMAT "%8.3" /begin IF_DATA ASAP1B_KWP2000 KP_BLOB 0x380BE4 EXTERN 0x2 /end IF_DATA /begin IF_DATA ETK KP_BLOB 0x380BE4 EXTERN 0x2 /end IF_DATA /end MEASUREMENT
/begin MEASUREMENT psini_w "Saugrohrdruck bei nmot=0" UWORD p_uw_q0p039 1 100 0 2559.96 FORMAT "%8.3" /begin IF_DATA ASAP1B_KWP2000 KP_BLOB 0x380B7A EXTERN 0x2 /end IF_DATA /begin IF_DATA ETK KP_BLOB 0x380B7A EXTERN 0x2 /end IF_DATA /end MEASUREMENT
/begin MEASUREMENT psmod_w "modellierter Saugrohrdruck" UWORD p_uw_q0p039 1 100 0 2559.96 FORMAT "%8.3" /begin IF_DATA ASAP1B_KWP2000 KP_BLOB 0x380B52 EXTERN 0x2 /end IF_DATA /begin IF_DATA ETK KP_BLOB 0x380B52 EXTERN 0x2 /end IF_DATA /end MEASUREMENT
/begin MEASUREMENT psmp_w "extrapolierter Saugrohrdruck (Word)" UWORD p_uw_q0p039 1 100 0 2559.96 FORMAT "%8.3" /begin IF_DATA ASAP1B_KWP2000 KP_BLOB 0x380BD4 EXTERN 0x2 /end IF_DATA /begin IF_DATA ETK KP_BLOB 0x380BD4 EXTERN 0x2 /end IF_DATA /end MEASUREMENT
/begin MEASUREMENT psmx_w "Saugrohrmaximaldruckbegrenzung für modellierten Saugrohrdruck" UWORD p_uw_q0p039 1 100 0 2559.96 FORMAT "%8.3" /begin IF_DATA ASAP1B_KWP2000 KP_BLOB 0x380B54 EXTERN 0x2 /end IF_DATA /begin IF_DATA ETK KP_BLOB 0x380B54 EXTERN 0x2 /end IF_DATA /end MEASUREMENT
/begin MEASUREMENT pspvdk_w "Quotient Saugrohrdruck/Druck vor Drosselklappe (word)" UWORD fak_uw_b2 1 100 0 1.99997 FORMAT "%8.6" /begin IF_DATA ASAP1B_KWP2000 KP_BLOB 0x380B2A EXTERN 0x2 /end IF_DATA /begin IF_DATA ETK KP_BLOB 0x380B2A EXTERN 0x2 /end IF_DATA /end MEASUREMENT
/begin MEASUREMENT pspvds_w "Quotient Saugrohrdruck/Druck vor DK" UWORD fak_uw_b2 1 100 0 1.99997 FORMAT "%8.6" /begin IF_DATA ASAP1B_KWP2000 KP_BLOB 0x380B2C EXTERN 0x2 /end IF_DATA /begin IF_DATA ETK KP_BLOB 0x380B2C EXTERN 0x2 /end IF_DATA /end MEASUREMENT
/begin MEASUREMENT psp_w "praedizierter Saugrohrdruck (Word)" UWORD p_uw_q0p039 1 100 0 2559.96 FORMAT "%8.3" /begin IF_DATA ASAP1B_KWP2000 KP_BLOB 0x380BD6 EXTERN 0x2 /end IF_DATA /begin IF_DATA ETK KP_BLOB 0x380BD6 EXTERN 0x2 /end IF_DATA /end MEASUREMENT
/begin MEASUREMENT psrlro_w "Rohwert für Faktor systembezogene Umrechnung Druck auf Füllung" UWORD rel_uw_b0p3 1 100 0 0.299995 FORMAT "%8.6" /begin IF_DATA ASAP1B_KWP2000 KP_BLOB 0x380B48 EXTERN 0x2 /end IF_DATA /begin IF_DATA ETK KP_BLOB 0x380B48 EXTERN 0x2 /end IF_DATA /end MEASUREMENT
/begin MEASUREMENT ps_w "Saugrohr-Absolutdruck (Word)" UWORD p_uw_q0p039 1 100 0 2559.96 FORMAT "%8.3" /begin IF_DATA ASAP1B_KWP2000 KP_BLOB 0xF864 INTERN 0x2 /end IF_DATA /begin IF_DATA ETK KP_BLOB 0xF864 INTERN 0x2 /end IF_DATA /end MEASUREMENT
/begin MEASUREMENT pvdk_w "Druck vor Drosselklappe 16-Bit" UWORD p_uw_q0p039 1 100 0 2559.96 FORMAT "%8.3" /begin IF_DATA ASAP1B_KWP2000 KP_BLOB 0x380B2E EXTERN 0x2 /end IF_DATA /begin IF_DATA ETK KP_BLOB 0x380B2E EXTERN 0x2 /end IF_DATA /end MEASUREMENT
/begin MEASUREMENT redbas "Basis-Reduzierstufe" UBYTE dez 1 100 0 255 FORMAT "%5.1" /begin IF_DATA ASAP1B_KWP2000 KP_BLOB 0x380384 EXTERN 0x1 /end IF_DATA /begin IF_DATA ETK KP_BLOB 0x380384 EXTERN 0x1 /end IF_DATA /end MEASUREMENT
/begin MEASUREMENT redist "Ist-Reduzierstufe" UBYTE dez 1 100 0 255 FORMAT "%5.1" /begin IF_DATA ASAP1B_KWP2000 KP_BLOB 0x380385 EXTERN 0x1 /end IF_DATA /begin IF_DATA ETK KP_BLOB 0x380385 EXTERN 0x1 /end IF_DATA /end MEASUREMENT
/begin MEASUREMENT redsolr "Realisierte Reduzierstufe" UBYTE dez 1 100 0 255 FORMAT "%5.1" /begin IF_DATA ASAP1B_KWP2000 KP_BLOB 0x380386 EXTERN 0x1 /end IF_DATA /begin IF_DATA ETK KP_BLOB 0x380386 EXTERN 0x1 /end IF_DATA /end MEASUREMENT
/begin MEASUREMENT redsol_one "Berechnete Soll-Reduzierstufe - 1 zur Adress. von REDABM" UBYTE dez 1 100 0 255 FORMAT "%5.1" /begin IF_DATA ASAP1B_KWP2000 KP_BLOB 0x380387 EXTERN 0x1 /end IF_DATA /begin IF_DATA ETK KP_BLOB 0x380387 EXTERN 0x1 /end IF_DATA /end MEASUREMENT
/begin MEASUREMENT restw_b1 "" UBYTE dez 1 100 0 255 FORMAT "%5.1" /begin IF_DATA ASAP1B_KWP2000 KP_BLOB 0xF7FD INTERN 0x1 /end IF_DATA /begin IF_DATA ETK KP_BLOB 0xF7FD INTERN 0x1 /end IF_DATA /end MEASUREMENT
/begin MEASUREMENT restw_b2 "" UBYTE dez 1 100 0 255 FORMAT "%5.1" /begin IF_DATA ASAP1B_KWP2000 KP_BLOB 0xF7FE INTERN 0x1 /end IF_DATA /begin IF_DATA ETK KP_BLOB 0xF7FE INTERN 0x1 /end IF_DATA /end MEASUREMENT
/begin MEASUREMENT rfgdss_w "gesamte relative Füllung mit Saugrohrdrucksensor (inklusive AGR) 16-Bit" UWORD rel_uw_q0p0234 1 100 0 1535.98 FORMAT "%8.3" /begin IF_DATA ASAP1B_KWP2000 KP_BLOB 0x380B56 EXTERN 0x2 /end IF_DATA /begin IF_DATA ETK KP_BLOB 0x380B56 EXTERN 0x2 /end IF_DATA /end MEASUREMENT
/begin MEASUREMENT rfgmod_w "gesamte relative Füllung mit mod. Saugrohrdruck (inclusive AGR) 16-Bit" UWORD rel_uw_q0p0234 1 100 0 1535.98 FORMAT "%8.3" /begin IF_DATA ASAP1B_KWP2000 KP_BLOB 0x380B58 EXTERN 0x2 /end IF_DATA /begin IF_DATA ETK KP_BLOB 0x380B58 EXTERN 0x2 /end IF_DATA /end MEASUREMENT
/begin MEASUREMENT rl "relative Luftfüllung" UBYTE rel_ub_q0p75 1 100 0 191.25 FORMAT "%5.1" /begin IF_DATA ASAP1B_KWP2000 KP_BLOB 0xF860 INTERN 0x1 /end IF_DATA /begin IF_DATA ETK KP_BLOB 0xF860 INTERN 0x1 /end IF_DATA /end MEASUREMENT
/begin MEASUREMENT rldvs_w "relative Luftfüllung durch Drosselventile am Saugrohr 16-Bit" UWORD rel_uw_q0p0234 1 100 0 1535.98 FORMAT "%8.3" /begin IF_DATA ASAP1B_KWP2000 KP_BLOB 0x380B30 EXTERN 0x2 /end IF_DATA /begin IF_DATA ETK KP_BLOB 0x380B30 EXTERN 0x2 /end IF_DATA /end MEASUREMENT
/begin MEASUREMENT rlmod_w "relative Luftfüllung modelliert (Word)" UWORD rel_uw_q0p0234 1 100 0 1535.98 FORMAT "%8.3" /begin IF_DATA ASAP1B_KWP2000 KP_BLOB 0x380B5A EXTERN 0x2 /end IF_DATA /begin IF_DATA ETK KP_BLOB 0x380B5A EXTERN 0x2 /end IF_DATA /end MEASUREMENT
/begin MEASUREMENT rlmp_w "rel. extrapolierte Luftfuellung (Word)" UWORD rel_uw_q0p0234 1 100 0 1535.98 FORMAT "%8.3" /begin IF_DATA ASAP1B_KWP2000 KP_BLOB 0x380BD8 EXTERN 0x2 /end IF_DATA /begin IF_DATA ETK KP_BLOB 0x380BD8 EXTERN 0x2 /end IF_DATA /end MEASUREMENT
/begin MEASUREMENT rlp "rel. Luftfüllung praediziert für Einspritzberechnung" UBYTE rel_ub_q0p75 1 100 0 191.25 FORMAT "%5.1" /begin IF_DATA ASAP1B_KWP2000 KP_BLOB 0x380378 EXTERN 0x1 /end IF_DATA /begin IF_DATA ETK KP_BLOB 0x380378 EXTERN 0x1 /end IF_DATA /end MEASUREMENT
/begin MEASUREMENT rlp_w "rel. Luftfüllung praediziert für Einspritzberechnung (Word)" UWORD rel_uw_q0p0234 1 100 0 1535.98 FORMAT "%8.3" /begin IF_DATA ASAP1B_KWP2000 KP_BLOB 0x380BDA EXTERN 0x2 /end IF_DATA /begin IF_DATA ETK KP_BLOB 0x380BDA EXTERN 0x2 /end IF_DATA /end MEASUREMENT
/begin MEASUREMENT rlrohmp_w "rel. Luftfüllung Saugrohrzufluss bei Saugrohrdruck psmp_w (Word)" UWORD rel_uw_q0p0234 1 100 0 1535.98 FORMAT "%8.3" /begin IF_DATA ASAP1B_KWP2000 KP_BLOB 0x380BDC EXTERN 0x2 /end IF_DATA /begin IF_DATA ETK KP_BLOB 0x380BDC EXTERN 0x2 /end IF_DATA /end MEASUREMENT
/begin MEASUREMENT rlroh_w "relative Luftfüllung: Rohwert vom Lastsensor (word)" UWORD rel_uw_q0p0234 1 100 0 1535.98 FORMAT "%8.3" /begin IF_DATA ASAP1B_KWP2000 KP_BLOB 0xF85C INTERN 0x2 /end IF_DATA /begin IF_DATA ETK KP_BLOB 0xF85C INTERN 0x2 /end IF_DATA /end MEASUREMENT
/begin MEASUREMENT rl_w "relative Luftfüllung (Word)" UWORD rel_uw_q0p0234 1 100 0 1535.98 FORMAT "%8.3" /begin IF_DATA ASAP1B_KWP2000 KP_BLOB 0xF866 INTERN 0x2 /end IF_DATA /begin IF_DATA ETK KP_BLOB 0xF866 INTERN 0x2 /end IF_DATA /end MEASUREMENT
/begin MEASUREMENT segz "" UBYTE dez 1 100 0 255 FORMAT "%5.1" ARRAY_SIZE 8 /begin IF_DATA ASAP1B_KWP2000 KP_BLOB 0xF7FF INTERN 0x1 /end IF_DATA /begin IF_DATA ETK KP_BLOB 0xF7FF INTERN 0x1 /end IF_DATA /end MEASUREMENT
/begin MEASUREMENT sfpbm "Status Fehlerpfad: Bezugsmarkengeber" UWORD dez 1 100 0 65535 FORMAT "%8.2" /begin IF_DATA ASAP1B_KWP2000 KP_BLOB 0x382A8A EXTERN 0x2 /end IF_DATA /begin IF_DATA ETK KP_BLOB 0x382A8A EXTERN 0x2 /end IF_DATA /end MEASUREMENT
/begin MEASUREMENT sfpdk "Status Fehlerpfad DK: Drosselklappe" UWORD dez 1 100 0 65535 FORMAT "%8.2" /begin IF_DATA ASAP1B_KWP2000 KP_BLOB 0x382A8C EXTERN 0x2 /end IF_DATA /begin IF_DATA ETK KP_BLOB 0x382A8C EXTERN 0x2 /end IF_DATA /end MEASUREMENT
/begin MEASUREMENT sfplm "Status Fehlerpfad: Hauptfüllungssensor" UWORD dez 1 100 0 65535 FORMAT "%8.2" /begin IF_DATA ASAP1B_KWP2000 KP_BLOB 0x382ABE EXTERN 0x2 /end IF_DATA /begin IF_DATA ETK KP_BLOB 0x382ABE EXTERN 0x2 /end IF_DATA /end MEASUREMENT
/begin MEASUREMENT sfpn "Status Fehlerpfad: Drehzahlgeber" UWORD dez 1 100 0 65535 FORMAT "%8.2" /begin IF_DATA ASAP1B_KWP2000 KP_BLOB 0x382AC8 EXTERN 0x2 /end IF_DATA /begin IF_DATA ETK KP_BLOB 0x382AC8 EXTERN 0x2 /end IF_DATA /end MEASUREMENT
/begin MEASUREMENT sumode "Zustand der Saugrohrumschaltung" UBYTE dez 1 100 0 255 FORMAT "%5.1" /begin IF_DATA ASAP1B_KWP2000 KP_BLOB 0x38036B EXTERN 0x1 /end IF_DATA /begin IF_DATA ETK KP_BLOB 0x38036B EXTERN 0x1 /end IF_DATA /end MEASUREMENT
/begin MEASUREMENT tabgm "Abgastemperatur vor Kat aus Modell" UBYTE temp_ub_q5_o50 1 100 -50 1225 FORMAT "%5.0" /begin IF_DATA ASAP1B_KWP2000 KP_BLOB 0x380352 EXTERN 0x1 /end IF_DATA /begin IF_DATA ETK KP_BLOB 0x380352 EXTERN 0x1 /end IF_DATA /end MEASUREMENT
/begin MEASUREMENT tabgm2 "Abgastemperatur vor Kat aus Modell Bank2" UBYTE temp_ub_q5_o50 1 100 -50 1225 FORMAT "%5.0" /begin IF_DATA ASAP1B_KWP2000 KP_BLOB 0x380353 EXTERN 0x1 /end IF_DATA /begin IF_DATA ETK KP_BLOB 0x380353 EXTERN 0x1 /end IF_DATA /end MEASUREMENT
/begin MEASUREMENT tabgm2_w "Abgastemperatur vor Kat aus Modell (Word) Bank2" UWORD temp_uw_q0p0195_o50 1 100 -50 1229.98 FORMAT "%8.3" /begin IF_DATA ASAP1B_KWP2000 KP_BLOB 0x380A10 EXTERN 0x2 /end IF_DATA /begin IF_DATA ETK KP_BLOB 0x380A10 EXTERN 0x2 /end IF_DATA /end MEASUREMENT
/begin MEASUREMENT tabgm_w "Abgastemperatur vor Kat aus Modell (Word)" UWORD temp_uw_q0p0195_o50 1 100 -50 1229.98 FORMAT "%8.3" /begin IF_DATA ASAP1B_KWP2000 KP_BLOB 0x380A12 EXTERN 0x2 /end IF_DATA /begin IF_DATA ETK KP_BLOB 0x380A12 EXTERN 0x2 /end IF_DATA /end MEASUREMENT
/begin MEASUREMENT tatmkf "Abgastemperatur vor Kat aus Kennfeld KFTATM" UBYTE temp_ub_q5_o50 1 100 -50 1225 FORMAT "%5.0" /begin IF_DATA ASAP1B_KWP2000 KP_BLOB 0x380354 EXTERN 0x1 /end IF_DATA /begin IF_DATA ETK KP_BLOB 0x380354 EXTERN 0x1 /end IF_DATA /end MEASUREMENT
/begin MEASUREMENT tatmsta "Abgastemperatur vor Kat aus Modell stationär" UBYTE temp_ub_q5_o50 1 100 -50 1225 FORMAT "%5.0" /begin IF_DATA ASAP1B_KWP2000 KP_BLOB 0x380355 EXTERN 0x1 /end IF_DATA /begin IF_DATA ETK KP_BLOB 0x380355 EXTERN 0x1 /end IF_DATA /end MEASUREMENT
/begin MEASUREMENT tempin "Temperatur Eingang (Adressierung von FWFTBRTA)" UBYTE temp_ub_q0p75_o48 1 100 -48 143.25 FORMAT "%5.1" /begin IF_DATA ASAP1B_KWP2000 KP_BLOB 0x380370 EXTERN 0x1 /end IF_DATA /begin IF_DATA ETK KP_BLOB 0x380370 EXTERN 0x1 /end IF_DATA /end MEASUREMENT
/begin MEASUREMENT tistzyl "Zylindernummer der ersten Einspritzung und Zündung" UBYTE dez 1 100 0 255 FORMAT "%5.1" /begin IF_DATA ASAP1B_KWP2000 KP_BLOB 0xF807 INTERN 0x1 /end IF_DATA /begin IF_DATA ETK KP_BLOB 0xF807 INTERN 0x1 /end IF_DATA /end MEASUREMENT
/begin MEASUREMENT ti_ev_1 "Einspritzzeit 1. Zylinder in Zündfolge" UWORD tinjection_sy 1 100 0 209.712 FORMAT "%8.4" /begin IF_DATA ASAP1B_KWP2000 KP_BLOB 0xF820 INTERN 0x2 /end IF_DATA /begin IF_DATA ETK KP_BLOB 0xF820 INTERN 0x2 /end IF_DATA /end MEASUREMENT
/begin MEASUREMENT ti_ev_2 "Einspritzzeit 2. Zylinder in Zündfolge" UWORD tinjection_sy 1 100 0 209.712 FORMAT "%8.4" /begin IF_DATA ASAP1B_KWP2000 KP_BLOB 0xF822 INTERN 0x2 /end IF_DATA /begin IF_DATA ETK KP_BLOB 0xF822 INTERN 0x2 /end IF_DATA /end MEASUREMENT
/begin MEASUREMENT ti_ev_3 "Einspritzzeit 3. Zylinder in Zündfolge" UWORD tinjection_sy 1 100 0 209.712 FORMAT "%8.4" /begin IF_DATA ASAP1B_KWP2000 KP_BLOB 0xF824 INTERN 0x2 /end IF_DATA /begin IF_DATA ETK KP_BLOB 0xF824 INTERN 0x2 /end IF_DATA /end MEASUREMENT
/begin MEASUREMENT ti_ev_4 "Einspritzzeit 4. Zylinder in Zündfolge" UWORD tinjection_sy 1 100 0 209.712 FORMAT "%8.4" /begin IF_DATA ASAP1B_KWP2000 KP_BLOB 0xF826 INTERN 0x2 /end IF_DATA /begin IF_DATA ETK KP_BLOB 0xF826 INTERN 0x2 /end IF_DATA /end MEASUREMENT
/begin MEASUREMENT ti_ev_5 "Einspritzzeit 5. Zylinder in Zündfolge" UWORD tinjection_sy 1 100 0 209.712 FORMAT "%8.4" /begin IF_DATA ASAP1B_KWP2000 KP_BLOB 0xF828 INTERN 0x2 /end IF_DATA /begin IF_DATA ETK KP_BLOB 0xF828 INTERN 0x2 /end IF_DATA /end MEASUREMENT
/begin MEASUREMENT ti_ev_6 "Einspritzzeit 6. Zylinder in Zündfolge" UWORD tinjection_sy 1 100 0 209.712 FORMAT "%8.4" /begin IF_DATA ASAP1B_KWP2000 KP_BLOB 0xF82A INTERN 0x2 /end IF_DATA /begin IF_DATA ETK KP_BLOB 0xF82A INTERN 0x2 /end IF_DATA /end MEASUREMENT
/begin MEASUREMENT ti_ev_7 "Einspritzzeit 7. Zylinder in Zündfolge" UWORD tinjection_sy 1 100 0 209.712 FORMAT "%8.4" /begin IF_DATA ASAP1B_KWP2000 KP_BLOB 0xF82C INTERN 0x2 /end IF_DATA /begin IF_DATA ETK KP_BLOB 0xF82C INTERN 0x2 /end IF_DATA /end MEASUREMENT
/begin MEASUREMENT ti_ev_8 "Einspritzzeit 8. Zylinder in Zündfolge" UWORD tinjection_sy 1 100 0 209.712 FORMAT "%8.4" /begin IF_DATA ASAP1B_KWP2000 KP_BLOB 0xF82E INTERN 0x2 /end IF_DATA /begin IF_DATA ETK KP_BLOB 0xF82E INTERN 0x2 /end IF_DATA /end MEASUREMENT
/begin MEASUREMENT ti_sto_0 "ausgegebene Einspritzzeit für Nachspritzer 1. Zyl. in Zündfolge" UWORD tinjection_sy 1 100 0 209.712 FORMAT "%8.4" /begin IF_DATA ASAP1B_KWP2000 KP_BLOB 0xF830 INTERN 0x2 /end IF_DATA /begin IF_DATA ETK KP_BLOB 0xF830 INTERN 0x2 /end IF_DATA /end MEASUREMENT
/begin MEASUREMENT ti_sto_1 "ausgegebene Einspritzzeit für Nachspritzer 2. Zyl. in Zündfolge" UWORD tinjection_sy 1 100 0 209.712 FORMAT "%8.4" /begin IF_DATA ASAP1B_KWP2000 KP_BLOB 0xF832 INTERN 0x2 /end IF_DATA /begin IF_DATA ETK KP_BLOB 0xF832 INTERN 0x2 /end IF_DATA /end MEASUREMENT
/begin MEASUREMENT ti_sto_2 "ausgegebene Einspritzzeit für Nachspritzer 3. Zyl. in Zündfolge" UWORD tinjection_sy 1 100 0 209.712 FORMAT "%8.4" /begin IF_DATA ASAP1B_KWP2000 KP_BLOB 0xF834 INTERN 0x2 /end IF_DATA /begin IF_DATA ETK KP_BLOB 0xF834 INTERN 0x2 /end IF_DATA /end MEASUREMENT
/begin MEASUREMENT ti_sto_3 "ausgegebene Einspritzzeit für Nachspritzer 4. Zyl. in Zündfolge" UWORD tinjection_sy 1 100 0 209.712 FORMAT "%8.4" /begin IF_DATA ASAP1B_KWP2000 KP_BLOB 0xF836 INTERN 0x2 /end IF_DATA /begin IF_DATA ETK KP_BLOB 0xF836 INTERN 0x2 /end IF_DATA /end MEASUREMENT
/begin MEASUREMENT ti_sto_4 "ausgegebene Einspritzzeit für Nachspritzer 5. Zyl. in Zündfolge" UWORD tinjection_sy 1 100 0 209.712 FORMAT "%8.4" /begin IF_DATA ASAP1B_KWP2000 KP_BLOB 0xF838 INTERN 0x2 /end IF_DATA /begin IF_DATA ETK KP_BLOB 0xF838 INTERN 0x2 /end IF_DATA /end MEASUREMENT
/begin MEASUREMENT ti_sto_5 "ausgegebene Einspritzzeit für Nachspritzer 6. Zyl. in Zündfolge" UWORD tinjection_sy 1 100 0 209.712 FORMAT "%8.4" /begin IF_DATA ASAP1B_KWP2000 KP_BLOB 0xF83A INTERN 0x2 /end IF_DATA /begin IF_DATA ETK KP_BLOB 0xF83A INTERN 0x2 /end IF_DATA /end MEASUREMENT
/begin MEASUREMENT ti_sto_6 "ausgegebene Einspritzzeit für Nachspritzer 7. Zyl. in Zündfolge" UWORD tinjection_sy 1 100 0 209.712 FORMAT "%8.4" /begin IF_DATA ASAP1B_KWP2000 KP_BLOB 0xF83C INTERN 0x2 /end IF_DATA /begin IF_DATA ETK KP_BLOB 0xF83C INTERN 0x2 /end IF_DATA /end MEASUREMENT
/begin MEASUREMENT ti_sto_7 "ausgegebene Einspritzzeit für Nachspritzer 8. Zyl. in Zündfolge" UWORD tinjection_sy 1 100 0 209.712 FORMAT "%8.4" /begin IF_DATA ASAP1B_KWP2000 KP_BLOB 0xF83E INTERN 0x2 /end IF_DATA /begin IF_DATA ETK KP_BLOB 0xF83E INTERN 0x2 /end IF_DATA /end MEASUREMENT
/begin MEASUREMENT tmotfil "gefilterte Motortemperatur" UBYTE temp_ub_q0p75_o48 1 100 -48 143.25 FORMAT "%5.1" /begin IF_DATA ASAP1B_KWP2000 KP_BLOB 0x380371 EXTERN 0x1 /end IF_DATA /begin IF_DATA ETK KP_BLOB 0x380371 EXTERN 0x1 /end IF_DATA /end MEASUREMENT
/begin MEASUREMENT tnse_w "Zeitzähler ab Startende (16bit)" UWORD t100msxs_uw_b6553p5 1 100 0 6553.5 FORMAT "%8.3" /begin IF_DATA ASAP1B_KWP2000 KP_BLOB 0x38150C EXTERN 0x2 /end IF_DATA /begin IF_DATA ETK KP_BLOB 0x38150C EXTERN 0x2 /end IF_DATA /end MEASUREMENT
/begin MEASUREMENT tnst_w "Zeit nach Startende" UWORD t10msxs_uw_b655p35 1 100 0 655.35 FORMAT "%8.4" /begin IF_DATA ASAP1B_KWP2000 KP_BLOB 0x38150E EXTERN 0x2 /end IF_DATA /begin IF_DATA ETK KP_BLOB 0x38150E EXTERN 0x2 /end IF_DATA /end MEASUREMENT
/begin MEASUREMENT tsas_w "Zeit über ein Arbeitsspiel für ngas_w" UWORD tsquantl 1 100 0 838848 FORMAT "%8.1" /begin IF_DATA ASAP1B_KWP2000 KP_BLOB 0x380A00 EXTERN 0x2 /end IF_DATA /begin IF_DATA ETK KP_BLOB 0x380A00 EXTERN 0x2 /end IF_DATA /end MEASUREMENT
/begin MEASUREMENT tsegrsp_w "Beginn Ringspeicher für Segmentzeit" UWORD tsquant 1 100 0 52428 FORMAT "%8.2" ARRAY_SIZE 8 /begin IF_DATA ASAP1B_KWP2000 KP_BLOB 0xF7EA INTERN 0x2 /end IF_DATA /begin IF_DATA ETK KP_BLOB 0xF7EA INTERN 0x2 /end IF_DATA /end MEASUREMENT
/begin MEASUREMENT ttooth10msCtr "" UBYTE dez 1 100 0 255 FORMAT "%5.1" /begin IF_DATA ASAP1B_KWP2000 KP_BLOB 0x38034A EXTERN 0x1 /end IF_DATA /begin IF_DATA ETK KP_BLOB 0x38034A EXTERN 0x1 /end IF_DATA /end MEASUREMENT
/begin MEASUREMENT ttoothv10ms "" UBYTE t10msxs_ub_b2p55 1 100 0 2.55 FORMAT "%5.3" /begin IF_DATA ASAP1B_KWP2000 KP_BLOB 0x38034B EXTERN 0x1 /end IF_DATA /begin IF_DATA ETK KP_BLOB 0x38034B EXTERN 0x1 /end IF_DATA /end MEASUREMENT
/begin MEASUREMENT tvfznw_t "" UBYTE t10msxs_ub_b2p55 1 100 0 2.55 FORMAT "%5.3" /begin IF_DATA ASAP1B_KWP2000 KP_BLOB 0xF808 INTERN 0x1 /end IF_DATA /begin IF_DATA ETK KP_BLOB 0xF808 INTERN 0x1 /end IF_DATA /end MEASUREMENT
/begin MEASUREMENT tvrnr "Verzögerungszeit bis zum wirklichen Ev-Abschaltende" UBYTE dez 1 100 0 255 FORMAT "%5.1" /begin IF_DATA ASAP1B_KWP2000 KP_BLOB 0x380388 EXTERN 0x1 /end IF_DATA /begin IF_DATA ETK KP_BLOB 0x380388 EXTERN 0x1 /end IF_DATA /end MEASUREMENT
/begin MEASUREMENT tvu_w "Batteriespannungskorrektur" UWORD tinjection_sy 1 100 0 209.712 FORMAT "%8.4" /begin IF_DATA ASAP1B_KWP2000 KP_BLOB 0x380BE6 EXTERN 0x2 /end IF_DATA /begin IF_DATA ETK KP_BLOB 0x380BE6 EXTERN 0x2 /end IF_DATA /end MEASUREMENT
/begin MEASUREMENT TYP_bm "" UWORD B_TRUE 1 100 0 15 BIT_MASK 0xf00 FORMAT "%5.2" /begin IF_DATA ASAP1B_KWP2000 KP_BLOB 0x382A8A EXTERN 0x2 /end IF_DATA /begin IF_DATA ETK KP_BLOB 0x382A8A EXTERN 0x2 /end IF_DATA /end MEASUREMENT
/begin MEASUREMENT TYP_dk "" UWORD B_TRUE 1 100 0 15 BIT_MASK 0xf00 FORMAT "%5.2" /begin IF_DATA ASAP1B_KWP2000 KP_BLOB 0x382A8C EXTERN 0x2 /end IF_DATA /begin IF_DATA ETK KP_BLOB 0x382A8C EXTERN 0x2 /end IF_DATA /end MEASUREMENT
/begin MEASUREMENT TYP_lm "" UWORD B_TRUE 1 100 0 15 BIT_MASK 0xf00 FORMAT "%5.2" /begin IF_DATA ASAP1B_KWP2000 KP_BLOB 0x382ABE EXTERN 0x2 /end IF_DATA /begin IF_DATA ETK KP_BLOB 0x382ABE EXTERN 0x2 /end IF_DATA /end MEASUREMENT
/begin MEASUREMENT TYP_n "" UWORD B_TRUE 1 100 0 15 BIT_MASK 0xf00 FORMAT "%5.2" /begin IF_DATA ASAP1B_KWP2000 KP_BLOB 0x382AC8 EXTERN 0x2 /end IF_DATA /begin IF_DATA ETK KP_BLOB 0x382AC8 EXTERN 0x2 /end IF_DATA /end MEASUREMENT
/begin MEASUREMENT uats2_w "Abgastemperatur-Rohwert, Bank 2" UWORD spg_uw_q0p00488 1 100 0 319.995 FORMAT "%8.4" /begin IF_DATA ASAP1B_KWP2000 KP_BLOB 0x380700 EXTERN 0x2 /end IF_DATA /begin IF_DATA ETK KP_BLOB 0x380700 EXTERN 0x2 /end IF_DATA /end MEASUREMENT
/begin MEASUREMENT uats_w "Abgastemperatur-Rohwert" UWORD spg_uw_q0p00488 1 100 0 319.995 FORMAT "%8.4" /begin IF_DATA ASAP1B_KWP2000 KP_BLOB 0x380702 EXTERN 0x2 /end IF_DATA /begin IF_DATA ETK KP_BLOB 0x380702 EXTERN 0x2 /end IF_DATA /end MEASUREMENT
/begin MEASUREMENT udsl_w "Spannung Drucksensor Ladedruck (word)" UWORD spg_uw_q0p00488 1 100 0 319.995 FORMAT "%8.4" /begin IF_DATA ASAP1B_KWP2000 KP_BLOB 0x380704 EXTERN 0x2 /end IF_DATA /begin IF_DATA ETK KP_BLOB 0x380704 EXTERN 0x2 /end IF_DATA /end MEASUREMENT
/begin MEASUREMENT udss_w "Spannung Drucksensor Saugrohrdruck (word)" UWORD spg_uw_q0p00488 1 100 0 319.995 FORMAT "%8.4" /begin IF_DATA ASAP1B_KWP2000 KP_BLOB 0xF7B6 INTERN 0x2 /end IF_DATA /begin IF_DATA ETK KP_BLOB 0xF7B6 INTERN 0x2 /end IF_DATA /end MEASUREMENT
/begin MEASUREMENT udsu_w "Spannung Umgebungsdrucksensor (word 10-Bit von ADC)" UWORD spg_uw_q0p00488 1 100 0 319.995 FORMAT "%8.4" /begin IF_DATA ASAP1B_KWP2000 KP_BLOB 0x380706 EXTERN 0x2 /end IF_DATA /begin IF_DATA ETK KP_BLOB 0x380706 EXTERN 0x2 /end IF_DATA /end MEASUREMENT
/begin MEASUREMENT uebver "Übersetzungsverhältnis" UBYTE fak_b0p051 1 100 0 0.051 FORMAT "%6.4" /begin IF_DATA ASAP1B_KWP2000 KP_BLOB 0x38043E EXTERN 0x1 /end IF_DATA /begin IF_DATA ETK KP_BLOB 0x38043E EXTERN 0x1 /end IF_DATA /end MEASUREMENT
/begin MEASUREMENT ugs_w "A/D-Eingangsspannung für Getriebeschaltfunktion" UWORD spg_uw_q0p00488 1 100 0 319.995 FORMAT "%8.4" /begin IF_DATA ASAP1B_KWP2000 KP_BLOB 0x380708 EXTERN 0x2 /end IF_DATA /begin IF_DATA ETK KP_BLOB 0x380708 EXTERN 0x2 /end IF_DATA /end MEASUREMENT
/begin MEASUREMENT uhsv "Spannung an der Heizerendstufe vor Kat" UBYTE spg_ub_b5 1 100 0 5 FORMAT "%5.3" /begin IF_DATA ASAP1B_KWP2000 KP_BLOB 0x380336 EXTERN 0x1 /end IF_DATA /begin IF_DATA ETK KP_BLOB 0x380336 EXTERN 0x1 /end IF_DATA /end MEASUREMENT
/begin MEASUREMENT uhsv2 "Spannung an der Heizerendstufe 2 vor Kat" UBYTE spg_ub_b5 1 100 0 5 FORMAT "%5.3" /begin IF_DATA ASAP1B_KWP2000 KP_BLOB 0x380337 EXTERN 0x1 /end IF_DATA /begin IF_DATA ETK KP_BLOB 0x380337 EXTERN 0x1 /end IF_DATA /end MEASUREMENT
/begin MEASUREMENT umsrln_w "Umrechnungsfaktor Füllung in Massenstrom" UWORD m_uw_q0p0005 1 100 0 32.7675 FORMAT "%8.5" /begin IF_DATA ASAP1B_KWP2000 KP_BLOB 0x380B32 EXTERN 0x2 /end IF_DATA /begin IF_DATA ETK KP_BLOB 0x380B32 EXTERN 0x2 /end IF_DATA /end MEASUREMENT
/begin MEASUREMENT upfuel "Kraftstoffdruck-Rohwert" UBYTE spg_ub_b5 1 100 0 5 FORMAT "%5.3" /begin IF_DATA ASAP1B_KWP2000 KP_BLOB 0x380338 EXTERN 0x1 /end IF_DATA /begin IF_DATA ETK KP_BLOB 0x380338 EXTERN 0x1 /end IF_DATA /end MEASUREMENT
/begin MEASUREMENT upoel "Öldruck-Rohwert" UBYTE spg_ub_b5 1 100 0 5 FORMAT "%5.3" /begin IF_DATA ASAP1B_KWP2000 KP_BLOB 0x380339 EXTERN 0x1 /end IF_DATA /begin IF_DATA ETK KP_BLOB 0x380339 EXTERN 0x1 /end IF_DATA /end MEASUREMENT
/begin MEASUREMENT utfuel "A/D-Eingangsspannung Temperaturfühler Kraftstoff" UBYTE spg_ub_b5 1 100 0 5 FORMAT "%5.3" /begin IF_DATA ASAP1B_KWP2000 KP_BLOB 0x38033A EXTERN 0x1 /end IF_DATA /begin IF_DATA ETK KP_BLOB 0x38033A EXTERN 0x1 /end IF_DATA /end MEASUREMENT
/begin MEASUREMENT utol "A/D-Eingangsspannung Oeltemperaturfühler" UBYTE spg_ub_b5 1 100 0 5 FORMAT "%5.3" /begin IF_DATA ASAP1B_KWP2000 KP_BLOB 0x38033B EXTERN 0x1 /end IF_DATA /begin IF_DATA ETK KP_BLOB 0x38033B EXTERN 0x1 /end IF_DATA /end MEASUREMENT
/begin MEASUREMENT uulsuv2_w "Sondenspannung vor Kat einer Breitbandlambdasonde Bank2 (ADC-Wert)" UWORD spg_uw_b5 1 100 0 319.995 FORMAT "%8.4" /begin IF_DATA ASAP1B_KWP2000 KP_BLOB 0x38070A EXTERN 0x2 /end IF_DATA /begin IF_DATA ETK KP_BLOB 0x38070A EXTERN 0x2 /end IF_DATA /end MEASUREMENT
/begin MEASUREMENT uulsuv_w "Sondenspannung vor Kat einer Breitbandlambdasonde (ADC-Wert)" UWORD spg_uw_b5 1 100 0 319.995 FORMAT "%8.4" /begin IF_DATA ASAP1B_KWP2000 KP_BLOB 0x38070C EXTERN 0x2 /end IF_DATA /begin IF_DATA ETK KP_BLOB 0x38070C EXTERN 0x2 /end IF_DATA /end MEASUREMENT
/begin MEASUREMENT uvv1 "" UWORD spg_uw_q0p00488 1 100 0 319.995 FORMAT "%8.4" /begin IF_DATA ASAP1B_KWP2000 KP_BLOB 0x38070E EXTERN 0x2 /end IF_DATA /begin IF_DATA ETK KP_BLOB 0x38070E EXTERN 0x2 /end IF_DATA /end MEASUREMENT
/begin MEASUREMENT uwdk_w "ADW-Signal Drosselklappenwinkel 16 Bit" UWORD spg_uw_q0p000076 1 100 0 4.99992 FORMAT "%8.6" /begin IF_DATA ASAP1B_KWP2000 KP_BLOB 0xF7B8 INTERN 0x2 /end IF_DATA /begin IF_DATA ETK KP_BLOB 0xF7B8 INTERN 0x2 /end IF_DATA /end MEASUREMENT
/begin MEASUREMENT vwkw "KW-Winkelgeschwindigkeit" UBYTE rel_ub_q0p1875 1 100 0 47.8125 FORMAT "%5.2" /begin IF_DATA ASAP1B_KWP2000 KP_BLOB 0x380379 EXTERN 0x1 /end IF_DATA /begin IF_DATA ETK KP_BLOB 0x380379 EXTERN 0x1 /end IF_DATA /end MEASUREMENT
/begin MEASUREMENT wdkbap_w "fuer Einspritzung praedizierter Drosselklappenwinkel (Word)" UWORD relDK_uw_b100 1 100 0 100 FORMAT "%8.4" /begin IF_DATA ASAP1B_KWP2000 KP_BLOB 0x380BC8 EXTERN 0x2 /end IF_DATA /begin IF_DATA ETK KP_BLOB 0x380BC8 EXTERN 0x2 /end IF_DATA /end MEASUREMENT
/begin MEASUREMENT weests_r "" UBYTE kw_q2p8125 1 100 0 717.188 FORMAT "%5.1" /begin IF_DATA ASAP1B_KWP2000 KP_BLOB 0xF809 INTERN 0x1 /end IF_DATA /begin IF_DATA ETK KP_BLOB 0xF809 INTERN 0x1 /end IF_DATA /end MEASUREMENT
/begin MEASUREMENT winkl_b1 "" UWORD dez 1 100 0 65535 FORMAT "%8.2" /begin IF_DATA ASAP1B_KWP2000 KP_BLOB 0xF840 INTERN 0x2 /end IF_DATA /begin IF_DATA ETK KP_BLOB 0xF840 INTERN 0x2 /end IF_DATA /end MEASUREMENT
/begin MEASUREMENT winkl_b2 "" UWORD dez 1 100 0 65535 FORMAT "%8.2" /begin IF_DATA ASAP1B_KWP2000 KP_BLOB 0xF842 INTERN 0x2 /end IF_DATA /begin IF_DATA ETK KP_BLOB 0xF842 INTERN 0x2 /end IF_DATA /end MEASUREMENT
/begin MEASUREMENT wpr "Einspritzberechnungs-Praediktions-Winkel" UBYTE zw_ub_q6 1 100 0 1530 FORMAT "%5.0" /begin IF_DATA ASAP1B_KWP2000 KP_BLOB 0x38037A EXTERN 0x1 /end IF_DATA /begin IF_DATA ETK KP_BLOB 0x38037A EXTERN 0x1 /end IF_DATA /end MEASUREMENT
/begin MEASUREMENT wprnsp "Einspritzberechnungs-Praediktions-Winkel bei Nachspritzer" UBYTE zw_ub_q6 1 100 0 1530 FORMAT "%5.0" /begin IF_DATA ASAP1B_KWP2000 KP_BLOB 0x38037B EXTERN 0x1 /end IF_DATA /begin IF_DATA ETK KP_BLOB 0x38037B EXTERN 0x1 /end IF_DATA /end MEASUREMENT
/begin MEASUREMENT wtans "A/D-Wert für Ansauglufttemperatur tans" UBYTE spg_ub_q0p019 1 100 0 4.98047 FORMAT "%5.3" /begin IF_DATA ASAP1B_KWP2000 KP_BLOB 0x38033C EXTERN 0x1 /end IF_DATA /begin IF_DATA ETK KP_BLOB 0x38033C EXTERN 0x1 /end IF_DATA /end MEASUREMENT
/begin MEASUREMENT wtmot "A/D-Wert für tmot" UBYTE spg_ub_q0p019 1 100 0 4.98047 FORMAT "%5.3" /begin IF_DATA ASAP1B_KWP2000 KP_BLOB 0x38033D EXTERN 0x1 /end IF_DATA /begin IF_DATA ETK KP_BLOB 0x38033D EXTERN 0x1 /end IF_DATA /end MEASUREMENT
/begin MEASUREMENT wub "Batteriespannung; vom AD-Wandler erfaßter Wert" UBYTE spg_ub 1 100 0 17.3655 FORMAT "%5.2" /begin IF_DATA ASAP1B_KWP2000 KP_BLOB 0x38033E EXTERN 0x1 /end IF_DATA /begin IF_DATA ETK KP_BLOB 0x38033E EXTERN 0x1 /end IF_DATA /end MEASUREMENT
/begin MEASUREMENT znostend "Anzahl Zündung=ein ohne Erreichen von Startende" UBYTE dez 1 100 0 255 FORMAT "%5.1" /begin IF_DATA ASAP1B_KWP2000 KP_BLOB 0x38294F EXTERN 0x1 /end IF_DATA /begin IF_DATA ETK KP_BLOB 0x38294F EXTERN 0x1 /end IF_DATA /end MEASUREMENT
/begin MEASUREMENT zrph "Zähler Raster Phasensignal" UBYTE dez 1 100 0 255 FORMAT "%5.1" /begin IF_DATA ASAP1B_KWP2000 KP_BLOB 0x38034C EXTERN 0x1 /end IF_DATA /begin IF_DATA ETK KP_BLOB 0x38034C EXTERN 0x1 /end IF_DATA /end MEASUREMENT
/begin MEASUREMENT zylvek_a "" UBYTE dez 1 100 0 255 FORMAT "%5.1" /begin IF_DATA ASAP1B_KWP2000 KP_BLOB 0xF80A INTERN 0x1 /end IF_DATA /begin IF_DATA ETK KP_BLOB 0xF80A INTERN 0x1 /end IF_DATA /end MEASUREMENT
/begin MEASUREMENT zzbank "Zylinderzuordnung zu Einspritzbänken" UBYTE dez 1 100 0 255 FORMAT "%5.1" /begin IF_DATA ASAP1B_KWP2000 KP_BLOB 0x38037C EXTERN 0x1 /end IF_DATA /begin IF_DATA ETK KP_BLOB 0x38037C EXTERN 0x1 /end IF_DATA /end MEASUREMENT
/begin MEASUREMENT Z_bm "Zyklusflag: Bezugsmarkengeber" UWORD B_TRUE 1 100 0 1 BIT_MASK 0x2 FORMAT "%5.3" /begin IF_DATA ASAP1B_KWP2000 KP_BLOB 0x382A8A EXTERN 0x2 /end IF_DATA /begin IF_DATA ETK KP_BLOB 0x382A8A EXTERN 0x2 /end IF_DATA /end MEASUREMENT
/begin MEASUREMENT Z_dk "Zyklusflag:	DK - Potentiometer" UWORD B_TRUE 1 100 0 1 BIT_MASK 0x2 FORMAT "%5.3" /begin IF_DATA ASAP1B_KWP2000 KP_BLOB 0x382A8C EXTERN 0x2 /end IF_DATA /begin IF_DATA ETK KP_BLOB 0x382A8C EXTERN 0x2 /end IF_DATA /end MEASUREMENT
/begin MEASUREMENT Z_lm "Zyklusflag:	LMM/HLM/HFM" UWORD B_TRUE 1 100 0 1 BIT_MASK 0x2 FORMAT "%5.3" /begin IF_DATA ASAP1B_KWP2000 KP_BLOB 0x382ABE EXTERN 0x2 /end IF_DATA /begin IF_DATA ETK KP_BLOB 0x382ABE EXTERN 0x2 /end IF_DATA /end MEASUREMENT
/begin MEASUREMENT Z_n "Zyklusflag: Drehzahlsignalgeber" UWORD B_TRUE 1 100 0 1 BIT_MASK 0x2 FORMAT "%5.3" /begin IF_DATA ASAP1B_KWP2000 KP_BLOB 0x382AC8 EXTERN 0x2 /end IF_DATA /begin IF_DATA ETK KP_BLOB 0x382AC8 EXTERN 0x2 /end IF_DATA /end MEASUREMENT
/begin FUNCTION ACIFI "Ausgabe für zylinderindividuelle Einspritzung"
 /begin DEF_CHARACTERISTIC DTIABS DTIREL WESBM WEESTS TVFZNW FZNWN1 FZNWN2 FZNWN3 FZNWN4 FZNWN5 FZNWN6 FZNWN7 FZNWN8 FZN1 FZN2 FZN3 FZN4 FZN5 FZN6 FZN7 FZN8 /end DEF_CHARACTERISTIC
 /begin REF_CHARACTERISTIC SNM16CIUB NMIN CWZZBANK /end REF_CHARACTERISTIC
 /begin IN_MEASUREMENT B_kl15 B_nsp esst_snm16ciub evz_austot nmot nmot_w ti_b1 ti_b2 ti_tvu_w tn2 weer /end IN_MEASUREMENT
 /begin OUT_MEASUREMENT anzti anzti_w B_encifi B_nwsaktiv B_nwsalt B_spontan0 B_spontan1 B_spontan2 B_spontan3 B_spontan4 B_spontan5 B_spontan6 B_spontan7 B_synti B_ti_cha0 B_ti_cha1 B_ti_cha2 B_ti_cha3 B_ti_cha4 B_ti_cha5 B_ti_cha6 B_ti_cha7 B_ti_out0 B_ti_out1 B_ti_out2 B_ti_out3 B_ti_out4 B_ti_out5 B_ti_out6 B_ti_out7 B_ti_wai0 B_ti_wai1 B_ti_wai2 B_ti_wai3 B_ti_wai4 B_ti_wai5 B_ti_wai6 B_ti_wai7 cc_cha_0 cc_cha_1 cc_cha_2 cc_cha_3 cc_cha_4 cc_cha_5 cc_cha_6 cc_cha_7 fgezs1 fgezs2 fgezs3 fgezs4 fgezs5 fgezs6 fgezs7 fgezs8 tistzyl ti_ev_1 ti_ev_2 ti_ev_3 ti_ev_4 ti_ev_5 ti_ev_6 ti_ev_7 ti_ev_8 ti_sto_0 ti_sto_1 ti_sto_2 ti_sto_3 ti_sto_4 ti_sto_5 ti_sto_6 ti_sto_7 tvfznw_t weests_r winkl_b1 winkl_b2 zylvek_a /end OUT_MEASUREMENT
 /begin LOC_MEASUREMENT na_abs_c na_rel_c pd_we_zy restw_b1 restw_b2 segz /end LOC_MEASUREMENT
 /begin SUB_FUNCTION /end SUB_FUNCTION
/end FUNCTION
/begin FUNCTION ADB "Ausgabe Dashboard"
 /begin DEF_CHARACTERISTIC POELLAMPN NSHLEDG NSHLEDO4 NSHLEDO3 NSHLEDO2 NSHLEDO1 DDU2LEDT VFZLAMPU VFZLAMPO NSHLAMPG TMOTSPECMN TMOTSPECMX TOELSPECMN TOELSPECMX PFUESPECMN PFUESPECMX TLAED /end DEF_CHARACTERISTIC
 /begin REF_CHARACTERISTIC /end REF_CHARACTERISTIC
 /begin IN_MEASUREMENT B_ddu2pres B_nmot dfpmMilState gangi nmot nmot_w pfuel poel tmot toel vfzg_w /end IN_MEASUREMENT
 /begin OUT_MEASUREMENT B_mil B_milblk B_milspec B_oellamp B_shlamp B_shled1 B_shled2 B_shled3 B_shled4 B_shled5 ddu2leds milstat /end OUT_MEASUREMENT
 /begin LOC_MEASUREMENT B_blkeb B_mileb B_milst /end LOC_MEASUREMENT
 /begin SUB_FUNCTION /end SUB_FUNCTION
/end FUNCTION
/begin FUNCTION aekp "Ausgabe EKP-Ansteuerung" /begin DEF_CHARACTERISTIC TPVL TZMIN TEBF ZNOSTMX UBSTS TNLEKPVL TAPVLTM /end DEF_CHARACTERISTIC /begin REF_CHARACTERISTIC /end REF_CHARACTERISTIC
 /begin IN_MEASUREMENT B_nachlend B_nmin B_st B_stend B_uhrrsec swOffDlBits tabst_w tmotab tnachl_w ub /end IN_MEASUREMENT
 /begin OUT_MEASUREMENT B_ekp B_kstebfa /end OUT_MEASUREMENT
 /begin LOC_MEASUREMENT AEKPintbits B_ekpd B_ekpn B_ekpubn B_ekpvl B_pvl1 B_pvl2 B_pvlnl B_tpvl dekpub lokBits_Aekp znostend /end LOC_MEASUREMENT
 /begin SUB_FUNCTION /end SUB_FUNCTION
/end FUNCTION
/begin FUNCTION AES "Ausgabe Einspritzung" /begin DEF_CHARACTERISTIC KRKTE TVUB FRLFSDP CWPKAPP PSAPES /end DEF_CHARACTERISTIC /begin REF_CHARACTERISTIC /end REF_CHARACTERISTIC /begin IN_MEASUREMENT ps_w pu_w ub /end IN_MEASUREMENT /begin OUT_MEASUREMENT dpus_w frkte_w tvu_w /end OUT_MEASUREMENT /begin LOC_MEASUREMENT pses_w /end LOC_MEASUREMENT /begin SUB_FUNCTION /end SUB_FUNCTION /end FUNCTION
/begin FUNCTION AEVAB "Ausgabe Einspritzung Ev-Ausblendung" /begin DEF_CHARACTERISTIC CWZZBANK EVOFFAPP REDABM /end DEF_CHARACTERISTIC /begin REF_CHARACTERISTIC /end REF_CHARACTERISTIC /begin IN_MEASUREMENT nmot redsol zzyl /end IN_MEASUREMENT
 /begin OUT_MEASUREMENT abmf B_bevab B_bevab2 B_evloc evz_ags evz_aus evz_austot redbas redist zzbank /end OUT_MEASUREMENT
 /begin LOC_MEASUREMENT eevx evrbgn evrbgn_one redsolr redsol_one tvrnr /end LOC_MEASUREMENT
 /begin SUB_FUNCTION /end SUB_FUNCTION
/end FUNCTION
/begin FUNCTION ASC0F "" /begin DEF_CHARACTERISTIC /end DEF_CHARACTERISTIC /begin REF_CHARACTERISTIC /end REF_CHARACTERISTIC /begin IN_MEASUREMENT /end IN_MEASUREMENT /begin OUT_MEASUREMENT B_klineok /end OUT_MEASUREMENT /begin LOC_MEASUREMENT /end LOC_MEASUREMENT /begin SUB_FUNCTION /end SUB_FUNCTION /end FUNCTION
/begin FUNCTION ATM "18.100    Abgastemperaturmodell"
 /begin DEF_CHARACTERISTIC CWATM TMATMTH TATMTH TATMTP TMATMTP TATMSA TATMWMK TATMTMOT ATMTANS ZATMAML KFWMABG KFATMLA KFTATM /end DEF_CHARACTERISTIC
 /begin REF_CHARACTERISTIC SML07TMUW /end REF_CHARACTERISTIC
 /begin IN_MEASUREMENT B_nmot B_pwf B_sa B_st B_stend esst_sml07tmuw lamsons_w ml ml_w nmot rl tabst_w tans tats tats2 tmot tmst tumg vfzg /end IN_MEASUREMENT
 /begin OUT_MEASUREMENT B_atmtpa B_atmtpa2 imlatm imlatm_w iwmatm_w lamsons8 tabgm tabgm2 tabgm2_w tabgm_w /end OUT_MEASUREMENT
 /begin LOC_MEASUREMENT B_atmth tatmkf tatmsta /end LOC_MEASUREMENT
 /begin SUB_FUNCTION /end SUB_FUNCTION
/end FUNCTION
/begin FUNCTION AUFA "" /begin DEF_CHARACTERISTIC /end DEF_CHARACTERISTIC /begin REF_CHARACTERISTIC /end REF_CHARACTERISTIC /begin IN_MEASUREMENT /end IN_MEASUREMENT
 /begin OUT_MEASUREMENT uats2_w uats_w udsl_w udss_w udsu_w ugs_w uhsv uhsv2 upfuel upoel utfuel utol uulsuv2_w uulsuv_w uvv1 uwdk_w wtans wtmot wub /end OUT_MEASUREMENT
 /begin LOC_MEASUREMENT /end LOC_MEASUREMENT
 /begin SUB_FUNCTION /end SUB_FUNCTION
/end FUNCTION
/begin FUNCTION AZUE "Ausgabe Zündung" /begin DEF_CHARACTERISTIC CWZNDAUS /end DEF_CHARACTERISTIC /begin REF_CHARACTERISTIC /end REF_CHARACTERISTIC /begin IN_MEASUREMENT /end IN_MEASUREMENT /begin OUT_MEASUREMENT /end OUT_MEASUREMENT /begin LOC_MEASUREMENT /end LOC_MEASUREMENT /begin SUB_FUNCTION /end SUB_FUNCTION /end FUNCTION
/begin FUNCTION BBGANG "Betriebsbereich Gang"
 /begin DEF_CHARACTERISTIC UVGANG01 UVGANG12 UVGANG23 UVGANG34 UVGANG45 UVGANG56 UVGANG67 /end DEF_CHARACTERISTIC
 /begin REF_CHARACTERISTIC /end REF_CHARACTERISTIC
 /begin IN_MEASUREMENT B_ll B_vnull E_vfz nmot_w vfzg_w /end IN_MEASUREMENT
 /begin OUT_MEASUREMENT gangi uebver /end OUT_MEASUREMENT
 /begin LOC_MEASUREMENT nmitt4_w /end LOC_MEASUREMENT
 /begin SUB_FUNCTION /end SUB_FUNCTION
/end FUNCTION
/begin FUNCTION BBSAWE "18.40     Betriebsbereich Schubabschalten/Wiedereinsetzen"
 /begin DEF_CHARACTERISTIC DNSAH DNSAL DNVSA DNSLL DVSA VSAA NGDNSA NWEM NWENG TVSATM KFTVSA ENASAG /end DEF_CHARACTERISTIC
 /begin REF_CHARACTERISTIC SNM08__UB STM05SAUB /end REF_CHARACTERISTIC
 /begin IN_MEASUREMENT B_ll B_stend esst_snm08__ub esst_stm05saub gangi ngfil nmot tmot tmst vfzg /end IN_MEASUREMENT
 /begin OUT_MEASUREMENT B_sab /end OUT_MEASUREMENT
 /begin LOC_MEASUREMENT BBSAWElokbits B_dnsll B_sabt dnsa nsa nwe /end LOC_MEASUREMENT
 /begin SUB_FUNCTION /end SUB_FUNCTION
/end FUNCTION
/begin FUNCTION BBSTT "Betriebsbereich: Start" /begin DEF_CHARACTERISTIC NNSTA NSTNM /end DEF_CHARACTERISTIC /begin REF_CHARACTERISTIC /end REF_CHARACTERISTIC /begin IN_MEASUREMENT B_nmot nmot tans tmot /end IN_MEASUREMENT /begin OUT_MEASUREMENT B_st B_stend tnse_w tnst_w /end OUT_MEASUREMENT /begin LOC_MEASUREMENT /end LOC_MEASUREMENT /begin SUB_FUNCTION /end SUB_FUNCTION /end FUNCTION
/begin FUNCTION BGMSZS "13.10     Berechnungsgröße Massenströme zum Saugrohr"
 /begin DEF_CHARACTERISTIC MLFKMSDK RLNOT FKMSDKMX FKMSDKMN FKPVDKMX FKPVDKMN KUMSRL TDFKMSDK ZKPVDK ZKMSDK KFMSNWDK /end DEF_CHARACTERISTIC
 /begin REF_CHARACTERISTIC /end REF_CHARACTERISTIC
 /begin IN_MEASUREMENT B_dslvh B_dsuv B_pwf B_stend fpvdkds_w ftvdk ml_w nmot nmot_w ps_w pu_w pvdkds_w rlmod_w rl_w wdkba_w /end IN_MEASUREMENT
 /begin OUT_MEASUREMENT B_fkpvdk dfuelsan_w fkmsdks_w fkmsdk_w fkpvdk_w fpvdk_w frhodk_w msdk_w msndk_w pspvdk_w pspvds_w pvdk_w rldvs_w rlroh_w umsrln_w /end OUT_MEASUREMENT
 /begin LOC_MEASUREMENT msdkue_w /end LOC_MEASUREMENT
 /begin SUB_FUNCTION /end SUB_FUNCTION
/end FUNCTION
/begin FUNCTION BGNG "Berechnete Größe Drehzahlgradient" /begin DEF_CHARACTERISTIC ZNGFIL /end DEF_CHARACTERISTIC /begin REF_CHARACTERISTIC /end REF_CHARACTERISTIC /begin IN_MEASUREMENT nmot_w tseghi tseg_w /end IN_MEASUREMENT
 /begin OUT_MEASUREMENT B_ngasok B_syn2nd dnmotas_w dnmot_w irspsyn ngas_w ngfil ngfil_w nmotas_w nmotrsp_w tsas_w tsegrsp_w /end OUT_MEASUREMENT
 /begin LOC_MEASUREMENT /end LOC_MEASUREMENT
 /begin SUB_FUNCTION /end SUB_FUNCTION
/end FUNCTION
/begin FUNCTION BGNMOT "Berechnete Größe Drehzahl" /begin DEF_CHARACTERISTIC NMIN /end DEF_CHARACTERISTIC /begin REF_CHARACTERISTIC /end REF_CHARACTERISTIC /begin IN_MEASUREMENT tseghi tseg_w /end IN_MEASUREMENT /begin OUT_MEASUREMENT B_nmin B_nmot nmot nmot_w ttooth10msCtr ttoothv10ms /end OUT_MEASUREMENT /begin LOC_MEASUREMENT /end LOC_MEASUREMENT /begin SUB_FUNCTION /end SUB_FUNCTION /end FUNCTION
/begin FUNCTION BGRLP "Berechnungsgröße rlp prädizierte Luftfüllung" /begin DEF_CHARACTERISTIC CBGRLP DRLMIN DRLDYNU DWPR DWPRNSP DTEPRU TNSURLP /end DEF_CHARACTERISTIC /begin REF_CHARACTERISTIC KFMSNWDK /end REF_CHARACTERISTIC
 /begin IN_MEASUREMENT B_ll B_st B_stend dpsfg_w drl_w frhodk_w fupsrl_w fvisrm_w nmot nmot_w pirg_w psmx_w ps_w pvdk_w rldvs_w rl_w te_w tvu_w umsrln_w wdkbap_w wea wee /end IN_MEASUREMENT
 /begin OUT_MEASUREMENT B_nsp drlp_w rlp rlp_w /end OUT_MEASUREMENT
 /begin LOC_MEASUREMENT B_rlp B_rlpns dpsdvs_w dpsmp_w fwprs_w msndkpk_w psmp_w psp_w rlmp_w rlrohmp_w vwkw wpr wprnsp /end LOC_MEASUREMENT
 /begin SUB_FUNCTION /end SUB_FUNCTION
/end FUNCTION
/begin FUNCTION BGSRM "Füllungserfassung Saugrohrmodell" /begin DEF_CHARACTERISTIC KFURL KFPRG KFPSDSSK FPVMOMXN KISRM ZVTPRGSU /end DEF_CHARACTERISTIC /begin REF_CHARACTERISTIC /end REF_CHARACTERISTIC
 /begin IN_MEASUREMENT B_ehfs fho_w ftbr_w ftsr nmot_w psdss_w pu_w pvdkds_w rlroh_w umsrln_w wdkba_w wnwue /end IN_MEASUREMENT
 /begin OUT_MEASUREMENT B_sumod1 B_sumod2 B_sumod3 dpsfgm_w dpsfg_w drl_w fupsrl_w fvisrm_w ml ml_w pirg_w ps psmx_w ps_w rl rlmod_w rl_w sumode /end OUT_MEASUREMENT
 /begin LOC_MEASUREMENT pirgro_w psdssk_w psmod_w psrlro_w rfgdss_w rfgmod_w /end LOC_MEASUREMENT
 /begin SUB_FUNCTION /end SUB_FUNCTION
/end FUNCTION
/begin FUNCTION BGTEMPK "Füllungserfassung Berechnung Temperaturkompensation" /begin DEF_CHARACTERISTIC FDVANS FWFTBRTA EVTMODO KFFWTBR ZBRT ZTMMBR CWTEMPK /end DEF_CHARACTERISTIC /begin REF_CHARACTERISTIC /end REF_CHARACTERISTIC /begin IN_MEASUREMENT B_nmot nmot rl tans tmot /end IN_MEASUREMENT /begin OUT_MEASUREMENT ftbr ftbr_w ftsr ftu ftvdk ftw /end OUT_MEASUREMENT /begin LOC_MEASUREMENT evtmod tempin tmotfil /end LOC_MEASUREMENT /begin SUB_FUNCTION /end SUB_FUNCTION /end FUNCTION
/begin FUNCTION BGWDKM "Berechnung Dk-Winkel Modell" /begin DEF_CHARACTERISTIC TDKPV DWDKPU /end DEF_CHARACTERISTIC /begin REF_CHARACTERISTIC /end REF_CHARACTERISTIC /begin IN_MEASUREMENT dwdkba_w wdkba_w /end IN_MEASUREMENT /begin OUT_MEASUREMENT wdkbap_w /end OUT_MEASUREMENT /begin LOC_MEASUREMENT B_wdkp ddwdkba_w /end LOC_MEASUREMENT /begin SUB_FUNCTION /end SUB_FUNCTION /end FUNCTION
/begin FUNCTION CAN "CAN-Signalliste" /begin DEF_CHARACTERISTIC /end DEF_CHARACTERISTIC /begin REF_CHARACTERISTIC CWDDU /end REF_CHARACTERISTIC
 /begin IN_MEASUREMENT B_kl B_shlamp B_vmax B_vmaxreq dwkrz fr2_w fr_w gangi kvges_w kvlapold_w lamsoni2_w lamsoni_w mappos nmot_w pfuel poel pu rl tans te2_w te_w tfuel tmot toel ub vfzg vfzgmph_w wdkba zwist /end IN_MEASUREMENT
 /begin OUT_MEASUREMENT lapctrcan /end OUT_MEASUREMENT
 /begin LOC_MEASUREMENT /end LOC_MEASUREMENT
 /begin SUB_FUNCTION /end SUB_FUNCTION
/end FUNCTION
/begin FUNCTION DCLA "OBDII; Klassentabelle"
 /begin DEF_CHARACTERISTIC CL30LINE CL31LINE CL32LINE CL33LINE CL34LINE CL35LINE CL36LINE CL37LINE CL38LINE CL39LINE /end DEF_CHARACTERISTIC
 /begin REF_CHARACTERISTIC /end REF_CHARACTERISTIC
 /begin IN_MEASUREMENT /end IN_MEASUREMENT
 /begin OUT_MEASUREMENT /end OUT_MEASUREMENT
 /begin LOC_MEASUREMENT /end LOC_MEASUREMENT
 /begin SUB_FUNCTION /end SUB_FUNCTION
/end FUNCTION
/begin FUNCTION DDCY "OBDII; Erfüllung Bedingung 'driving cycle'" /begin DEF_CHARACTERISTIC TWBDCY /end DEF_CHARACTERISTIC /begin REF_CHARACTERISTIC /end REF_CHARACTERISTIC /begin IN_MEASUREMENT B_stend /end IN_MEASUREMENT /begin OUT_MEASUREMENT bbdcy B_dcy /end OUT_MEASUREMENT /begin LOC_MEASUREMENT /end LOC_MEASUREMENT /begin SUB_FUNCTION /end SUB_FUNCTION /end FUNCTION
/begin FUNCTION DDG "Diagnose Drehzahlgeber" /begin DEF_CHARACTERISTIC PGFLWA /end DEF_CHARACTERISTIC /begin REF_CHARACTERISTIC /end REF_CHARACTERISTIC /begin IN_MEASUREMENT B_nmin /end IN_MEASUREMENT /begin OUT_MEASUREMENT zrph /end OUT_MEASUREMENT /begin LOC_MEASUREMENT /end LOC_MEASUREMENT /begin SUB_FUNCTION /end SUB_FUNCTION /end FUNCTION
/begin FUNCTION DDKG "Diagnose; Plausibilitätsprüfung Drosselklappenwinkelgeber (OBDII)" /begin DEF_CHARACTERISTIC NDDKST TDDK TDDKNF TDDKST WDKDU WDKDO /end DEF_CHARACTERISTIC /begin REF_CHARACTERISTIC /end REF_CHARACTERISTIC /begin IN_MEASUREMENT nmot wdk_w /end IN_MEASUREMENT /begin OUT_MEASUREMENT /end OUT_MEASUREMENT /begin LOC_MEASUREMENT /end LOC_MEASUREMENT /begin SUB_FUNCTION /end SUB_FUNCTION /end FUNCTION
/begin FUNCTION DDSS "Diagnose; Drucksensor im  Saugrohr" /begin DEF_CHARACTERISTIC DPDDF NDDFA TDDF TDDFZ UADPSMN UADPSMX PSINIPL /end DEF_CHARACTERISTIC /begin REF_CHARACTERISTIC /end REF_CHARACTERISTIC
 /begin IN_MEASUREMENT B_ll B_nachlend B_nmot B_pwf B_stend nmot_w psdss_w pu_w udsm_w wdkba_w /end IN_MEASUREMENT
 /begin OUT_MEASUREMENT B_ehfs psini_w /end OUT_MEASUREMENT
 /begin LOC_MEASUREMENT /end LOC_MEASUREMENT
 /begin SUB_FUNCTION /end SUB_FUNCTION
/end FUNCTION
/begin FUNCTION DDU2 "" /begin DEF_CHARACTERISTIC CWDDU /end DEF_CHARACTERISTIC /begin REF_CHARACTERISTIC /end REF_CHARACTERISTIC
 /begin IN_MEASUREMENT ddu2leds distkm_w distlap_w distm_w fs1_dfp fs2_dfp gangi kvges_w kvlapold_w kvlap_w lamsoni2ma lamsoni2mi lamsoni2_w lamsonima lamsonimi lamsoni_w lapctr laptimeo_h laptimeo_l laptime_h laptime_l ltdistkm_w ltdistm_w ltmot_w ltnmotmo_w ltnmotmx_w mappos mapposma mapposmi nmot_w pfuel pfuelma pfuelmi poel poelma poelmi ps_w puma pumi pu_w rl_w tans tansma tansmi tfuel tmot tmotma tmotmi toel toelma toelmi ub ubma ubmi vfzgmph_w vfzg_w wdkba wdkbama wdkbami /end IN_MEASUREMENT
 /begin OUT_MEASUREMENT B_ddu2pres /end OUT_MEASUREMENT
 /begin LOC_MEASUREMENT DDU2Data /end LOC_MEASUREMENT
 /begin SUB_FUNCTION /end SUB_FUNCTION
/end FUNCTION
/begin FUNCTION DECJ "Diagnose; Endstufe CJ4x/9x" /begin DEF_CHARACTERISTIC /end DEF_CHARACTERISTIC /begin REF_CHARACTERISTIC /end REF_CHARACTERISTIC /begin IN_MEASUREMENT nmot ub /end IN_MEASUREMENT /begin OUT_MEASUREMENT B_desee B_esdia /end OUT_MEASUREMENT /begin LOC_MEASUREMENT /end LOC_MEASUREMENT /begin SUB_FUNCTION /end SUB_FUNCTION /end FUNCTION
/begin FUNCTION DEKON "Konfiguration der Endstufendiagnose" /begin DEF_CHARACTERISTIC ESKONF_A ESKONF_B /end DEF_CHARACTERISTIC /begin REF_CHARACTERISTIC /end REF_CHARACTERISTIC /begin IN_MEASUREMENT /end IN_MEASUREMENT /begin OUT_MEASUREMENT /end OUT_MEASUREMENT /begin LOC_MEASUREMENT /end LOC_MEASUREMENT /begin SUB_FUNCTION /end SUB_FUNCTION /end FUNCTION
/begin FUNCTION DEKPE "Diagnose; Elektrokraftstoffpumpe Endstufe" /begin DEF_CHARACTERISTIC /end DEF_CHARACTERISTIC /begin REF_CHARACTERISTIC /end REF_CHARACTERISTIC /begin IN_MEASUREMENT B_desee /end IN_MEASUREMENT /begin OUT_MEASUREMENT /end OUT_MEASUREMENT /begin LOC_MEASUREMENT /end LOC_MEASUREMENT /begin SUB_FUNCTION /end SUB_FUNCTION /end FUNCTION
/begin FUNCTION DEVE "Diagnose; Einspritzventil - Endstufe" /begin DEF_CHARACTERISTIC /end DEF_CHARACTERISTIC /begin REF_CHARACTERISTIC /end REF_CHARACTERISTIC /begin IN_MEASUREMENT B_desee B_sa B_stend evz_austot /end IN_MEASUREMENT /begin OUT_MEASUREMENT B_eev /end OUT_MEASUREMENT /begin LOC_MEASUREMENT /end LOC_MEASUREMENT /begin SUB_FUNCTION /end SUB_FUNCTION /end FUNCTION
/begin FUNCTION DFFT "Diagnose; Freeze Frame Auswahltabelle" /begin DEF_CHARACTERISTIC /end DEF_CHARACTERISTIC /begin REF_CHARACTERISTIC /end REF_CHARACTERISTIC
 /begin IN_MEASUREMENT frz2 frz4 frz5 frz6 frz7 lamsoni lamsoni2 nmot pfuel poel rl tans tmot tmotlin toel ub usvk usvk2 vfzg wdkba /end IN_MEASUREMENT
 /begin OUT_MEASUREMENT /end OUT_MEASUREMENT
 /begin LOC_MEASUREMENT /end LOC_MEASUREMENT
 /begin SUB_FUNCTION /end SUB_FUNCTION
/end FUNCTION
/begin FUNCTION DFFTK "Diagnose; Kundenspezifische Auswahlliste für Freeze Frame-Werte" /begin DEF_CHARACTERISTIC /end DEF_CHARACTERISTIC /begin REF_CHARACTERISTIC /end REF_CHARACTERISTIC /begin IN_MEASUREMENT nmot tmot /end IN_MEASUREMENT /begin OUT_MEASUREMENT /end OUT_MEASUREMENT /begin LOC_MEASUREMENT /end LOC_MEASUREMENT /begin SUB_FUNCTION /end SUB_FUNCTION /end FUNCTION
/begin FUNCTION DFPM "OBDII; Fehlerpfadmanager" /begin DEF_CHARACTERISTIC CLRFSP /end DEF_CHARACTERISTIC /begin REF_CHARACTERISTIC /end REF_CHARACTERISTIC /begin IN_MEASUREMENT bbwuc B_pwf nmot tans tmot tmotlin usvk usvk2 vfzg /end IN_MEASUREMENT
 /begin OUT_MEASUREMENT bbsp3 bbtim B_sp3 B_tim dfcmFcm dfcmNo dfcmSfp dfpmEpclState dfpmMilState dfp_ap fcmEnd FCMTab fs1_cla fs1_dfp fs1_dlc fs1_fes fs1_flc fs1_fps fs1_frz1 fs1_frz10 fs1_frz11 fs1_frz2 fs1_frz3 fs1_frz4 fs1_frz5 fs1_frz6 fs1_frz7 fs1_frz8 fs1_frz9 fs1_hlc fs1_hz fs1_tsf fs1_typ fs2_cla fs2_dfp fs2_dlc fs2_fes fs2_flc fs2_fps fs2_frz1 fs2_frz10 fs2_frz11 fs2_frz2 fs2_frz3 fs2_frz4 fs2_frz5 fs2_frz6 fs2_frz7 fs2_frz8 fs2_frz9 fs2_hlc fs2_hz fs2_tsf fs2_typ /end OUT_MEASUREMENT
 /begin LOC_MEASUREMENT /end LOC_MEASUREMENT
 /begin SUB_FUNCTION /end SUB_FUNCTION
/end FUNCTION
/begin FUNCTION DFPMEEP "Diagnose; Fehlerpfadmanager, EEPROM-Speicherung" /begin DEF_CHARACTERISTIC /end DEF_CHARACTERISTIC /begin REF_CHARACTERISTIC /end REF_CHARACTERISTIC /begin IN_MEASUREMENT B_pwf dfcmNo fcmEnd FCMTab /end IN_MEASUREMENT /begin OUT_MEASUREMENT /end OUT_MEASUREMENT /begin LOC_MEASUREMENT /end LOC_MEASUREMENT /begin SUB_FUNCTION /end SUB_FUNCTION /end FUNCTION
/begin FUNCTION DFPM_DDG "" /begin DEF_CHARACTERISTIC CDTN CLAN TSFN CDKN FFTN CDTBM CLABM TSFBM CDKBM FFTBM /end DEF_CHARACTERISTIC /begin REF_CHARACTERISTIC /end REF_CHARACTERISTIC /begin IN_MEASUREMENT /end IN_MEASUREMENT
 /begin OUT_MEASUREMENT B_cln B_mnbm B_mnn B_mxbm B_mxn B_npbm B_npn B_sibm B_sin E_bm E_n sfpbm sfpn TYP_bm TYP_n Z_bm Z_n /end OUT_MEASUREMENT
 /begin LOC_MEASUREMENT /end LOC_MEASUREMENT
 /begin SUB_FUNCTION /end SUB_FUNCTION
/end FUNCTION
/begin FUNCTION DFPM_DDKG "" /begin DEF_CHARACTERISTIC CDTDK CLADK TSFDK CDKDK FFTDK /end DEF_CHARACTERISTIC /begin REF_CHARACTERISTIC /end REF_CHARACTERISTIC /begin IN_MEASUREMENT /end IN_MEASUREMENT /begin OUT_MEASUREMENT B_cldk B_mndk B_mxdk B_npdk B_sidk E_dk sfpdk TYP_dk Z_dk /end OUT_MEASUREMENT /begin LOC_MEASUREMENT /end LOC_MEASUREMENT /begin SUB_FUNCTION /end SUB_FUNCTION /end FUNCTION
/begin FUNCTION DFPM_DDSS "" /begin DEF_CHARACTERISTIC CDTLM CLALM TSFLM CDKLM FFTLM /end DEF_CHARACTERISTIC /begin REF_CHARACTERISTIC /end REF_CHARACTERISTIC /begin IN_MEASUREMENT /end IN_MEASUREMENT /begin OUT_MEASUREMENT B_cllm B_mnlm B_mxlm B_nplm B_silm E_lm sfplm TYP_lm Z_lm /end OUT_MEASUREMENT /begin LOC_MEASUREMENT /end LOC_MEASUREMENT /begin SUB_FUNCTION /end SUB_FUNCTION /end FUNCTION
/begin COMPU_METHOD B_TRUE "boolsche Zustände, positive Logik" TAB_VERB "%6.3" "" COMPU_TAB_REF B_TRUE /end COMPU_METHOD
/begin COMPU_VTAB B_TRUE "boolsche Zustände, positive Logik" TAB_VERB 2 0 "----" 1 "TRUE" /end COMPU_VTAB
/begin COMPU_METHOD DEZ "1 : 1 Umrechnug (dez/hex)" RAT_FUNC "%6.2" "" COEFFS 0 1 0 0 0 1 /end COMPU_METHOD
/begin COMPU_METHOD dez "1 : 1 Umrechnug (dez/hex)" RAT_FUNC "%6.2" "" COEFFS 0 1 0 0 0 1 /end COMPU_METHOD
/begin COMPU_METHOD fak_b0p051 "" RAT_FUNC "%6.5" "" COEFFS 0 255 0 0 0 0.051 /end COMPU_METHOD
/begin COMPU_METHOD fak_sw_b1 "" RAT_FUNC "%7.6" "-" COEFFS 0 65536 0 0 0 2 /end COMPU_METHOD
/begin COMPU_METHOD fak_ub_b1 "" RAT_FUNC "%6.4" "-" COEFFS 0 256 0 0 0 1 /end COMPU_METHOD
/begin COMPU_METHOD fak_ub_b2 "" RAT_FUNC "%6.4" "-" COEFFS 0 256 0 0 0 2 /end COMPU_METHOD
/begin COMPU_METHOD fak_ub_b4 "" RAT_FUNC "%6.4" "-" COEFFS 0 256 0 0 0 4 /end COMPU_METHOD
/begin COMPU_METHOD fak_ub_q0p0019_o0p75 "" RAT_FUNC "%6.3" "" COEFFS 0 512 -384 0 0 1 /end COMPU_METHOD
/begin COMPU_METHOD fak_uw_b1 "" RAT_FUNC "%7.6" "-" COEFFS 0 65536 0 0 0 1 /end COMPU_METHOD
/begin COMPU_METHOD fak_uw_b16 "" RAT_FUNC "%6.5" "-" COEFFS 0 65536 0 0 0 16 /end COMPU_METHOD
/begin COMPU_METHOD fak_uw_b2 "" RAT_FUNC "%7.6" "-" COEFFS 0 65536 0 0 0 2 /end COMPU_METHOD
/begin COMPU_METHOD fak_uw_b32 "" RAT_FUNC "%6.5" "-" COEFFS 0 65536 0 0 0 32 /end COMPU_METHOD
/begin COMPU_METHOD fak_uw_b4 "" RAT_FUNC "%7.6" "-" COEFFS 0 65536 0 0 0 4 /end COMPU_METHOD
/begin COMPU_METHOD kumsrl_ub_b0p002 "" RAT_FUNC "%8.7" "(kg/h)/(1/min)(%)" COEFFS 0 128000 0 0 0 1 /end COMPU_METHOD
/begin COMPU_METHOD kw_q2p8125 "" RAT_FUNC "%6.2" "°KW" COEFFS 0 1 0 0 0 2.8125 /end COMPU_METHOD
/begin COMPU_METHOD kw_q6 "" RAT_FUNC "%6.2" "°KW" COEFFS 0 1 0 0 0 6 /end COMPU_METHOD
/begin COMPU_METHOD kw_ub_q0p5 "" RAT_FUNC "%6.3" "°KW" COEFFS 0 256 0 0 0 128 /end COMPU_METHOD
/begin COMPU_METHOD msd_poil_ub_0 "" RAT_FUNC "%6.4" "bar" COEFFS 0 255 0 0 0 16 /end COMPU_METHOD
/begin COMPU_METHOD m_ub_b1020 "" RAT_FUNC "%6.2" "kg/h" COEFFS 0 1 0 0 0 4 /end COMPU_METHOD
/begin COMPU_METHOD m_ub_b23p3 "" RAT_FUNC "%6.3" "kg" COEFFS 0 2812.5 0 0 0 256 /end COMPU_METHOD
/begin COMPU_METHOD m_uw_b23p3 "" RAT_FUNC "%6.5" "kg" COEFFS 0 2812.5 0 0 0 1 /end COMPU_METHOD
/begin COMPU_METHOD m_uw_b6553p5 "" RAT_FUNC "%6.3" "kg/h" COEFFS 0 1 0 0 0 0.1 /end COMPU_METHOD
/begin COMPU_METHOD m_uw_q0p0005 "" RAT_FUNC "%6.5" "kg/h" COEFFS 0 1 0 0 0 0.0005 /end COMPU_METHOD
/begin COMPU_METHOD nmotg_sb_q100 "" RAT_FUNC "%6.0" "U/min/s" COEFFS 0 1 0 0 0 100 /end COMPU_METHOD
/begin COMPU_METHOD nmotg_sw_q0p15625 "" RAT_FUNC "%6.3" "U/min/s" COEFFS 0 1 0 0 0 0.15625 /end COMPU_METHOD
/begin COMPU_METHOD nmotg_sw_q0p39 "" RAT_FUNC "%6.3" "U/min/s" COEFFS 0 1 0 0 0 0.39063 /end COMPU_METHOD
/begin COMPU_METHOD nmot_sw_q0p25 "" RAT_FUNC "%6.3" "U/min" COEFFS 0 1 0 0 0 0.25 /end COMPU_METHOD
/begin COMPU_METHOD nmot_ub_q40 "" RAT_FUNC "%6.1" "Upm" COEFFS 0 1 0 0 0 40 /end COMPU_METHOD
/begin COMPU_METHOD nmot_uw_q0p25 "" RAT_FUNC "%6.3" "U/min" COEFFS 0 1 0 0 0 0.25 /end COMPU_METHOD
/begin COMPU_METHOD p_sw_q0p039 "" RAT_FUNC "%6.4" "hPa" COEFFS 0 256 0 0 0 10 /end COMPU_METHOD
/begin COMPU_METHOD p_sw_q0p078 "" RAT_FUNC "%6.4" "hPa" COEFFS 0 65536 0 0 0 5120 /end COMPU_METHOD
/begin COMPU_METHOD p_ub_q10 "" RAT_FUNC "%6.1" "hPa" COEFFS 0 1 0 0 0 10 /end COMPU_METHOD
/begin COMPU_METHOD p_uw_b32 "" RAT_FUNC "%6.5" "hPa/%" COEFFS 0 65536 0 0 0 32 /end COMPU_METHOD
/begin COMPU_METHOD p_uw_q0p039 "" RAT_FUNC "%6.4" "hPa" COEFFS 0 256 0 0 0 10 /end COMPU_METHOD
/begin COMPU_METHOD q_uw_q0p0566 "" RAT_FUNC "%6.4" "kJ" COEFFS 0 65535 0 0 0 3712 /end COMPU_METHOD
/begin COMPU_METHOD relDK_q0p02441 "" RAT_FUNC "%6.4" "% DK" COEFFS 0 65536 0 0 0 1600 /end COMPU_METHOD
/begin COMPU_METHOD relDK_ub_b100 "" RAT_FUNC "%6.3" "% DK" COEFFS 0 255 0 0 0 100 /end COMPU_METHOD
/begin COMPU_METHOD relDK_uw_b100 "" RAT_FUNC "%6.4" "% DK" COEFFS 0 65535 0 0 0 100 /end COMPU_METHOD
/begin COMPU_METHOD rel_sw_b50 "" RAT_FUNC "%6.4" "%" COEFFS 0 65536 0 0 0 100 /end COMPU_METHOD
/begin COMPU_METHOD rel_sw_q0p0234 "" RAT_FUNC "%6.4" "%/seg" COEFFS 0 32 0 0 0 0.75 /end COMPU_METHOD
/begin COMPU_METHOD rel_ub_b99p6 "" RAT_FUNC "%6.3" "%" COEFFS 0 256 0 0 0 100 /end COMPU_METHOD
/begin COMPU_METHOD rel_ub_q0p1875 "" RAT_FUNC "%6.3" "Grad KW/ms" COEFFS 0 256 0 0 0 48 /end COMPU_METHOD
/begin COMPU_METHOD rel_ub_q0p75 "" RAT_FUNC "%6.3" "%" COEFFS 0 1 0 0 0 0.75 /end COMPU_METHOD
/begin COMPU_METHOD rel_uw_b0p3 "" RAT_FUNC "%8.7" "%/hPa" COEFFS 0 65536 0 0 0 0.3 /end COMPU_METHOD
/begin COMPU_METHOD rel_uw_b100 "" RAT_FUNC "%6.4" "%" COEFFS 0 65536 0 0 0 100 /end COMPU_METHOD
/begin COMPU_METHOD rel_uw_q0p0234 "" RAT_FUNC "%6.4" "%" COEFFS 0 32 0 0 0 0.75 /end COMPU_METHOD
/begin COMPU_METHOD rktiw_sy "" RAT_FUNC "%8.7" "ms/%" COEFFS 0 120000 0 0 0 1 /end COMPU_METHOD
/begin COMPU_METHOD spg_ub "" RAT_FUNC "%6.4" "V" COEFFS 0 1 0 0 0 0.0681 /end COMPU_METHOD
/begin COMPU_METHOD spg_ubatt "" RAT_FUNC "%6.4" "V" COEFFS 0 1 0 0 0 0.0681 /end COMPU_METHOD
/begin COMPU_METHOD spg_ub_b5 "" RAT_FUNC "%6.4" "V" COEFFS 0 255 0 0 0 5 /end COMPU_METHOD
/begin COMPU_METHOD spg_ub_q0p019 "" RAT_FUNC "%6.4" "V" COEFFS 0 256 0 0 0 5 /end COMPU_METHOD
/begin COMPU_METHOD spg_uw_b5 "" RAT_FUNC "%6.4" "V" COEFFS 0 1024 0 0 0 5 /end COMPU_METHOD
/begin COMPU_METHOD spg_uw_q0p000076 "" RAT_FUNC "%7.6" "V" COEFFS 0 65536 0 0 0 5 /end COMPU_METHOD
/begin COMPU_METHOD spg_uw_q0p00488 "" RAT_FUNC "%6.4" "V" COEFFS 0 1024 0 0 0 5 /end COMPU_METHOD
/begin COMPU_METHOD t100msxs_ub_b25p5 "" RAT_FUNC "%6.3" "s" COEFFS 0 1 0 0 0 0.1 /end COMPU_METHOD
/begin COMPU_METHOD t100msxs_uw_b6553p5 "" RAT_FUNC "%6.3" "s" COEFFS 0 1 0 0 0 0.1 /end COMPU_METHOD
/begin COMPU_METHOD t10msxs_ub_b2p55 "" RAT_FUNC "%6.4" "s" COEFFS 0 1 0 0 0 0.01 /end COMPU_METHOD
/begin COMPU_METHOD t10msxs_uw_b655p35 "" RAT_FUNC "%6.4" "s" COEFFS 0 1 0 0 0 0.01 /end COMPU_METHOD
/begin COMPU_METHOD t1sxs_ub_b255 "" RAT_FUNC "%6.2" "s" COEFFS 0 1 0 0 0 1 /end COMPU_METHOD
/begin COMPU_METHOD t1sxs_uw_b65535 "" RAT_FUNC "%6.2" "s" COEFFS 0 1 0 0 0 1 /end COMPU_METHOD
/begin COMPU_METHOD t200msxs_ub_b51 "" RAT_FUNC "%6.3" "s" COEFFS 0 1 0 0 0 0.2 /end COMPU_METHOD
/begin COMPU_METHOD temp_q5 "" RAT_FUNC "%6.2" "Grad C" COEFFS 0 1 0 0 0 5 /end COMPU_METHOD
/begin COMPU_METHOD temp_ub_q0p75_o48 "" RAT_FUNC "%6.2" "Grad C" COEFFS 0 1 48 0 0 0.75 /end COMPU_METHOD
/begin COMPU_METHOD temp_ub_q1_o40 "" RAT_FUNC "%6.2" "Grad C" COEFFS 0 1 40 0 0 1 /end COMPU_METHOD
/begin COMPU_METHOD temp_ub_q5_o50 "" RAT_FUNC "%6.2" "Grad C" COEFFS 0 1 50 0 0 5 /end COMPU_METHOD
/begin COMPU_METHOD temp_uw_q0p0195_o50 "" RAT_FUNC "%6.2" "Grad C" COEFFS 0 256 12800 0 0 5 /end COMPU_METHOD
/begin COMPU_METHOD tinjection_sy "" RAT_FUNC "%6.4" "ms" COEFFS 0 312.5 0 0 0 1 /end COMPU_METHOD
/begin COMPU_METHOD tsquant "Umrechnung Segmentzeit in DMD" RAT_FUNC "%6.2" "us" COEFFS 0 1.25 0 0 0 1 /end COMPU_METHOD
/begin COMPU_METHOD tsquantl "" RAT_FUNC "%6.1" "us" COEFFS 0 0.078125 0 0 0 1 /end COMPU_METHOD
/begin COMPU_METHOD vfzg_ub_q1p25 "" RAT_FUNC "%6.2" "km/h" COEFFS 0 1 0 0 0 1.25 /end COMPU_METHOD
/begin COMPU_METHOD vfzg_uw_q0p00781 "" RAT_FUNC "%6.4" "km/h" COEFFS 0 1 0 0 0 0.0078125 /end COMPU_METHOD
/begin COMPU_METHOD zk100msxs_ub_b25p5 "" RAT_FUNC "%6.3" "s" COEFFS 0 0 256 0 10 0 /end COMPU_METHOD
/begin COMPU_METHOD zk100msxs_uw_b6553 "" RAT_FUNC "%6.1" "s" COEFFS 0 0 65536 0 10 0 /end COMPU_METHOD
/begin COMPU_METHOD zk10msxs_uw_b655 "" RAT_FUNC "%6.2" "s" COEFFS 0 0 65536 0 100 0 /end COMPU_METHOD
/begin COMPU_METHOD zk200msxs_uw_b13107 "" RAT_FUNC "%10.2" "s" COEFFS 0 0 13107.2 0 1 0 /end COMPU_METHOD
/begin COMPU_METHOD zk50msxs_ub_b12p8 "" RAT_FUNC "%6.3" "s" COEFFS 0 0 128 0 10 0 /end COMPU_METHOD
/begin COMPU_METHOD zw_ub_q6 "" RAT_FUNC "%6.2" "Grad KW" COEFFS 0 255 0 0 0 1530 /end COMPU_METHOD
/begin COMPU_METHOD default "" RAT_FUNC "%6.2" "" COEFFS 0 1 0 0 0 1 /end COMPU_METHOD
/begin RECORD_LAYOUT FkfNoShNoOffWUb FNC_VALUES 1 UBYTE COLUMN_DIR DIRECT /end RECORD_LAYOUT
/begin RECORD_LAYOUT FklWUw FNC_VALUES 1 UWORD COLUMN_DIR DIRECT /end RECORD_LAYOUT
/begin RECORD_LAYOUT GkfWUb FNC_VALUES 1 UBYTE COLUMN_DIR DIRECT /end RECORD_LAYOUT
/begin RECORD_LAYOUT GklWUb FNC_VALUES 1 UBYTE COLUMN_DIR DIRECT /end RECORD_LAYOUT
/begin RECORD_LAYOUT GklWUw FNC_VALUES 1 UWORD COLUMN_DIR DIRECT /end RECORD_LAYOUT
/begin RECORD_LAYOUT KfAxUbAyUbSstxUbSstyUbWSb NO_AXIS_PTS_X 1 UBYTE NO_AXIS_PTS_Y 2 UBYTE AXIS_PTS_X 3 UBYTE INDEX_INCR DIRECT AXIS_PTS_Y 4 UBYTE INDEX_INCR DIRECT FNC_VALUES 5 SBYTE COLUMN_DIR DIRECT /end RECORD_LAYOUT
/begin RECORD_LAYOUT KfAxUbAyUbSstxUbSstyUbWUb NO_AXIS_PTS_X 1 UBYTE NO_AXIS_PTS_Y 2 UBYTE AXIS_PTS_X 3 UBYTE INDEX_INCR DIRECT AXIS_PTS_Y 4 UBYTE INDEX_INCR DIRECT FNC_VALUES 5 UBYTE COLUMN_DIR DIRECT /end RECORD_LAYOUT
/begin RECORD_LAYOUT KfAxUbAyUbSstxUbSstyUwWUw NO_AXIS_PTS_X 1 UBYTE NO_AXIS_PTS_Y 2 UBYTE AXIS_PTS_X 3 UBYTE INDEX_INCR DIRECT AXIS_PTS_Y 4 UWORD INDEX_INCR DIRECT FNC_VALUES 5 UWORD COLUMN_DIR DIRECT /end RECORD_LAYOUT
/begin RECORD_LAYOUT KfAxUwAyUwSstxSwSstyUwWUw NO_AXIS_PTS_X 1 UWORD NO_AXIS_PTS_Y 2 UWORD AXIS_PTS_X 3 SWORD INDEX_INCR DIRECT AXIS_PTS_Y 4 UWORD INDEX_INCR DIRECT FNC_VALUES 5 UWORD COLUMN_DIR DIRECT /end RECORD_LAYOUT
/begin RECORD_LAYOUT KfAxUwAyUwSstxUwSstyUwWUw NO_AXIS_PTS_X 1 UWORD NO_AXIS_PTS_Y 2 UWORD AXIS_PTS_X 3 UWORD INDEX_INCR DIRECT AXIS_PTS_Y 4 UWORD INDEX_INCR DIRECT FNC_VALUES 5 UWORD COLUMN_DIR DIRECT /end RECORD_LAYOUT
/begin RECORD_LAYOUT KlAUbSstSbWUb NO_AXIS_PTS_X 1 UBYTE AXIS_PTS_X 2 SBYTE INDEX_INCR DIRECT FNC_VALUES 3 UBYTE COLUMN_DIR DIRECT /end RECORD_LAYOUT
/begin RECORD_LAYOUT KlAUbSstUbWSb NO_AXIS_PTS_X 1 UBYTE AXIS_PTS_X 2 UBYTE INDEX_INCR DIRECT FNC_VALUES 3 SBYTE COLUMN_DIR DIRECT /end RECORD_LAYOUT
/begin RECORD_LAYOUT KlAUbSstUbWUb NO_AXIS_PTS_X 1 UBYTE AXIS_PTS_X 2 UBYTE INDEX_INCR DIRECT FNC_VALUES 3 UBYTE COLUMN_DIR DIRECT /end RECORD_LAYOUT
/begin RECORD_LAYOUT KlAUbSstUbWUw NO_AXIS_PTS_X 1 UBYTE AXIS_PTS_X 2 UBYTE INDEX_INCR DIRECT FNC_VALUES 3 UWORD COLUMN_DIR DIRECT /end RECORD_LAYOUT
/begin RECORD_LAYOUT KlAUwSstSwWUw NO_AXIS_PTS_X 1 UWORD AXIS_PTS_X 2 SWORD INDEX_INCR DIRECT FNC_VALUES 3 UWORD COLUMN_DIR DIRECT /end RECORD_LAYOUT
/begin RECORD_LAYOUT KlAUwSstUwWUw NO_AXIS_PTS_X 1 UWORD AXIS_PTS_X 2 UWORD INDEX_INCR DIRECT FNC_VALUES 3 UWORD COLUMN_DIR DIRECT /end RECORD_LAYOUT
/begin RECORD_LAYOUT KwbUb FNC_VALUES 1 UBYTE COLUMN_DIR DIRECT /end RECORD_LAYOUT
/begin RECORD_LAYOUT KwSb FNC_VALUES 1 SBYTE COLUMN_DIR DIRECT /end RECORD_LAYOUT
/begin RECORD_LAYOUT KwSw FNC_VALUES 1 SWORD COLUMN_DIR DIRECT /end RECORD_LAYOUT
/begin RECORD_LAYOUT KwUb FNC_VALUES 1 UBYTE COLUMN_DIR DIRECT /end RECORD_LAYOUT
/begin RECORD_LAYOUT KwUw FNC_VALUES 1 UWORD COLUMN_DIR DIRECT /end RECORD_LAYOUT
/begin RECORD_LAYOUT SstAUbSstUb NO_AXIS_PTS_X 1 UBYTE AXIS_PTS_X 2 UBYTE INDEX_INCR DIRECT /end RECORD_LAYOUT
/begin RECORD_LAYOUT SstAUwSstUw NO_AXIS_PTS_X 1 UWORD AXIS_PTS_X 2 UWORD INDEX_INCR DIRECT /end RECORD_LAYOUT
/end MODULE
/end PROJECT
