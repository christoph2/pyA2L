/******************************************************************************
* ASAP2 file: variants.a2l
******************************************************************************/ ASAP2_VERSION 1 71
/begin PROJECT ProjectName "Project Comment Goes Here"
/begin HEADER "Header Comments go here" /end HEADER
/begin MODULE ModuleName "Module Comment Goes Here"
/begin IF_DATA XCP
 /begin PROTOCOL_LAYER 0x0100 0x03E8 0x00C8 0x0000 0x0000 0x0000 0x0000 0x0000 0xFC 0x0578 BYTE_ORDER_MSB_LAST ADDRESS_GRANULARITY_BYTE OPTIONAL_CMD ALLOC_ODT_ENTRY OPTIONAL_CMD ALLOC_ODT OPTIONAL_CMD ALLOC_DAQ OPTIONAL_CMD FREE_DAQ OPTIONAL_CMD GET_DAQ_RESOLUTION_INFO OPTIONAL_CMD GET_DAQ_PROCESSOR_INFO OPTIONAL_CMD START_STOP_SYNCH OPTIONAL_CMD START_STOP_DAQ_LIST OPTIONAL_CMD SET_DAQ_LIST_MODE OPTIONAL_CMD WRITE_DAQ OPTIONAL_CMD SET_DAQ_PTR OPTIONAL_CMD GET_CAL_PAGE OPTIONAL_CMD SET_CAL_PAGE OPTIONAL_CMD COPY_CAL_PAGE OPTIONAL_CMD SHORT_DOWNLOAD OPTIONAL_CMD DOWNLOAD_MAX OPTIONAL_CMD DOWNLOAD OPTIONAL_CMD SHORT_UPLOAD OPTIONAL_CMD UPLOAD OPTIONAL_CMD SET_MTA /end PROTOCOL_LAYER
 /begin DAQ DYNAMIC 0x0000 0x0080 0x00 OPTIMISATION_TYPE_DEFAULT ADDRESS_EXTENSION_FREE IDENTIFICATION_FIELD_TYPE_RELATIVE_WORD_ALIGNED GRANULARITY_ODT_ENTRY_SIZE_DAQ_BYTE 0xFF OVERLOAD_INDICATION_PID PRESCALER_SUPPORTED /begin STIM GRANULARITY_ODT_ENTRY_SIZE_STIM_BYTE 0xFF /end STIM /begin TIMESTAMP_SUPPORTED 0x0001 SIZE_DWORD UNIT_1US TIMESTAMP_FIXED /end TIMESTAMP_SUPPORTED /begin EVENT "1 ms" "1 ms" 0x0000 DAQ 0xFF 0x01 0x06 0x00 /end EVENT /end DAQ
 /begin XCP_ON_UDP_IP 0x0100 0x15B3 ADDRESS "192.168.7.1" /end XCP_ON_UDP_IP
/end IF_DATA
/begin MOD_PAR "MOD PAR Comment Goes Here"
 /begin MEMORY_SEGMENT tstCom_cal_impl "tstCom_cal_impl" DATA FLASH INTERN 0x0023F020 0x948 -1 -1 -1 -1 -1
  /begin IF_DATA XCP
   /begin SEGMENT 0x00 0x02 0x00 0x00 0x00
    /begin PAGE 0x00 ECU_ACCESS_DONT_CARE XCP_READ_ACCESS_DONT_CARE XCP_WRITE_ACCESS_NOT_ALLOWED /end PAGE
    /begin PAGE 0x01 ECU_ACCESS_DONT_CARE XCP_READ_ACCESS_DONT_CARE XCP_WRITE_ACCESS_DONT_CARE /end PAGE
   /end SEGMENT
  /end IF_DATA
 /end MEMORY_SEGMENT
/end MOD_PAR
/begin MOD_COMMON "Mod Common Comment Here" BYTE_ORDER MSB_LAST ALIGNMENT_BYTE 1 ALIGNMENT_WORD 2 ALIGNMENT_LONG 8 ALIGNMENT_FLOAT32_IEEE 4 ALIGNMENT_FLOAT64_IEEE 8 ALIGNMENT_INT64 4 /end MOD_COMMON
/begin CHARACTERISTIC PUMKF /* name */ "Pump characteristic map" /* long identifier */ MAP /* type */ 0x7140 /* address */ DAMOS_KF /* deposit */ 100.0 /* maxdiff */ R_VOLTAGE 0.0 5000.0 MAX_REFRESH 3 15 /* 15 msec */ /begin DEPENDENT_CHARACTERISTIC "sin(X1)" ALPHA /end DEPENDENT_CHARACTERISTIC /begin VIRTUAL_CHARACTERISTIC "sqrt(X1)" B_AREA /end VIRTUAL_CHARACTERISTIC REF_MEMORY_SEGMENT Data1 /begin FUNCTION_LIST NL_ADJUSTMENT FL_ADJUSTMENT SPEED_LIM /end FUNCTION_LIST
 /begin AXIS_DESCR /* description of X-axis points */ STD_AXIS /* standard axis points */ N /* reference to input quantity */ CON_N 13 /* maximum number of axis points*/ 0.0 5800.0 MAX_GRAD 20.0 /* X-axis: maximum gradient */ /end AXIS_DESCR
 /begin AXIS_DESCR /* description of Y-axis points */ STD_AXIS /* standard axis points */ AMOUNT /* reference to input quantity */ CON_ME 17 /* maximum number of axis points*/ 0.0 43.0 /end AXIS_DESCR
/end CHARACTERISTIC
/begin RECORD_LAYOUT DAMOS_KF FNC_VALUES 7 SWORD COLUMN_DIR DIRECT AXIS_PTS_X 3 SWORD INDEX_INCR DIRECT AXIS_PTS_Y 6 UBYTE INDEX_INCR DIRECT NO_AXIS_PTS_X 2 UBYTE NO_AXIS_PTS_Y 5 UBYTE SRC_ADDR_X 1 UBYTE SRC_ADDR_Y 4 UBYTE ALIGNMENT_BYTE 2 /end RECORD_LAYOUT
/begin COMPU_VTAB V_GEAR_BOX /* "variants of criterion ""Type of Gear Box""" */ "variants of criterion Type of Gear Box" TAB_VERB 3 17 "Limousine" 39 "Kombi" 41 "Cabrio" DEFAULT_VALUE "unknown" /end COMPU_VTAB
/begin VARIANT_CODING VAR_SEPARATOR "." /* PUMKF.1 */ VAR_NAMING NUMERIC /* variant criterion "Car body" with three variants */
 /begin VAR_CRITERION Car "Car body" Limousine Kombi Cabrio VAR_MEASUREMENT S_CAR VAR_SELECTION_CHARACTERISTIC V_CAR /end VAR_CRITERION
 /* variant criterion "Type of gear box" with two variants */ /begin VAR_CRITERION Gear "Type of gear box" Manual Automatic /end VAR_CRITERION /begin VAR_FORBIDDEN_COMB /* forbidden: Limousine-Manual*/ Car Limousine Gear Manual /end VAR_FORBIDDEN_COMB /begin VAR_FORBIDDEN_COMB /* forbidden: Cabrio-Automatic*/ Car Cabrio Gear Automatic /end VAR_FORBIDDEN_COMB
 /begin VAR_CHARACTERISTIC PUMKF /*define PUMKF as variant coded*/ Gear /* Gear box variants */ /begin VAR_ADDRESS 0x7140 0x7168 /end VAR_ADDRESS /end VAR_CHARACTERISTIC
 /begin VAR_CHARACTERISTIC NLLM /*define NLLM as variant coded */ Gear Car /* gear box including the 2 variants "Manual" and "Automatic" */ /* car body including the 3 variants "Limousine", "Kombi" and "Cabrio" */ /* four addresses corresponding to the four valid combinations */ /* of criterion 'Gear' and 'Car' (see example for VAR_CRITERION)*/ /begin VAR_ADDRESS 0x8840 0x8858 0x8870 0x8888 /end VAR_ADDRESS /end VAR_CHARACTERISTIC
/end VARIANT_CODING
/end MODULE
/end PROJECT
