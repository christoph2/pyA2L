/begin PROJECT DPU-2XX "Visteon Diesel"
/begin HEADER " " VERSION "1" PROJECT_NO Global /end HEADER
/begin MODULE ENGINE "International Engine Controller"
/begin MOD_COMMON " " BYTE_ORDER MSB_FIRST /end MOD_COMMON
/begin CHARACTERISTIC FN039DS "Engine speed normalization function" CURVE 0x4355C FD_FLOAT32_IEEE 0 FCY_FN039DS 0 9 /begin AXIS_DESCR STD_AXIS N FCX_FN039DS 10 0 5000 /end AXIS_DESCR /end CHARACTERISTIC
/begin COMPU_METHOD FCX_FN039DS "FN039DS X-axis conversion" RAT_FUNC "%10.5" "RPM" COEFFS 0 1 0 0 0 1 /end COMPU_METHOD
/begin COMPU_METHOD FCY_FN039DS "FN039DS Y-axis conversion" RAT_FUNC "%10.5" "unitless" COEFFS 0 1 0 0 0 1 /end COMPU_METHOD
/begin CHARACTERISTIC FN040DS "Normalize N for table FN1401" CURVE 0x495B4 FD_FLOAT32_IEEE 0 FCY_FN040DS 0 10 /begin AXIS_DESCR STD_AXIS N FCX_FN040DS 8 0 4000 /end AXIS_DESCR /end CHARACTERISTIC
/begin COMPU_METHOD FCX_FN040DS "FN040DS X-axis conversion" RAT_FUNC "%10.5" "RPM" COEFFS 0 1 0 0 0 1 /end COMPU_METHOD
/begin COMPU_METHOD FCY_FN040DS "FN040DS Y-axis conversion" RAT_FUNC "%10.5" "unitless" COEFFS 0 1 0 0 0 1 /end COMPU_METHOD
/begin CHARACTERISTIC FN041DS "Mass fuel desired Normalization" CURVE 0x495F4 FD_FLOAT32_IEEE 0 FCY_FN041DS 0 10 /begin AXIS_DESCR STD_AXIS MFDES FCX_FN041DS 11 0 100 /end AXIS_DESCR /end CHARACTERISTIC
/begin COMPU_METHOD FCX_FN041DS "FN041DS X-axis conversion" RAT_FUNC "%10.5" "unitless" COEFFS 0 1 0 0 0 1 /end COMPU_METHOD
/begin COMPU_METHOD FCY_FN041DS "FN041DS Y-axis conversion" RAT_FUNC "%10.5" "unitless" COEFFS 0 1 0 0 0 1 /end COMPU_METHOD
/begin CHARACTERISTIC FN046DS "IPR_FLOW normalization for ICP feed forward term" CURVE 0x4964C FD_FLOAT32_IEEE 0 FCY_FN046DS 0 10 /begin AXIS_DESCR STD_AXIS IPR_FLOW FCX_FN046DS 11 0 25 /end AXIS_DESCR /end CHARACTERISTIC
/begin COMPU_METHOD FCX_FN046DS "FN046DS X-axis conversion" RAT_FUNC "%10.5" "L/min" COEFFS 0 1 0 0 0 1 /end COMPU_METHOD
/begin COMPU_METHOD FCY_FN046DS "FN046DS Y-axis conversion" RAT_FUNC "%10.5" "unitless" COEFFS 0 1 0 0 0 1 /end COMPU_METHOD
/begin CHARACTERISTIC FN047DS "ICP_DES normalization for ICP feed forward term" CURVE 0x496A4 FD_FLOAT32_IEEE 0 FCY_FN047DS 0 10 /begin AXIS_DESCR STD_AXIS ICP_DES FCX_FN047DS 11 0 30 /end AXIS_DESCR /end CHARACTERISTIC
/begin COMPU_METHOD FCX_FN047DS "FN047DS X-axis conversion" RAT_FUNC "%10.5" "MPa" COEFFS 0 1 0 0 0 1 /end COMPU_METHOD
/begin COMPU_METHOD FCY_FN047DS "FN047DS Y-axis conversion" RAT_FUNC "%10.5" "unitless" COEFFS 0 1 0 0 0 1 /end COMPU_METHOD
/begin CHARACTERISTIC FN052DS "MFDES normalization function" CURVE 0x435AC FD_FLOAT32_IEEE 0 FCY_FN052DS 0 9 /begin AXIS_DESCR STD_AXIS MFDES FCX_FN052DS 10 0 255.996 /end AXIS_DESCR /end CHARACTERISTIC
/begin COMPU_METHOD FCX_FN052DS "FN052DS X-axis conversion" RAT_FUNC "%10.5" "unitless" COEFFS 0 1 0 0 0 1 /end COMPU_METHOD
/begin COMPU_METHOD FCY_FN052DS "FN052DS Y-axis conversion" RAT_FUNC "%10.5" "unitless" COEFFS 0 1 0 0 0 1 /end COMPU_METHOD
/begin CHARACTERISTIC FN053DS "Engine speed normalization function" CURVE 0x435FC FD_FLOAT32_IEEE 0 FCY_FN053DS 0 9 /begin AXIS_DESCR STD_AXIS N FCX_FN053DS 10 0 5000 /end AXIS_DESCR /end CHARACTERISTIC
/begin COMPU_METHOD FCX_FN053DS "FN053DS X-axis conversion" RAT_FUNC "%10.5" "RPM" COEFFS 0 1 0 0 0 1 /end COMPU_METHOD
/begin COMPU_METHOD FCY_FN053DS "FN053DS Y-axis conversion" RAT_FUNC "%10.5" "unitless" COEFFS 0 1 0 0 0 1 /end COMPU_METHOD
/begin CHARACTERISTIC FN055DS "Normalized Engine Oil Temperature (degrees C)" CURVE 0x4627C FD_FLOAT32_IEEE 0 FCY_FN055DS 0 8 /begin AXIS_DESCR STD_AXIS EOT_C FCX_FN055DS 9 -40 150 /end AXIS_DESCR /end CHARACTERISTIC
/begin COMPU_METHOD FCX_FN055DS "FN055DS X-axis conversion" RAT_FUNC "%10.5" "unitless" COEFFS 0 1 0 0 0 1 /end COMPU_METHOD
/begin COMPU_METHOD FCY_FN055DS "FN055DS Y-axis conversion" RAT_FUNC "%10.5" "unitless" COEFFS 0 1 0 0 0 1 /end COMPU_METHOD
/begin CHARACTERISTIC FN056DS "Normalized engine speed (RPM)" CURVE 0x462C4 FD_FLOAT32_IEEE 0 FCY_FN056DS 0 8 /begin AXIS_DESCR STD_AXIS N FCX_FN056DS 9 0 5000 /end AXIS_DESCR /end CHARACTERISTIC
/begin COMPU_METHOD FCX_FN056DS "FN056DS X-axis conversion" RAT_FUNC "%10.5" "unitless" COEFFS 0 1 0 0 0 1 /end COMPU_METHOD
/begin COMPU_METHOD FCY_FN056DS "FN056DS Y-axis conversion" RAT_FUNC "%10.5" "unitless" COEFFS 0 1 0 0 0 1 /end COMPU_METHOD
/begin CHARACTERISTIC FN057DS "Normalized Mass Fuel Desired (mg/stroke)" CURVE 0x461DC FD_FLOAT32_IEEE 0 FCY_FN057DS 0 9 /begin AXIS_DESCR STD_AXIS MFDES FCX_FN057DS 10 0 255.996 /end AXIS_DESCR /end CHARACTERISTIC
/begin COMPU_METHOD FCX_FN057DS "FN057DS X-axis conversion" RAT_FUNC "%10.5" "unitless" COEFFS 0 1 0 0 0 1 /end COMPU_METHOD
/begin COMPU_METHOD FCY_FN057DS "FN057DS Y-axis conversion" RAT_FUNC "%10.5" "unitless" COEFFS 0 1 0 0 0 1 /end COMPU_METHOD
/begin CHARACTERISTIC FN058DS "Normalized engine speed (RPM)" CURVE 0x4622C FD_FLOAT32_IEEE 0 FCY_FN058DS 0 9 /begin AXIS_DESCR STD_AXIS N FCX_FN058DS 10 0 5000 /end AXIS_DESCR /end CHARACTERISTIC
/begin COMPU_METHOD FCX_FN058DS "FN058DS X-axis conversion" RAT_FUNC "%10.5" "unitless" COEFFS 0 1 0 0 0 1 /end COMPU_METHOD
/begin COMPU_METHOD FCY_FN058DS "FN058DS Y-axis conversion" RAT_FUNC "%10.5" "unitless" COEFFS 0 1 0 0 0 1 /end COMPU_METHOD
/begin CHARACTERISTIC FN059DS "Normalized Mass Fuel Desired (mg/stroke)" CURVE 0x4613C FD_FLOAT32_IEEE 0 FCY_FN059DS 0 9 /begin AXIS_DESCR STD_AXIS MFDES FCX_FN059DS 10 0 255.996 /end AXIS_DESCR /end CHARACTERISTIC
/begin COMPU_METHOD FCX_FN059DS "FN059DS X-axis conversion" RAT_FUNC "%10.5" "unitless" COEFFS 0 1 0 0 0 1 /end COMPU_METHOD
/begin COMPU_METHOD FCY_FN059DS "FN059DS Y-axis conversion" RAT_FUNC "%10.5" "unitless" COEFFS 0 1 0 0 0 1 /end COMPU_METHOD
/begin CHARACTERISTIC FN060DS "Normalized engine speed (RPM)" CURVE 0x4618C FD_FLOAT32_IEEE 0 FCY_FN060DS 0 9 /begin AXIS_DESCR STD_AXIS N FCX_FN060DS 10 0 5000 /end AXIS_DESCR /end CHARACTERISTIC
/begin COMPU_METHOD FCX_FN060DS "FN060DS X-axis conversion" RAT_FUNC "%10.5" "unitless" COEFFS 0 1 0 0 0 1 /end COMPU_METHOD
/begin COMPU_METHOD FCY_FN060DS "FN060DS Y-axis conversion" RAT_FUNC "%10.5" "unitless" COEFFS 0 1 0 0 0 1 /end COMPU_METHOD
/begin CHARACTERISTIC FN064 "MFDES normalization function" CURVE 0x4364C FD_FLOAT32_IEEE 0 FCY_FN064 0 9 /begin AXIS_DESCR STD_AXIS MFDES FCX_FN064 10 0 255.996 /end AXIS_DESCR /end CHARACTERISTIC
/begin COMPU_METHOD FCX_FN064 "FN064 X-axis conversion" RAT_FUNC "%10.5" "unitless" COEFFS 0 1 0 0 0 1 /end COMPU_METHOD
/begin COMPU_METHOD FCY_FN064 "FN064 Y-axis conversion" RAT_FUNC "%10.5" "unitless" COEFFS 0 1 0 0 0 1 /end COMPU_METHOD
/begin CHARACTERISTIC FN065 "Engine speed normalization function" CURVE 0x4369C FD_FLOAT32_IEEE 0 FCY_FN065 0 9 /begin AXIS_DESCR STD_AXIS N FCX_FN065 10 0 5000 /end AXIS_DESCR /end CHARACTERISTIC
/begin COMPU_METHOD FCX_FN065 "FN065 X-axis conversion" RAT_FUNC "%10.5" "RPM" COEFFS 0 1 0 0 0 1 /end COMPU_METHOD
/begin COMPU_METHOD FCY_FN065 "FN065 Y-axis conversion" RAT_FUNC "%10.5" "unitless" COEFFS 0 1 0 0 0 1 /end COMPU_METHOD
/begin CHARACTERISTIC FN066 "ICP normalization" CURVE 0x436EC FD_FLOAT32_IEEE 0 FCY_FN066 0 50 /begin AXIS_DESCR STD_AXIS ICP_MPA FCX_FN066 13 0 35 /end AXIS_DESCR /end CHARACTERISTIC
/begin COMPU_METHOD FCX_FN066 "FN066 X-axis conversion" RAT_FUNC "%10.5" "MPa" COEFFS 0 1 0 0 0 1 /end COMPU_METHOD
/begin COMPU_METHOD FCY_FN066 "FN066 Y-axis conversion" RAT_FUNC "%10.5" "(mm)3" COEFFS 0 1 0 0 0 1 /end COMPU_METHOD
/begin CHARACTERISTIC FN070C "RPM normalizing function for torque purposes, for TQ_NET calculation." CURVE 0x541CC FD_FLOAT32_IEEE 0 FCY_FN070C 0 5 /begin AXIS_DESCR STD_AXIS N FCX_FN070C 7 0 16383.8 /end AXIS_DESCR /end CHARACTERISTIC
/begin COMPU_METHOD FCX_FN070C "FN070C X-axis conversion" RAT_FUNC "%10.5" "RPM" COEFFS 0 1 0 0 0 1 /end COMPU_METHOD
/begin COMPU_METHOD FCY_FN070C "FN070C Y-axis conversion" RAT_FUNC "%10.5" "NORMD" COEFFS 0 1 0 0 0 1 /end COMPU_METHOD
/begin CHARACTERISTIC FN090DS_EGR "" CURVE 0x4E01C FD_FLOAT32_IEEE 0 FCY_FN090DS_EGR 0 5000 /begin AXIS_DESCR STD_AXIS N FCX_FN090DS_EGR 14 0 5001 /end AXIS_DESCR /end CHARACTERISTIC
/begin COMPU_METHOD FCX_FN090DS_EGR "FN090DS_EGR X-axis conversion" RAT_FUNC "%10.5" "unitless" COEFFS 0 1 0 0 0 1 /end COMPU_METHOD
/begin COMPU_METHOD FCY_FN090DS_EGR "FN090DS_EGR Y-axis conversion" RAT_FUNC "%10.5" "unitless" COEFFS 0 1 0 0 0 1 /end COMPU_METHOD
/begin CHARACTERISTIC FN090DS_ITH "" CURVE 0x5033C FD_FLOAT32_IEEE 0 FCY_FN090DS_ITH 0 15 /begin AXIS_DESCR STD_AXIS N FCX_FN090DS_ITH 14 0 5000 /end AXIS_DESCR /end CHARACTERISTIC
/begin COMPU_METHOD FCX_FN090DS_ITH "FN090DS_ITH X-axis conversion" RAT_FUNC "%10.5" "unitless" COEFFS 0 1 0 0 0 1 /end COMPU_METHOD
/begin COMPU_METHOD FCY_FN090DS_ITH "FN090DS_ITH Y-axis conversion" RAT_FUNC "%10.5" "unitless" COEFFS 0 1 0 0 0 1 /end COMPU_METHOD
/begin CHARACTERISTIC FN090DS_TQ "" CURVE 0x4A82C FD_FLOAT32_IEEE 0 FCY_FN090DS_TQ 0 14 /begin AXIS_DESCR STD_AXIS N FCX_FN090DS_TQ 14 0 8000 /end AXIS_DESCR /end CHARACTERISTIC
/begin COMPU_METHOD FCX_FN090DS_TQ "FN090DS_TQ X-axis conversion" RAT_FUNC "%10.5" "unitless" COEFFS 0 1 0 0 0 1 /end COMPU_METHOD
/begin COMPU_METHOD FCY_FN090DS_TQ "FN090DS_TQ Y-axis conversion" RAT_FUNC "%10.5" "unitless" COEFFS 0 1 0 0 0 1 /end COMPU_METHOD
/begin CHARACTERISTIC FN090P_AFR "" CURVE 0x43E5C FD_FLOAT32_IEEE 0 FCY_FN090P_AFR 0 12 /begin AXIS_DESCR STD_AXIS N FCX_FN090P_AFR 12 0 5000 /end AXIS_DESCR /end CHARACTERISTIC
/begin COMPU_METHOD FCX_FN090P_AFR "FN090P_AFR X-axis conversion" RAT_FUNC "%10.5" "unitless" COEFFS 0 1 0 0 0 1 /end COMPU_METHOD
/begin COMPU_METHOD FCY_FN090P_AFR "FN090P_AFR Y-axis conversion" RAT_FUNC "%10.5" "unitless" COEFFS 0 1 0 0 0 1 /end COMPU_METHOD
/begin CHARACTERISTIC FN090_AFR "Engine speed normalization for VGT control" CURVE 0x43DFC FD_FLOAT32_IEEE 0 FCY_FN090_AFR 0 10 /begin AXIS_DESCR STD_AXIS N FCX_FN090_AFR 12 0 5000 /end AXIS_DESCR /end CHARACTERISTIC
/begin COMPU_METHOD FCX_FN090_AFR "FN090_AFR X-axis conversion" RAT_FUNC "%10.5" "RPM" COEFFS 0 1 0 0 0 1 /end COMPU_METHOD
/begin COMPU_METHOD FCY_FN090_AFR "FN090_AFR Y-axis conversion" RAT_FUNC "%10.5" "unitless" COEFFS 0 1 0 0 0 1 /end COMPU_METHOD
/begin CHARACTERISTIC FN090_VGT "" CURVE 0x50FAC FD_FLOAT32_IEEE 0 FCY_FN090_VGT 0 15 /begin AXIS_DESCR STD_AXIS N FCX_FN090_VGT 14 0 6000 /end AXIS_DESCR /end CHARACTERISTIC
/begin COMPU_METHOD FCX_FN090_VGT "FN090_VGT X-axis conversion" RAT_FUNC "%10.5" "unitless" COEFFS 0 1 0 0 0 1 /end COMPU_METHOD
/begin COMPU_METHOD FCY_FN090_VGT "FN090_VGT Y-axis conversion" RAT_FUNC "%10.5" "unitless" COEFFS 0 1 0 0 0 1 /end COMPU_METHOD
/begin CHARACTERISTIC FN091DS_EGR "" CURVE 0x4E08C FD_FLOAT32_IEEE 0 FCY_FN091DS_EGR 0 100 /begin AXIS_DESCR STD_AXIS MFDES FCX_FN091DS_EGR 14 0 500 /end AXIS_DESCR /end CHARACTERISTIC
/begin COMPU_METHOD FCX_FN091DS_EGR "FN091DS_EGR X-axis conversion" RAT_FUNC "%10.5" "unitless" COEFFS 0 1 0 0 0 1 /end COMPU_METHOD
/begin COMPU_METHOD FCY_FN091DS_EGR "FN091DS_EGR Y-axis conversion" RAT_FUNC "%10.5" "unitless" COEFFS 0 1 0 0 0 1 /end COMPU_METHOD
/begin CHARACTERISTIC FN091DS_ITH "" CURVE 0x503AC FD_FLOAT32_IEEE 0 FCY_FN091DS_ITH 0 15 /begin AXIS_DESCR STD_AXIS MFDES FCX_FN091DS_ITH 14 0 100 /end AXIS_DESCR /end CHARACTERISTIC
/begin COMPU_METHOD FCX_FN091DS_ITH "FN091DS_ITH X-axis conversion" RAT_FUNC "%10.5" "unitless" COEFFS 0 1 0 0 0 1 /end COMPU_METHOD
/begin COMPU_METHOD FCY_FN091DS_ITH "FN091DS_ITH Y-axis conversion" RAT_FUNC "%10.5" "unitless" COEFFS 0 1 0 0 0 1 /end COMPU_METHOD
/begin CHARACTERISTIC FN091DS_TQ "" CURVE 0x4A7BC FD_FLOAT32_IEEE 0 FCY_FN091DS_TQ 0 14 /begin AXIS_DESCR STD_AXIS MFDES FCX_FN091DS_TQ 14 -2048 2048 /end AXIS_DESCR /end CHARACTERISTIC
/begin COMPU_METHOD FCX_FN091DS_TQ "FN091DS_TQ X-axis conversion" RAT_FUNC "%10.5" "unitless" COEFFS 0 1 0 0 0 1 /end COMPU_METHOD
/begin COMPU_METHOD FCY_FN091DS_TQ "FN091DS_TQ Y-axis conversion" RAT_FUNC "%10.5" "unitless" COEFFS 0 1 0 0 0 1 /end COMPU_METHOD
/begin CHARACTERISTIC FN091P_AFR "" CURVE 0x43F14 FD_FLOAT32_IEEE 0 FCY_FN091P_AFR 0 10 /begin AXIS_DESCR STD_AXIS MAF_GMS FCX_FN091P_AFR 11 0 1000 /end AXIS_DESCR /end CHARACTERISTIC
/begin COMPU_METHOD FCX_FN091P_AFR "FN091P_AFR X-axis conversion" RAT_FUNC "%10.5" "g/s" COEFFS 0 1 0 0 0 1 /end COMPU_METHOD
/begin COMPU_METHOD FCY_FN091P_AFR "FN091P_AFR Y-axis conversion" RAT_FUNC "%10.5" "unitless" COEFFS 0 1 0 0 0 1 /end COMPU_METHOD
/begin CHARACTERISTIC FN091_AFR "Mass air flow normalization for air/fuel ratio" CURVE 0x43EBC FD_FLOAT32_IEEE 0 FCY_FN091_AFR 0 10 /begin AXIS_DESCR STD_AXIS MAF_GMS FCX_FN091_AFR 11 0 1000 /end AXIS_DESCR /end CHARACTERISTIC
/begin COMPU_METHOD FCX_FN091_AFR "FN091_AFR X-axis conversion" RAT_FUNC "%10.5" "g/s" COEFFS 0 1 0 0 0 1 /end COMPU_METHOD
/begin COMPU_METHOD FCY_FN091_AFR "FN091_AFR Y-axis conversion" RAT_FUNC "%10.5" "unitless" COEFFS 0 1 0 0 0 1 /end COMPU_METHOD
/begin CHARACTERISTIC FN091_VGT "" CURVE 0x5101C FD_FLOAT32_IEEE 0 FCY_FN091_VGT 0 15 /begin AXIS_DESCR STD_AXIS MFDES FCX_FN091_VGT 14 0 100 /end AXIS_DESCR /end CHARACTERISTIC
/begin COMPU_METHOD FCX_FN091_VGT "FN091_VGT X-axis conversion" RAT_FUNC "%10.5" "unitless" COEFFS 0 1 0 0 0 1 /end COMPU_METHOD
/begin COMPU_METHOD FCY_FN091_VGT "FN091_VGT Y-axis conversion" RAT_FUNC "%10.5" "unitless" COEFFS 0 1 0 0 0 1 /end COMPU_METHOD
/begin CHARACTERISTIC FN100DS_HI "Crank fuel function" CURVE 0x42D8C FD_FLOAT32_IEEE 0 FCY_FN100DS_HI 0 160 /begin AXIS_DESCR STD_AXIS EOT_C FCX_FN100DS_HI 8 -40 150 /end AXIS_DESCR /end CHARACTERISTIC
/begin COMPU_METHOD FCX_FN100DS_HI "FN100DS_HI X-axis conversion" RAT_FUNC "%10.5" "degC" COEFFS 0 1 0 0 0 1 /end COMPU_METHOD
/begin COMPU_METHOD FCY_FN100DS_HI "FN100DS_HI Y-axis conversion" RAT_FUNC "%10.5" "unitless" COEFFS 0 1 0 0 0 1 /end COMPU_METHOD
/begin CHARACTERISTIC FN100DS_LO "Crank fuel function" CURVE 0x42E0C FD_FLOAT32_IEEE 0 FCY_FN100DS_LO 0 160 /begin AXIS_DESCR STD_AXIS EOT_C FCX_FN100DS_LO 8 -40 150 /end AXIS_DESCR /end CHARACTERISTIC
/begin COMPU_METHOD FCX_FN100DS_LO "FN100DS_LO X-axis conversion" RAT_FUNC "%10.5" "degC" COEFFS 0 1 0 0 0 1 /end COMPU_METHOD
/begin COMPU_METHOD FCY_FN100DS_LO "FN100DS_LO Y-axis conversion" RAT_FUNC "%10.5" "unitless" COEFFS 0 1 0 0 0 1 /end COMPU_METHOD
/begin CHARACTERISTIC FN101DS_HI "Crank fuel adder function" CURVE 0x42CCC FD_FLOAT32_IEEE 0 FCY_FN101DS_HI 0 160 /begin AXIS_DESCR STD_AXIS CRANK_TMR FCX_FN101DS_HI 8 0 255 /end AXIS_DESCR /end CHARACTERISTIC
/begin COMPU_METHOD FCX_FN101DS_HI "FN101DS_HI X-axis conversion" RAT_FUNC "%10.5" "s" COEFFS 0 1 0 0 0 1 /end COMPU_METHOD
/begin COMPU_METHOD FCY_FN101DS_HI "FN101DS_HI Y-axis conversion" RAT_FUNC "%10.5" "unitless" COEFFS 0 1 0 0 0 1 /end COMPU_METHOD
/begin CHARACTERISTIC FN101DS_LO "Crank fuel adder function" CURVE 0x42D4C FD_FLOAT32_IEEE 0 FCY_FN101DS_LO 0 160 /begin AXIS_DESCR STD_AXIS CRANK_TMR FCX_FN101DS_LO 8 0 255 /end AXIS_DESCR /end CHARACTERISTIC
/begin COMPU_METHOD FCX_FN101DS_LO "FN101DS_LO X-axis conversion" RAT_FUNC "%10.5" "s" COEFFS 0 1 0 0 0 1 /end COMPU_METHOD
/begin COMPU_METHOD FCY_FN101DS_LO "FN101DS_LO Y-axis conversion" RAT_FUNC "%10.5" "unitless" COEFFS 0 1 0 0 0 1 /end COMPU_METHOD
/begin CHARACTERISTIC FN101DS_MED "Crank fuel adder function" CURVE 0x42D0C FD_FLOAT32_IEEE 0 FCY_FN101DS_MED 0 160 /begin AXIS_DESCR STD_AXIS CRANK_TMR FCX_FN101DS_MED 8 0 255 /end AXIS_DESCR /end CHARACTERISTIC
/begin COMPU_METHOD FCX_FN101DS_MED "FN101DS_MED X-axis conversion" RAT_FUNC "%10.5" "s" COEFFS 0 1 0 0 0 1 /end COMPU_METHOD
/begin COMPU_METHOD FCY_FN101DS_MED "FN101DS_MED Y-axis conversion" RAT_FUNC "%10.5" "unitless" COEFFS 0 1 0 0 0 1 /end COMPU_METHOD
/begin CHARACTERISTIC FN1020H "X Norm=FN014DS, Y Norm=unknown" MAP 0x440EC TD_FLOAT32_IEEE 0 TCZ_FN1020H 0 200
 /begin AXIS_DESCR FIX_AXIS NO_INPUT_QUANTITY TCX_FN1020H 14 0 13 FIX_AXIS_PAR 0 0 14 /end AXIS_DESCR
 /begin AXIS_DESCR FIX_AXIS NO_INPUT_QUANTITY TCY_FN1020H 7 0 6 FIX_AXIS_PAR 0 0 7 /end AXIS_DESCR
/end CHARACTERISTIC
/begin COMPU_METHOD TCZ_FN1020H "FN1020H Z-axis conversion" RAT_FUNC "%10.5" "unitless" COEFFS 0 1 0 0 0 1 /end COMPU_METHOD
/begin COMPU_METHOD TCX_FN1020H "FN1020H X-axis conversion" RAT_FUNC "%10.5" "RPM" COEFFS 0 1 0 0 0 1 /end COMPU_METHOD
/begin COMPU_METHOD TCY_FN1020H "FN1020H Y-axis conversion" RAT_FUNC "%10.5" "Unitless" COEFFS 0 1 0 0 0 1 /end COMPU_METHOD
/begin CHARACTERISTIC FN1020L "X Norm=FN014DS, Y Norm=unknown" MAP 0x443FC TD_FLOAT32_IEEE 0 TCZ_FN1020L 0 200
 /begin AXIS_DESCR FIX_AXIS NO_INPUT_QUANTITY TCX_FN1020L 14 0 13 FIX_AXIS_PAR 0 0 14 /end AXIS_DESCR
 /begin AXIS_DESCR FIX_AXIS NO_INPUT_QUANTITY TCY_FN1020L 7 0 6 FIX_AXIS_PAR 0 0 7 /end AXIS_DESCR
/end CHARACTERISTIC
/begin COMPU_METHOD TCZ_FN1020L "FN1020L Z-axis conversion" RAT_FUNC "%10.5" "unitless" COEFFS 0 1 0 0 0 1 /end COMPU_METHOD
/begin COMPU_METHOD TCX_FN1020L "FN1020L X-axis conversion" RAT_FUNC "%10.5" "RPM" COEFFS 0 1 0 0 0 1 /end COMPU_METHOD
/begin COMPU_METHOD TCY_FN1020L "FN1020L Y-axis conversion" RAT_FUNC "%10.5" "Unitless" COEFFS 0 1 0 0 0 1 /end COMPU_METHOD
/begin CHARACTERISTIC FN1020M "X Norm=FN014DS, Y Norm=unknown" MAP 0x44274 TD_FLOAT32_IEEE 0 TCZ_FN1020M 0 200
 /begin AXIS_DESCR FIX_AXIS NO_INPUT_QUANTITY TCX_FN1020M 14 0 13 FIX_AXIS_PAR 0 0 14 /end AXIS_DESCR
 /begin AXIS_DESCR FIX_AXIS NO_INPUT_QUANTITY TCY_FN1020M 7 0 6 FIX_AXIS_PAR 0 0 7 /end AXIS_DESCR
/end CHARACTERISTIC
/begin COMPU_METHOD TCZ_FN1020M "FN1020M Z-axis conversion" RAT_FUNC "%10.5" "unitless" COEFFS 0 1 0 0 0 1 /end COMPU_METHOD
/begin COMPU_METHOD TCX_FN1020M "FN1020M X-axis conversion" RAT_FUNC "%10.5" "RPM" COEFFS 0 1 0 0 0 1 /end COMPU_METHOD
/begin COMPU_METHOD TCY_FN1020M "FN1020M Y-axis conversion" RAT_FUNC "%10.5" "Unitless" COEFFS 0 1 0 0 0 1 /end COMPU_METHOD
/begin CHARACTERISTIC FN1020PH "X Norm=FN014P, Y Norm=unknown" MAP 0x44584 TD_FLOAT32_IEEE 0 TCZ_FN1020PH 0 200
 /begin AXIS_DESCR FIX_AXIS NO_INPUT_QUANTITY TCX_FN1020PH 14 0 13 FIX_AXIS_PAR 0 0 14 /end AXIS_DESCR
 /begin AXIS_DESCR FIX_AXIS NO_INPUT_QUANTITY TCY_FN1020PH 7 0 6 FIX_AXIS_PAR 0 0 7 /end AXIS_DESCR
/end CHARACTERISTIC
/begin COMPU_METHOD TCZ_FN1020PH "FN1020PH Z-axis conversion" RAT_FUNC "%10.5" "unitless" COEFFS 0 1 0 0 0 1 /end COMPU_METHOD
/begin COMPU_METHOD TCX_FN1020PH "FN1020PH X-axis conversion" RAT_FUNC "%10.5" "RPM" COEFFS 0 1 0 0 0 1 /end COMPU_METHOD
/begin COMPU_METHOD TCY_FN1020PH "FN1020PH Y-axis conversion" RAT_FUNC "%10.5" "Unitless" COEFFS 0 1 0 0 0 1 /end COMPU_METHOD
/begin CHARACTERISTIC FN1020PL "X Norm=FN014P, Y Norm=unknown" MAP 0x44894 TD_FLOAT32_IEEE 0 TCZ_FN1020PL 0 200
 /begin AXIS_DESCR FIX_AXIS NO_INPUT_QUANTITY TCX_FN1020PL 14 0 13 FIX_AXIS_PAR 0 0 14 /end AXIS_DESCR
 /begin AXIS_DESCR FIX_AXIS NO_INPUT_QUANTITY TCY_FN1020PL 7 0 6 FIX_AXIS_PAR 0 0 7 /end AXIS_DESCR
/end CHARACTERISTIC
/begin COMPU_METHOD TCZ_FN1020PL "FN1020PL Z-axis conversion" RAT_FUNC "%10.5" "unitless" COEFFS 0 1 0 0 0 1 /end COMPU_METHOD
/begin COMPU_METHOD TCX_FN1020PL "FN1020PL X-axis conversion" RAT_FUNC "%10.5" "RPM" COEFFS 0 1 0 0 0 1 /end COMPU_METHOD
/begin COMPU_METHOD TCY_FN1020PL "FN1020PL Y-axis conversion" RAT_FUNC "%10.5" "Unitless" COEFFS 0 1 0 0 0 1 /end COMPU_METHOD
/begin CHARACTERISTIC FN1020PM "X Norm=FN014P, Y Norm=unknown" MAP 0x4470C TD_FLOAT32_IEEE 0 TCZ_FN1020PM 0 200
 /begin AXIS_DESCR FIX_AXIS NO_INPUT_QUANTITY TCX_FN1020PM 14 0 13 FIX_AXIS_PAR 0 0 14 /end AXIS_DESCR
 /begin AXIS_DESCR FIX_AXIS NO_INPUT_QUANTITY TCY_FN1020PM 7 0 6 FIX_AXIS_PAR 0 0 7 /end AXIS_DESCR
/end CHARACTERISTIC
/begin COMPU_METHOD TCZ_FN1020PM "FN1020PM Z-axis conversion" RAT_FUNC "%10.5" "unitless" COEFFS 0 1 0 0 0 1 /end COMPU_METHOD
/begin COMPU_METHOD TCX_FN1020PM "FN1020PM X-axis conversion" RAT_FUNC "%10.5" "RPM" COEFFS 0 1 0 0 0 1 /end COMPU_METHOD
/begin COMPU_METHOD TCY_FN1020PM "FN1020PM Y-axis conversion" RAT_FUNC "%10.5" "Unitless" COEFFS 0 1 0 0 0 1 /end COMPU_METHOD
/begin MEASUREMENT FN1020_MFMTQ "Torque fuel limit function output" FLOAT32_IEEE MC_FN1020_MFMTQ 0 0 0 0 ECU_ADDRESS 0x3FA344 /end MEASUREMENT
/begin COMPU_METHOD MC_FN1020_MFMTQ "FN1020_MFMTQ conversion" RAT_FUNC "%10.5" "Unitless" COEFFS 0 1 0 0 0 1 /end COMPU_METHOD
/begin MEASUREMENT FN1020_MFMTQ_P "Torque fuel limit function output for pilot mode" FLOAT32_IEEE MC_FN1020_MFMTQ_P 0 0 0 0 ECU_ADDRESS 0x3FA340 /end MEASUREMENT
/begin COMPU_METHOD MC_FN1020_MFMTQ_P "FN1020_MFMTQ_P conversion" RAT_FUNC "%10.5" "Unitless" COEFFS 0 1 0 0 0 1 /end COMPU_METHOD
/begin CHARACTERISTIC FN103DRV "Governor proportional gain in 'drive' or 'reverse'" CURVE 0x4282C FD_FLOAT32_IEEE 0 FCY_FN103DRV 0 1 /begin AXIS_DESCR STD_AXIS NERR FCX_FN103DRV 10 -2000 5000 /end AXIS_DESCR /end CHARACTERISTIC
/begin COMPU_METHOD FCX_FN103DRV "FN103DRV X-axis conversion" RAT_FUNC "%10.5" "RPM" COEFFS 0 1 0 0 0 1 /end COMPU_METHOD
/begin COMPU_METHOD FCY_FN103DRV "FN103DRV Y-axis conversion" RAT_FUNC "%10.5" "unitless" COEFFS 0 1 0 0 0 1 /end COMPU_METHOD
/begin CHARACTERISTIC FN103DRV_P "Governor proportional gain in 'drive' or 'reverse' - pilot fuelling mode" CURVE 0x4287C FD_FLOAT32_IEEE 0 FCY_FN103DRV_P 0 1 /begin AXIS_DESCR STD_AXIS NERR FCX_FN103DRV_P 10 -2000 5000 /end AXIS_DESCR /end CHARACTERISTIC
/begin COMPU_METHOD FCX_FN103DRV_P "FN103DRV_P X-axis conversion" RAT_FUNC "%10.5" "RPM" COEFFS 0 1 0 0 0 1 /end COMPU_METHOD
/begin COMPU_METHOD FCY_FN103DRV_P "FN103DRV_P Y-axis conversion" RAT_FUNC "%10.5" "unitless" COEFFS 0 1 0 0 0 1 /end COMPU_METHOD
/begin CHARACTERISTIC FN103NEU "Governor proportional gain in 'park' or 'neutral'" CURVE 0x4278C FD_FLOAT32_IEEE 0 FCY_FN103NEU 0 1 /begin AXIS_DESCR STD_AXIS NERR FCX_FN103NEU 10 -2000 5000 /end AXIS_DESCR /end CHARACTERISTIC
/begin COMPU_METHOD FCX_FN103NEU "FN103NEU X-axis conversion" RAT_FUNC "%10.5" "RPM" COEFFS 0 1 0 0 0 1 /end COMPU_METHOD
/begin COMPU_METHOD FCY_FN103NEU "FN103NEU Y-axis conversion" RAT_FUNC "%10.5" "unitless" COEFFS 0 1 0 0 0 1 /end COMPU_METHOD
/begin CHARACTERISTIC FN103NEU_P "Governor proportional gain in 'park' or 'neutral' - pilot fuelling mode" CURVE 0x427DC FD_FLOAT32_IEEE 0 FCY_FN103NEU_P 0 1 /begin AXIS_DESCR STD_AXIS NERR FCX_FN103NEU_P 10 -2000 5000 /end AXIS_DESCR /end CHARACTERISTIC
/begin COMPU_METHOD FCX_FN103NEU_P "FN103NEU_P X-axis conversion" RAT_FUNC "%10.5" "RPM" COEFFS 0 1 0 0 0 1 /end COMPU_METHOD
/begin COMPU_METHOD FCY_FN103NEU_P "FN103NEU_P Y-axis conversion" RAT_FUNC "%10.5" "unitless" COEFFS 0 1 0 0 0 1 /end COMPU_METHOD
/begin CHARACTERISTIC FN104DN "Drive/Neutral Feed-Forward Adder for MFGOV_PI" CURVE 0x42A0C FD_FLOAT32_IEEE 0 FCY_FN104DN -20 20 /begin AXIS_DESCR STD_AXIS TOT FCX_FN104DN 8 -40 300 /end AXIS_DESCR /end CHARACTERISTIC
/begin COMPU_METHOD FCX_FN104DN "FN104DN X-axis conversion" RAT_FUNC "%10.5" "degF" COEFFS 0 1 0 0 0 1 /end COMPU_METHOD
/begin COMPU_METHOD FCY_FN104DN "FN104DN Y-axis conversion" RAT_FUNC "%10.5" "unitless" COEFFS 0 1 0 0 0 1 /end COMPU_METHOD
/begin CHARACTERISTIC FN104ND "Neutral/Drive Feed-Forward Adder for MFGOV_PI" CURVE 0x4298C FD_FLOAT32_IEEE 0 FCY_FN104ND 0 20 /begin AXIS_DESCR STD_AXIS TOT FCX_FN104ND 8 -40 300 /end AXIS_DESCR /end CHARACTERISTIC
/begin COMPU_METHOD FCX_FN104ND "FN104ND X-axis conversion" RAT_FUNC "%10.5" "degF" COEFFS 0 1 0 0 0 1 /end COMPU_METHOD
/begin COMPU_METHOD FCY_FN104ND "FN104ND Y-axis conversion" RAT_FUNC "%10.5" "unitless" COEFFS 0 1 0 0 0 1 /end COMPU_METHOD
/begin CHARACTERISTIC FN105D "Isochronous governor reference fuel in 'drive' or 'reverse'" CURVE 0x4274C FD_FLOAT32_IEEE 0 FCY_FN105D 0 80 /begin AXIS_DESCR STD_AXIS EOT_C FCX_FN105D 8 -40 150 /end AXIS_DESCR /end CHARACTERISTIC
/begin COMPU_METHOD FCX_FN105D "FN105D X-axis conversion" RAT_FUNC "%10.5" "degC" COEFFS 0 1 0 0 0 1 /end COMPU_METHOD
/begin COMPU_METHOD FCY_FN105D "FN105D Y-axis conversion" RAT_FUNC "%10.5" "unitless" COEFFS 0 1 0 0 0 1 /end COMPU_METHOD
/begin CHARACTERISTIC FN105N "Isochronous governor reference fuel in 'park' or 'neutral'" CURVE 0x4270C FD_FLOAT32_IEEE 0 FCY_FN105N 0 80 /begin AXIS_DESCR STD_AXIS EOT_C FCX_FN105N 8 -40 150 /end AXIS_DESCR /end CHARACTERISTIC
/begin COMPU_METHOD FCX_FN105N "FN105N X-axis conversion" RAT_FUNC "%10.5" "degC" COEFFS 0 1 0 0 0 1 /end COMPU_METHOD
/begin COMPU_METHOD FCY_FN105N "FN105N Y-axis conversion" RAT_FUNC "%10.5" "unitless" COEFFS 0 1 0 0 0 1 /end COMPU_METHOD
/begin CHARACTERISTIC FN106D "Isochronous govern integrator seed (Crank mode only) in 'drive' or 'reverse'" CURVE 0x42C8C FD_FLOAT32_IEEE 0 FCY_FN106D 0 80 /begin AXIS_DESCR STD_AXIS EOT_C FCX_FN106D 8 -40 150 /end AXIS_DESCR /end CHARACTERISTIC
/begin COMPU_METHOD FCX_FN106D "FN106D X-axis conversion" RAT_FUNC "%10.5" "degC" COEFFS 0 1 0 0 0 1 /end COMPU_METHOD
/begin COMPU_METHOD FCY_FN106D "FN106D Y-axis conversion" RAT_FUNC "%10.5" "unitless" COEFFS 0 1 0 0 0 1 /end COMPU_METHOD
/begin CHARACTERISTIC FN106N "Isochronous govern integrator seed (Crank mode only) in 'park' or 'neutral'" CURVE 0x42C4C FD_FLOAT32_IEEE 0 FCY_FN106N 0 80 /begin AXIS_DESCR STD_AXIS EOT_C FCX_FN106N 8 -40 150 /end AXIS_DESCR /end CHARACTERISTIC
/begin COMPU_METHOD FCX_FN106N "FN106N X-axis conversion" RAT_FUNC "%10.5" "degC" COEFFS 0 1 0 0 0 1 /end COMPU_METHOD
/begin COMPU_METHOD FCY_FN106N "FN106N Y-axis conversion" RAT_FUNC "%10.5" "unitless" COEFFS 0 1 0 0 0 1 /end COMPU_METHOD
/begin CHARACTERISTIC FN107 "Idle speed setpoint" CURVE 0x426AC FD_FLOAT32_IEEE 0 FCY_FN107 400 4000 /begin AXIS_DESCR STD_AXIS EOT_C FCX_FN107 6 -40 150 /end AXIS_DESCR /end CHARACTERISTIC
/begin COMPU_METHOD FCX_FN107 "FN107 X-axis conversion" RAT_FUNC "%10.5" "degC" COEFFS 0 1 0 0 0 1 /end COMPU_METHOD
/begin COMPU_METHOD FCY_FN107 "FN107 Y-axis conversion" RAT_FUNC "%10.5" "RPM" COEFFS 0 1 0 0 0 1 /end COMPU_METHOD
/begin CHARACTERISTIC FN108 "Feed-Forward term for A/C clutch On/Off" CURVE 0x42A4C FD_FLOAT32_IEEE 0 FCY_FN108 0 5 /begin AXIS_DESCR STD_AXIS MAT FCX_FN108 8 -40 300 /end AXIS_DESCR /end CHARACTERISTIC
/begin COMPU_METHOD FCX_FN108 "FN108 X-axis conversion" RAT_FUNC "%10.5" "degC" COEFFS 0 1 0 0 0 1 /end COMPU_METHOD
/begin COMPU_METHOD FCY_FN108 "FN108 Y-axis conversion" RAT_FUNC "%10.5" "unitless" COEFFS 0 1 0 0 0 1 /end COMPU_METHOD
/begin CHARACTERISTIC FN109 "Road speed limiter" CURVE 0x426DC FD_FLOAT32_IEEE 0 FCY_FN109 650 4000 /begin AXIS_DESCR STD_AXIS RDSP_FILT FCX_FN109 6 0 180 /end AXIS_DESCR /end CHARACTERISTIC
/begin COMPU_METHOD FCX_FN109 "FN109 X-axis conversion" RAT_FUNC "%10.5" "KPH" COEFFS 0 1 0 0 0 1 /end COMPU_METHOD
/begin COMPU_METHOD FCY_FN109 "FN109 Y-axis conversion" RAT_FUNC "%10.5" "RPM" COEFFS 0 1 0 0 0 1 /end COMPU_METHOD
/begin CHARACTERISTIC FN110 "Fuel density adjustment" CURVE 0x434CC FD_FLOAT32_IEEE 0 FCY_FN110 0.7 1.3 /begin AXIS_DESCR STD_AXIS EOT_C FCX_FN110 8 -40 150 /end AXIS_DESCR /end CHARACTERISTIC
/begin COMPU_METHOD FCX_FN110 "FN110 X-axis conversion" RAT_FUNC "%10.5" "degC" COEFFS 0 1 0 0 0 1 /end COMPU_METHOD
/begin COMPU_METHOD FCY_FN110 "FN110 Y-axis conversion" RAT_FUNC "%10.5" "unitless" COEFFS 0 1 0 0 0 1 /end COMPU_METHOD
/begin CHARACTERISTIC FN1108 "X Norm=FN021DS, Y Norm=FN035DS, All-speed fuel quantity table" MAP 0x42E8C TD_FLOAT32_IEEE 0 TCZ_FN1108 -1024 1023
 /begin AXIS_DESCR FIX_AXIS NO_INPUT_QUANTITY TCX_FN1108 14 0 13 FIX_AXIS_PAR 0 0 14 /end AXIS_DESCR
 /begin AXIS_DESCR FIX_AXIS NO_INPUT_QUANTITY TCY_FN1108 14 0 13 FIX_AXIS_PAR 0 0 14 /end AXIS_DESCR
/end CHARACTERISTIC
/begin COMPU_METHOD TCZ_FN1108 "FN1108 Z-axis conversion" RAT_FUNC "%10.5" "unitless" COEFFS 0 1 0 0 0 1 /end COMPU_METHOD
/begin COMPU_METHOD TCX_FN1108 "FN1108 X-axis conversion" RAT_FUNC "%10.5" "RPM" COEFFS 0 1 0 0 0 1 /end COMPU_METHOD
/begin COMPU_METHOD TCY_FN1108 "FN1108 Y-axis conversion" RAT_FUNC "%10.5" "ADct" COEFFS 0 1 0 0 0 1 /end COMPU_METHOD
/begin CHARACTERISTIC FN1108P "X Norm=FN021P, Y Norm=FN035P, All-speed fuel quantity table" MAP 0x4319C TD_FLOAT32_IEEE 0 TCZ_FN1108P -1024 1023
 /begin AXIS_DESCR FIX_AXIS NO_INPUT_QUANTITY TCX_FN1108P 14 0 13 FIX_AXIS_PAR 0 0 14 /end AXIS_DESCR
 /begin AXIS_DESCR FIX_AXIS NO_INPUT_QUANTITY TCY_FN1108P 14 0 13 FIX_AXIS_PAR 0 0 14 /end AXIS_DESCR
/end CHARACTERISTIC
/begin COMPU_METHOD TCZ_FN1108P "FN1108P Z-axis conversion" RAT_FUNC "%10.5" "unitless" COEFFS 0 1 0 0 0 1 /end COMPU_METHOD
/begin COMPU_METHOD TCX_FN1108P "FN1108P X-axis conversion" RAT_FUNC "%10.5" "RPM" COEFFS 0 1 0 0 0 1 /end COMPU_METHOD
/begin COMPU_METHOD TCY_FN1108P "FN1108P Y-axis conversion" RAT_FUNC "%10.5" "ADct" COEFFS 0 1 0 0 0 1 /end COMPU_METHOD
/begin CHARACTERISTIC FN111DN "Timer term for Drive/Neutral engagement delay" CURVE 0x429CC FD_FLOAT32_IEEE 0 FCY_FN111DN 0 65535 /begin AXIS_DESCR STD_AXIS TOT FCX_FN111DN 8 -40 300 /end AXIS_DESCR /end CHARACTERISTIC
/begin COMPU_METHOD FCX_FN111DN "FN111DN X-axis conversion" RAT_FUNC "%10.5" "degF" COEFFS 0 1 0 0 0 1 /end COMPU_METHOD
/begin COMPU_METHOD FCY_FN111DN "FN111DN Y-axis conversion" RAT_FUNC "%10.5" "ms" COEFFS 0 1 0 0 0 1 /end COMPU_METHOD
/begin CHARACTERISTIC FN111ND "Timer term for Neutral/Drive engagement delay" CURVE 0x4294C FD_FLOAT32_IEEE 0 FCY_FN111ND 0 25 /begin AXIS_DESCR STD_AXIS TOT FCX_FN111ND 8 -40 300 /end AXIS_DESCR /end CHARACTERISTIC
/begin COMPU_METHOD FCX_FN111ND "FN111ND X-axis conversion" RAT_FUNC "%10.5" "degF" COEFFS 0 1 0 0 0 1 /end COMPU_METHOD
/begin COMPU_METHOD FCY_FN111ND "FN111ND Y-axis conversion" RAT_FUNC "%10.5" "ms" COEFFS 0 1 0 0 0 1 /end COMPU_METHOD
/begin CHARACTERISTIC FN1120H "X Norm=FN012DS, Y Norm=FN030DS" MAP 0x4567C TD_FLOAT32_IEEE 0 TCZ_FN1120H 0 1000
 /begin AXIS_DESCR FIX_AXIS NO_INPUT_QUANTITY TCX_FN1120H 10 0 9 FIX_AXIS_PAR 0 0 10 /end AXIS_DESCR
 /begin AXIS_DESCR FIX_AXIS NO_INPUT_QUANTITY TCY_FN1120H 8 0 7 FIX_AXIS_PAR 0 0 8 /end AXIS_DESCR
/end CHARACTERISTIC
/begin COMPU_METHOD TCZ_FN1120H "FN1120H Z-axis conversion" RAT_FUNC "%10.5" "unitless" COEFFS 0 1 0 0 0 1 /end COMPU_METHOD
/begin COMPU_METHOD TCX_FN1120H "FN1120H X-axis conversion" RAT_FUNC "%10.5" "RPM" COEFFS 0 1 0 0 0 1 /end COMPU_METHOD
/begin COMPU_METHOD TCY_FN1120H "FN1120H Y-axis conversion" RAT_FUNC "%10.5" "unitless" COEFFS 0 1 0 0 0 1 /end COMPU_METHOD
/begin CHARACTERISTIC FN1120L "X Norm=FN012DS, Y Norm=FN030DS" MAP 0x458FC TD_FLOAT32_IEEE 0 TCZ_FN1120L 0 1000
 /begin AXIS_DESCR FIX_AXIS NO_INPUT_QUANTITY TCX_FN1120L 10 0 9 FIX_AXIS_PAR 0 0 10 /end AXIS_DESCR
 /begin AXIS_DESCR FIX_AXIS NO_INPUT_QUANTITY TCY_FN1120L 8 0 7 FIX_AXIS_PAR 0 0 8 /end AXIS_DESCR
/end CHARACTERISTIC
/begin COMPU_METHOD TCZ_FN1120L "FN1120L Z-axis conversion" RAT_FUNC "%10.5" "unitless" COEFFS 0 1 0 0 0 1 /end COMPU_METHOD
/begin COMPU_METHOD TCX_FN1120L "FN1120L X-axis conversion" RAT_FUNC "%10.5" "RPM" COEFFS 0 1 0 0 0 1 /end COMPU_METHOD
/begin COMPU_METHOD TCY_FN1120L "FN1120L Y-axis conversion" RAT_FUNC "%10.5" "unitless" COEFFS 0 1 0 0 0 1 /end COMPU_METHOD
/begin CHARACTERISTIC FN1120M "X Norm=FN012DS, Y Norm=FN030DS" MAP 0x457BC TD_FLOAT32_IEEE 0 TCZ_FN1120M 0 1000
 /begin AXIS_DESCR FIX_AXIS NO_INPUT_QUANTITY TCX_FN1120M 10 0 9 FIX_AXIS_PAR 0 0 10 /end AXIS_DESCR
 /begin AXIS_DESCR FIX_AXIS NO_INPUT_QUANTITY TCY_FN1120M 8 0 7 FIX_AXIS_PAR 0 0 8 /end AXIS_DESCR
/end CHARACTERISTIC
/begin COMPU_METHOD TCZ_FN1120M "FN1120M Z-axis conversion" RAT_FUNC "%10.5" "unitless" COEFFS 0 1 0 0 0 1 /end COMPU_METHOD
/begin COMPU_METHOD TCX_FN1120M "FN1120M X-axis conversion" RAT_FUNC "%10.5" "RPM" COEFFS 0 1 0 0 0 1 /end COMPU_METHOD
/begin COMPU_METHOD TCY_FN1120M "FN1120M Y-axis conversion" RAT_FUNC "%10.5" "unitless" COEFFS 0 1 0 0 0 1 /end COMPU_METHOD
/begin CHARACTERISTIC FN1120PH "X Norm=FN012P, Y Norm=FN030P" MAP 0x45A3C TD_FLOAT32_IEEE 0 TCZ_FN1120PH 0 1000
 /begin AXIS_DESCR FIX_AXIS NO_INPUT_QUANTITY TCX_FN1120PH 10 0 9 FIX_AXIS_PAR 0 0 10 /end AXIS_DESCR
 /begin AXIS_DESCR FIX_AXIS NO_INPUT_QUANTITY TCY_FN1120PH 8 0 7 FIX_AXIS_PAR 0 0 8 /end AXIS_DESCR
/end CHARACTERISTIC
/begin COMPU_METHOD TCZ_FN1120PH "FN1120PH Z-axis conversion" RAT_FUNC "%10.5" "unitless" COEFFS 0 1 0 0 0 1 /end COMPU_METHOD
/begin COMPU_METHOD TCX_FN1120PH "FN1120PH X-axis conversion" RAT_FUNC "%10.5" "RPM" COEFFS 0 1 0 0 0 1 /end COMPU_METHOD
/begin COMPU_METHOD TCY_FN1120PH "FN1120PH Y-axis conversion" RAT_FUNC "%10.5" "unitless" COEFFS 0 1 0 0 0 1 /end COMPU_METHOD
/begin CHARACTERISTIC FN1120PL "X Norm=FN012P, Y Norm=FN030P" MAP 0x45CBC TD_FLOAT32_IEEE 0 TCZ_FN1120PL 0 1000
 /begin AXIS_DESCR FIX_AXIS NO_INPUT_QUANTITY TCX_FN1120PL 10 0 9 FIX_AXIS_PAR 0 0 10 /end AXIS_DESCR
 /begin AXIS_DESCR FIX_AXIS NO_INPUT_QUANTITY TCY_FN1120PL 8 0 7 FIX_AXIS_PAR 0 0 8 /end AXIS_DESCR
/end CHARACTERISTIC
/begin COMPU_METHOD TCZ_FN1120PL "FN1120PL Z-axis conversion" RAT_FUNC "%10.5" "unitless" COEFFS 0 1 0 0 0 1 /end COMPU_METHOD
/begin COMPU_METHOD TCX_FN1120PL "FN1120PL X-axis conversion" RAT_FUNC "%10.5" "RPM" COEFFS 0 1 0 0 0 1 /end COMPU_METHOD
/begin COMPU_METHOD TCY_FN1120PL "FN1120PL Y-axis conversion" RAT_FUNC "%10.5" "unitless" COEFFS 0 1 0 0 0 1 /end COMPU_METHOD
/begin CHARACTERISTIC FN1120PM "X Norm=FN012P, Y Norm=FN030P" MAP 0x45B7C TD_FLOAT32_IEEE 0 TCZ_FN1120PM 0 1000
 /begin AXIS_DESCR FIX_AXIS NO_INPUT_QUANTITY TCX_FN1120PM 10 0 9 FIX_AXIS_PAR 0 0 10 /end AXIS_DESCR
 /begin AXIS_DESCR FIX_AXIS NO_INPUT_QUANTITY TCY_FN1120PM 8 0 7 FIX_AXIS_PAR 0 0 8 /end AXIS_DESCR
/end CHARACTERISTIC
/begin COMPU_METHOD TCZ_FN1120PM "FN1120PM Z-axis conversion" RAT_FUNC "%10.5" "unitless" COEFFS 0 1 0 0 0 1 /end COMPU_METHOD
/begin COMPU_METHOD TCX_FN1120PM "FN1120PM X-axis conversion" RAT_FUNC "%10.5" "RPM" COEFFS 0 1 0 0 0 1 /end COMPU_METHOD
/begin COMPU_METHOD TCY_FN1120PM "FN1120PM Y-axis conversion" RAT_FUNC "%10.5" "unitless" COEFFS 0 1 0 0 0 1 /end COMPU_METHOD
/begin CHARACTERISTIC FN1200DSH "X Norm=FN019DS, Y Norm=FN013DS" MAP 0x48CFC TD_FLOAT32_IEEE 0 TCZ_FN1200DSH -100 200
 /begin AXIS_DESCR FIX_AXIS NO_INPUT_QUANTITY TCX_FN1200DSH 11 0 10 FIX_AXIS_PAR 0 0 11 /end AXIS_DESCR
 /begin AXIS_DESCR FIX_AXIS NO_INPUT_QUANTITY TCY_FN1200DSH 10 0 9 FIX_AXIS_PAR 0 0 10 /end AXIS_DESCR
/end CHARACTERISTIC
/begin COMPU_METHOD TCZ_FN1200DSH "FN1200DSH Z-axis conversion" RAT_FUNC "%10.5" "unitless" COEFFS 0 1 0 0 0 1 /end COMPU_METHOD
/begin COMPU_METHOD TCX_FN1200DSH "FN1200DSH X-axis conversion" RAT_FUNC "%10.5" "unitless" COEFFS 0 1 0 0 0 1 /end COMPU_METHOD
/begin COMPU_METHOD TCY_FN1200DSH "FN1200DSH Y-axis conversion" RAT_FUNC "%10.5" "unitless" COEFFS 0 1 0 0 0 1 /end COMPU_METHOD
/begin CHARACTERISTIC FN1200DSL "X Norm=FN019DS, Y Norm=FN013DS" MAP 0x4898C TD_FLOAT32_IEEE 0 TCZ_FN1200DSL -100 200
 /begin AXIS_DESCR FIX_AXIS NO_INPUT_QUANTITY TCX_FN1200DSL 11 0 10 FIX_AXIS_PAR 0 0 11 /end AXIS_DESCR
 /begin AXIS_DESCR FIX_AXIS NO_INPUT_QUANTITY TCY_FN1200DSL 10 0 9 FIX_AXIS_PAR 0 0 10 /end AXIS_DESCR
/end CHARACTERISTIC
/begin COMPU_METHOD TCZ_FN1200DSL "FN1200DSL Z-axis conversion" RAT_FUNC "%10.5" "unitless" COEFFS 0 1 0 0 0 1 /end COMPU_METHOD
/begin COMPU_METHOD TCX_FN1200DSL "FN1200DSL X-axis conversion" RAT_FUNC "%10.5" "unitless" COEFFS 0 1 0 0 0 1 /end COMPU_METHOD
/begin COMPU_METHOD TCY_FN1200DSL "FN1200DSL Y-axis conversion" RAT_FUNC "%10.5" "unitless" COEFFS 0 1 0 0 0 1 /end COMPU_METHOD
/begin CHARACTERISTIC FN1200DSM "X Norm=FN019DS, Y Norm=FN013DS" MAP 0x48B44 TD_FLOAT32_IEEE 0 TCZ_FN1200DSM -100 200
 /begin AXIS_DESCR FIX_AXIS NO_INPUT_QUANTITY TCX_FN1200DSM 11 0 10 FIX_AXIS_PAR 0 0 11 /end AXIS_DESCR
 /begin AXIS_DESCR FIX_AXIS NO_INPUT_QUANTITY TCY_FN1200DSM 10 0 9 FIX_AXIS_PAR 0 0 10 /end AXIS_DESCR
/end CHARACTERISTIC
/begin COMPU_METHOD TCZ_FN1200DSM "FN1200DSM Z-axis conversion" RAT_FUNC "%10.5" "unitless" COEFFS 0 1 0 0 0 1 /end COMPU_METHOD
/begin COMPU_METHOD TCX_FN1200DSM "FN1200DSM X-axis conversion" RAT_FUNC "%10.5" "unitless" COEFFS 0 1 0 0 0 1 /end COMPU_METHOD
/begin COMPU_METHOD TCY_FN1200DSM "FN1200DSM Y-axis conversion" RAT_FUNC "%10.5" "unitless" COEFFS 0 1 0 0 0 1 /end COMPU_METHOD
/begin CHARACTERISTIC FN1200PH "X Norm=FN019P, Y Norm=FN013P" MAP 0x47A84 TD_FLOAT32_IEEE 0 TCZ_FN1200PH -100 200
 /begin AXIS_DESCR FIX_AXIS NO_INPUT_QUANTITY TCX_FN1200PH 11 0 10 FIX_AXIS_PAR 0 0 11 /end AXIS_DESCR
 /begin AXIS_DESCR FIX_AXIS NO_INPUT_QUANTITY TCY_FN1200PH 10 0 9 FIX_AXIS_PAR 0 0 10 /end AXIS_DESCR
/end CHARACTERISTIC
/begin COMPU_METHOD TCZ_FN1200PH "FN1200PH Z-axis conversion" RAT_FUNC "%10.5" "unitless" COEFFS 0 1 0 0 0 1 /end COMPU_METHOD
/begin COMPU_METHOD TCX_FN1200PH "FN1200PH X-axis conversion" RAT_FUNC "%10.5" "unitless" COEFFS 0 1 0 0 0 1 /end COMPU_METHOD
/begin COMPU_METHOD TCY_FN1200PH "FN1200PH Y-axis conversion" RAT_FUNC "%10.5" "unitless" COEFFS 0 1 0 0 0 1 /end COMPU_METHOD
/begin CHARACTERISTIC FN1200PL "X Norm=FN019P, Y Norm=FN013P" MAP 0x47714 TD_FLOAT32_IEEE 0 TCZ_FN1200PL -100 200
 /begin AXIS_DESCR FIX_AXIS NO_INPUT_QUANTITY TCX_FN1200PL 11 0 10 FIX_AXIS_PAR 0 0 11 /end AXIS_DESCR
 /begin AXIS_DESCR FIX_AXIS NO_INPUT_QUANTITY TCY_FN1200PL 10 0 9 FIX_AXIS_PAR 0 0 10 /end AXIS_DESCR
/end CHARACTERISTIC
/begin COMPU_METHOD TCZ_FN1200PL "FN1200PL Z-axis conversion" RAT_FUNC "%10.5" "unitless" COEFFS 0 1 0 0 0 1 /end COMPU_METHOD
/begin COMPU_METHOD TCX_FN1200PL "FN1200PL X-axis conversion" RAT_FUNC "%10.5" "unitless" COEFFS 0 1 0 0 0 1 /end COMPU_METHOD
/begin COMPU_METHOD TCY_FN1200PL "FN1200PL Y-axis conversion" RAT_FUNC "%10.5" "unitless" COEFFS 0 1 0 0 0 1 /end COMPU_METHOD
/begin CHARACTERISTIC FN1200PM "X Norm=FN019P, Y Norm=FN013P" MAP 0x478CC TD_FLOAT32_IEEE 0 TCZ_FN1200PM -100 200
 /begin AXIS_DESCR FIX_AXIS NO_INPUT_QUANTITY TCX_FN1200PM 11 0 10 FIX_AXIS_PAR 0 0 11 /end AXIS_DESCR
 /begin AXIS_DESCR FIX_AXIS NO_INPUT_QUANTITY TCY_FN1200PM 10 0 9 FIX_AXIS_PAR 0 0 10 /end AXIS_DESCR
/end CHARACTERISTIC
/begin COMPU_METHOD TCZ_FN1200PM "FN1200PM Z-axis conversion" RAT_FUNC "%10.5" "unitless" COEFFS 0 1 0 0 0 1 /end COMPU_METHOD
/begin COMPU_METHOD TCX_FN1200PM "FN1200PM X-axis conversion" RAT_FUNC "%10.5" "unitless" COEFFS 0 1 0 0 0 1 /end COMPU_METHOD
/begin COMPU_METHOD TCY_FN1200PM "FN1200PM Y-axis conversion" RAT_FUNC "%10.5" "unitless" COEFFS 0 1 0 0 0 1 /end COMPU_METHOD
/begin CHARACTERISTIC FN1202DSH "X Norm=FN019DS, Y Norm=FNMATDS" MAP 0x487D4 TD_FLOAT32_IEEE 0 TCZ_FN1202DSH -500 500
 /begin AXIS_DESCR FIX_AXIS NO_INPUT_QUANTITY TCX_FN1202DSH 11 0 10 FIX_AXIS_PAR 0 0 11 /end AXIS_DESCR
 /begin AXIS_DESCR FIX_AXIS NO_INPUT_QUANTITY TCY_FN1202DSH 10 0 9 FIX_AXIS_PAR 0 0 10 /end AXIS_DESCR
/end CHARACTERISTIC
/begin COMPU_METHOD TCZ_FN1202DSH "FN1202DSH Z-axis conversion" RAT_FUNC "%10.5" "unitless" COEFFS 0 1 0 0 0 1 /end COMPU_METHOD
/begin COMPU_METHOD TCX_FN1202DSH "FN1202DSH X-axis conversion" RAT_FUNC "%10.5" "unitless" COEFFS 0 1 0 0 0 1 /end COMPU_METHOD
/begin COMPU_METHOD TCY_FN1202DSH "FN1202DSH Y-axis conversion" RAT_FUNC "%10.5" "unitless" COEFFS 0 1 0 0 0 1 /end COMPU_METHOD
/begin CHARACTERISTIC FN1202DSL "X Norm=FN019DS, Y Norm=FNMATDS" MAP 0x48464 TD_FLOAT32_IEEE 0 TCZ_FN1202DSL -500 500
 /begin AXIS_DESCR FIX_AXIS NO_INPUT_QUANTITY TCX_FN1202DSL 11 0 10 FIX_AXIS_PAR 0 0 11 /end AXIS_DESCR
 /begin AXIS_DESCR FIX_AXIS NO_INPUT_QUANTITY TCY_FN1202DSL 10 0 9 FIX_AXIS_PAR 0 0 10 /end AXIS_DESCR
/end CHARACTERISTIC
/begin COMPU_METHOD TCZ_FN1202DSL "FN1202DSL Z-axis conversion" RAT_FUNC "%10.5" "unitless" COEFFS 0 1 0 0 0 1 /end COMPU_METHOD
/begin COMPU_METHOD TCX_FN1202DSL "FN1202DSL X-axis conversion" RAT_FUNC "%10.5" "unitless" COEFFS 0 1 0 0 0 1 /end COMPU_METHOD
/begin COMPU_METHOD TCY_FN1202DSL "FN1202DSL Y-axis conversion" RAT_FUNC "%10.5" "unitless" COEFFS 0 1 0 0 0 1 /end COMPU_METHOD
/begin CHARACTERISTIC FN1202DSM "X Norm=FN019DS, Y Norm=FNMATDS" MAP 0x4861C TD_FLOAT32_IEEE 0 TCZ_FN1202DSM -500 500
 /begin AXIS_DESCR FIX_AXIS NO_INPUT_QUANTITY TCX_FN1202DSM 11 0 10 FIX_AXIS_PAR 0 0 11 /end AXIS_DESCR
 /begin AXIS_DESCR FIX_AXIS NO_INPUT_QUANTITY TCY_FN1202DSM 10 0 9 FIX_AXIS_PAR 0 0 10 /end AXIS_DESCR
/end CHARACTERISTIC
/begin COMPU_METHOD TCZ_FN1202DSM "FN1202DSM Z-axis conversion" RAT_FUNC "%10.5" "unitless" COEFFS 0 1 0 0 0 1 /end COMPU_METHOD
/begin COMPU_METHOD TCX_FN1202DSM "FN1202DSM X-axis conversion" RAT_FUNC "%10.5" "unitless" COEFFS 0 1 0 0 0 1 /end COMPU_METHOD
/begin COMPU_METHOD TCY_FN1202DSM "FN1202DSM Y-axis conversion" RAT_FUNC "%10.5" "unitless" COEFFS 0 1 0 0 0 1 /end COMPU_METHOD
/begin CHARACTERISTIC FN1202PH "X Norm=FN019P, Y Norm=FNMATP" MAP 0x47FAC TD_FLOAT32_IEEE 0 TCZ_FN1202PH -500 500
 /begin AXIS_DESCR FIX_AXIS NO_INPUT_QUANTITY TCX_FN1202PH 11 0 10 FIX_AXIS_PAR 0 0 11 /end AXIS_DESCR
 /begin AXIS_DESCR FIX_AXIS NO_INPUT_QUANTITY TCY_FN1202PH 10 0 9 FIX_AXIS_PAR 0 0 10 /end AXIS_DESCR
/end CHARACTERISTIC
/begin COMPU_METHOD TCZ_FN1202PH "FN1202PH Z-axis conversion" RAT_FUNC "%10.5" "unitless" COEFFS 0 1 0 0 0 1 /end COMPU_METHOD
/begin COMPU_METHOD TCX_FN1202PH "FN1202PH X-axis conversion" RAT_FUNC "%10.5" "unitless" COEFFS 0 1 0 0 0 1 /end COMPU_METHOD
/begin COMPU_METHOD TCY_FN1202PH "FN1202PH Y-axis conversion" RAT_FUNC "%10.5" "unitless" COEFFS 0 1 0 0 0 1 /end COMPU_METHOD
/begin CHARACTERISTIC FN1202PL "X Norm=FN019P, Y Norm=FNMATP" MAP 0x47C3C TD_FLOAT32_IEEE 0 TCZ_FN1202PL -500 500
 /begin AXIS_DESCR FIX_AXIS NO_INPUT_QUANTITY TCX_FN1202PL 11 0 10 FIX_AXIS_PAR 0 0 11 /end AXIS_DESCR
 /begin AXIS_DESCR FIX_AXIS NO_INPUT_QUANTITY TCY_FN1202PL 10 0 9 FIX_AXIS_PAR 0 0 10 /end AXIS_DESCR
/end CHARACTERISTIC
/begin COMPU_METHOD TCZ_FN1202PL "FN1202PL Z-axis conversion" RAT_FUNC "%10.5" "unitless" COEFFS 0 1 0 0 0 1 /end COMPU_METHOD
/begin COMPU_METHOD TCX_FN1202PL "FN1202PL X-axis conversion" RAT_FUNC "%10.5" "unitless" COEFFS 0 1 0 0 0 1 /end COMPU_METHOD
/begin COMPU_METHOD TCY_FN1202PL "FN1202PL Y-axis conversion" RAT_FUNC "%10.5" "unitless" COEFFS 0 1 0 0 0 1 /end COMPU_METHOD
/begin CHARACTERISTIC FN1202PM "X Norm=FN019P, Y Norm=FNMATP" MAP 0x47DF4 TD_FLOAT32_IEEE 0 TCZ_FN1202PM -500 500
 /begin AXIS_DESCR FIX_AXIS NO_INPUT_QUANTITY TCX_FN1202PM 11 0 10 FIX_AXIS_PAR 0 0 11 /end AXIS_DESCR
 /begin AXIS_DESCR FIX_AXIS NO_INPUT_QUANTITY TCY_FN1202PM 10 0 9 FIX_AXIS_PAR 0 0 10 /end AXIS_DESCR
/end CHARACTERISTIC
/begin COMPU_METHOD TCZ_FN1202PM "FN1202PM Z-axis conversion" RAT_FUNC "%10.5" "unitless" COEFFS 0 1 0 0 0 1 /end COMPU_METHOD
/begin COMPU_METHOD TCX_FN1202PM "FN1202PM X-axis conversion" RAT_FUNC "%10.5" "unitless" COEFFS 0 1 0 0 0 1 /end COMPU_METHOD
/begin COMPU_METHOD TCY_FN1202PM "FN1202PM Y-axis conversion" RAT_FUNC "%10.5" "unitless" COEFFS 0 1 0 0 0 1 /end COMPU_METHOD
/begin CHARACTERISTIC FN1205DSH "X Norm=FN033DS, Y Norm=FN032DS" MAP 0x490B4 TD_FLOAT32_IEEE 0 TCZ_FN1205DSH -500 500
 /begin AXIS_DESCR FIX_AXIS NO_INPUT_QUANTITY TCX_FN1205DSH 8 0 7 FIX_AXIS_PAR 0 0 8 /end AXIS_DESCR
 /begin AXIS_DESCR FIX_AXIS NO_INPUT_QUANTITY TCY_FN1205DSH 8 0 7 FIX_AXIS_PAR 0 0 8 /end AXIS_DESCR
/end CHARACTERISTIC
/begin COMPU_METHOD TCZ_FN1205DSH "FN1205DSH Z-axis conversion" RAT_FUNC "%10.5" "unitless" COEFFS 0 1 0 0 0 1 /end COMPU_METHOD
/begin COMPU_METHOD TCX_FN1205DSH "FN1205DSH X-axis conversion" RAT_FUNC "%10.5" "unitless" COEFFS 0 1 0 0 0 1 /end COMPU_METHOD
/begin COMPU_METHOD TCY_FN1205DSH "FN1205DSH Y-axis conversion" RAT_FUNC "%10.5" "unitless" COEFFS 0 1 0 0 0 1 /end COMPU_METHOD
/begin CHARACTERISTIC FN1205DSL "X Norm=FN033DS, Y Norm=FN032DS" MAP 0x48EB4 TD_FLOAT32_IEEE 0 TCZ_FN1205DSL -500 500
 /begin AXIS_DESCR FIX_AXIS NO_INPUT_QUANTITY TCX_FN1205DSL 8 0 7 FIX_AXIS_PAR 0 0 8 /end AXIS_DESCR
 /begin AXIS_DESCR FIX_AXIS NO_INPUT_QUANTITY TCY_FN1205DSL 8 0 7 FIX_AXIS_PAR 0 0 8 /end AXIS_DESCR
/end CHARACTERISTIC
/begin COMPU_METHOD TCZ_FN1205DSL "FN1205DSL Z-axis conversion" RAT_FUNC "%10.5" "unitless" COEFFS 0 1 0 0 0 1 /end COMPU_METHOD
/begin COMPU_METHOD TCX_FN1205DSL "FN1205DSL X-axis conversion" RAT_FUNC "%10.5" "unitless" COEFFS 0 1 0 0 0 1 /end COMPU_METHOD
/begin COMPU_METHOD TCY_FN1205DSL "FN1205DSL Y-axis conversion" RAT_FUNC "%10.5" "unitless" COEFFS 0 1 0 0 0 1 /end COMPU_METHOD
/begin CHARACTERISTIC FN1205DSM "X Norm=FN033DS, Y Norm=FN032DS" MAP 0x48FB4 TD_FLOAT32_IEEE 0 TCZ_FN1205DSM -500 500
 /begin AXIS_DESCR FIX_AXIS NO_INPUT_QUANTITY TCX_FN1205DSM 8 0 7 FIX_AXIS_PAR 0 0 8 /end AXIS_DESCR
 /begin AXIS_DESCR FIX_AXIS NO_INPUT_QUANTITY TCY_FN1205DSM 8 0 7 FIX_AXIS_PAR 0 0 8 /end AXIS_DESCR
/end CHARACTERISTIC
/begin COMPU_METHOD TCZ_FN1205DSM "FN1205DSM Z-axis conversion" RAT_FUNC "%10.5" "unitless" COEFFS 0 1 0 0 0 1 /end COMPU_METHOD
/begin COMPU_METHOD TCX_FN1205DSM "FN1205DSM X-axis conversion" RAT_FUNC "%10.5" "unitless" COEFFS 0 1 0 0 0 1 /end COMPU_METHOD
/begin COMPU_METHOD TCY_FN1205DSM "FN1205DSM Y-axis conversion" RAT_FUNC "%10.5" "unitless" COEFFS 0 1 0 0 0 1 /end COMPU_METHOD
/begin CHARACTERISTIC FN1205PH "X Norm=FN033P, Y Norm=FN032P" MAP 0x48364 TD_FLOAT32_IEEE 0 TCZ_FN1205PH -500 500
 /begin AXIS_DESCR FIX_AXIS NO_INPUT_QUANTITY TCX_FN1205PH 8 0 7 FIX_AXIS_PAR 0 0 8 /end AXIS_DESCR
 /begin AXIS_DESCR FIX_AXIS NO_INPUT_QUANTITY TCY_FN1205PH 8 0 7 FIX_AXIS_PAR 0 0 8 /end AXIS_DESCR
/end CHARACTERISTIC
/begin COMPU_METHOD TCZ_FN1205PH "FN1205PH Z-axis conversion" RAT_FUNC "%10.5" "unitless" COEFFS 0 1 0 0 0 1 /end COMPU_METHOD
/begin COMPU_METHOD TCX_FN1205PH "FN1205PH X-axis conversion" RAT_FUNC "%10.5" "unitless" COEFFS 0 1 0 0 0 1 /end COMPU_METHOD
/begin COMPU_METHOD TCY_FN1205PH "FN1205PH Y-axis conversion" RAT_FUNC "%10.5" "unitless" COEFFS 0 1 0 0 0 1 /end COMPU_METHOD
/begin CHARACTERISTIC FN1205PL "X Norm=FN033P, Y Norm=FN032P" MAP 0x48164 TD_FLOAT32_IEEE 0 TCZ_FN1205PL -500 500
 /begin AXIS_DESCR FIX_AXIS NO_INPUT_QUANTITY TCX_FN1205PL 8 0 7 FIX_AXIS_PAR 0 0 8 /end AXIS_DESCR
 /begin AXIS_DESCR FIX_AXIS NO_INPUT_QUANTITY TCY_FN1205PL 8 0 7 FIX_AXIS_PAR 0 0 8 /end AXIS_DESCR
/end CHARACTERISTIC
/begin COMPU_METHOD TCZ_FN1205PL "FN1205PL Z-axis conversion" RAT_FUNC "%10.5" "unitless" COEFFS 0 1 0 0 0 1 /end COMPU_METHOD
/begin COMPU_METHOD TCX_FN1205PL "FN1205PL X-axis conversion" RAT_FUNC "%10.5" "unitless" COEFFS 0 1 0 0 0 1 /end COMPU_METHOD
/begin COMPU_METHOD TCY_FN1205PL "FN1205PL Y-axis conversion" RAT_FUNC "%10.5" "unitless" COEFFS 0 1 0 0 0 1 /end COMPU_METHOD
/begin CHARACTERISTIC FN1205PM "X Norm=FN033P, Y Norm=FN032P" MAP 0x48264 TD_FLOAT32_IEEE 0 TCZ_FN1205PM -500 500
 /begin AXIS_DESCR FIX_AXIS NO_INPUT_QUANTITY TCX_FN1205PM 8 0 7 FIX_AXIS_PAR 0 0 8 /end AXIS_DESCR
 /begin AXIS_DESCR FIX_AXIS NO_INPUT_QUANTITY TCY_FN1205PM 8 0 7 FIX_AXIS_PAR 0 0 8 /end AXIS_DESCR
/end CHARACTERISTIC
/begin COMPU_METHOD TCZ_FN1205PM "FN1205PM Z-axis conversion" RAT_FUNC "%10.5" "unitless" COEFFS 0 1 0 0 0 1 /end COMPU_METHOD
/begin COMPU_METHOD TCX_FN1205PM "FN1205PM X-axis conversion" RAT_FUNC "%10.5" "unitless" COEFFS 0 1 0 0 0 1 /end COMPU_METHOD
/begin COMPU_METHOD TCY_FN1205PM "FN1205PM Y-axis conversion" RAT_FUNC "%10.5" "unitless" COEFFS 0 1 0 0 0 1 /end COMPU_METHOD
/begin CHARACTERISTIC FN1300P_HI "X Norm=FN011P, Y Norm=FN031P" MAP 0x4A1BC TD_FLOAT32_IEEE 0 TCZ_FN1300P_HI 0 30
 /begin AXIS_DESCR FIX_AXIS NO_INPUT_QUANTITY TCX_FN1300P_HI 11 0 10 FIX_AXIS_PAR 0 0 11 /end AXIS_DESCR
 /begin AXIS_DESCR FIX_AXIS NO_INPUT_QUANTITY TCY_FN1300P_HI 10 0 9 FIX_AXIS_PAR 0 0 10 /end AXIS_DESCR
/end CHARACTERISTIC
/begin COMPU_METHOD TCZ_FN1300P_HI "FN1300P_HI Z-axis conversion" RAT_FUNC "%10.5" "unitless" COEFFS 0 1 0 0 0 1 /end COMPU_METHOD
/begin COMPU_METHOD TCX_FN1300P_HI "FN1300P_HI X-axis conversion" RAT_FUNC "%10.5" "RPM" COEFFS 0 1 0 0 0 1 /end COMPU_METHOD
/begin COMPU_METHOD TCY_FN1300P_HI "FN1300P_HI Y-axis conversion" RAT_FUNC "%10.5" "unitless" COEFFS 0 1 0 0 0 1 /end COMPU_METHOD
/begin CHARACTERISTIC FN1300P_LO "X Norm=FN011P, Y Norm=FN031P" MAP 0x49E4C TD_FLOAT32_IEEE 0 TCZ_FN1300P_LO 0 30
 /begin AXIS_DESCR FIX_AXIS NO_INPUT_QUANTITY TCX_FN1300P_LO 11 0 10 FIX_AXIS_PAR 0 0 11 /end AXIS_DESCR
 /begin AXIS_DESCR FIX_AXIS NO_INPUT_QUANTITY TCY_FN1300P_LO 10 0 9 FIX_AXIS_PAR 0 0 10 /end AXIS_DESCR
/end CHARACTERISTIC
/begin COMPU_METHOD TCZ_FN1300P_LO "FN1300P_LO Z-axis conversion" RAT_FUNC "%10.5" "unitless" COEFFS 0 1 0 0 0 1 /end COMPU_METHOD
/begin COMPU_METHOD TCX_FN1300P_LO "FN1300P_LO X-axis conversion" RAT_FUNC "%10.5" "RPM" COEFFS 0 1 0 0 0 1 /end COMPU_METHOD
/begin COMPU_METHOD TCY_FN1300P_LO "FN1300P_LO Y-axis conversion" RAT_FUNC "%10.5" "unitless" COEFFS 0 1 0 0 0 1 /end COMPU_METHOD
/begin CHARACTERISTIC FN1300P_MED "X Norm=FN011P, Y Norm=FN031P" MAP 0x4A004 TD_FLOAT32_IEEE 0 TCZ_FN1300P_MED 0 30
 /begin AXIS_DESCR FIX_AXIS NO_INPUT_QUANTITY TCX_FN1300P_MED 11 0 10 FIX_AXIS_PAR 0 0 11 /end AXIS_DESCR
 /begin AXIS_DESCR FIX_AXIS NO_INPUT_QUANTITY TCY_FN1300P_MED 10 0 9 FIX_AXIS_PAR 0 0 10 /end AXIS_DESCR
/end CHARACTERISTIC
/begin COMPU_METHOD TCZ_FN1300P_MED "FN1300P_MED Z-axis conversion" RAT_FUNC "%10.5" "unitless" COEFFS 0 1 0 0 0 1 /end COMPU_METHOD
/begin COMPU_METHOD TCX_FN1300P_MED "FN1300P_MED X-axis conversion" RAT_FUNC "%10.5" "RPM" COEFFS 0 1 0 0 0 1 /end COMPU_METHOD
/begin COMPU_METHOD TCY_FN1300P_MED "FN1300P_MED Y-axis conversion" RAT_FUNC "%10.5" "unitless" COEFFS 0 1 0 0 0 1 /end COMPU_METHOD
/begin CHARACTERISTIC FN1300_HI "X Norm=FN011DS, Y Norm=FN031DS" MAP 0x49C94 TD_FLOAT32_IEEE 0 TCZ_FN1300_HI 0 30
 /begin AXIS_DESCR FIX_AXIS NO_INPUT_QUANTITY TCX_FN1300_HI 11 0 10 FIX_AXIS_PAR 0 0 11 /end AXIS_DESCR
 /begin AXIS_DESCR FIX_AXIS NO_INPUT_QUANTITY TCY_FN1300_HI 10 0 9 FIX_AXIS_PAR 0 0 10 /end AXIS_DESCR
/end CHARACTERISTIC
/begin COMPU_METHOD TCZ_FN1300_HI "FN1300_HI Z-axis conversion" RAT_FUNC "%10.5" "unitless" COEFFS 0 1 0 0 0 1 /end COMPU_METHOD
/begin COMPU_METHOD TCX_FN1300_HI "FN1300_HI X-axis conversion" RAT_FUNC "%10.5" "RPM" COEFFS 0 1 0 0 0 1 /end COMPU_METHOD
/begin COMPU_METHOD TCY_FN1300_HI "FN1300_HI Y-axis conversion" RAT_FUNC "%10.5" "unitless" COEFFS 0 1 0 0 0 1 /end COMPU_METHOD
/begin CHARACTERISTIC FN1300_LO "X Norm=FN011DS, Y Norm=FN031DS" MAP 0x49924 TD_FLOAT32_IEEE 0 TCZ_FN1300_LO 0 30
 /begin AXIS_DESCR FIX_AXIS NO_INPUT_QUANTITY TCX_FN1300_LO 11 0 10 FIX_AXIS_PAR 0 0 11 /end AXIS_DESCR
 /begin AXIS_DESCR FIX_AXIS NO_INPUT_QUANTITY TCY_FN1300_LO 10 0 9 FIX_AXIS_PAR 0 0 10 /end AXIS_DESCR
/end CHARACTERISTIC
/begin COMPU_METHOD TCZ_FN1300_LO "FN1300_LO Z-axis conversion" RAT_FUNC "%10.5" "unitless" COEFFS 0 1 0 0 0 1 /end COMPU_METHOD
/begin COMPU_METHOD TCX_FN1300_LO "FN1300_LO X-axis conversion" RAT_FUNC "%10.5" "RPM" COEFFS 0 1 0 0 0 1 /end COMPU_METHOD
/begin COMPU_METHOD TCY_FN1300_LO "FN1300_LO Y-axis conversion" RAT_FUNC "%10.5" "unitless" COEFFS 0 1 0 0 0 1 /end COMPU_METHOD
/begin CHARACTERISTIC FN1300_MED "X Norm=FN011DS, Y Norm=FN031DS" MAP 0x49ADC TD_FLOAT32_IEEE 0 TCZ_FN1300_MED 0 30
 /begin AXIS_DESCR FIX_AXIS NO_INPUT_QUANTITY TCX_FN1300_MED 11 0 10 FIX_AXIS_PAR 0 0 11 /end AXIS_DESCR
 /begin AXIS_DESCR FIX_AXIS NO_INPUT_QUANTITY TCY_FN1300_MED 10 0 9 FIX_AXIS_PAR 0 0 10 /end AXIS_DESCR
/end CHARACTERISTIC
/begin COMPU_METHOD TCZ_FN1300_MED "FN1300_MED Z-axis conversion" RAT_FUNC "%10.5" "unitless" COEFFS 0 1 0 0 0 1 /end COMPU_METHOD
/begin COMPU_METHOD TCX_FN1300_MED "FN1300_MED X-axis conversion" RAT_FUNC "%10.5" "RPM" COEFFS 0 1 0 0 0 1 /end COMPU_METHOD
/begin COMPU_METHOD TCY_FN1300_MED "FN1300_MED Y-axis conversion" RAT_FUNC "%10.5" "unitless" COEFFS 0 1 0 0 0 1 /end COMPU_METHOD
/begin CHARACTERISTIC FN1301DS "X Norm=FN039DS, Y Norm=FN038DS, Pilot mode VFDES multiplier table" MAP 0x43754 TD_FLOAT32_IEEE 0 TCZ_FN1301DS 0 1.9999
 /begin AXIS_DESCR FIX_AXIS NO_INPUT_QUANTITY TCX_FN1301DS 10 0 9 FIX_AXIS_PAR 0 0 10 /end AXIS_DESCR
 /begin AXIS_DESCR FIX_AXIS NO_INPUT_QUANTITY TCY_FN1301DS 10 0 9 FIX_AXIS_PAR 0 0 10 /end AXIS_DESCR
/end CHARACTERISTIC
/begin COMPU_METHOD TCZ_FN1301DS "FN1301DS Z-axis conversion" RAT_FUNC "%10.5" "unitless" COEFFS 0 1 0 0 0 1 /end COMPU_METHOD
/begin COMPU_METHOD TCX_FN1301DS "FN1301DS X-axis conversion" RAT_FUNC "%10.5" "RPM" COEFFS 0 1 0 0 0 1 /end COMPU_METHOD
/begin COMPU_METHOD TCY_FN1301DS "FN1301DS Y-axis conversion" RAT_FUNC "%10.5" "unitless" COEFFS 0 1 0 0 0 1 /end COMPU_METHOD
/begin CHARACTERISTIC FN1302 "X Norm=FN053DS, Y Norm=FN052DS, Pilot mode VFDES multiplier table" MAP 0x438E4 TD_FLOAT32_IEEE 0 TCZ_FN1302 0 1.9999
 /begin AXIS_DESCR FIX_AXIS NO_INPUT_QUANTITY TCX_FN1302 10 0 9 FIX_AXIS_PAR 0 0 10 /end AXIS_DESCR
 /begin AXIS_DESCR FIX_AXIS NO_INPUT_QUANTITY TCY_FN1302 10 0 9 FIX_AXIS_PAR 0 0 10 /end AXIS_DESCR
/end CHARACTERISTIC
/begin COMPU_METHOD TCZ_FN1302 "FN1302 Z-axis conversion" RAT_FUNC "%10.5" "unitless" COEFFS 0 1 0 0 0 1 /end COMPU_METHOD
/begin COMPU_METHOD TCX_FN1302 "FN1302 X-axis conversion" RAT_FUNC "%10.5" "RPM" COEFFS 0 1 0 0 0 1 /end COMPU_METHOD
/begin COMPU_METHOD TCY_FN1302 "FN1302 Y-axis conversion" RAT_FUNC "%10.5" "unitless" COEFFS 0 1 0 0 0 1 /end COMPU_METHOD
/begin CHARACTERISTIC FN1303DSH "X Norm=FN058DS, Y Norm=FN057DS" MAP 0x46DEC TD_FLOAT32_IEEE 0 TCZ_FN1303DSH -500 500
 /begin AXIS_DESCR FIX_AXIS NO_INPUT_QUANTITY TCX_FN1303DSH 10 0 9 FIX_AXIS_PAR 0 0 10 /end AXIS_DESCR
 /begin AXIS_DESCR FIX_AXIS NO_INPUT_QUANTITY TCY_FN1303DSH 10 0 9 FIX_AXIS_PAR 0 0 10 /end AXIS_DESCR
/end CHARACTERISTIC
/begin COMPU_METHOD TCZ_FN1303DSH "FN1303DSH Z-axis conversion" RAT_FUNC "%10.5" "unitless" COEFFS 0 1 0 0 0 1 /end COMPU_METHOD
/begin COMPU_METHOD TCX_FN1303DSH "FN1303DSH X-axis conversion" RAT_FUNC "%10.5" "unitless" COEFFS 0 1 0 0 0 1 /end COMPU_METHOD
/begin COMPU_METHOD TCY_FN1303DSH "FN1303DSH Y-axis conversion" RAT_FUNC "%10.5" "unitless" COEFFS 0 1 0 0 0 1 /end COMPU_METHOD
/begin CHARACTERISTIC FN1303DSL "X Norm=FN058DS, Y Norm=FN057DS" MAP 0x46ACC TD_FLOAT32_IEEE 0 TCZ_FN1303DSL -500 500
 /begin AXIS_DESCR FIX_AXIS NO_INPUT_QUANTITY TCX_FN1303DSL 10 0 9 FIX_AXIS_PAR 0 0 10 /end AXIS_DESCR
 /begin AXIS_DESCR FIX_AXIS NO_INPUT_QUANTITY TCY_FN1303DSL 10 0 9 FIX_AXIS_PAR 0 0 10 /end AXIS_DESCR
/end CHARACTERISTIC
/begin COMPU_METHOD TCZ_FN1303DSL "FN1303DSL Z-axis conversion" RAT_FUNC "%10.5" "unitless" COEFFS 0 1 0 0 0 1 /end COMPU_METHOD
/begin COMPU_METHOD TCX_FN1303DSL "FN1303DSL X-axis conversion" RAT_FUNC "%10.5" "unitless" COEFFS 0 1 0 0 0 1 /end COMPU_METHOD
/begin COMPU_METHOD TCY_FN1303DSL "FN1303DSL Y-axis conversion" RAT_FUNC "%10.5" "unitless" COEFFS 0 1 0 0 0 1 /end COMPU_METHOD
/begin CHARACTERISTIC FN1303DSM "X Norm=FN058DS, Y Norm=FN057DS" MAP 0x46C5C TD_FLOAT32_IEEE 0 TCZ_FN1303DSM -500 500
 /begin AXIS_DESCR FIX_AXIS NO_INPUT_QUANTITY TCX_FN1303DSM 10 0 9 FIX_AXIS_PAR 0 0 10 /end AXIS_DESCR
 /begin AXIS_DESCR FIX_AXIS NO_INPUT_QUANTITY TCY_FN1303DSM 10 0 9 FIX_AXIS_PAR 0 0 10 /end AXIS_DESCR
/end CHARACTERISTIC
/begin COMPU_METHOD TCZ_FN1303DSM "FN1303DSM Z-axis conversion" RAT_FUNC "%10.5" "unitless" COEFFS 0 1 0 0 0 1 /end COMPU_METHOD
/begin COMPU_METHOD TCX_FN1303DSM "FN1303DSM X-axis conversion" RAT_FUNC "%10.5" "unitless" COEFFS 0 1 0 0 0 1 /end COMPU_METHOD
/begin COMPU_METHOD TCY_FN1303DSM "FN1303DSM Y-axis conversion" RAT_FUNC "%10.5" "unitless" COEFFS 0 1 0 0 0 1 /end COMPU_METHOD
/begin CHARACTERISTIC FN1304DSH "X Norm=FN060DS, Y Norm=FN059DS" MAP 0x4693C TD_FLOAT32_IEEE 0 TCZ_FN1304DSH -500 500
 /begin AXIS_DESCR FIX_AXIS NO_INPUT_QUANTITY TCX_FN1304DSH 10 0 9 FIX_AXIS_PAR 0 0 10 /end AXIS_DESCR
 /begin AXIS_DESCR FIX_AXIS NO_INPUT_QUANTITY TCY_FN1304DSH 10 0 9 FIX_AXIS_PAR 0 0 10 /end AXIS_DESCR
/end CHARACTERISTIC
/begin COMPU_METHOD TCZ_FN1304DSH "FN1304DSH Z-axis conversion" RAT_FUNC "%10.5" "unitless" COEFFS 0 1 0 0 0 1 /end COMPU_METHOD
/begin COMPU_METHOD TCX_FN1304DSH "FN1304DSH X-axis conversion" RAT_FUNC "%10.5" "unitless" COEFFS 0 1 0 0 0 1 /end COMPU_METHOD
/begin COMPU_METHOD TCY_FN1304DSH "FN1304DSH Y-axis conversion" RAT_FUNC "%10.5" "unitless" COEFFS 0 1 0 0 0 1 /end COMPU_METHOD
/begin CHARACTERISTIC FN1304DSL "X Norm=FN060DS, Y Norm=FN059DS" MAP 0x4661C TD_FLOAT32_IEEE 0 TCZ_FN1304DSL -500 500
 /begin AXIS_DESCR FIX_AXIS NO_INPUT_QUANTITY TCX_FN1304DSL 10 0 9 FIX_AXIS_PAR 0 0 10 /end AXIS_DESCR
 /begin AXIS_DESCR FIX_AXIS NO_INPUT_QUANTITY TCY_FN1304DSL 10 0 9 FIX_AXIS_PAR 0 0 10 /end AXIS_DESCR
/end CHARACTERISTIC
/begin COMPU_METHOD TCZ_FN1304DSL "FN1304DSL Z-axis conversion" RAT_FUNC "%10.5" "unitless" COEFFS 0 1 0 0 0 1 /end COMPU_METHOD
/begin COMPU_METHOD TCX_FN1304DSL "FN1304DSL X-axis conversion" RAT_FUNC "%10.5" "unitless" COEFFS 0 1 0 0 0 1 /end COMPU_METHOD
/begin COMPU_METHOD TCY_FN1304DSL "FN1304DSL Y-axis conversion" RAT_FUNC "%10.5" "unitless" COEFFS 0 1 0 0 0 1 /end COMPU_METHOD
/begin CHARACTERISTIC FN1304DSM "X Norm=FN060DS, Y Norm=FN059DS" MAP 0x467AC TD_FLOAT32_IEEE 0 TCZ_FN1304DSM -500 500
 /begin AXIS_DESCR FIX_AXIS NO_INPUT_QUANTITY TCX_FN1304DSM 10 0 9 FIX_AXIS_PAR 0 0 10 /end AXIS_DESCR
 /begin AXIS_DESCR FIX_AXIS NO_INPUT_QUANTITY TCY_FN1304DSM 10 0 9 FIX_AXIS_PAR 0 0 10 /end AXIS_DESCR
/end CHARACTERISTIC
/begin COMPU_METHOD TCZ_FN1304DSM "FN1304DSM Z-axis conversion" RAT_FUNC "%10.5" "unitless" COEFFS 0 1 0 0 0 1 /end COMPU_METHOD
/begin COMPU_METHOD TCX_FN1304DSM "FN1304DSM X-axis conversion" RAT_FUNC "%10.5" "unitless" COEFFS 0 1 0 0 0 1 /end COMPU_METHOD
/begin COMPU_METHOD TCY_FN1304DSM "FN1304DSM Y-axis conversion" RAT_FUNC "%10.5" "unitless" COEFFS 0 1 0 0 0 1 /end COMPU_METHOD
/begin CHARACTERISTIC FN1307DS "X Norm=FN065, Y Norm=FN064, Pilot mode VFDES multiplier table" MAP 0x43A74 TD_FLOAT32_IEEE 0 TCZ_FN1307DS 0 1.9999
 /begin AXIS_DESCR FIX_AXIS NO_INPUT_QUANTITY TCX_FN1307DS 10 0 9 FIX_AXIS_PAR 0 0 10 /end AXIS_DESCR
 /begin AXIS_DESCR FIX_AXIS NO_INPUT_QUANTITY TCY_FN1307DS 10 0 9 FIX_AXIS_PAR 0 0 10 /end AXIS_DESCR
/end CHARACTERISTIC
/begin COMPU_METHOD TCZ_FN1307DS "FN1307DS Z-axis conversion" RAT_FUNC "%10.5" "unitless" COEFFS 0 1 0 0 0 1 /end COMPU_METHOD
/begin COMPU_METHOD TCX_FN1307DS "FN1307DS X-axis conversion" RAT_FUNC "%10.5" "RPM" COEFFS 0 1 0 0 0 1 /end COMPU_METHOD
/begin COMPU_METHOD TCY_FN1307DS "FN1307DS Y-axis conversion" RAT_FUNC "%10.5" "unitless" COEFFS 0 1 0 0 0 1 /end COMPU_METHOD
/begin MEASUREMENT FN1307_OUT "FN1307 output" FLOAT32_IEEE MC_FN1307_OUT 0 0 0 0 ECU_ADDRESS 0x3FA300 /end MEASUREMENT
/begin COMPU_METHOD MC_FN1307_OUT "FN1307_OUT conversion" RAT_FUNC "%10.5" "Unitless" COEFFS 0 1 0 0 0 1 /end COMPU_METHOD
/begin CHARACTERISTIC FN1400 "X Norm=FN047DS, Y Norm=FN046DS, ICP control feed forward table" MAP 0x4A374 TD_FLOAT32_IEEE 0 TCZ_FN1400 0 1
 /begin AXIS_DESCR FIX_AXIS NO_INPUT_QUANTITY TCX_FN1400 11 0 10 FIX_AXIS_PAR 0 0 11 /end AXIS_DESCR
 /begin AXIS_DESCR FIX_AXIS NO_INPUT_QUANTITY TCY_FN1400 11 0 10 FIX_AXIS_PAR 0 0 11 /end AXIS_DESCR
/end CHARACTERISTIC
/begin COMPU_METHOD TCZ_FN1400 "FN1400 Z-axis conversion" RAT_FUNC "%10.5" "MPa" COEFFS 0 1 0 0 0 1 /end COMPU_METHOD
/begin COMPU_METHOD TCX_FN1400 "FN1400 X-axis conversion" RAT_FUNC "%10.5" "MPa" COEFFS 0 1 0 0 0 1 /end COMPU_METHOD
/begin COMPU_METHOD TCY_FN1400 "FN1400 Y-axis conversion" RAT_FUNC "%10.5" "L/min" COEFFS 0 1 0 0 0 1 /end COMPU_METHOD
/begin CHARACTERISTIC FN1401 "X Norm=FN040DS, Y Norm=FN041DS, ICP Dashpot setpoint table" MAP 0x4A558 TD_FLOAT32_IEEE 0 TCZ_FN1401 -1 1
 /begin AXIS_DESCR FIX_AXIS NO_INPUT_QUANTITY TCX_FN1401 11 0 10 FIX_AXIS_PAR 0 0 11 /end AXIS_DESCR
 /begin AXIS_DESCR FIX_AXIS NO_INPUT_QUANTITY TCY_FN1401 11 0 10 FIX_AXIS_PAR 0 0 11 /end AXIS_DESCR
/end CHARACTERISTIC
/begin COMPU_METHOD TCZ_FN1401 "FN1401 Z-axis conversion" RAT_FUNC "%10.5" "unitless" COEFFS 0 1 0 0 0 1 /end COMPU_METHOD
/begin COMPU_METHOD TCX_FN1401 "FN1401 X-axis conversion" RAT_FUNC "%10.5" "RPM" COEFFS 0 1 0 0 0 1 /end COMPU_METHOD
/begin COMPU_METHOD TCY_FN1401 "FN1401 Y-axis conversion" RAT_FUNC "%10.5" "unitless" COEFFS 0 1 0 0 0 1 /end COMPU_METHOD
/begin CHARACTERISTIC FN1619 "X Norm=FN070C, Y Norm=FNAC_NORM, A/C Torque mapping data as a function of engine speed, FN070C and A/C pressure, FNAC_NORM." MAP 0x40E14 TD_FLOAT32_IEEE 0 TCZ_FN1619 0 510
 /begin AXIS_DESCR FIX_AXIS NO_INPUT_QUANTITY TCX_FN1619 6 0 5 FIX_AXIS_PAR 0 0 6 /end AXIS_DESCR
 /begin AXIS_DESCR FIX_AXIS NO_INPUT_QUANTITY TCY_FN1619 6 0 5 FIX_AXIS_PAR 0 0 6 /end AXIS_DESCR
/end CHARACTERISTIC
/begin COMPU_METHOD TCZ_FN1619 "FN1619 Z-axis conversion" RAT_FUNC "%10.5" "lbf*ft" COEFFS 0 1 0 0 0 1 /end COMPU_METHOD
/begin COMPU_METHOD TCX_FN1619 "FN1619 X-axis conversion" RAT_FUNC "%10.5" "RPM" COEFFS 0 1 0 0 0 1 /end COMPU_METHOD
/begin COMPU_METHOD TCY_FN1619 "FN1619 Y-axis conversion" RAT_FUNC "%10.5" "PSI" COEFFS 0 1 0 0 0 1 /end COMPU_METHOD
/begin CHARACTERISTIC FN2010DS "Custom Drive-by-Wire Pedal curve (Diesel)" CURVE 0x4202C FD_FLOAT32_IEEE 0 FCY_FN2010DS 0 1023 /begin AXIS_DESCR STD_AXIS NO_INPUT_QUANTITY FCX_FN2010DS 14 0 1023 /end AXIS_DESCR /end CHARACTERISTIC
/begin COMPU_METHOD FCX_FN2010DS "FN2010DS X-axis conversion" RAT_FUNC "%10.5" "unitless" COEFFS 0 1 0 0 0 1 /end COMPU_METHOD
/begin COMPU_METHOD FCY_FN2010DS "FN2010DS Y-axis conversion" RAT_FUNC "%10.5" "unitless" COEFFS 0 1 0 0 0 1 /end COMPU_METHOD
/begin CHARACTERISTIC FN2011 "Variable filter constant based on PPS rate of chg" CURVE 0x4209C FD_FLOAT32_IEEE 0 FCY_FN2011 0 64 /begin AXIS_DESCR STD_AXIS AD_ROC_PPS FCX_FN2011 11 -512 512 /end AXIS_DESCR /end CHARACTERISTIC
/begin COMPU_METHOD FCX_FN2011 "FN2011 X-axis conversion" RAT_FUNC "%10.5" "unitless" COEFFS 0 1 0 0 0 1 /end COMPU_METHOD
/begin COMPU_METHOD FCY_FN2011 "FN2011 Y-axis conversion" RAT_FUNC "%10.5" "unitless" COEFFS 0 1 0 0 0 1 /end COMPU_METHOD
/begin CHARACTERISTIC FN2_TQ_LOALT_BASE_REV "X Norm=FN_TQ114, Y Norm=FN_TQ104, Fuel required for desired gross torque" MAP 0x4D8FC TD_FLOAT32_IEEE 0 TCZ_FN2_TQ_LOALT_BASE_REV 0 1000
 /begin AXIS_DESCR FIX_AXIS NO_INPUT_QUANTITY TCX_FN2_TQ_LOALT_BASE_REV 14 0 13 FIX_AXIS_PAR 0 0 14 /end AXIS_DESCR
 /begin AXIS_DESCR FIX_AXIS NO_INPUT_QUANTITY TCY_FN2_TQ_LOALT_BASE_REV 14 0 13 FIX_AXIS_PAR 0 0 14 /end AXIS_DESCR
/end CHARACTERISTIC
/begin COMPU_METHOD TCZ_FN2_TQ_LOALT_BASE_REV "FN2_TQ_LOALT_BASE_REV Z-axis conversion" RAT_FUNC "%10.5" "unitless" COEFFS 0 1 0 0 0 1 /end COMPU_METHOD
/begin COMPU_METHOD TCX_FN2_TQ_LOALT_BASE_REV "FN2_TQ_LOALT_BASE_REV X-axis conversion" RAT_FUNC "%10.5" "unitless" COEFFS 0 1 0 0 0 1 /end COMPU_METHOD
/begin COMPU_METHOD TCY_FN2_TQ_LOALT_BASE_REV "FN2_TQ_LOALT_BASE_REV Y-axis conversion" RAT_FUNC "%10.5" "lbf*ft" COEFFS 0 1 0 0 0 1 /end COMPU_METHOD
/begin CHARACTERISTIC FN2_TQ_MAX_BRK_CF "X Norm=FN_TQ100, Y Norm=FN_TQ101, Output a correction factor for the base torque curve." MAP 0x4CC5C TD_FLOAT32_IEEE 0 TCZ_FN2_TQ_MAX_BRK_CF 0 5
 /begin AXIS_DESCR FIX_AXIS NO_INPUT_QUANTITY TCX_FN2_TQ_MAX_BRK_CF 10 0 9 FIX_AXIS_PAR 0 0 10 /end AXIS_DESCR
 /begin AXIS_DESCR FIX_AXIS NO_INPUT_QUANTITY TCY_FN2_TQ_MAX_BRK_CF 10 0 9 FIX_AXIS_PAR 0 0 10 /end AXIS_DESCR
/end CHARACTERISTIC
/begin COMPU_METHOD TCZ_FN2_TQ_MAX_BRK_CF "FN2_TQ_MAX_BRK_CF Z-axis conversion" RAT_FUNC "%10.5" "unitless" COEFFS 0 1 0 0 0 1 /end COMPU_METHOD
/begin COMPU_METHOD TCX_FN2_TQ_MAX_BRK_CF "FN2_TQ_MAX_BRK_CF X-axis conversion" RAT_FUNC "%10.5" "degC" COEFFS 0 1 0 0 0 1 /end COMPU_METHOD
/begin COMPU_METHOD TCY_FN2_TQ_MAX_BRK_CF "FN2_TQ_MAX_BRK_CF Y-axis conversion" RAT_FUNC "%10.5" "kPa" COEFFS 0 1 0 0 0 1 /end COMPU_METHOD
/begin CHARACTERISTIC FN2_TQ_MIN_BRK_CF "X Norm=FN_TQ100, Y Norm=FN_TQ101, Output a correction factor for the motoring torquecurve." MAP 0x4CDFC TD_FLOAT32_IEEE 0 TCZ_FN2_TQ_MIN_BRK_CF 0 5
 /begin AXIS_DESCR FIX_AXIS NO_INPUT_QUANTITY TCX_FN2_TQ_MIN_BRK_CF 10 0 9 FIX_AXIS_PAR 0 0 10 /end AXIS_DESCR
 /begin AXIS_DESCR FIX_AXIS NO_INPUT_QUANTITY TCY_FN2_TQ_MIN_BRK_CF 10 0 9 FIX_AXIS_PAR 0 0 10 /end AXIS_DESCR
/end CHARACTERISTIC
/begin COMPU_METHOD TCZ_FN2_TQ_MIN_BRK_CF "FN2_TQ_MIN_BRK_CF Z-axis conversion" RAT_FUNC "%10.5" "unitless" COEFFS 0 1 0 0 0 1 /end COMPU_METHOD
/begin COMPU_METHOD TCX_FN2_TQ_MIN_BRK_CF "FN2_TQ_MIN_BRK_CF X-axis conversion" RAT_FUNC "%10.5" "degC" COEFFS 0 1 0 0 0 1 /end COMPU_METHOD
/begin COMPU_METHOD TCY_FN2_TQ_MIN_BRK_CF "FN2_TQ_MIN_BRK_CF Y-axis conversion" RAT_FUNC "%10.5" "kPa" COEFFS 0 1 0 0 0 1 /end COMPU_METHOD
/begin CHARACTERISTIC FN352DS "MAF frequency to eng units (gram/sec) transfer function" CURVE 0x53A1C FD_FLOAT32_IEEE 0 FCY_FN352DS 0 744 /begin AXIS_DESCR STD_AXIS NO_INPUT_QUANTITY FCX_FN352DS 25 0 20000 /end AXIS_DESCR /end CHARACTERISTIC
/begin COMPU_METHOD FCX_FN352DS "FN352DS X-axis conversion" RAT_FUNC "%10.5" "Hz" COEFFS 0 1 0 0 0 1 /end COMPU_METHOD
/begin COMPU_METHOD FCY_FN352DS "FN352DS Y-axis conversion" RAT_FUNC "%10.5" "g/s" COEFFS 0 1 0 0 0 1 /end COMPU_METHOD
/begin CHARACTERISTIC FN352_ANALOG "MAF A/D counts to eng units (g/s) transfer function" CURVE 0x5399C FD_FLOAT32_IEEE 0 FCY_FN352_ANALOG 0 750 /begin AXIS_DESCR STD_AXIS MAF_CNTS FCX_FN352_ANALOG 15 0 1023 /end AXIS_DESCR /end CHARACTERISTIC
/begin COMPU_METHOD FCX_FN352_ANALOG "FN352_ANALOG X-axis conversion" RAT_FUNC "%10.5" "ADct" COEFFS 0 1 0 0 0 1 /end COMPU_METHOD
/begin COMPU_METHOD FCY_FN352_ANALOG "FN352_ANALOG Y-axis conversion" RAT_FUNC "%10.5" "g/s" COEFFS 0 1 0 0 0 1 /end COMPU_METHOD
/begin CHARACTERISTIC FN402 "Viscosity based offset to desired rail pressure" CURVE 0x496FC FD_FLOAT32_IEEE 0 FCY_FN402 0 21 /begin AXIS_DESCR STD_AXIS NORM_FN027 FCX_FN402 8 -16 16 /end AXIS_DESCR /end CHARACTERISTIC
/begin COMPU_METHOD FCX_FN402 "FN402 X-axis conversion" RAT_FUNC "%10.5" "unitless" COEFFS 0 1 0 0 0 1 /end COMPU_METHOD
/begin COMPU_METHOD FCY_FN402 "FN402 Y-axis conversion" RAT_FUNC "%10.5" "unitless" COEFFS 0 1 0 0 0 1 /end COMPU_METHOD
/begin CHARACTERISTIC FN403 "Engine oil temp multiplier" CURVE 0x4973C FD_FLOAT32_IEEE 0 FCY_FN403 0 5 /begin AXIS_DESCR STD_AXIS EOT_C FCX_FN403 9 -40 150 /end AXIS_DESCR /end CHARACTERISTIC
/begin COMPU_METHOD FCX_FN403 "FN403 X-axis conversion" RAT_FUNC "%10.5" "degC" COEFFS 0 1 0 0 0 1 /end COMPU_METHOD
/begin COMPU_METHOD FCY_FN403 "FN403 Y-axis conversion" RAT_FUNC "%10.5" "unitless" COEFFS 0 1 0 0 0 1 /end COMPU_METHOD
/begin CHARACTERISTIC FN4444DSH "X Norm=FN056DS, Y Norm=FN055DS" MAP 0x47204 TD_FLOAT32_IEEE 0 TCZ_FN4444DSH -500 500
 /begin AXIS_DESCR FIX_AXIS NO_INPUT_QUANTITY TCX_FN4444DSH 9 0 8 FIX_AXIS_PAR 0 0 9 /end AXIS_DESCR
 /begin AXIS_DESCR FIX_AXIS NO_INPUT_QUANTITY TCY_FN4444DSH 9 0 8 FIX_AXIS_PAR 0 0 9 /end AXIS_DESCR
/end CHARACTERISTIC
/begin COMPU_METHOD TCZ_FN4444DSH "FN4444DSH Z-axis conversion" RAT_FUNC "%10.5" "unitless" COEFFS 0 1 0 0 0 1 /end COMPU_METHOD
/begin COMPU_METHOD TCX_FN4444DSH "FN4444DSH X-axis conversion" RAT_FUNC "%10.5" "unitless" COEFFS 0 1 0 0 0 1 /end COMPU_METHOD
/begin COMPU_METHOD TCY_FN4444DSH "FN4444DSH Y-axis conversion" RAT_FUNC "%10.5" "unitless" COEFFS 0 1 0 0 0 1 /end COMPU_METHOD
/begin CHARACTERISTIC FN4444DSL "X Norm=FN056DS, Y Norm=FN055DS" MAP 0x46F7C TD_FLOAT32_IEEE 0 TCZ_FN4444DSL -500 500
 /begin AXIS_DESCR FIX_AXIS NO_INPUT_QUANTITY TCX_FN4444DSL 9 0 8 FIX_AXIS_PAR 0 0 9 /end AXIS_DESCR
 /begin AXIS_DESCR FIX_AXIS NO_INPUT_QUANTITY TCY_FN4444DSL 9 0 8 FIX_AXIS_PAR 0 0 9 /end AXIS_DESCR
/end CHARACTERISTIC
/begin COMPU_METHOD TCZ_FN4444DSL "FN4444DSL Z-axis conversion" RAT_FUNC "%10.5" "unitless" COEFFS 0 1 0 0 0 1 /end COMPU_METHOD
/begin COMPU_METHOD TCX_FN4444DSL "FN4444DSL X-axis conversion" RAT_FUNC "%10.5" "unitless" COEFFS 0 1 0 0 0 1 /end COMPU_METHOD
/begin COMPU_METHOD TCY_FN4444DSL "FN4444DSL Y-axis conversion" RAT_FUNC "%10.5" "unitless" COEFFS 0 1 0 0 0 1 /end COMPU_METHOD
/begin CHARACTERISTIC FN4444DSM "X Norm=FN056DS, Y Norm=FN055DS" MAP 0x470C0 TD_FLOAT32_IEEE 0 TCZ_FN4444DSM -500 500
 /begin AXIS_DESCR FIX_AXIS NO_INPUT_QUANTITY TCX_FN4444DSM 9 0 8 FIX_AXIS_PAR 0 0 9 /end AXIS_DESCR
 /begin AXIS_DESCR FIX_AXIS NO_INPUT_QUANTITY TCY_FN4444DSM 9 0 8 FIX_AXIS_PAR 0 0 9 /end AXIS_DESCR
/end CHARACTERISTIC
/begin COMPU_METHOD TCZ_FN4444DSM "FN4444DSM Z-axis conversion" RAT_FUNC "%10.5" "unitless" COEFFS 0 1 0 0 0 1 /end COMPU_METHOD
/begin COMPU_METHOD TCX_FN4444DSM "FN4444DSM X-axis conversion" RAT_FUNC "%10.5" "unitless" COEFFS 0 1 0 0 0 1 /end COMPU_METHOD
/begin COMPU_METHOD TCY_FN4444DSM "FN4444DSM Y-axis conversion" RAT_FUNC "%10.5" "unitless" COEFFS 0 1 0 0 0 1 /end COMPU_METHOD
/begin CHARACTERISTIC FN4444PH "X Norm=FN056DS, Y Norm=FN055DS" MAP 0x475D0 TD_FLOAT32_IEEE 0 TCZ_FN4444PH -500 500
 /begin AXIS_DESCR FIX_AXIS NO_INPUT_QUANTITY TCX_FN4444PH 9 0 8 FIX_AXIS_PAR 0 0 9 /end AXIS_DESCR
 /begin AXIS_DESCR FIX_AXIS NO_INPUT_QUANTITY TCY_FN4444PH 9 0 8 FIX_AXIS_PAR 0 0 9 /end AXIS_DESCR
/end CHARACTERISTIC
/begin COMPU_METHOD TCZ_FN4444PH "FN4444PH Z-axis conversion" RAT_FUNC "%10.5" "unitless" COEFFS 0 1 0 0 0 1 /end COMPU_METHOD
/begin COMPU_METHOD TCX_FN4444PH "FN4444PH X-axis conversion" RAT_FUNC "%10.5" "unitless" COEFFS 0 1 0 0 0 1 /end COMPU_METHOD
/begin COMPU_METHOD TCY_FN4444PH "FN4444PH Y-axis conversion" RAT_FUNC "%10.5" "unitless" COEFFS 0 1 0 0 0 1 /end COMPU_METHOD
/begin CHARACTERISTIC FN4444PL "X Norm=FN056DS, Y Norm=FN055DS" MAP 0x47348 TD_FLOAT32_IEEE 0 TCZ_FN4444PL -500 500
 /begin AXIS_DESCR FIX_AXIS NO_INPUT_QUANTITY TCX_FN4444PL 9 0 8 FIX_AXIS_PAR 0 0 9 /end AXIS_DESCR
 /begin AXIS_DESCR FIX_AXIS NO_INPUT_QUANTITY TCY_FN4444PL 9 0 8 FIX_AXIS_PAR 0 0 9 /end AXIS_DESCR
/end CHARACTERISTIC
/begin COMPU_METHOD TCZ_FN4444PL "FN4444PL Z-axis conversion" RAT_FUNC "%10.5" "unitless" COEFFS 0 1 0 0 0 1 /end COMPU_METHOD
/begin COMPU_METHOD TCX_FN4444PL "FN4444PL X-axis conversion" RAT_FUNC "%10.5" "unitless" COEFFS 0 1 0 0 0 1 /end COMPU_METHOD
/begin COMPU_METHOD TCY_FN4444PL "FN4444PL Y-axis conversion" RAT_FUNC "%10.5" "unitless" COEFFS 0 1 0 0 0 1 /end COMPU_METHOD
/begin CHARACTERISTIC FN4444PM "X Norm=FN056DS, Y Norm=FN055DS" MAP 0x4748C TD_FLOAT32_IEEE 0 TCZ_FN4444PM -500 500
 /begin AXIS_DESCR FIX_AXIS NO_INPUT_QUANTITY TCX_FN4444PM 9 0 8 FIX_AXIS_PAR 0 0 9 /end AXIS_DESCR
 /begin AXIS_DESCR FIX_AXIS NO_INPUT_QUANTITY TCY_FN4444PM 9 0 8 FIX_AXIS_PAR 0 0 9 /end AXIS_DESCR
/end CHARACTERISTIC
/begin COMPU_METHOD TCZ_FN4444PM "FN4444PM Z-axis conversion" RAT_FUNC "%10.5" "unitless" COEFFS 0 1 0 0 0 1 /end COMPU_METHOD
/begin COMPU_METHOD TCX_FN4444PM "FN4444PM X-axis conversion" RAT_FUNC "%10.5" "unitless" COEFFS 0 1 0 0 0 1 /end COMPU_METHOD
/begin COMPU_METHOD TCY_FN4444PM "FN4444PM Y-axis conversion" RAT_FUNC "%10.5" "unitless" COEFFS 0 1 0 0 0 1 /end COMPU_METHOD
/begin CHARACTERISTIC FN610A_SCP "Transfer function used when fuel level input is received over SCP bus." CURVE 0x5382C FD_FLOAT32_IEEE 0 FCY_FN610A_SCP 0 1.999 /begin AXIS_DESCR STD_AXIS NO_INPUT_QUANTITY FCX_FN610A_SCP 9 0 255 /end AXIS_DESCR /end CHARACTERISTIC
/begin COMPU_METHOD FCX_FN610A_SCP "FN610A_SCP X-axis conversion" RAT_FUNC "%10.5" "ADct" COEFFS 0 1 0 0 0 1 /end COMPU_METHOD
/begin COMPU_METHOD FCY_FN610A_SCP "FN610A_SCP Y-axis conversion" RAT_FUNC "%10.5" "%" COEFFS 0 1 0 0 0 1 /end COMPU_METHOD
/begin CHARACTERISTIC FN642V_C "Proportional ECT control in degC." CURVE 0x5349C FD_FLOAT32_IEEE 0 FCY_FN642V_C 0 7000 /begin AXIS_DESCR STD_AXIS VFD_ECT_ER_DEGC FCX_FN642V_C 6 -65536 65534 /end AXIS_DESCR /end CHARACTERISTIC
/begin COMPU_METHOD FCX_FN642V_C "FN642V_C X-axis conversion" RAT_FUNC "%10.5" "degC" COEFFS 0 1 0 0 0 1 /end COMPU_METHOD
/begin COMPU_METHOD FCY_FN642V_C "FN642V_C Y-axis conversion" RAT_FUNC "%10.5" "RPM" COEFFS 0 1 0 0 0 1 /end COMPU_METHOD
/begin CHARACTERISTIC FN7000 "X Norm=FN022DS, Y Norm=FN023DS, Glow plug lamp activation time table" MAP 0x4DD3C TD_FLOAT32_IEEE 0 TCZ_FN7000 0 300
 /begin AXIS_DESCR FIX_AXIS NO_INPUT_QUANTITY TCX_FN7000 11 0 10 FIX_AXIS_PAR 0 0 11 /end AXIS_DESCR
 /begin AXIS_DESCR FIX_AXIS NO_INPUT_QUANTITY TCY_FN7000 6 0 5 FIX_AXIS_PAR 0 0 6 /end AXIS_DESCR
/end CHARACTERISTIC
/begin COMPU_METHOD TCZ_FN7000 "FN7000 Z-axis conversion" RAT_FUNC "%10.5" "s" COEFFS 0 1 0 0 0 1 /end COMPU_METHOD
/begin COMPU_METHOD TCX_FN7000 "FN7000 X-axis conversion" RAT_FUNC "%10.5" "degC" COEFFS 0 1 0 0 0 1 /end COMPU_METHOD
/begin COMPU_METHOD TCY_FN7000 "FN7000 Y-axis conversion" RAT_FUNC "%10.5" "V" COEFFS 0 1 0 0 0 1 /end COMPU_METHOD
/begin CHARACTERISTIC FN700HIALT "GPC activation time function at high altitude" CURVE 0x4DCDC FD_FLOAT32_IEEE 0 FCY_FN700HIALT 0 300 /begin AXIS_DESCR STD_AXIS EOT_C FCX_FN700HIALT 12 -40 150 /end AXIS_DESCR /end CHARACTERISTIC
/begin COMPU_METHOD FCX_FN700HIALT "FN700HIALT X-axis conversion" RAT_FUNC "%10.5" "degC" COEFFS 0 1 0 0 0 1 /end COMPU_METHOD
/begin COMPU_METHOD FCY_FN700HIALT "FN700HIALT Y-axis conversion" RAT_FUNC "%10.5" "unitless" COEFFS 0 1 0 0 0 1 /end COMPU_METHOD
/begin CHARACTERISTIC FN700LOALT "GPC activation time function at low altitude" CURVE 0x4DC1C FD_FLOAT32_IEEE 0 FCY_FN700LOALT 0 300 /begin AXIS_DESCR STD_AXIS EOT_C FCX_FN700LOALT 12 -40 150 /end AXIS_DESCR /end CHARACTERISTIC
/begin COMPU_METHOD FCX_FN700LOALT "FN700LOALT X-axis conversion" RAT_FUNC "%10.5" "degC" COEFFS 0 1 0 0 0 1 /end COMPU_METHOD
/begin COMPU_METHOD FCY_FN700LOALT "FN700LOALT Y-axis conversion" RAT_FUNC "%10.5" "unitless" COEFFS 0 1 0 0 0 1 /end COMPU_METHOD
/begin CHARACTERISTIC FN701A "GPC modulation duty cycle function one time Power ON" CURVE 0x4DF34 FD_FLOAT32_IEEE 0 FCY_FN701A 0 0.99998 /begin AXIS_DESCR STD_AXIS IVPWR FCX_FN701A 8 0 25.2 /end AXIS_DESCR /end CHARACTERISTIC
/begin COMPU_METHOD FCX_FN701A "FN701A X-axis conversion" RAT_FUNC "%10.5" "V" COEFFS 0 1 0 0 0 1 /end COMPU_METHOD
/begin COMPU_METHOD FCY_FN701A "FN701A Y-axis conversion" RAT_FUNC "%10.5" "unitless" COEFFS 0 1 0 0 0 1 /end COMPU_METHOD
/begin CHARACTERISTIC FN701DS "GPC modulation duty cycle function" CURVE 0x4DEF4 FD_FLOAT32_IEEE 0 FCY_FN701DS 0 0.99998 /begin AXIS_DESCR STD_AXIS IVPWR FCX_FN701DS 8 0 25.2 /end AXIS_DESCR /end CHARACTERISTIC
/begin COMPU_METHOD FCX_FN701DS "FN701DS X-axis conversion" RAT_FUNC "%10.5" "V" COEFFS 0 1 0 0 0 1 /end COMPU_METHOD
/begin COMPU_METHOD FCY_FN701DS "FN701DS Y-axis conversion" RAT_FUNC "%10.5" "unitless" COEFFS 0 1 0 0 0 1 /end COMPU_METHOD
/begin CHARACTERISTIC FN702A "GPC modulation period calculation one time power on" CURVE 0x4DFB4 FD_FLOAT32_IEEE 0 FCY_FN702A 0 65535 /begin AXIS_DESCR STD_AXIS IVPWR FCX_FN702A 8 0 25.2 /end AXIS_DESCR /end CHARACTERISTIC
/begin COMPU_METHOD FCX_FN702A "FN702A X-axis conversion" RAT_FUNC "%10.5" "V" COEFFS 0 1 0 0 0 1 /end COMPU_METHOD
/begin COMPU_METHOD FCY_FN702A "FN702A Y-axis conversion" RAT_FUNC "%10.5" "ms" COEFFS 0 1 0 0 0 1 /end COMPU_METHOD
/begin CHARACTERISTIC FN702DS "GPC modulation period calculation" CURVE 0x4DF74 FD_FLOAT32_IEEE 0 FCY_FN702DS 0 65535 /begin AXIS_DESCR STD_AXIS IVPWR FCX_FN702DS 8 0 25.2 /end AXIS_DESCR /end CHARACTERISTIC
/begin COMPU_METHOD FCX_FN702DS "FN702DS X-axis conversion" RAT_FUNC "%10.5" "V" COEFFS 0 1 0 0 0 1 /end COMPU_METHOD
/begin COMPU_METHOD FCY_FN702DS "FN702DS Y-axis conversion" RAT_FUNC "%10.5" "ms" COEFFS 0 1 0 0 0 1 /end COMPU_METHOD
/begin CHARACTERISTIC FN704DS "Adder for glow plug lamp altitude compensation" CURVE 0x4DFF4 FD_FLOAT32_IEEE 0 FCY_FN704DS 0 30 /begin AXIS_DESCR STD_AXIS BP_KPA FCX_FN704DS 5 0 150 /end AXIS_DESCR /end CHARACTERISTIC
/begin COMPU_METHOD FCX_FN704DS "FN704DS X-axis conversion" RAT_FUNC "%10.5" "kPa" COEFFS 0 1 0 0 0 1 /end COMPU_METHOD
/begin COMPU_METHOD FCY_FN704DS "FN704DS Y-axis conversion" RAT_FUNC "%10.5" "s" COEFFS 0 1 0 0 0 1 /end COMPU_METHOD
/begin CHARACTERISTIC FN800DS "Exhaust back pressure sensor transfer function" CURVE 0x53B5C FD_FLOAT32_IEEE 0 FCY_FN800DS 0 400 /begin AXIS_DESCR STD_AXIS EBP_CNTS FCX_FN800DS 10 0 1023 /end AXIS_DESCR /end CHARACTERISTIC
/begin COMPU_METHOD FCX_FN800DS "FN800DS X-axis conversion" RAT_FUNC "%10.5" "ADct" COEFFS 0 1 0 0 0 1 /end COMPU_METHOD
/begin COMPU_METHOD FCY_FN800DS "FN800DS Y-axis conversion" RAT_FUNC "%10.5" "kPa" COEFFS 0 1 0 0 0 1 /end COMPU_METHOD
/begin CHARACTERISTIC FN808A "Engine oil temperature sensor transfer function" CURVE 0x5364C FD_FLOAT32_IEEE 0 FCY_FN808A -40 150 /begin AXIS_DESCR STD_AXIS EOT_CNTS FCX_FN808A 24 0 1023 /end AXIS_DESCR /end CHARACTERISTIC
/begin COMPU_METHOD FCX_FN808A "FN808A X-axis conversion" RAT_FUNC "%10.5" "ADct" COEFFS 0 1 0 0 0 1 /end COMPU_METHOD
/begin COMPU_METHOD FCY_FN808A "FN808A Y-axis conversion" RAT_FUNC "%10.5" "degC" COEFFS 0 1 0 0 0 1 /end COMPU_METHOD
/begin CHARACTERISTIC FN809A "Intake Air Temperature sensor transfer function" CURVE 0x53AEC FD_FLOAT32_IEEE 0 FCY_FN809A -40 150 /begin AXIS_DESCR STD_AXIS IAT_CNTS FCX_FN809A 14 0 1023 /end AXIS_DESCR /end CHARACTERISTIC
/begin COMPU_METHOD FCX_FN809A "FN809A X-axis conversion" RAT_FUNC "%10.5" "ADct" COEFFS 0 1 0 0 0 1 /end COMPU_METHOD
/begin COMPU_METHOD FCY_FN809A "FN809A Y-axis conversion" RAT_FUNC "%10.5" "degC" COEFFS 0 1 0 0 0 1 /end COMPU_METHOD
/begin CHARACTERISTIC FN809B "Manifold air temperature sensor transfer function" CURVE 0x5351C FD_FLOAT32_IEEE 0 FCY_FN809B -40 150 /begin AXIS_DESCR STD_AXIS MAT_CNTS FCX_FN809B 14 0 1023 /end AXIS_DESCR /end CHARACTERISTIC
/begin COMPU_METHOD FCX_FN809B "FN809B X-axis conversion" RAT_FUNC "%10.5" "ADct" COEFFS 0 1 0 0 0 1 /end COMPU_METHOD
/begin COMPU_METHOD FCY_FN809B "FN809B Y-axis conversion" RAT_FUNC "%10.5" "degC" COEFFS 0 1 0 0 0 1 /end COMPU_METHOD
/begin CHARACTERISTIC FNACC_DELAY "Delay to synchronise A/C ON and ISC compensation - with system not cycling" CURVE 0x40CBC FD_FLOAT32_IEEE 0 FCY_FNACC_DELAY 0 62 /begin AXIS_DESCR STD_AXIS NO_INPUT_QUANTITY FCX_FNACC_DELAY 6 0 16383.8 /end AXIS_DESCR /end CHARACTERISTIC
/begin COMPU_METHOD FCX_FNACC_DELAY "FNACC_DELAY X-axis conversion" RAT_FUNC "%10.5" "RPM" COEFFS 0 1 0 0 0 1 /end COMPU_METHOD
/begin COMPU_METHOD FCY_FNACC_DELAY "FNACC_DELAY Y-axis conversion" RAT_FUNC "%10.5" "s" COEFFS 0 1 0 0 0 1 /end COMPU_METHOD
/begin CHARACTERISTIC FNACC_DELAY2 "Delay to synchronise A/C ON and ISC compensation - with system cycling" CURVE 0x40CEC FD_FLOAT32_IEEE 0 FCY_FNACC_DELAY2 0 62 /begin AXIS_DESCR STD_AXIS N FCX_FNACC_DELAY2 6 0 16383.8 /end AXIS_DESCR /end CHARACTERISTIC
/begin COMPU_METHOD FCX_FNACC_DELAY2 "FNACC_DELAY2 X-axis conversion" RAT_FUNC "%10.5" "RPM" COEFFS 0 1 0 0 0 1 /end COMPU_METHOD
/begin COMPU_METHOD FCY_FNACC_DELAY2 "FNACC_DELAY2 Y-axis conversion" RAT_FUNC "%10.5" "s" COEFFS 0 1 0 0 0 1 /end COMPU_METHOD
/begin CHARACTERISTIC FNAC_MATNORM "MAT normalising function for FNAC_MINOFF table." CURVE 0x40BEC FD_FLOAT32_IEEE 0 FCY_FNAC_MATNORM 0 5 /begin AXIS_DESCR STD_AXIS MAT FCX_FNAC_MATNORM 6 -110 110 /end AXIS_DESCR /end CHARACTERISTIC
/begin COMPU_METHOD FCX_FNAC_MATNORM "FNAC_MATNORM X-axis conversion" RAT_FUNC "%10.5" "degC" COEFFS 0 1 0 0 0 1 /end COMPU_METHOD
/begin COMPU_METHOD FCY_FNAC_MATNORM "FNAC_MATNORM Y-axis conversion" RAT_FUNC "%10.5" "Unitless" COEFFS 0 1 0 0 0 1 /end COMPU_METHOD
/begin CHARACTERISTIC FNAC_MINOFF_D "X Norm=FNAC_MPHNORM, Y Norm=FNAC_MATNORM, A/C minimum off time as a function of MAT and vehicle speed." MAP 0x40C1C TD_FLOAT32_IEEE 0 TCZ_FNAC_MINOFF_D 0 62
 /begin AXIS_DESCR FIX_AXIS NO_INPUT_QUANTITY TCX_FNAC_MINOFF_D 6 0 5 FIX_AXIS_PAR 0 0 6 /end AXIS_DESCR
 /begin AXIS_DESCR FIX_AXIS NO_INPUT_QUANTITY TCY_FNAC_MINOFF_D 6 0 5 FIX_AXIS_PAR 0 0 6 /end AXIS_DESCR
/end CHARACTERISTIC
/begin COMPU_METHOD TCZ_FNAC_MINOFF_D "FNAC_MINOFF_D Z-axis conversion" RAT_FUNC "%10.5" "s" COEFFS 0 1 0 0 0 1 /end COMPU_METHOD
/begin COMPU_METHOD TCX_FNAC_MINOFF_D "FNAC_MINOFF_D X-axis conversion" RAT_FUNC "%10.5" "MPH" COEFFS 0 1 0 0 0 1 /end COMPU_METHOD
/begin COMPU_METHOD TCY_FNAC_MINOFF_D "FNAC_MINOFF_D Y-axis conversion" RAT_FUNC "%10.5" "degC" COEFFS 0 1 0 0 0 1 /end COMPU_METHOD
/begin CHARACTERISTIC FNAC_MPHNORM "MPH Filtered normalising function for FNAC_MINOFF table." CURVE 0x40BBC FD_FLOAT32_IEEE 0 FCY_FNAC_MPHNORM 0 5 /begin AXIS_DESCR STD_AXIS VSBAR FCX_FNAC_MPHNORM 6 0 127.5 /end AXIS_DESCR /end CHARACTERISTIC
/begin COMPU_METHOD FCX_FNAC_MPHNORM "FNAC_MPHNORM X-axis conversion" RAT_FUNC "%10.5" "MPH" COEFFS 0 1 0 0 0 1 /end COMPU_METHOD
/begin COMPU_METHOD FCY_FNAC_MPHNORM "FNAC_MPHNORM Y-axis conversion" RAT_FUNC "%10.5" "Unitless" COEFFS 0 1 0 0 0 1 /end COMPU_METHOD
/begin CHARACTERISTIC FNAC_NORM "ACPRES normalizing function." CURVE 0x40DDC FD_FLOAT32_IEEE 0 FCY_FNAC_NORM 0 5 /begin AXIS_DESCR STD_AXIS ACPRES FCX_FNAC_NORM 7 0 510 /end AXIS_DESCR /end CHARACTERISTIC
/begin COMPU_METHOD FCX_FNAC_NORM "FNAC_NORM X-axis conversion" RAT_FUNC "%10.5" "PSI" COEFFS 0 1 0 0 0 1 /end COMPU_METHOD
/begin COMPU_METHOD FCY_FNAC_NORM "FNAC_NORM Y-axis conversion" RAT_FUNC "%10.5" "normalised" COEFFS 0 1 0 0 0 1 /end COMPU_METHOD
/begin CHARACTERISTIC FNAFRMIN "X Norm=FN090_AFR, Y Norm=FN091_AFR, Volume efficiency" MAP 0x45DFC TD_FLOAT32_IEEE 0 TCZ_FNAFRMIN 0 100
 /begin AXIS_DESCR FIX_AXIS NO_INPUT_QUANTITY TCX_FNAFRMIN 12 0 11 FIX_AXIS_PAR 0 0 12 /end AXIS_DESCR
 /begin AXIS_DESCR FIX_AXIS NO_INPUT_QUANTITY TCY_FNAFRMIN 11 0 10 FIX_AXIS_PAR 0 0 11 /end AXIS_DESCR
/end CHARACTERISTIC
/begin COMPU_METHOD TCZ_FNAFRMIN "FNAFRMIN Z-axis conversion" RAT_FUNC "%10.5" "unitless" COEFFS 0 1 0 0 0 1 /end COMPU_METHOD
/begin COMPU_METHOD TCX_FNAFRMIN "FNAFRMIN X-axis conversion" RAT_FUNC "%10.5" "RPM" COEFFS 0 1 0 0 0 1 /end COMPU_METHOD
/begin COMPU_METHOD TCY_FNAFRMIN "FNAFRMIN Y-axis conversion" RAT_FUNC "%10.5" "g/s" COEFFS 0 1 0 0 0 1 /end COMPU_METHOD
/begin CHARACTERISTIC FNBARO_V2KPA "Transfer function for barometric pressure transducer from volts to kpa" CURVE 0x5376C FD_FLOAT32_IEEE 0 FCY_FNBARO_V2KPA 0 120 /begin AXIS_DESCR STD_AXIS BP_VOLTAGE FCX_FNBARO_V2KPA 15 0 5 /end AXIS_DESCR /end CHARACTERISTIC
/begin COMPU_METHOD FCX_FNBARO_V2KPA "FNBARO_V2KPA X-axis conversion" RAT_FUNC "%10.5" "V" COEFFS 0 1 0 0 0 1 /end COMPU_METHOD
/begin COMPU_METHOD FCY_FNBARO_V2KPA "FNBARO_V2KPA Y-axis conversion" RAT_FUNC "%10.5" "kPa" COEFFS 0 1 0 0 0 1 /end COMPU_METHOD
/begin CHARACTERISTIC FNBPTC_REC "BP filter constant selection based on RPM." CURVE 0x411CC FD_FLOAT32_IEEE 0 FCY_FNBPTC_REC 0 64 /begin AXIS_DESCR STD_AXIS N FCX_FNBPTC_REC 14 0 8000 /end AXIS_DESCR /end CHARACTERISTIC
/begin COMPU_METHOD FCX_FNBPTC_REC "FNBPTC_REC X-axis conversion" RAT_FUNC "%10.5" "RPM" COEFFS 0 1 0 0 0 1 /end COMPU_METHOD
/begin COMPU_METHOD FCY_FNBPTC_REC "FNBPTC_REC Y-axis conversion" RAT_FUNC "%10.5" "s" COEFFS 0 1 0 0 0 1 /end COMPU_METHOD
/begin CHARACTERISTIC FNCOLDIDL "Idle speed setpoint adder" CURVE 0x4264C FD_FLOAT32_IEEE 0 FCY_FNCOLDIDL 400 4000 /begin AXIS_DESCR STD_AXIS MAT FCX_FNCOLDIDL 6 -40 150 /end AXIS_DESCR /end CHARACTERISTIC
/begin COMPU_METHOD FCX_FNCOLDIDL "FNCOLDIDL X-axis conversion" RAT_FUNC "%10.5" "degC" COEFFS 0 1 0 0 0 1 /end COMPU_METHOD
/begin COMPU_METHOD FCY_FNCOLDIDL "FNCOLDIDL Y-axis conversion" RAT_FUNC "%10.5" "RPM" COEFFS 0 1 0 0 0 1 /end COMPU_METHOD
/begin CHARACTERISTIC FNCOLDIDLMLT "Timer based multiplier for NLIDLE" CURVE 0x4261C FD_FLOAT32_IEEE 0 FCY_FNCOLDIDLMLT 0 1 /begin AXIS_DESCR STD_AXIS COLDIDLETMR FCX_FNCOLDIDLMLT 6 0 4000 /end AXIS_DESCR /end CHARACTERISTIC
/begin COMPU_METHOD FCX_FNCOLDIDLMLT "FNCOLDIDLMLT X-axis conversion" RAT_FUNC "%10.5" "s" COEFFS 0 1 0 0 0 1 /end COMPU_METHOD
/begin COMPU_METHOD FCY_FNCOLDIDLMLT "FNCOLDIDLMLT Y-axis conversion" RAT_FUNC "%10.5" "unitless" COEFFS 0 1 0 0 0 1 /end COMPU_METHOD
/begin CHARACTERISTIC FNEBPNORM "Norm function for fneotebpcorr" CURVE 0x421FC FD_FLOAT32_IEEE 0 FCY_FNEBPNORM 0 400 /begin AXIS_DESCR STD_AXIS EBP_ENG_KPA FCX_FNEBPNORM 12 0 400 /end AXIS_DESCR /end CHARACTERISTIC
/begin COMPU_METHOD FCX_FNEBPNORM "FNEBPNORM X-axis conversion" RAT_FUNC "%10.5" "kPa" COEFFS 0 1 0 0 0 1 /end COMPU_METHOD
/begin COMPU_METHOD FCY_FNEBPNORM "FNEBPNORM Y-axis conversion" RAT_FUNC "%10.5" "kPa" COEFFS 0 1 0 0 0 1 /end COMPU_METHOD
/begin CHARACTERISTIC FNEBPTC_REC "EBP Filter time constant" CURVE 0x423DC FD_FLOAT32_IEEE 0 FCY_FNEBPTC_REC 0 64 /begin AXIS_DESCR STD_AXIS N FCX_FNEBPTC_REC 14 0 8000 /end AXIS_DESCR /end CHARACTERISTIC
/begin COMPU_METHOD FCX_FNEBPTC_REC "FNEBPTC_REC X-axis conversion" RAT_FUNC "%10.5" "RPM" COEFFS 0 1 0 0 0 1 /end COMPU_METHOD
/begin COMPU_METHOD FCY_FNEBPTC_REC "FNEBPTC_REC Y-axis conversion" RAT_FUNC "%10.5" "s" COEFFS 0 1 0 0 0 1 /end COMPU_METHOD
/begin CHARACTERISTIC FNECTTC_REC "Time constant table for ECT filter based on Engine speed." CURVE 0x414DC FD_FLOAT32_IEEE 0 FCY_FNECTTC_REC 0 64 /begin AXIS_DESCR STD_AXIS N FCX_FNECTTC_REC 14 0 8000 /end AXIS_DESCR /end CHARACTERISTIC
/begin COMPU_METHOD FCX_FNECTTC_REC "FNECTTC_REC X-axis conversion" RAT_FUNC "%10.5" "RPM" COEFFS 0 1 0 0 0 1 /end COMPU_METHOD
/begin COMPU_METHOD FCY_FNECTTC_REC "FNECTTC_REC Y-axis conversion" RAT_FUNC "%10.5" "s" COEFFS 0 1 0 0 0 1 /end COMPU_METHOD
/begin CHARACTERISTIC FNECT_FNW "Engine coolant temperature sensor transfer function" CURVE 0x5358C FD_FLOAT32_IEEE 0 FCY_FNECT_FNW -40 150 /begin AXIS_DESCR STD_AXIS ECT_CNTS FCX_FNECT_FNW 24 0 1023 /end AXIS_DESCR /end CHARACTERISTIC
/begin COMPU_METHOD FCX_FNECT_FNW "FNECT_FNW X-axis conversion" RAT_FUNC "%10.5" "ADct" COEFFS 0 1 0 0 0 1 /end COMPU_METHOD
/begin COMPU_METHOD FCY_FNECT_FNW "FNECT_FNW Y-axis conversion" RAT_FUNC "%10.5" "degC" COEFFS 0 1 0 0 0 1 /end COMPU_METHOD
/begin CHARACTERISTIC FNEGRPTC_REC "EGRP filter time constant selection based on RPM." CURVE 0x4170C FD_FLOAT32_IEEE 0 FCY_FNEGRPTC_REC 0 64 /begin AXIS_DESCR STD_AXIS N FCX_FNEGRPTC_REC 14 0 8000 /end AXIS_DESCR /end CHARACTERISTIC
/begin COMPU_METHOD FCX_FNEGRPTC_REC "FNEGRPTC_REC X-axis conversion" RAT_FUNC "%10.5" "RPM" COEFFS 0 1 0 0 0 1 /end COMPU_METHOD
/begin COMPU_METHOD FCY_FNEGRPTC_REC "FNEGRPTC_REC Y-axis conversion" RAT_FUNC "%10.5" "s" COEFFS 0 1 0 0 0 1 /end COMPU_METHOD
/begin CHARACTERISTIC FNEGRP_FNW "Transferfunction for EGRP" CURVE 0x538DC FD_FLOAT32_IEEE 0 FCY_FNEGRP_FNW 0 1 /begin AXIS_DESCR STD_AXIS EGRP_RAW FCX_FNEGRP_FNW 24 0 1023 /end AXIS_DESCR /end CHARACTERISTIC
/begin COMPU_METHOD FCX_FNEGRP_FNW "FNEGRP_FNW X-axis conversion" RAT_FUNC "%10.5" "ADct" COEFFS 0 1 0 0 0 1 /end COMPU_METHOD
/begin COMPU_METHOD FCY_FNEGRP_FNW "FNEGRP_FNW Y-axis conversion" RAT_FUNC "%10.5" "%" COEFFS 0 1 0 0 0 1 /end COMPU_METHOD
/begin CHARACTERISTIC FNEGR_DEF_MULT "" CURVE 0x4E1DC FD_FLOAT32_IEEE 0 FCY_FNEGR_DEF_MULT 0 100
 /begin AXIS_DESCR STD_AXIS NO_INPUT_QUANTITY FCX_FNEGR_DEF_MULT 14 -150000 10000 /end AXIS_DESCR
/end CHARACTERISTIC
/begin COMPU_METHOD FCX_FNEGR_DEF_MULT "FNEGR_DEF_MULT X-axis conversion" RAT_FUNC "%10.5" "unitless" COEFFS 0 1 0 0 0 1 /end COMPU_METHOD
/begin COMPU_METHOD FCY_FNEGR_DEF_MULT "FNEGR_DEF_MULT Y-axis conversion" RAT_FUNC "%10.5" "unitless" COEFFS 0 1 0 0 0 1 /end COMPU_METHOD
/begin CHARACTERISTIC FNEGR_KI "" CURVE 0x4E2BC FD_FLOAT32_IEEE 0 FCY_FNEGR_KI 0 100 /begin AXIS_DESCR STD_AXIS N FCX_FNEGR_KI 14 0 5100 /end AXIS_DESCR /end CHARACTERISTIC
/begin COMPU_METHOD FCX_FNEGR_KI "FNEGR_KI X-axis conversion" RAT_FUNC "%10.5" "unitless" COEFFS 0 1 0 0 0 1 /end COMPU_METHOD
/begin COMPU_METHOD FCY_FNEGR_KI "FNEGR_KI Y-axis conversion" RAT_FUNC "%10.5" "unitless" COEFFS 0 1 0 0 0 1 /end COMPU_METHOD
/begin CHARACTERISTIC FNEGR_KP "" CURVE 0x4E24C FD_FLOAT32_IEEE 0 FCY_FNEGR_KP 0 1000 /begin AXIS_DESCR STD_AXIS N FCX_FNEGR_KP 14 0 5500 /end AXIS_DESCR /end CHARACTERISTIC
/begin COMPU_METHOD FCX_FNEGR_KP "FNEGR_KP X-axis conversion" RAT_FUNC "%10.5" "unitless" COEFFS 0 1 0 0 0 1 /end COMPU_METHOD
/begin COMPU_METHOD FCY_FNEGR_KP "FNEGR_KP Y-axis conversion" RAT_FUNC "%10.5" "unitless" COEFFS 0 1 0 0 0 1 /end COMPU_METHOD
/begin CHARACTERISTIC FNEGR_MAF_SP "X Norm=FN090DS_EGR, Y Norm=FN091DS_EGR" MAP 0x4E32C TD_FLOAT32_IEEE 0 TCZ_FNEGR_MAF_SP 0 1000
 /begin AXIS_DESCR FIX_AXIS NO_INPUT_QUANTITY TCX_FNEGR_MAF_SP 14 0 13 FIX_AXIS_PAR 0 0 14 /end AXIS_DESCR
 /begin AXIS_DESCR FIX_AXIS NO_INPUT_QUANTITY TCY_FNEGR_MAF_SP 14 0 13 FIX_AXIS_PAR 0 0 14 /end AXIS_DESCR
/end CHARACTERISTIC
/begin COMPU_METHOD TCZ_FNEGR_MAF_SP "FNEGR_MAF_SP Z-axis conversion" RAT_FUNC "%10.5" "unitless" COEFFS 0 1 0 0 0 1 /end COMPU_METHOD
/begin COMPU_METHOD TCX_FNEGR_MAF_SP "FNEGR_MAF_SP X-axis conversion" RAT_FUNC "%10.5" "unitless" COEFFS 0 1 0 0 0 1 /end COMPU_METHOD
/begin COMPU_METHOD TCY_FNEGR_MAF_SP "FNEGR_MAF_SP Y-axis conversion" RAT_FUNC "%10.5" "unitless" COEFFS 0 1 0 0 0 1 /end COMPU_METHOD
/begin CHARACTERISTIC FNEGR_PPS_DIF "" CURVE 0x4E16C FD_FLOAT32_IEEE 0 FCY_FNEGR_PPS_DIF 0 100 /begin AXIS_DESCR STD_AXIS EGR_PPS_DIF FCX_FNEGR_PPS_DIF 14 -5000 5000 /end AXIS_DESCR /end CHARACTERISTIC
/begin COMPU_METHOD FCX_FNEGR_PPS_DIF "FNEGR_PPS_DIF X-axis conversion" RAT_FUNC "%10.5" "unitless" COEFFS 0 1 0 0 0 1 /end COMPU_METHOD
/begin COMPU_METHOD FCY_FNEGR_PPS_DIF "FNEGR_PPS_DIF Y-axis conversion" RAT_FUNC "%10.5" "unitless" COEFFS 0 1 0 0 0 1 /end COMPU_METHOD
/begin CHARACTERISTIC FNEGR_PPS_FOF "" CURVE 0x4E0FC FD_FLOAT32_IEEE 0 FCY_FNEGR_PPS_FOF 0 100 /begin AXIS_DESCR STD_AXIS EGR_PPS_FOF FCX_FNEGR_PPS_FOF 14 0 1500 /end AXIS_DESCR /end CHARACTERISTIC
/begin COMPU_METHOD FCX_FNEGR_PPS_FOF "FNEGR_PPS_FOF X-axis conversion" RAT_FUNC "%10.5" "unitless" COEFFS 0 1 0 0 0 1 /end COMPU_METHOD
/begin COMPU_METHOD FCY_FNEGR_PPS_FOF "FNEGR_PPS_FOF Y-axis conversion" RAT_FUNC "%10.5" "unitless" COEFFS 0 1 0 0 0 1 /end COMPU_METHOD
/begin CHARACTERISTIC FNEGR_PPS_MLT "X Norm=FNEGR_PPS_FOF, Y Norm=FNEGR_PPS_DIF" MAP 0x4E63C TD_FLOAT32_IEEE 0 TCZ_FNEGR_PPS_MLT 0 100
 /begin AXIS_DESCR FIX_AXIS NO_INPUT_QUANTITY TCX_FNEGR_PPS_MLT 14 0 13 FIX_AXIS_PAR 0 0 14 /end AXIS_DESCR
 /begin AXIS_DESCR FIX_AXIS NO_INPUT_QUANTITY TCY_FNEGR_PPS_MLT 14 0 13 FIX_AXIS_PAR 0 0 14 /end AXIS_DESCR
/end CHARACTERISTIC
/begin COMPU_METHOD TCZ_FNEGR_PPS_MLT "FNEGR_PPS_MLT Z-axis conversion" RAT_FUNC "%10.5" "unitless" COEFFS 0 1 0 0 0 1 /end COMPU_METHOD
/begin COMPU_METHOD TCX_FNEGR_PPS_MLT "FNEGR_PPS_MLT X-axis conversion" RAT_FUNC "%10.5" "unitless" COEFFS 0 1 0 0 0 1 /end COMPU_METHOD
/begin COMPU_METHOD TCY_FNEGR_PPS_MLT "FNEGR_PPS_MLT Y-axis conversion" RAT_FUNC "%10.5" "unitless" COEFFS 0 1 0 0 0 1 /end COMPU_METHOD
/begin CHARACTERISTIC FNEGR_TRNS "X Norm=FN090DS_EGR, Y Norm=FN091DS_EGR" MAP 0x4E94C TD_FLOAT32_IEEE 0 TCZ_FNEGR_TRNS 0 1000
 /begin AXIS_DESCR FIX_AXIS NO_INPUT_QUANTITY TCX_FNEGR_TRNS 14 0 13 FIX_AXIS_PAR 0 0 14 /end AXIS_DESCR
 /begin AXIS_DESCR FIX_AXIS NO_INPUT_QUANTITY TCY_FNEGR_TRNS 14 0 13 FIX_AXIS_PAR 0 0 14 /end AXIS_DESCR
/end CHARACTERISTIC
/begin COMPU_METHOD TCZ_FNEGR_TRNS "FNEGR_TRNS Z-axis conversion" RAT_FUNC "%10.5" "unitless" COEFFS 0 1 0 0 0 1 /end COMPU_METHOD
/begin COMPU_METHOD TCX_FNEGR_TRNS "FNEGR_TRNS X-axis conversion" RAT_FUNC "%10.5" "unitless" COEFFS 0 1 0 0 0 1 /end COMPU_METHOD
/begin COMPU_METHOD TCY_FNEGR_TRNS "FNEGR_TRNS Y-axis conversion" RAT_FUNC "%10.5" "unitless" COEFFS 0 1 0 0 0 1 /end COMPU_METHOD
/begin CHARACTERISTIC FNEOTC_FRICT_NORM "" CURVE 0x4AACC FD_FLOAT32_IEEE 0 FCY_FNEOTC_FRICT_NORM 0 14 /begin AXIS_DESCR STD_AXIS EOT_C FCX_FNEOTC_FRICT_NORM 14 -800 800 /end AXIS_DESCR /end CHARACTERISTIC
/begin COMPU_METHOD FCX_FNEOTC_FRICT_NORM "FNEOTC_FRICT_NORM X-axis conversion" RAT_FUNC "%10.5" "unitless" COEFFS 0 1 0 0 0 1 /end COMPU_METHOD
/begin COMPU_METHOD FCY_FNEOTC_FRICT_NORM "FNEOTC_FRICT_NORM Y-axis conversion" RAT_FUNC "%10.5" "unitless" COEFFS 0 1 0 0 0 1 /end COMPU_METHOD
/begin CHARACTERISTIC FNEOTEBPCORR "X Norm=FNEBPNORM, Y Norm=unknown" MAP 0x4225C TD_FLOAT32_IEEE 0 TCZ_FNEOTEBPCORR 0 400
 /begin AXIS_DESCR FIX_AXIS NO_INPUT_QUANTITY TCX_FNEOTEBPCORR 8 0 7 FIX_AXIS_PAR 0 0 8 /end AXIS_DESCR
 /begin AXIS_DESCR FIX_AXIS NO_INPUT_QUANTITY TCY_FNEOTEBPCORR 12 0 11 FIX_AXIS_PAR 0 0 12 /end AXIS_DESCR
/end CHARACTERISTIC
/begin COMPU_METHOD TCZ_FNEOTEBPCORR "FNEOTEBPCORR Z-axis conversion" RAT_FUNC "%10.5" "kPa" COEFFS 0 1 0 0 0 1 /end COMPU_METHOD
/begin COMPU_METHOD TCX_FNEOTEBPCORR "FNEOTEBPCORR X-axis conversion" RAT_FUNC "%10.5" "kPa" COEFFS 0 1 0 0 0 1 /end COMPU_METHOD
/begin COMPU_METHOD TCY_FNEOTEBPCORR "FNEOTEBPCORR Y-axis conversion" RAT_FUNC "%10.5" "Unitless" COEFFS 0 1 0 0 0 1 /end COMPU_METHOD
/begin CHARACTERISTIC FNEOTTC_REC "Time constant table for EOT filter based on Engine speed." CURVE 0x4123C FD_FLOAT32_IEEE 0 FCY_FNEOTTC_REC 0 64 /begin AXIS_DESCR STD_AXIS N FCX_FNEOTTC_REC 14 0 8000 /end AXIS_DESCR /end CHARACTERISTIC
/begin COMPU_METHOD FCX_FNEOTTC_REC "FNEOTTC_REC X-axis conversion" RAT_FUNC "%10.5" "RPM" COEFFS 0 1 0 0 0 1 /end COMPU_METHOD
/begin COMPU_METHOD FCY_FNEOTTC_REC "FNEOTTC_REC Y-axis conversion" RAT_FUNC "%10.5" "s" COEFFS 0 1 0 0 0 1 /end COMPU_METHOD
/begin CHARACTERISTIC FNGOVFLRSEED "Flair 'SEED' function, Automatic in Drive Only" CURVE 0x42E4C FD_FLOAT32_IEEE 0 FCY_FNGOVFLRSEED 0 160 /begin AXIS_DESCR STD_AXIS EOT_C FCX_FNGOVFLRSEED 8 -40 150 /end AXIS_DESCR /end CHARACTERISTIC
/begin COMPU_METHOD FCX_FNGOVFLRSEED "FNGOVFLRSEED X-axis conversion" RAT_FUNC "%10.5" "degC" COEFFS 0 1 0 0 0 1 /end COMPU_METHOD
/begin COMPU_METHOD FCY_FNGOVFLRSEED "FNGOVFLRSEED Y-axis conversion" RAT_FUNC "%10.5" "unitless" COEFFS 0 1 0 0 0 1 /end COMPU_METHOD
/begin CHARACTERISTIC FNHICAM "Idle speed setpoint adder for 'HICAM' feature" CURVE 0x4267C FD_FLOAT32_IEEE 0 FCY_FNHICAM 0 500 /begin AXIS_DESCR STD_AXIS EOT_C FCX_FNHICAM 6 -40 150 /end AXIS_DESCR /end CHARACTERISTIC
/begin COMPU_METHOD FCX_FNHICAM "FNHICAM X-axis conversion" RAT_FUNC "%10.5" "degC" COEFFS 0 1 0 0 0 1 /end COMPU_METHOD
/begin COMPU_METHOD FCY_FNHICAM "FNHICAM Y-axis conversion" RAT_FUNC "%10.5" "RPM" COEFFS 0 1 0 0 0 1 /end COMPU_METHOD
/begin CHARACTERISTIC FNIATMAFCORR "X Norm=FNMAFNORM, Y Norm=FNIATNORM, MAF temperature compensation multiplier table" MAP 0x418FC TD_FLOAT32_IEEE 0 TCZ_FNIATMAFCORR -10 10
 /begin AXIS_DESCR FIX_AXIS NO_INPUT_QUANTITY TCX_FNIATMAFCORR 12 0 11 FIX_AXIS_PAR 0 0 12 /end AXIS_DESCR
 /begin AXIS_DESCR FIX_AXIS NO_INPUT_QUANTITY TCY_FNIATMAFCORR 8 0 7 FIX_AXIS_PAR 0 0 8 /end AXIS_DESCR
/end CHARACTERISTIC
/begin COMPU_METHOD TCZ_FNIATMAFCORR "FNIATMAFCORR Z-axis conversion" RAT_FUNC "%10.5" "unitless" COEFFS 0 1 0 0 0 1 /end COMPU_METHOD
/begin COMPU_METHOD TCX_FNIATMAFCORR "FNIATMAFCORR X-axis conversion" RAT_FUNC "%10.5" "g/s" COEFFS 0 1 0 0 0 1 /end COMPU_METHOD
/begin COMPU_METHOD TCY_FNIATMAFCORR "FNIATMAFCORR Y-axis conversion" RAT_FUNC "%10.5" "degC" COEFFS 0 1 0 0 0 1 /end COMPU_METHOD
/begin CHARACTERISTIC FNIATNORM "Ambient Air Temp normalization function" CURVE 0x417EC FD_FLOAT32_IEEE 0 FCY_FNIATNORM 0 7 /begin AXIS_DESCR STD_AXIS AAT FCX_FNIATNORM 8 -40 150 /end AXIS_DESCR /end CHARACTERISTIC
/begin COMPU_METHOD FCX_FNIATNORM "FNIATNORM X-axis conversion" RAT_FUNC "%10.5" "degC" COEFFS 0 1 0 0 0 1 /end COMPU_METHOD
/begin COMPU_METHOD FCY_FNIATNORM "FNIATNORM Y-axis conversion" RAT_FUNC "%10.5" "unitless" COEFFS 0 1 0 0 0 1 /end COMPU_METHOD
/begin CHARACTERISTIC FNIATTC_REC "IAT filter constant selection based on RPM." CURVE 0x4218C FD_FLOAT32_IEEE 0 FCY_FNIATTC_REC 0 64 /begin AXIS_DESCR STD_AXIS N FCX_FNIATTC_REC 14 0 8000 /end AXIS_DESCR /end CHARACTERISTIC
/begin COMPU_METHOD FCX_FNIATTC_REC "FNIATTC_REC X-axis conversion" RAT_FUNC "%10.5" "RPM" COEFFS 0 1 0 0 0 1 /end COMPU_METHOD
/begin COMPU_METHOD FCY_FNIATTC_REC "FNIATTC_REC Y-axis conversion" RAT_FUNC "%10.5" "s" COEFFS 0 1 0 0 0 1 /end COMPU_METHOD
/begin CHARACTERISTIC FNICPDESCRK "ICP Desired for Crank mode" CURVE 0x498CC FD_FLOAT32_IEEE 0 FCY_FNICPDESCRK 0 21 /begin AXIS_DESCR STD_AXIS EOT_C FCX_FNICPDESCRK 11 -40 150 /end AXIS_DESCR /end CHARACTERISTIC
/begin COMPU_METHOD FCX_FNICPDESCRK "FNICPDESCRK X-axis conversion" RAT_FUNC "%10.5" "degC" COEFFS 0 1 0 0 0 1 /end COMPU_METHOD
/begin COMPU_METHOD FCY_FNICPDESCRK "FNICPDESCRK Y-axis conversion" RAT_FUNC "%10.5" "MPa" COEFFS 0 1 0 0 0 1 /end COMPU_METHOD
/begin CHARACTERISTIC FNICPEOTLMX "Limit maximum ICP desired as function of EOT" CURVE 0x49864 FD_FLOAT32_IEEE 0 FCY_FNICPEOTLMX 0 30 /begin AXIS_DESCR STD_AXIS EOT_C FCX_FNICPEOTLMX 13 -300 300 /end AXIS_DESCR /end CHARACTERISTIC
/begin COMPU_METHOD FCX_FNICPEOTLMX "FNICPEOTLMX X-axis conversion" RAT_FUNC "%10.5" "degC" COEFFS 0 1 0 0 0 1 /end COMPU_METHOD
/begin COMPU_METHOD FCY_FNICPEOTLMX "FNICPEOTLMX Y-axis conversion" RAT_FUNC "%10.5" "MPa" COEFFS 0 1 0 0 0 1 /end COMPU_METHOD
/begin CHARACTERISTIC FNICPTC_REC "Time constant value for ICP_Mpa output filter based on Engine speed" CURVE 0x4177C FD_FLOAT32_IEEE 0 FCY_FNICPTC_REC 0 64 /begin AXIS_DESCR STD_AXIS N FCX_FNICPTC_REC 14 0 16383.8 /end AXIS_DESCR /end CHARACTERISTIC
/begin COMPU_METHOD FCX_FNICPTC_REC "FNICPTC_REC X-axis conversion" RAT_FUNC "%10.5" "RPM" COEFFS 0 1 0 0 0 1 /end COMPU_METHOD
/begin COMPU_METHOD FCY_FNICPTC_REC "FNICPTC_REC Y-axis conversion" RAT_FUNC "%10.5" "s" COEFFS 0 1 0 0 0 1 /end COMPU_METHOD
/begin CHARACTERISTIC FNICP_DES_LMT_LO "" CURVE 0x49784 FD_FLOAT32_IEEE 0 FCY_FNICP_DES_LMT_LO -100000 100000 /begin AXIS_DESCR STD_AXIS N FCX_FNICP_DES_LMT_LO 14 0 6000 /end AXIS_DESCR /end CHARACTERISTIC
/begin COMPU_METHOD FCX_FNICP_DES_LMT_LO "FNICP_DES_LMT_LO X-axis conversion" RAT_FUNC "%10.5" "unitless" COEFFS 0 1 0 0 0 1 /end COMPU_METHOD
/begin COMPU_METHOD FCY_FNICP_DES_LMT_LO "FNICP_DES_LMT_LO Y-axis conversion" RAT_FUNC "%10.5" "unitless" COEFFS 0 1 0 0 0 1 /end COMPU_METHOD
/begin CHARACTERISTIC FNICP_KI "" CURVE 0x497F4 FD_FLOAT32_IEEE 0 FCY_FNICP_KI 0 1 /begin AXIS_DESCR STD_AXIS N FCX_FNICP_KI 14 0 6000 /end AXIS_DESCR /end CHARACTERISTIC
/begin COMPU_METHOD FCX_FNICP_KI "FNICP_KI X-axis conversion" RAT_FUNC "%10.5" "unitless" COEFFS 0 1 0 0 0 1 /end COMPU_METHOD
/begin COMPU_METHOD FCY_FNICP_KI "FNICP_KI Y-axis conversion" RAT_FUNC "%10.5" "unitless" COEFFS 0 1 0 0 0 1 /end COMPU_METHOD
/begin CHARACTERISTIC FNICP_V2MPA "Transfer function for injector  control pressure transducer from volts to MPA" CURVE 0x537EC FD_FLOAT32_IEEE 0 FCY_FNICP_V2MPA 0 50 /begin AXIS_DESCR STD_AXIS NO_INPUT_QUANTITY FCX_FNICP_V2MPA 7 0 5 /end AXIS_DESCR /end CHARACTERISTIC
/begin COMPU_METHOD FCX_FNICP_V2MPA "FNICP_V2MPA X-axis conversion" RAT_FUNC "%10.5" "V" COEFFS 0 1 0 0 0 1 /end COMPU_METHOD
/begin COMPU_METHOD FCY_FNICP_V2MPA "FNICP_V2MPA Y-axis conversion" RAT_FUNC "%10.5" "MPa" COEFFS 0 1 0 0 0 1 /end COMPU_METHOD
/begin CHARACTERISTIC FNIDLCOT "A/C clutch delay time after start." CURVE 0x40D1C FD_FLOAT32_IEEE 0 FCY_FNIDLCOT 0 62 /begin AXIS_DESCR STD_AXIS N FCX_FNIDLCOT 6 0 16383.8 /end AXIS_DESCR /end CHARACTERISTIC
/begin COMPU_METHOD FCX_FNIDLCOT "FNIDLCOT X-axis conversion" RAT_FUNC "%10.5" "RPM" COEFFS 0 1 0 0 0 1 /end COMPU_METHOD
/begin COMPU_METHOD FCY_FNIDLCOT "FNIDLCOT Y-axis conversion" RAT_FUNC "%10.5" "s" COEFFS 0 1 0 0 0 1 /end COMPU_METHOD
/begin CHARACTERISTIC FNIDLCOT2 "A/C clutch delay time when cycling." CURVE 0x40D4C FD_FLOAT32_IEEE 0 FCY_FNIDLCOT2 0 62 /begin AXIS_DESCR STD_AXIS N FCX_FNIDLCOT2 6 0 16383.8 /end AXIS_DESCR /end CHARACTERISTIC
/begin COMPU_METHOD FCX_FNIDLCOT2 "FNIDLCOT2 X-axis conversion" RAT_FUNC "%10.5" "RPM" COEFFS 0 1 0 0 0 1 /end COMPU_METHOD
/begin COMPU_METHOD FCY_FNIDLCOT2 "FNIDLCOT2 Y-axis conversion" RAT_FUNC "%10.5" "s" COEFFS 0 1 0 0 0 1 /end COMPU_METHOD
/begin CHARACTERISTIC FNITHPTC_REC "ITHP filter constant selection based on RPM." CURVE 0x4245C FD_FLOAT32_IEEE 0 FCY_FNITHPTC_REC 0 64 /begin AXIS_DESCR STD_AXIS N FCX_FNITHPTC_REC 14 0 8000 /end AXIS_DESCR /end CHARACTERISTIC
/begin COMPU_METHOD FCX_FNITHPTC_REC "FNITHPTC_REC X-axis conversion" RAT_FUNC "%10.5" "RPM" COEFFS 0 1 0 0 0 1 /end COMPU_METHOD
/begin COMPU_METHOD FCY_FNITHPTC_REC "FNITHPTC_REC Y-axis conversion" RAT_FUNC "%10.5" "s" COEFFS 0 1 0 0 0 1 /end COMPU_METHOD
/begin CHARACTERISTIC FNITH_CONV "Intake throttle position sensor transfer function" CURVE 0x53BBC FD_FLOAT32_IEEE 0 FCY_FNITH_CONV 0 1 /begin AXIS_DESCR STD_AXIS TP_CNTS FCX_FNITH_CONV 11 0 1023 /end AXIS_DESCR /end CHARACTERISTIC
/begin COMPU_METHOD FCX_FNITH_CONV "FNITH_CONV X-axis conversion" RAT_FUNC "%10.5" "ADct" COEFFS 0 1 0 0 0 1 /end COMPU_METHOD
/begin COMPU_METHOD FCY_FNITH_CONV "FNITH_CONV Y-axis conversion" RAT_FUNC "%10.5" "unitless" COEFFS 0 1 0 0 0 1 /end COMPU_METHOD
/begin CHARACTERISTIC FNITH_DTY_MAG "" CURVE 0x5056C FD_FLOAT32_IEEE 0 FCY_FNITH_DTY_MAG 0 100 /begin AXIS_DESCR STD_AXIS ITH_DTY FCX_FNITH_DTY_MAG 14 -100 100 /end AXIS_DESCR /end CHARACTERISTIC
/begin COMPU_METHOD FCX_FNITH_DTY_MAG "FNITH_DTY_MAG X-axis conversion" RAT_FUNC "%10.5" "unitless" COEFFS 0 1 0 0 0 1 /end COMPU_METHOD
/begin COMPU_METHOD FCY_FNITH_DTY_MAG "FNITH_DTY_MAG Y-axis conversion" RAT_FUNC "%10.5" "unitless" COEFFS 0 1 0 0 0 1 /end COMPU_METHOD
/begin CHARACTERISTIC FNITH_FF "" CURVE 0x505DC FD_FLOAT32_IEEE 0 FCY_FNITH_FF 0 100 /begin AXIS_DESCR STD_AXIS ITH_DES FCX_FNITH_FF 14 0 100 /end AXIS_DESCR /end CHARACTERISTIC
/begin COMPU_METHOD FCX_FNITH_FF "FNITH_FF X-axis conversion" RAT_FUNC "%10.5" "unitless" COEFFS 0 1 0 0 0 1 /end COMPU_METHOD
/begin COMPU_METHOD FCY_FNITH_FF "FNITH_FF Y-axis conversion" RAT_FUNC "%10.5" "unitless" COEFFS 0 1 0 0 0 1 /end COMPU_METHOD
/begin CHARACTERISTIC FNITH_HIALT "X Norm=FN090DS_ITH, Y Norm=FN091DS_ITH" MAP 0x5064C TD_FLOAT32_IEEE 0 TCZ_FNITH_HIALT 0 5000
 /begin AXIS_DESCR FIX_AXIS NO_INPUT_QUANTITY TCX_FNITH_HIALT 14 0 13 FIX_AXIS_PAR 0 0 14 /end AXIS_DESCR
 /begin AXIS_DESCR FIX_AXIS NO_INPUT_QUANTITY TCY_FNITH_HIALT 14 0 13 FIX_AXIS_PAR 0 0 14 /end AXIS_DESCR
/end CHARACTERISTIC
/begin COMPU_METHOD TCZ_FNITH_HIALT "FNITH_HIALT Z-axis conversion" RAT_FUNC "%10.5" "unitless" COEFFS 0 1 0 0 0 1 /end COMPU_METHOD
/begin COMPU_METHOD TCX_FNITH_HIALT "FNITH_HIALT X-axis conversion" RAT_FUNC "%10.5" "unitless" COEFFS 0 1 0 0 0 1 /end COMPU_METHOD
/begin COMPU_METHOD TCY_FNITH_HIALT "FNITH_HIALT Y-axis conversion" RAT_FUNC "%10.5" "unitless" COEFFS 0 1 0 0 0 1 /end COMPU_METHOD
/begin CHARACTERISTIC FNITH_IVP_MLT "" CURVE 0x504FC FD_FLOAT32_IEEE 0 FCY_FNITH_IVP_MLT 0 100 /begin AXIS_DESCR STD_AXIS IVPWR FCX_FNITH_IVP_MLT 14 0 100 /end AXIS_DESCR /end CHARACTERISTIC
/begin COMPU_METHOD FCX_FNITH_IVP_MLT "FNITH_IVP_MLT X-axis conversion" RAT_FUNC "%10.5" "unitless" COEFFS 0 1 0 0 0 1 /end COMPU_METHOD
/begin COMPU_METHOD FCY_FNITH_IVP_MLT "FNITH_IVP_MLT Y-axis conversion" RAT_FUNC "%10.5" "unitless" COEFFS 0 1 0 0 0 1 /end COMPU_METHOD
/begin CHARACTERISTIC FNITH_LOALT "X Norm=FN090DS_ITH, Y Norm=FN091DS_ITH" MAP 0x5095C TD_FLOAT32_IEEE 0 TCZ_FNITH_LOALT 0 5000
 /begin AXIS_DESCR FIX_AXIS NO_INPUT_QUANTITY TCX_FNITH_LOALT 14 0 13 FIX_AXIS_PAR 0 0 14 /end AXIS_DESCR
 /begin AXIS_DESCR FIX_AXIS NO_INPUT_QUANTITY TCY_FNITH_LOALT 14 0 13 FIX_AXIS_PAR 0 0 14 /end AXIS_DESCR
/end CHARACTERISTIC
/begin COMPU_METHOD TCZ_FNITH_LOALT "FNITH_LOALT Z-axis conversion" RAT_FUNC "%10.5" "unitless" COEFFS 0 1 0 0 0 1 /end COMPU_METHOD
/begin COMPU_METHOD TCX_FNITH_LOALT "FNITH_LOALT X-axis conversion" RAT_FUNC "%10.5" "unitless" COEFFS 0 1 0 0 0 1 /end COMPU_METHOD
/begin COMPU_METHOD TCY_FNITH_LOALT "FNITH_LOALT Y-axis conversion" RAT_FUNC "%10.5" "unitless" COEFFS 0 1 0 0 0 1 /end COMPU_METHOD
/begin CHARACTERISTIC FNITH_MEALT "X Norm=FN090DS_ITH, Y Norm=FN091DS_ITH" MAP 0x50C6C TD_FLOAT32_IEEE 0 TCZ_FNITH_MEALT 0 5000
 /begin AXIS_DESCR FIX_AXIS NO_INPUT_QUANTITY TCX_FNITH_MEALT 14 0 13 FIX_AXIS_PAR 0 0 14 /end AXIS_DESCR
 /begin AXIS_DESCR FIX_AXIS NO_INPUT_QUANTITY TCY_FNITH_MEALT 14 0 13 FIX_AXIS_PAR 0 0 14 /end AXIS_DESCR
/end CHARACTERISTIC
/begin COMPU_METHOD TCZ_FNITH_MEALT "FNITH_MEALT Z-axis conversion" RAT_FUNC "%10.5" "unitless" COEFFS 0 1 0 0 0 1 /end COMPU_METHOD
/begin COMPU_METHOD TCX_FNITH_MEALT "FNITH_MEALT X-axis conversion" RAT_FUNC "%10.5" "unitless" COEFFS 0 1 0 0 0 1 /end COMPU_METHOD
/begin COMPU_METHOD TCY_FNITH_MEALT "FNITH_MEALT Y-axis conversion" RAT_FUNC "%10.5" "unitless" COEFFS 0 1 0 0 0 1 /end COMPU_METHOD
/begin CHARACTERISTIC FNIVPWRTC_REC "IVPWR filter constant selection based on RPM." CURVE 0x424CC FD_FLOAT32_IEEE 0 FCY_FNIVPWRTC_REC 0 64 /begin AXIS_DESCR STD_AXIS N FCX_FNIVPWRTC_REC 14 0 8000 /end AXIS_DESCR /end CHARACTERISTIC
/begin COMPU_METHOD FCX_FNIVPWRTC_REC "FNIVPWRTC_REC X-axis conversion" RAT_FUNC "%10.5" "RPM" COEFFS 0 1 0 0 0 1 /end COMPU_METHOD
/begin COMPU_METHOD FCY_FNIVPWRTC_REC "FNIVPWRTC_REC Y-axis conversion" RAT_FUNC "%10.5" "s" COEFFS 0 1 0 0 0 1 /end COMPU_METHOD
/begin CHARACTERISTIC FNMAFNORM "Mass Air Flow normalization function" CURVE 0x4182C FD_FLOAT32_IEEE 0 FCY_FNMAFNORM 0 11 /begin AXIS_DESCR STD_AXIS MAF_ENG_UNITS FCX_FNMAFNORM 12 0 750 /end AXIS_DESCR /end CHARACTERISTIC
/begin COMPU_METHOD FCX_FNMAFNORM "FNMAFNORM X-axis conversion" RAT_FUNC "%10.5" "g/s" COEFFS 0 1 0 0 0 1 /end COMPU_METHOD
/begin COMPU_METHOD FCY_FNMAFNORM "FNMAFNORM Y-axis conversion" RAT_FUNC "%10.5" "unitless" COEFFS 0 1 0 0 0 1 /end COMPU_METHOD
/begin CHARACTERISTIC FNMAFTC_REC "MAF filter constant selection based on RPM." CURVE 0x4188C FD_FLOAT32_IEEE 0 FCY_FNMAFTC_REC 0 64 /begin AXIS_DESCR STD_AXIS N FCX_FNMAFTC_REC 14 0 8000 /end AXIS_DESCR /end CHARACTERISTIC
/begin COMPU_METHOD FCX_FNMAFTC_REC "FNMAFTC_REC X-axis conversion" RAT_FUNC "%10.5" "RPM" COEFFS 0 1 0 0 0 1 /end COMPU_METHOD
/begin COMPU_METHOD FCY_FNMAFTC_REC "FNMAFTC_REC Y-axis conversion" RAT_FUNC "%10.5" "s" COEFFS 0 1 0 0 0 1 /end COMPU_METHOD
/begin CHARACTERISTIC FNMAPTC_REC "MAP filter constant selection based on RPM." CURVE 0x41CAC FD_FLOAT32_IEEE 0 FCY_FNMAPTC_REC 0 64 /begin AXIS_DESCR STD_AXIS N FCX_FNMAPTC_REC 14 0 8000 /end AXIS_DESCR /end CHARACTERISTIC
/begin COMPU_METHOD FCX_FNMAPTC_REC "FNMAPTC_REC X-axis conversion" RAT_FUNC "%10.5" "RPM" COEFFS 0 1 0 0 0 1 /end COMPU_METHOD
/begin COMPU_METHOD FCY_FNMAPTC_REC "FNMAPTC_REC Y-axis conversion" RAT_FUNC "%10.5" "s" COEFFS 0 1 0 0 0 1 /end COMPU_METHOD
/begin CHARACTERISTIC FNMAP_V2KPA "Transfer function for map pressure transducer from volts to kpa" CURVE 0x5370C FD_FLOAT32_IEEE 0 FCY_FNMAP_V2KPA 0 300 /begin AXIS_DESCR STD_AXIS NO_INPUT_QUANTITY FCX_FNMAP_V2KPA 10 0 5 /end AXIS_DESCR /end CHARACTERISTIC
/begin COMPU_METHOD FCX_FNMAP_V2KPA "FNMAP_V2KPA X-axis conversion" RAT_FUNC "%10.5" "V" COEFFS 0 1 0 0 0 1 /end COMPU_METHOD
/begin COMPU_METHOD FCY_FNMAP_V2KPA "FNMAP_V2KPA Y-axis conversion" RAT_FUNC "%10.5" "kPa" COEFFS 0 1 0 0 0 1 /end COMPU_METHOD
/begin CHARACTERISTIC FNMATDS "" CURVE 0x4657C FD_FLOAT32_IEEE 0 FCY_FNMATDS 0 10 /begin AXIS_DESCR STD_AXIS NO_INPUT_QUANTITY FCX_FNMATDS 10 -500 500 /end AXIS_DESCR /end CHARACTERISTIC
/begin COMPU_METHOD FCX_FNMATDS "FNMATDS X-axis conversion" RAT_FUNC "%10.5" "unitless" COEFFS 0 1 0 0 0 1 /end COMPU_METHOD
/begin COMPU_METHOD FCY_FNMATDS "FNMATDS Y-axis conversion" RAT_FUNC "%10.5" "unitless" COEFFS 0 1 0 0 0 1 /end COMPU_METHOD
/begin CHARACTERISTIC FNMATP "" CURVE 0x465CC FD_FLOAT32_IEEE 0 FCY_FNMATP 0 10 /begin AXIS_DESCR STD_AXIS NO_INPUT_QUANTITY FCX_FNMATP 10 -500 500 /end AXIS_DESCR /end CHARACTERISTIC
/begin COMPU_METHOD FCX_FNMATP "FNMATP X-axis conversion" RAT_FUNC "%10.5" "unitless" COEFFS 0 1 0 0 0 1 /end COMPU_METHOD
/begin COMPU_METHOD FCY_FNMATP "FNMATP Y-axis conversion" RAT_FUNC "%10.5" "unitless" COEFFS 0 1 0 0 0 1 /end COMPU_METHOD
/begin CHARACTERISTIC FNMATTC_REC "Filter time constant" CURVE 0x41D8C FD_FLOAT32_IEEE 0 FCY_FNMATTC_REC 0 64 /begin AXIS_DESCR STD_AXIS N FCX_FNMATTC_REC 14 0 8000 /end AXIS_DESCR /end CHARACTERISTIC
/begin COMPU_METHOD FCX_FNMATTC_REC "FNMATTC_REC X-axis conversion" RAT_FUNC "%10.5" "RPM" COEFFS 0 1 0 0 0 1 /end COMPU_METHOD
/begin COMPU_METHOD FCY_FNMATTC_REC "FNMATTC_REC Y-axis conversion" RAT_FUNC "%10.5" "s" COEFFS 0 1 0 0 0 1 /end COMPU_METHOD
/begin CHARACTERISTIC FNN_ACCY_TQ1 "" CURVE 0x4AC1C FD_FLOAT32_IEEE 0 FCY_FNN_ACCY_TQ1 0 14 /begin AXIS_DESCR STD_AXIS N FCX_FNN_ACCY_TQ1 14 0 8000 /end AXIS_DESCR /end CHARACTERISTIC
/begin COMPU_METHOD FCX_FNN_ACCY_TQ1 "FNN_ACCY_TQ1 X-axis conversion" RAT_FUNC "%10.5" "unitless" COEFFS 0 1 0 0 0 1 /end COMPU_METHOD
/begin COMPU_METHOD FCY_FNN_ACCY_TQ1 "FNN_ACCY_TQ1 Y-axis conversion" RAT_FUNC "%10.5" "unitless" COEFFS 0 1 0 0 0 1 /end COMPU_METHOD
/begin CHARACTERISTIC FNN_ACCY_TQ2 "" CURVE 0x4AC8C FD_FLOAT32_IEEE 0 FCY_FNN_ACCY_TQ2 0 14 /begin AXIS_DESCR STD_AXIS N FCX_FNN_ACCY_TQ2 14 0 8000 /end AXIS_DESCR /end CHARACTERISTIC
/begin COMPU_METHOD FCX_FNN_ACCY_TQ2 "FNN_ACCY_TQ2 X-axis conversion" RAT_FUNC "%10.5" "unitless" COEFFS 0 1 0 0 0 1 /end COMPU_METHOD
/begin COMPU_METHOD FCY_FNN_ACCY_TQ2 "FNN_ACCY_TQ2 Y-axis conversion" RAT_FUNC "%10.5" "unitless" COEFFS 0 1 0 0 0 1 /end COMPU_METHOD
/begin CHARACTERISTIC FNN_AIRC_TQ1 "" CURVE 0x4ACFC FD_FLOAT32_IEEE 0 FCY_FNN_AIRC_TQ1 0 14 /begin AXIS_DESCR STD_AXIS N FCX_FNN_AIRC_TQ1 14 0 8000 /end AXIS_DESCR /end CHARACTERISTIC
/begin COMPU_METHOD FCX_FNN_AIRC_TQ1 "FNN_AIRC_TQ1 X-axis conversion" RAT_FUNC "%10.5" "unitless" COEFFS 0 1 0 0 0 1 /end COMPU_METHOD
/begin COMPU_METHOD FCY_FNN_AIRC_TQ1 "FNN_AIRC_TQ1 Y-axis conversion" RAT_FUNC "%10.5" "unitless" COEFFS 0 1 0 0 0 1 /end COMPU_METHOD
/begin CHARACTERISTIC FNN_FRICT_NORM "" CURVE 0x4AB3C FD_FLOAT32_IEEE 0 FCY_FNN_FRICT_NORM 0 14 /begin AXIS_DESCR STD_AXIS N FCX_FNN_FRICT_NORM 14 0 8000 /end AXIS_DESCR /end CHARACTERISTIC
/begin COMPU_METHOD FCX_FNN_FRICT_NORM "FNN_FRICT_NORM X-axis conversion" RAT_FUNC "%10.5" "unitless" COEFFS 0 1 0 0 0 1 /end COMPU_METHOD
/begin COMPU_METHOD FCY_FNN_FRICT_NORM "FNN_FRICT_NORM Y-axis conversion" RAT_FUNC "%10.5" "unitless" COEFFS 0 1 0 0 0 1 /end COMPU_METHOD
/begin CHARACTERISTIC FNPPS_TPO "" CURVE 0x420F4 FD_FLOAT32_IEEE 0 FCY_FNPPS_TPO 0 1 /begin AXIS_DESCR STD_AXIS PPS FCX_FNPPS_TPO 14 0 1024 /end AXIS_DESCR /end CHARACTERISTIC
/begin COMPU_METHOD FCX_FNPPS_TPO "FNPPS_TPO X-axis conversion" RAT_FUNC "%10.5" "unitless" COEFFS 0 1 0 0 0 1 /end COMPU_METHOD
/begin COMPU_METHOD FCY_FNPPS_TPO "FNPPS_TPO Y-axis conversion" RAT_FUNC "%10.5" "unitless" COEFFS 0 1 0 0 0 1 /end COMPU_METHOD
/begin CHARACTERISTIC FNRDON1 "Trans pedal conversion RAM fox function" CURVE 0x3F9A18 FD_FLOAT32_IEEE 0 FCY_FNRDON1 0 100 /begin AXIS_DESCR STD_AXIS PPS FCX_FNRDON1 3 0 1024 /end AXIS_DESCR /end CHARACTERISTIC
/begin COMPU_METHOD FCX_FNRDON1 "FNRDON1 X-axis conversion" RAT_FUNC "%10.5" "ADct" COEFFS 0 1 0 0 0 1 /end COMPU_METHOD
/begin COMPU_METHOD FCY_FNRDON1 "FNRDON1 Y-axis conversion" RAT_FUNC "%10.5" "%" COEFFS 0 1 0 0 0 1 /end COMPU_METHOD
/begin CHARACTERISTIC FNTQCOMB_MULT "X Norm=FNTQ_MFCOMB_NORM, Y Norm=FNTQ_MAFCOMB_NORM" MAP 0x4C66C TD_FLOAT32_IEEE 0 TCZ_FNTQCOMB_MULT 0 500
 /begin AXIS_DESCR FIX_AXIS NO_INPUT_QUANTITY TCX_FNTQCOMB_MULT 14 0 13 FIX_AXIS_PAR 0 0 14 /end AXIS_DESCR
 /begin AXIS_DESCR FIX_AXIS NO_INPUT_QUANTITY TCY_FNTQCOMB_MULT 14 0 13 FIX_AXIS_PAR 0 0 14 /end AXIS_DESCR
/end CHARACTERISTIC
/begin COMPU_METHOD TCZ_FNTQCOMB_MULT "FNTQCOMB_MULT Z-axis conversion" RAT_FUNC "%10.5" "unitless" COEFFS 0 1 0 0 0 1 /end COMPU_METHOD
/begin COMPU_METHOD TCX_FNTQCOMB_MULT "FNTQCOMB_MULT X-axis conversion" RAT_FUNC "%10.5" "unitless" COEFFS 0 1 0 0 0 1 /end COMPU_METHOD
/begin COMPU_METHOD TCY_FNTQCOMB_MULT "FNTQCOMB_MULT Y-axis conversion" RAT_FUNC "%10.5" "unitless" COEFFS 0 1 0 0 0 1 /end COMPU_METHOD
/begin CHARACTERISTIC FNTQ_DELTAP "X Norm=FNTQ_DP_N_NORM, Y Norm=FNTQ_DP_DPERR_NORM" MAP 0x4C02C TD_FLOAT32_IEEE 0 TCZ_FNTQ_DELTAP 0 500
 /begin AXIS_DESCR FIX_AXIS NO_INPUT_QUANTITY TCX_FNTQ_DELTAP 14 0 13 FIX_AXIS_PAR 0 0 14 /end AXIS_DESCR
 /begin AXIS_DESCR FIX_AXIS NO_INPUT_QUANTITY TCY_FNTQ_DELTAP 14 0 13 FIX_AXIS_PAR 0 0 14 /end AXIS_DESCR
/end CHARACTERISTIC
/begin COMPU_METHOD TCZ_FNTQ_DELTAP "FNTQ_DELTAP Z-axis conversion" RAT_FUNC "%10.5" "unitless" COEFFS 0 1 0 0 0 1 /end COMPU_METHOD
/begin COMPU_METHOD TCX_FNTQ_DELTAP "FNTQ_DELTAP X-axis conversion" RAT_FUNC "%10.5" "unitless" COEFFS 0 1 0 0 0 1 /end COMPU_METHOD
/begin COMPU_METHOD TCY_FNTQ_DELTAP "FNTQ_DELTAP Y-axis conversion" RAT_FUNC "%10.5" "unitless" COEFFS 0 1 0 0 0 1 /end COMPU_METHOD
/begin CHARACTERISTIC FNTQ_DP_DPERR_NORM "" CURVE 0x4A89C FD_FLOAT32_IEEE 0 FCY_FNTQ_DP_DPERR_NORM 0 14 /begin AXIS_DESCR STD_AXIS TQ_DELTAP_ERR FCX_FNTQ_DP_DPERR_NORM 14 -500 500 /end AXIS_DESCR /end CHARACTERISTIC
/begin COMPU_METHOD FCX_FNTQ_DP_DPERR_NORM "FNTQ_DP_DPERR_NORM X-axis conversion" RAT_FUNC "%10.5" "unitless" COEFFS 0 1 0 0 0 1 /end COMPU_METHOD
/begin COMPU_METHOD FCY_FNTQ_DP_DPERR_NORM "FNTQ_DP_DPERR_NORM Y-axis conversion" RAT_FUNC "%10.5" "unitless" COEFFS 0 1 0 0 0 1 /end COMPU_METHOD
/begin CHARACTERISTIC FNTQ_DP_HIALT "X Norm=FN090DS_TQ, Y Norm=FN091DS_TQ" MAP 0x4B6CC TD_FLOAT32_IEEE 0 TCZ_FNTQ_DP_HIALT 0 500
 /begin AXIS_DESCR FIX_AXIS NO_INPUT_QUANTITY TCX_FNTQ_DP_HIALT 14 0 13 FIX_AXIS_PAR 0 0 14 /end AXIS_DESCR
 /begin AXIS_DESCR FIX_AXIS NO_INPUT_QUANTITY TCY_FNTQ_DP_HIALT 14 0 13 FIX_AXIS_PAR 0 0 14 /end AXIS_DESCR
/end CHARACTERISTIC
/begin COMPU_METHOD TCZ_FNTQ_DP_HIALT "FNTQ_DP_HIALT Z-axis conversion" RAT_FUNC "%10.5" "unitless" COEFFS 0 1 0 0 0 1 /end COMPU_METHOD
/begin COMPU_METHOD TCX_FNTQ_DP_HIALT "FNTQ_DP_HIALT X-axis conversion" RAT_FUNC "%10.5" "unitless" COEFFS 0 1 0 0 0 1 /end COMPU_METHOD
/begin COMPU_METHOD TCY_FNTQ_DP_HIALT "FNTQ_DP_HIALT Y-axis conversion" RAT_FUNC "%10.5" "unitless" COEFFS 0 1 0 0 0 1 /end COMPU_METHOD
/begin CHARACTERISTIC FNTQ_DP_LOALT "X Norm=FN090DS_TQ, Y Norm=FN091DS_TQ" MAP 0x4BD0C TD_FLOAT32_IEEE 0 TCZ_FNTQ_DP_LOALT 0 500
 /begin AXIS_DESCR FIX_AXIS NO_INPUT_QUANTITY TCX_FNTQ_DP_LOALT 14 0 13 FIX_AXIS_PAR 0 0 14 /end AXIS_DESCR
 /begin AXIS_DESCR FIX_AXIS NO_INPUT_QUANTITY TCY_FNTQ_DP_LOALT 14 0 13 FIX_AXIS_PAR 0 0 14 /end AXIS_DESCR
/end CHARACTERISTIC
/begin COMPU_METHOD TCZ_FNTQ_DP_LOALT "FNTQ_DP_LOALT Z-axis conversion" RAT_FUNC "%10.5" "unitless" COEFFS 0 1 0 0 0 1 /end COMPU_METHOD
/begin COMPU_METHOD TCX_FNTQ_DP_LOALT "FNTQ_DP_LOALT X-axis conversion" RAT_FUNC "%10.5" "unitless" COEFFS 0 1 0 0 0 1 /end COMPU_METHOD
/begin COMPU_METHOD TCY_FNTQ_DP_LOALT "FNTQ_DP_LOALT Y-axis conversion" RAT_FUNC "%10.5" "unitless" COEFFS 0 1 0 0 0 1 /end COMPU_METHOD
/begin CHARACTERISTIC FNTQ_DP_MEDALT "X Norm=FN090DS_TQ, Y Norm=FN091DS_TQ" MAP 0x4B9EC TD_FLOAT32_IEEE 0 TCZ_FNTQ_DP_MEDALT 0 500
 /begin AXIS_DESCR FIX_AXIS NO_INPUT_QUANTITY TCX_FNTQ_DP_MEDALT 14 0 13 FIX_AXIS_PAR 0 0 14 /end AXIS_DESCR
 /begin AXIS_DESCR FIX_AXIS NO_INPUT_QUANTITY TCY_FNTQ_DP_MEDALT 14 0 13 FIX_AXIS_PAR 0 0 14 /end AXIS_DESCR
/end CHARACTERISTIC
/begin COMPU_METHOD TCZ_FNTQ_DP_MEDALT "FNTQ_DP_MEDALT Z-axis conversion" RAT_FUNC "%10.5" "unitless" COEFFS 0 1 0 0 0 1 /end COMPU_METHOD
/begin COMPU_METHOD TCX_FNTQ_DP_MEDALT "FNTQ_DP_MEDALT X-axis conversion" RAT_FUNC "%10.5" "unitless" COEFFS 0 1 0 0 0 1 /end COMPU_METHOD
/begin COMPU_METHOD TCY_FNTQ_DP_MEDALT "FNTQ_DP_MEDALT Y-axis conversion" RAT_FUNC "%10.5" "unitless" COEFFS 0 1 0 0 0 1 /end COMPU_METHOD
/begin CHARACTERISTIC FNTQ_DP_N_NORM "" CURVE 0x4A90C FD_FLOAT32_IEEE 0 FCY_FNTQ_DP_N_NORM 0 14 /begin AXIS_DESCR STD_AXIS N FCX_FNTQ_DP_N_NORM 14 0 8000 /end AXIS_DESCR /end CHARACTERISTIC
/begin COMPU_METHOD FCX_FNTQ_DP_N_NORM "FNTQ_DP_N_NORM X-axis conversion" RAT_FUNC "%10.5" "unitless" COEFFS 0 1 0 0 0 1 /end COMPU_METHOD
/begin COMPU_METHOD FCY_FNTQ_DP_N_NORM "FNTQ_DP_N_NORM Y-axis conversion" RAT_FUNC "%10.5" "unitless" COEFFS 0 1 0 0 0 1 /end COMPU_METHOD
/begin CHARACTERISTIC FNTQ_DTQ_DICP "" CURVE 0x4A97C FD_FLOAT32_IEEE 0 FCY_FNTQ_DTQ_DICP 0 14 /begin AXIS_DESCR STD_AXIS N FCX_FNTQ_DTQ_DICP 14 0 8000 /end AXIS_DESCR /end CHARACTERISTIC
/begin COMPU_METHOD FCX_FNTQ_DTQ_DICP "FNTQ_DTQ_DICP X-axis conversion" RAT_FUNC "%10.5" "unitless" COEFFS 0 1 0 0 0 1 /end COMPU_METHOD
/begin COMPU_METHOD FCY_FNTQ_DTQ_DICP "FNTQ_DTQ_DICP Y-axis conversion" RAT_FUNC "%10.5" "unitless" COEFFS 0 1 0 0 0 1 /end COMPU_METHOD
/begin CHARACTERISTIC FNTQ_MAFCOMB_NORM "" CURVE 0x4A9EC FD_FLOAT32_IEEE 0 FCY_FNTQ_MAFCOMB_NORM 0 14 /begin AXIS_DESCR STD_AXIS MAF_MG_STK FCX_FNTQ_MAFCOMB_NORM 14 0 4096 /end AXIS_DESCR /end CHARACTERISTIC
/begin COMPU_METHOD FCX_FNTQ_MAFCOMB_NORM "FNTQ_MAFCOMB_NORM X-axis conversion" RAT_FUNC "%10.5" "unitless" COEFFS 0 1 0 0 0 1 /end COMPU_METHOD
/begin COMPU_METHOD FCY_FNTQ_MAFCOMB_NORM "FNTQ_MAFCOMB_NORM Y-axis conversion" RAT_FUNC "%10.5" "unitless" COEFFS 0 1 0 0 0 1 /end COMPU_METHOD
/begin CHARACTERISTIC FNTQ_MFCOMB_NORM "" CURVE 0x4AA5C FD_FLOAT32_IEEE 0 FCY_FNTQ_MFCOMB_NORM 0 14 /begin AXIS_DESCR STD_AXIS MFDES FCX_FNTQ_MFCOMB_NORM 14 -2048 2048 /end AXIS_DESCR /end CHARACTERISTIC
/begin COMPU_METHOD FCX_FNTQ_MFCOMB_NORM "FNTQ_MFCOMB_NORM X-axis conversion" RAT_FUNC "%10.5" "unitless" COEFFS 0 1 0 0 0 1 /end COMPU_METHOD
/begin COMPU_METHOD FCY_FNTQ_MFCOMB_NORM "FNTQ_MFCOMB_NORM Y-axis conversion" RAT_FUNC "%10.5" "unitless" COEFFS 0 1 0 0 0 1 /end COMPU_METHOD
/begin CHARACTERISTIC FNTQ_TAU_NORM "" CURVE 0x4ABAC FD_FLOAT32_IEEE 0 FCY_FNTQ_TAU_NORM 0 14 /begin AXIS_DESCR STD_AXIS N FCX_FNTQ_TAU_NORM 14 0 8000 /end AXIS_DESCR /end CHARACTERISTIC
/begin COMPU_METHOD FCX_FNTQ_TAU_NORM "FNTQ_TAU_NORM X-axis conversion" RAT_FUNC "%10.5" "unitless" COEFFS 0 1 0 0 0 1 /end COMPU_METHOD
/begin COMPU_METHOD FCY_FNTQ_TAU_NORM "FNTQ_TAU_NORM Y-axis conversion" RAT_FUNC "%10.5" "unitless" COEFFS 0 1 0 0 0 1 /end COMPU_METHOD
/begin CHARACTERISTIC FNVGT_EBPG_COLD_ADDR "X Norm=FN090_VGT, Y Norm=FN091_VGT" MAP 0x5155C TD_FLOAT32_IEEE 0 TCZ_FNVGT_EBPG_COLD_ADDR -20 250
 /begin AXIS_DESCR FIX_AXIS NO_INPUT_QUANTITY TCX_FNVGT_EBPG_COLD_ADDR 14 0 13 FIX_AXIS_PAR 0 0 14 /end AXIS_DESCR
 /begin AXIS_DESCR FIX_AXIS NO_INPUT_QUANTITY TCY_FNVGT_EBPG_COLD_ADDR 14 0 13 FIX_AXIS_PAR 0 0 14 /end AXIS_DESCR
/end CHARACTERISTIC
/begin COMPU_METHOD TCZ_FNVGT_EBPG_COLD_ADDR "FNVGT_EBPG_COLD_ADDR Z-axis conversion" RAT_FUNC "%10.5" "unitless" COEFFS 0 1 0 0 0 1 /end COMPU_METHOD
/begin COMPU_METHOD TCX_FNVGT_EBPG_COLD_ADDR "FNVGT_EBPG_COLD_ADDR X-axis conversion" RAT_FUNC "%10.5" "unitless" COEFFS 0 1 0 0 0 1 /end COMPU_METHOD
/begin COMPU_METHOD TCY_FNVGT_EBPG_COLD_ADDR "FNVGT_EBPG_COLD_ADDR Y-axis conversion" RAT_FUNC "%10.5" "unitless" COEFFS 0 1 0 0 0 1 /end COMPU_METHOD
/begin CHARACTERISTIC FNVGT_EBPG_DES_EGR_HI "X Norm=FN090_VGT, Y Norm=FN091_VGT" MAP 0x5219C TD_FLOAT32_IEEE 0 TCZ_FNVGT_EBPG_DES_EGR_HI -10 250
 /begin AXIS_DESCR FIX_AXIS NO_INPUT_QUANTITY TCX_FNVGT_EBPG_DES_EGR_HI 14 0 13 FIX_AXIS_PAR 0 0 14 /end AXIS_DESCR
 /begin AXIS_DESCR FIX_AXIS NO_INPUT_QUANTITY TCY_FNVGT_EBPG_DES_EGR_HI 14 0 13 FIX_AXIS_PAR 0 0 14 /end AXIS_DESCR
/end CHARACTERISTIC
/begin COMPU_METHOD TCZ_FNVGT_EBPG_DES_EGR_HI "FNVGT_EBPG_DES_EGR_HI Z-axis conversion" RAT_FUNC "%10.5" "unitless" COEFFS 0 1 0 0 0 1 /end COMPU_METHOD
/begin COMPU_METHOD TCX_FNVGT_EBPG_DES_EGR_HI "FNVGT_EBPG_DES_EGR_HI X-axis conversion" RAT_FUNC "%10.5" "unitless" COEFFS 0 1 0 0 0 1 /end COMPU_METHOD
/begin COMPU_METHOD TCY_FNVGT_EBPG_DES_EGR_HI "FNVGT_EBPG_DES_EGR_HI Y-axis conversion" RAT_FUNC "%10.5" "unitless" COEFFS 0 1 0 0 0 1 /end COMPU_METHOD
/begin CHARACTERISTIC FNVGT_EBPG_DES_EGR_LO "X Norm=FN090_VGT, Y Norm=FN091_VGT" MAP 0x524AC TD_FLOAT32_IEEE 0 TCZ_FNVGT_EBPG_DES_EGR_LO -10 250
 /begin AXIS_DESCR FIX_AXIS NO_INPUT_QUANTITY TCX_FNVGT_EBPG_DES_EGR_LO 14 0 13 FIX_AXIS_PAR 0 0 14 /end AXIS_DESCR
 /begin AXIS_DESCR FIX_AXIS NO_INPUT_QUANTITY TCY_FNVGT_EBPG_DES_EGR_LO 14 0 13 FIX_AXIS_PAR 0 0 14 /end AXIS_DESCR
/end CHARACTERISTIC
/begin COMPU_METHOD TCZ_FNVGT_EBPG_DES_EGR_LO "FNVGT_EBPG_DES_EGR_LO Z-axis conversion" RAT_FUNC "%10.5" "unitless" COEFFS 0 1 0 0 0 1 /end COMPU_METHOD
/begin COMPU_METHOD TCX_FNVGT_EBPG_DES_EGR_LO "FNVGT_EBPG_DES_EGR_LO X-axis conversion" RAT_FUNC "%10.5" "unitless" COEFFS 0 1 0 0 0 1 /end COMPU_METHOD
/begin COMPU_METHOD TCY_FNVGT_EBPG_DES_EGR_LO "FNVGT_EBPG_DES_EGR_LO Y-axis conversion" RAT_FUNC "%10.5" "unitless" COEFFS 0 1 0 0 0 1 /end COMPU_METHOD
/begin CHARACTERISTIC FNVGT_EBPG_DES_EGR_MED "X Norm=FN090_VGT, Y Norm=FN091_VGT" MAP 0x527BC TD_FLOAT32_IEEE 0 TCZ_FNVGT_EBPG_DES_EGR_MED -10 250
 /begin AXIS_DESCR FIX_AXIS NO_INPUT_QUANTITY TCX_FNVGT_EBPG_DES_EGR_MED 14 0 13 FIX_AXIS_PAR 0 0 14 /end AXIS_DESCR
 /begin AXIS_DESCR FIX_AXIS NO_INPUT_QUANTITY TCY_FNVGT_EBPG_DES_EGR_MED 14 0 13 FIX_AXIS_PAR 0 0 14 /end AXIS_DESCR
/end CHARACTERISTIC
/begin COMPU_METHOD TCZ_FNVGT_EBPG_DES_EGR_MED "FNVGT_EBPG_DES_EGR_MED Z-axis conversion" RAT_FUNC "%10.5" "unitless" COEFFS 0 1 0 0 0 1 /end COMPU_METHOD
/begin COMPU_METHOD TCX_FNVGT_EBPG_DES_EGR_MED "FNVGT_EBPG_DES_EGR_MED X-axis conversion" RAT_FUNC "%10.5" "unitless" COEFFS 0 1 0 0 0 1 /end COMPU_METHOD
/begin COMPU_METHOD TCY_FNVGT_EBPG_DES_EGR_MED "FNVGT_EBPG_DES_EGR_MED Y-axis conversion" RAT_FUNC "%10.5" "unitless" COEFFS 0 1 0 0 0 1 /end COMPU_METHOD
/begin CHARACTERISTIC FNVGT_EBPG_DES_NEGR_HI "X Norm=FN090_VGT, Y Norm=FN091_VGT" MAP 0x52ACC TD_FLOAT32_IEEE 0 TCZ_FNVGT_EBPG_DES_NEGR_HI -10 250
 /begin AXIS_DESCR FIX_AXIS NO_INPUT_QUANTITY TCX_FNVGT_EBPG_DES_NEGR_HI 14 0 13 FIX_AXIS_PAR 0 0 14 /end AXIS_DESCR
 /begin AXIS_DESCR FIX_AXIS NO_INPUT_QUANTITY TCY_FNVGT_EBPG_DES_NEGR_HI 14 0 13 FIX_AXIS_PAR 0 0 14 /end AXIS_DESCR
/end CHARACTERISTIC
/begin COMPU_METHOD TCZ_FNVGT_EBPG_DES_NEGR_HI "FNVGT_EBPG_DES_NEGR_HI Z-axis conversion" RAT_FUNC "%10.5" "unitless" COEFFS 0 1 0 0 0 1 /end COMPU_METHOD
/begin COMPU_METHOD TCX_FNVGT_EBPG_DES_NEGR_HI "FNVGT_EBPG_DES_NEGR_HI X-axis conversion" RAT_FUNC "%10.5" "unitless" COEFFS 0 1 0 0 0 1 /end COMPU_METHOD
/begin COMPU_METHOD TCY_FNVGT_EBPG_DES_NEGR_HI "FNVGT_EBPG_DES_NEGR_HI Y-axis conversion" RAT_FUNC "%10.5" "unitless" COEFFS 0 1 0 0 0 1 /end COMPU_METHOD
/begin CHARACTERISTIC FNVGT_EBPG_DES_NEGR_LO "X Norm=FN090_VGT, Y Norm=FN091_VGT" MAP 0x52DDC TD_FLOAT32_IEEE 0 TCZ_FNVGT_EBPG_DES_NEGR_LO -10 250
 /begin AXIS_DESCR FIX_AXIS NO_INPUT_QUANTITY TCX_FNVGT_EBPG_DES_NEGR_LO 14 0 13 FIX_AXIS_PAR 0 0 14 /end AXIS_DESCR
 /begin AXIS_DESCR FIX_AXIS NO_INPUT_QUANTITY TCY_FNVGT_EBPG_DES_NEGR_LO 14 0 13 FIX_AXIS_PAR 0 0 14 /end AXIS_DESCR
/end CHARACTERISTIC
/begin COMPU_METHOD TCZ_FNVGT_EBPG_DES_NEGR_LO "FNVGT_EBPG_DES_NEGR_LO Z-axis conversion" RAT_FUNC "%10.5" "unitless" COEFFS 0 1 0 0 0 1 /end COMPU_METHOD
/begin COMPU_METHOD TCX_FNVGT_EBPG_DES_NEGR_LO "FNVGT_EBPG_DES_NEGR_LO X-axis conversion" RAT_FUNC "%10.5" "unitless" COEFFS 0 1 0 0 0 1 /end COMPU_METHOD
/begin COMPU_METHOD TCY_FNVGT_EBPG_DES_NEGR_LO "FNVGT_EBPG_DES_NEGR_LO Y-axis conversion" RAT_FUNC "%10.5" "unitless" COEFFS 0 1 0 0 0 1 /end COMPU_METHOD
/begin CHARACTERISTIC FNVGT_EBPG_DES_NEGR_MED "X Norm=FN090_VGT, Y Norm=FN091_VGT" MAP 0x530EC TD_FLOAT32_IEEE 0 TCZ_FNVGT_EBPG_DES_NEGR_MED -10 250
 /begin AXIS_DESCR FIX_AXIS NO_INPUT_QUANTITY TCX_FNVGT_EBPG_DES_NEGR_MED 14 0 13 FIX_AXIS_PAR 0 0 14 /end AXIS_DESCR
 /begin AXIS_DESCR FIX_AXIS NO_INPUT_QUANTITY TCY_FNVGT_EBPG_DES_NEGR_MED 14 0 13 FIX_AXIS_PAR 0 0 14 /end AXIS_DESCR
/end CHARACTERISTIC
/begin COMPU_METHOD TCZ_FNVGT_EBPG_DES_NEGR_MED "FNVGT_EBPG_DES_NEGR_MED Z-axis conversion" RAT_FUNC "%10.5" "unitless" COEFFS 0 1 0 0 0 1 /end COMPU_METHOD
/begin COMPU_METHOD TCX_FNVGT_EBPG_DES_NEGR_MED "FNVGT_EBPG_DES_NEGR_MED X-axis conversion" RAT_FUNC "%10.5" "unitless" COEFFS 0 1 0 0 0 1 /end COMPU_METHOD
/begin COMPU_METHOD TCY_FNVGT_EBPG_DES_NEGR_MED "FNVGT_EBPG_DES_NEGR_MED Y-axis conversion" RAT_FUNC "%10.5" "unitless" COEFFS 0 1 0 0 0 1 /end COMPU_METHOD
/begin CHARACTERISTIC FNVGT_EBPG_FF_EGR "X Norm=FN090_VGT, Y Norm=FN091_VGT" MAP 0x5186C TD_FLOAT32_IEEE 0 TCZ_FNVGT_EBPG_FF_EGR 0 1
 /begin AXIS_DESCR FIX_AXIS NO_INPUT_QUANTITY TCX_FNVGT_EBPG_FF_EGR 14 0 13 FIX_AXIS_PAR 0 0 14 /end AXIS_DESCR
 /begin AXIS_DESCR FIX_AXIS NO_INPUT_QUANTITY TCY_FNVGT_EBPG_FF_EGR 14 0 13 FIX_AXIS_PAR 0 0 14 /end AXIS_DESCR
/end CHARACTERISTIC
/begin COMPU_METHOD TCZ_FNVGT_EBPG_FF_EGR "FNVGT_EBPG_FF_EGR Z-axis conversion" RAT_FUNC "%10.5" "unitless" COEFFS 0 1 0 0 0 1 /end COMPU_METHOD
/begin COMPU_METHOD TCX_FNVGT_EBPG_FF_EGR "FNVGT_EBPG_FF_EGR X-axis conversion" RAT_FUNC "%10.5" "unitless" COEFFS 0 1 0 0 0 1 /end COMPU_METHOD
/begin COMPU_METHOD TCY_FNVGT_EBPG_FF_EGR "FNVGT_EBPG_FF_EGR Y-axis conversion" RAT_FUNC "%10.5" "unitless" COEFFS 0 1 0 0 0 1 /end COMPU_METHOD
/begin CHARACTERISTIC FNVGT_EBPG_FF_NEGR "X Norm=FN090_VGT, Y Norm=FN091_VGT" MAP 0x51B7C TD_FLOAT32_IEEE 0 TCZ_FNVGT_EBPG_FF_NEGR 0 1
 /begin AXIS_DESCR FIX_AXIS NO_INPUT_QUANTITY TCX_FNVGT_EBPG_FF_NEGR 14 0 13 FIX_AXIS_PAR 0 0 14 /end AXIS_DESCR
 /begin AXIS_DESCR FIX_AXIS NO_INPUT_QUANTITY TCY_FNVGT_EBPG_FF_NEGR 14 0 13 FIX_AXIS_PAR 0 0 14 /end AXIS_DESCR
/end CHARACTERISTIC
/begin COMPU_METHOD TCZ_FNVGT_EBPG_FF_NEGR "FNVGT_EBPG_FF_NEGR Z-axis conversion" RAT_FUNC "%10.5" "unitless" COEFFS 0 1 0 0 0 1 /end COMPU_METHOD
/begin COMPU_METHOD TCX_FNVGT_EBPG_FF_NEGR "FNVGT_EBPG_FF_NEGR X-axis conversion" RAT_FUNC "%10.5" "unitless" COEFFS 0 1 0 0 0 1 /end COMPU_METHOD
/begin COMPU_METHOD TCY_FNVGT_EBPG_FF_NEGR "FNVGT_EBPG_FF_NEGR Y-axis conversion" RAT_FUNC "%10.5" "unitless" COEFFS 0 1 0 0 0 1 /end COMPU_METHOD
/begin CHARACTERISTIC FNVGT_EOT_COLD_MULT "" CURVE 0x5116C FD_FLOAT32_IEEE 0 FCY_FNVGT_EOT_COLD_MULT 0 1 /begin AXIS_DESCR STD_AXIS EOT_C FCX_FNVGT_EOT_COLD_MULT 14 -40 150 /end AXIS_DESCR /end CHARACTERISTIC
/begin COMPU_METHOD FCX_FNVGT_EOT_COLD_MULT "FNVGT_EOT_COLD_MULT X-axis conversion" RAT_FUNC "%10.5" "unitless" COEFFS 0 1 0 0 0 1 /end COMPU_METHOD
/begin COMPU_METHOD FCY_FNVGT_EOT_COLD_MULT "FNVGT_EOT_COLD_MULT Y-axis conversion" RAT_FUNC "%10.5" "unitless" COEFFS 0 1 0 0 0 1 /end COMPU_METHOD
/begin CHARACTERISTIC FNVGT_EOT_DUTY_MAX "" CURVE 0x514EC FD_FLOAT32_IEEE 0 FCY_FNVGT_EOT_DUTY_MAX 0 1 /begin AXIS_DESCR STD_AXIS EOT_C FCX_FNVGT_EOT_DUTY_MAX 14 -40 150 /end AXIS_DESCR /end CHARACTERISTIC
/begin COMPU_METHOD FCX_FNVGT_EOT_DUTY_MAX "FNVGT_EOT_DUTY_MAX X-axis conversion" RAT_FUNC "%10.5" "unitless" COEFFS 0 1 0 0 0 1 /end COMPU_METHOD
/begin COMPU_METHOD FCY_FNVGT_EOT_DUTY_MAX "FNVGT_EOT_DUTY_MAX Y-axis conversion" RAT_FUNC "%10.5" "unitless" COEFFS 0 1 0 0 0 1 /end COMPU_METHOD
/begin CHARACTERISTIC FNVGT_MAP_CLIP "" CURVE 0x5108C FD_FLOAT32_IEEE 0 FCY_FNVGT_MAP_CLIP 0 1 /begin AXIS_DESCR STD_AXIS VGT_OB_KPA FCX_FNVGT_MAP_CLIP 14 0 255.992 /end AXIS_DESCR /end CHARACTERISTIC
/begin COMPU_METHOD FCX_FNVGT_MAP_CLIP "FNVGT_MAP_CLIP X-axis conversion" RAT_FUNC "%10.5" "unitless" COEFFS 0 1 0 0 0 1 /end COMPU_METHOD
/begin COMPU_METHOD FCY_FNVGT_MAP_CLIP "FNVGT_MAP_CLIP Y-axis conversion" RAT_FUNC "%10.5" "unitless" COEFFS 0 1 0 0 0 1 /end COMPU_METHOD
/begin CHARACTERISTIC FNVGT_MAP_MAX "X Norm=FN090_VGT, Y Norm=FN091_VGT" MAP 0x51E8C TD_FLOAT32_IEEE 0 TCZ_FNVGT_MAP_MAX 0 255.992
 /begin AXIS_DESCR FIX_AXIS NO_INPUT_QUANTITY TCX_FNVGT_MAP_MAX 14 0 13 FIX_AXIS_PAR 0 0 14 /end AXIS_DESCR
 /begin AXIS_DESCR FIX_AXIS NO_INPUT_QUANTITY TCY_FNVGT_MAP_MAX 14 0 13 FIX_AXIS_PAR 0 0 14 /end AXIS_DESCR
/end CHARACTERISTIC
/begin COMPU_METHOD TCZ_FNVGT_MAP_MAX "FNVGT_MAP_MAX Z-axis conversion" RAT_FUNC "%10.5" "unitless" COEFFS 0 1 0 0 0 1 /end COMPU_METHOD
/begin COMPU_METHOD TCX_FNVGT_MAP_MAX "FNVGT_MAP_MAX X-axis conversion" RAT_FUNC "%10.5" "unitless" COEFFS 0 1 0 0 0 1 /end COMPU_METHOD
/begin COMPU_METHOD TCY_FNVGT_MAP_MAX "FNVGT_MAP_MAX Y-axis conversion" RAT_FUNC "%10.5" "unitless" COEFFS 0 1 0 0 0 1 /end COMPU_METHOD
/begin CHARACTERISTIC FNVGT_MF_TRNS_MULT "" CURVE 0x510FC FD_FLOAT32_IEEE 0 FCY_FNVGT_MF_TRNS_MULT 0 1
 /begin AXIS_DESCR STD_AXIS VGT_MF_TRNS_VAL FCX_FNVGT_MF_TRNS_MULT 14 -1000 1000 /end AXIS_DESCR
/end CHARACTERISTIC
/begin COMPU_METHOD FCX_FNVGT_MF_TRNS_MULT "FNVGT_MF_TRNS_MULT X-axis conversion" RAT_FUNC "%10.5" "unitless" COEFFS 0 1 0 0 0 1 /end COMPU_METHOD
/begin COMPU_METHOD FCY_FNVGT_MF_TRNS_MULT "FNVGT_MF_TRNS_MULT Y-axis conversion" RAT_FUNC "%10.5" "unitless" COEFFS 0 1 0 0 0 1 /end COMPU_METHOD
/begin CHARACTERISTIC FNVGT_N_DUTY_LMX "" CURVE 0x5124C FD_FLOAT32_IEEE 0 FCY_FNVGT_N_DUTY_LMX 0 1 /begin AXIS_DESCR STD_AXIS N FCX_FNVGT_N_DUTY_LMX 14 0 5000 /end AXIS_DESCR /end CHARACTERISTIC
/begin COMPU_METHOD FCX_FNVGT_N_DUTY_LMX "FNVGT_N_DUTY_LMX X-axis conversion" RAT_FUNC "%10.5" "unitless" COEFFS 0 1 0 0 0 1 /end COMPU_METHOD
/begin COMPU_METHOD FCY_FNVGT_N_DUTY_LMX "FNVGT_N_DUTY_LMX Y-axis conversion" RAT_FUNC "%10.5" "unitless" COEFFS 0 1 0 0 0 1 /end COMPU_METHOD
/begin CHARACTERISTIC FNVGT_OB_MFL_PCT "" CURVE 0x511DC FD_FLOAT32_IEEE 0 FCY_FNVGT_OB_MFL_PCT 0.5 1 /begin AXIS_DESCR STD_AXIS VGT_OB_KPA FCX_FNVGT_OB_MFL_PCT 14 0 255.992 /end AXIS_DESCR /end CHARACTERISTIC
/begin COMPU_METHOD FCX_FNVGT_OB_MFL_PCT "FNVGT_OB_MFL_PCT X-axis conversion" RAT_FUNC "%10.5" "unitless" COEFFS 0 1 0 0 0 1 /end COMPU_METHOD
/begin COMPU_METHOD FCY_FNVGT_OB_MFL_PCT "FNVGT_OB_MFL_PCT Y-axis conversion" RAT_FUNC "%10.5" "unitless" COEFFS 0 1 0 0 0 1 /end COMPU_METHOD
/begin CHARACTERISTIC FN_090_DP "" CURVE 0x4EC8C FD_FLOAT32_IEEE 0 FCY_FN_090_DP 0 14 /begin AXIS_DESCR STD_AXIS N FCX_FN_090_DP 14 0 5000 /end AXIS_DESCR /end CHARACTERISTIC
/begin COMPU_METHOD FCX_FN_090_DP "FN_090_DP X-axis conversion" RAT_FUNC "%10.5" "unitless" COEFFS 0 1 0 0 0 1 /end COMPU_METHOD
/begin COMPU_METHOD FCY_FN_090_DP "FN_090_DP Y-axis conversion" RAT_FUNC "%10.5" "unitless" COEFFS 0 1 0 0 0 1 /end COMPU_METHOD
/begin CHARACTERISTIC FN_091_DP "" CURVE 0x4ECFC FD_FLOAT32_IEEE 0 FCY_FN_091_DP 0 14 /begin AXIS_DESCR STD_AXIS MFDES FCX_FN_091_DP 14 0 150 /end AXIS_DESCR /end CHARACTERISTIC
/begin COMPU_METHOD FCX_FN_091_DP "FN_091_DP X-axis conversion" RAT_FUNC "%10.5" "unitless" COEFFS 0 1 0 0 0 1 /end COMPU_METHOD
/begin COMPU_METHOD FCY_FN_091_DP "FN_091_DP Y-axis conversion" RAT_FUNC "%10.5" "unitless" COEFFS 0 1 0 0 0 1 /end COMPU_METHOD
/begin CHARACTERISTIC FN_092_DP "" CURVE 0x4ED6C FD_FLOAT32_IEEE 0 FCY_FN_092_DP 0 15 /begin AXIS_DESCR STD_AXIS DP_EGR_MFLW FCX_FN_092_DP 14 0 10000 /end AXIS_DESCR /end CHARACTERISTIC
/begin COMPU_METHOD FCX_FN_092_DP "FN_092_DP X-axis conversion" RAT_FUNC "%10.5" "unitless" COEFFS 0 1 0 0 0 1 /end COMPU_METHOD
/begin COMPU_METHOD FCY_FN_092_DP "FN_092_DP Y-axis conversion" RAT_FUNC "%10.5" "unitless" COEFFS 0 1 0 0 0 1 /end COMPU_METHOD
/begin CHARACTERISTIC FN_093_DP "" CURVE 0x4EDDC FD_FLOAT32_IEEE 0 FCY_FN_093_DP 0 15 /begin AXIS_DESCR STD_AXIS DP_DP FCX_FN_093_DP 14 -150 50 /end AXIS_DESCR /end CHARACTERISTIC
/begin COMPU_METHOD FCX_FN_093_DP "FN_093_DP X-axis conversion" RAT_FUNC "%10.5" "unitless" COEFFS 0 1 0 0 0 1 /end COMPU_METHOD
/begin COMPU_METHOD FCY_FN_093_DP "FN_093_DP Y-axis conversion" RAT_FUNC "%10.5" "unitless" COEFFS 0 1 0 0 0 1 /end COMPU_METHOD
/begin CHARACTERISTIC FN_095_DP "" CURVE 0x4EE4C FD_FLOAT32_IEEE 0 FCY_FN_095_DP 0 15 /begin AXIS_DESCR STD_AXIS DP_EGRP_DES FCX_FN_095_DP 14 0 1 /end AXIS_DESCR /end CHARACTERISTIC
/begin COMPU_METHOD FCX_FN_095_DP "FN_095_DP X-axis conversion" RAT_FUNC "%10.5" "unitless" COEFFS 0 1 0 0 0 1 /end COMPU_METHOD
/begin COMPU_METHOD FCY_FN_095_DP "FN_095_DP Y-axis conversion" RAT_FUNC "%10.5" "unitless" COEFFS 0 1 0 0 0 1 /end COMPU_METHOD
/begin CHARACTERISTIC FN_AC_A_OFF "Delay between the system requesting the A/C off and the Air turn off as a function of engine speed." CURVE 0x40D7C FD_FLOAT32_IEEE 0 FCY_FN_AC_A_OFF 0 63.999 /begin AXIS_DESCR STD_AXIS N FCX_FN_AC_A_OFF 6 0 8000 /end AXIS_DESCR /end CHARACTERISTIC
/begin COMPU_METHOD FCX_FN_AC_A_OFF "FN_AC_A_OFF X-axis conversion" RAT_FUNC "%10.5" "RPM" COEFFS 0 1 0 0 0 1 /end COMPU_METHOD
/begin COMPU_METHOD FCY_FN_AC_A_OFF "FN_AC_A_OFF Y-axis conversion" RAT_FUNC "%10.5" "s" COEFFS 0 1 0 0 0 1 /end COMPU_METHOD
/begin CHARACTERISTIC FN_AC_C_OFF "Delay between the system requesting the A/C off and the Clutch disengaging as a function of engine speed." CURVE 0x40DAC FD_FLOAT32_IEEE 0 FCY_FN_AC_C_OFF 0 63.999 /begin AXIS_DESCR STD_AXIS N FCX_FN_AC_C_OFF 6 0 8000 /end AXIS_DESCR /end CHARACTERISTIC
/begin COMPU_METHOD FCX_FN_AC_C_OFF "FN_AC_C_OFF X-axis conversion" RAT_FUNC "%10.5" "RPM" COEFFS 0 1 0 0 0 1 /end COMPU_METHOD
/begin COMPU_METHOD FCY_FN_AC_C_OFF "FN_AC_C_OFF Y-axis conversion" RAT_FUNC "%10.5" "s" COEFFS 0 1 0 0 0 1 /end COMPU_METHOD
/begin CHARACTERISTIC FN_AFRMNH "X Norm=FN090_AFR, Y Norm=FN091_AFR" MAP 0x44A1C TD_FLOAT32_IEEE 0 TCZ_FN_AFRMNH 0 100
 /begin AXIS_DESCR FIX_AXIS NO_INPUT_QUANTITY TCX_FN_AFRMNH 12 0 11 FIX_AXIS_PAR 0 0 12 /end AXIS_DESCR
 /begin AXIS_DESCR FIX_AXIS NO_INPUT_QUANTITY TCY_FN_AFRMNH 11 0 10 FIX_AXIS_PAR 0 0 11 /end AXIS_DESCR
/end CHARACTERISTIC
/begin COMPU_METHOD TCZ_FN_AFRMNH "FN_AFRMNH Z-axis conversion" RAT_FUNC "%10.5" "unitless" COEFFS 0 1 0 0 0 1 /end COMPU_METHOD
/begin COMPU_METHOD TCX_FN_AFRMNH "FN_AFRMNH X-axis conversion" RAT_FUNC "%10.5" "RPM" COEFFS 0 1 0 0 0 1 /end COMPU_METHOD
/begin COMPU_METHOD TCY_FN_AFRMNH "FN_AFRMNH Y-axis conversion" RAT_FUNC "%10.5" "g/s" COEFFS 0 1 0 0 0 1 /end COMPU_METHOD
/begin CHARACTERISTIC FN_AFRMNL "X Norm=FN090_AFR, Y Norm=FN091_AFR" MAP 0x44E3C TD_FLOAT32_IEEE 0 TCZ_FN_AFRMNL 0 200
 /begin AXIS_DESCR FIX_AXIS NO_INPUT_QUANTITY TCX_FN_AFRMNL 12 0 11 FIX_AXIS_PAR 0 0 12 /end AXIS_DESCR
 /begin AXIS_DESCR FIX_AXIS NO_INPUT_QUANTITY TCY_FN_AFRMNL 11 0 10 FIX_AXIS_PAR 0 0 11 /end AXIS_DESCR
/end CHARACTERISTIC
/begin COMPU_METHOD TCZ_FN_AFRMNL "FN_AFRMNL Z-axis conversion" RAT_FUNC "%10.5" "unitless" COEFFS 0 1 0 0 0 1 /end COMPU_METHOD
/begin COMPU_METHOD TCX_FN_AFRMNL "FN_AFRMNL X-axis conversion" RAT_FUNC "%10.5" "RPM" COEFFS 0 1 0 0 0 1 /end COMPU_METHOD
/begin COMPU_METHOD TCY_FN_AFRMNL "FN_AFRMNL Y-axis conversion" RAT_FUNC "%10.5" "g/s" COEFFS 0 1 0 0 0 1 /end COMPU_METHOD
/begin CHARACTERISTIC FN_AFRMNM "X Norm=FN090_AFR, Y Norm=FN091_AFR" MAP 0x44C2C TD_FLOAT32_IEEE 0 TCZ_FN_AFRMNM 0 100
 /begin AXIS_DESCR FIX_AXIS NO_INPUT_QUANTITY TCX_FN_AFRMNM 12 0 11 FIX_AXIS_PAR 0 0 12 /end AXIS_DESCR
 /begin AXIS_DESCR FIX_AXIS NO_INPUT_QUANTITY TCY_FN_AFRMNM 11 0 10 FIX_AXIS_PAR 0 0 11 /end AXIS_DESCR
/end CHARACTERISTIC
/begin COMPU_METHOD TCZ_FN_AFRMNM "FN_AFRMNM Z-axis conversion" RAT_FUNC "%10.5" "unitless" COEFFS 0 1 0 0 0 1 /end COMPU_METHOD
/begin COMPU_METHOD TCX_FN_AFRMNM "FN_AFRMNM X-axis conversion" RAT_FUNC "%10.5" "RPM" COEFFS 0 1 0 0 0 1 /end COMPU_METHOD
/begin COMPU_METHOD TCY_FN_AFRMNM "FN_AFRMNM Y-axis conversion" RAT_FUNC "%10.5" "g/s" COEFFS 0 1 0 0 0 1 /end COMPU_METHOD
/begin CHARACTERISTIC FN_AFRMNPH "X Norm=FN090P_AFR, Y Norm=FN091P_AFR" MAP 0x4504C TD_FLOAT32_IEEE 0 TCZ_FN_AFRMNPH 0 200
 /begin AXIS_DESCR FIX_AXIS NO_INPUT_QUANTITY TCX_FN_AFRMNPH 12 0 11 FIX_AXIS_PAR 0 0 12 /end AXIS_DESCR
 /begin AXIS_DESCR FIX_AXIS NO_INPUT_QUANTITY TCY_FN_AFRMNPH 11 0 10 FIX_AXIS_PAR 0 0 11 /end AXIS_DESCR
/end CHARACTERISTIC
/begin COMPU_METHOD TCZ_FN_AFRMNPH "FN_AFRMNPH Z-axis conversion" RAT_FUNC "%10.5" "unitless" COEFFS 0 1 0 0 0 1 /end COMPU_METHOD
/begin COMPU_METHOD TCX_FN_AFRMNPH "FN_AFRMNPH X-axis conversion" RAT_FUNC "%10.5" "unitless" COEFFS 0 1 0 0 0 1 /end COMPU_METHOD
/begin COMPU_METHOD TCY_FN_AFRMNPH "FN_AFRMNPH Y-axis conversion" RAT_FUNC "%10.5" "g/s" COEFFS 0 1 0 0 0 1 /end COMPU_METHOD
/begin CHARACTERISTIC FN_AFRMNPL "X Norm=FN090P_AFR, Y Norm=FN091P_AFR" MAP 0x4546C TD_FLOAT32_IEEE 0 TCZ_FN_AFRMNPL 0 200
 /begin AXIS_DESCR FIX_AXIS NO_INPUT_QUANTITY TCX_FN_AFRMNPL 12 0 11 FIX_AXIS_PAR 0 0 12 /end AXIS_DESCR
 /begin AXIS_DESCR FIX_AXIS NO_INPUT_QUANTITY TCY_FN_AFRMNPL 11 0 10 FIX_AXIS_PAR 0 0 11 /end AXIS_DESCR
/end CHARACTERISTIC
/begin COMPU_METHOD TCZ_FN_AFRMNPL "FN_AFRMNPL Z-axis conversion" RAT_FUNC "%10.5" "unitless" COEFFS 0 1 0 0 0 1 /end COMPU_METHOD
/begin COMPU_METHOD TCX_FN_AFRMNPL "FN_AFRMNPL X-axis conversion" RAT_FUNC "%10.5" "unitless" COEFFS 0 1 0 0 0 1 /end COMPU_METHOD
/begin COMPU_METHOD TCY_FN_AFRMNPL "FN_AFRMNPL Y-axis conversion" RAT_FUNC "%10.5" "g/s" COEFFS 0 1 0 0 0 1 /end COMPU_METHOD
/begin CHARACTERISTIC FN_AFRMNPM "X Norm=FN090P_AFR, Y Norm=FN091P_AFR" MAP 0x4525C TD_FLOAT32_IEEE 0 TCZ_FN_AFRMNPM 0 200
 /begin AXIS_DESCR FIX_AXIS NO_INPUT_QUANTITY TCX_FN_AFRMNPM 12 0 11 FIX_AXIS_PAR 0 0 12 /end AXIS_DESCR
 /begin AXIS_DESCR FIX_AXIS NO_INPUT_QUANTITY TCY_FN_AFRMNPM 11 0 10 FIX_AXIS_PAR 0 0 11 /end AXIS_DESCR
/end CHARACTERISTIC
/begin COMPU_METHOD TCZ_FN_AFRMNPM "FN_AFRMNPM Z-axis conversion" RAT_FUNC "%10.5" "unitless" COEFFS 0 1 0 0 0 1 /end COMPU_METHOD
/begin COMPU_METHOD TCX_FN_AFRMNPM "FN_AFRMNPM X-axis conversion" RAT_FUNC "%10.5" "unitless" COEFFS 0 1 0 0 0 1 /end COMPU_METHOD
/begin COMPU_METHOD TCY_FN_AFRMNPM "FN_AFRMNPM Y-axis conversion" RAT_FUNC "%10.5" "g/s" COEFFS 0 1 0 0 0 1 /end COMPU_METHOD
/begin CHARACTERISTIC FN_BP2ALT "Barometric pressure multiplier function" CURVE 0x4118C FD_FLOAT32_IEEE 0 FCY_FN_BP2ALT 0 2 /begin AXIS_DESCR STD_AXIS NO_INPUT_QUANTITY FCX_FN_BP2ALT 8 0 300 /end AXIS_DESCR /end CHARACTERISTIC
/begin COMPU_METHOD FCX_FN_BP2ALT "FN_BP2ALT X-axis conversion" RAT_FUNC "%10.5" "unitless" COEFFS 0 1 0 0 0 1 /end COMPU_METHOD
/begin COMPU_METHOD FCY_FN_BP2ALT "FN_BP2ALT Y-axis conversion" RAT_FUNC "%10.5" "unitless" COEFFS 0 1 0 0 0 1 /end COMPU_METHOD
/begin CHARACTERISTIC FN_DP_ANTI_FOUL "" CURVE 0x4EEBC FD_FLOAT32_IEEE 0 FCY_FN_DP_ANTI_FOUL 0 15 /begin AXIS_DESCR STD_AXIS EOT_C FCX_FN_DP_ANTI_FOUL 14 -40 150 /end AXIS_DESCR /end CHARACTERISTIC
/begin COMPU_METHOD FCX_FN_DP_ANTI_FOUL "FN_DP_ANTI_FOUL X-axis conversion" RAT_FUNC "%10.5" "unitless" COEFFS 0 1 0 0 0 1 /end COMPU_METHOD
/begin COMPU_METHOD FCY_FN_DP_ANTI_FOUL "FN_DP_ANTI_FOUL Y-axis conversion" RAT_FUNC "%10.5" "unitless" COEFFS 0 1 0 0 0 1 /end COMPU_METHOD
/begin CHARACTERISTIC FN_DP_EGRPCT_LMX "" CURVE 0x4EF2C FD_FLOAT32_IEEE 0 FCY_FN_DP_EGRPCT_LMX 0 15 /begin AXIS_DESCR STD_AXIS DP_TOT_MASS_FLOW FCX_FN_DP_EGRPCT_LMX 14 0 50000 /end AXIS_DESCR /end CHARACTERISTIC
/begin COMPU_METHOD FCX_FN_DP_EGRPCT_LMX "FN_DP_EGRPCT_LMX X-axis conversion" RAT_FUNC "%10.5" "unitless" COEFFS 0 1 0 0 0 1 /end COMPU_METHOD
/begin COMPU_METHOD FCY_FN_DP_EGRPCT_LMX "FN_DP_EGRPCT_LMX Y-axis conversion" RAT_FUNC "%10.5" "unitless" COEFFS 0 1 0 0 0 1 /end COMPU_METHOD
/begin CHARACTERISTIC FN_DP_EGRVP_DES "X Norm=FN_092_DP, Y Norm=FN_093_DP" MAP 0x4FCBC TD_FLOAT32_IEEE 0 TCZ_FN_DP_EGRVP_DES 0 1
 /begin AXIS_DESCR FIX_AXIS NO_INPUT_QUANTITY TCX_FN_DP_EGRVP_DES 14 0 13 FIX_AXIS_PAR 0 0 14 /end AXIS_DESCR
 /begin AXIS_DESCR FIX_AXIS NO_INPUT_QUANTITY TCY_FN_DP_EGRVP_DES 14 0 13 FIX_AXIS_PAR 0 0 14 /end AXIS_DESCR
/end CHARACTERISTIC
/begin COMPU_METHOD TCZ_FN_DP_EGRVP_DES "FN_DP_EGRVP_DES Z-axis conversion" RAT_FUNC "%10.5" "unitless" COEFFS 0 1 0 0 0 1 /end COMPU_METHOD
/begin COMPU_METHOD TCX_FN_DP_EGRVP_DES "FN_DP_EGRVP_DES X-axis conversion" RAT_FUNC "%10.5" "unitless" COEFFS 0 1 0 0 0 1 /end COMPU_METHOD
/begin COMPU_METHOD TCY_FN_DP_EGRVP_DES "FN_DP_EGRVP_DES Y-axis conversion" RAT_FUNC "%10.5" "unitless" COEFFS 0 1 0 0 0 1 /end COMPU_METHOD
/begin CHARACTERISTIC FN_DP_EGR_FF "X Norm=FN_092_DP, Y Norm=FN_095_DP" MAP 0x4F07C TD_FLOAT32_IEEE 0 TCZ_FN_DP_EGR_FF 0 1
 /begin AXIS_DESCR FIX_AXIS NO_INPUT_QUANTITY TCX_FN_DP_EGR_FF 14 0 13 FIX_AXIS_PAR 0 0 14 /end AXIS_DESCR
 /begin AXIS_DESCR FIX_AXIS NO_INPUT_QUANTITY TCY_FN_DP_EGR_FF 14 0 13 FIX_AXIS_PAR 0 0 14 /end AXIS_DESCR
/end CHARACTERISTIC
/begin COMPU_METHOD TCZ_FN_DP_EGR_FF "FN_DP_EGR_FF Z-axis conversion" RAT_FUNC "%10.5" "unitless" COEFFS 0 1 0 0 0 1 /end COMPU_METHOD
/begin COMPU_METHOD TCX_FN_DP_EGR_FF "FN_DP_EGR_FF X-axis conversion" RAT_FUNC "%10.5" "unitless" COEFFS 0 1 0 0 0 1 /end COMPU_METHOD
/begin COMPU_METHOD TCY_FN_DP_EGR_FF "FN_DP_EGR_FF Y-axis conversion" RAT_FUNC "%10.5" "unitless" COEFFS 0 1 0 0 0 1 /end COMPU_METHOD
/begin CHARACTERISTIC FN_DP_EGR_PCT_DES_HI "X Norm=FN_090_DP, Y Norm=FN_091_DP" MAP 0x4F38C TD_FLOAT32_IEEE 0 TCZ_FN_DP_EGR_PCT_DES_HI 0 100
 /begin AXIS_DESCR FIX_AXIS NO_INPUT_QUANTITY TCX_FN_DP_EGR_PCT_DES_HI 14 0 13 FIX_AXIS_PAR 0 0 14 /end AXIS_DESCR
 /begin AXIS_DESCR FIX_AXIS NO_INPUT_QUANTITY TCY_FN_DP_EGR_PCT_DES_HI 14 0 13 FIX_AXIS_PAR 0 0 14 /end AXIS_DESCR
/end CHARACTERISTIC
/begin COMPU_METHOD TCZ_FN_DP_EGR_PCT_DES_HI "FN_DP_EGR_PCT_DES_HI Z-axis conversion" RAT_FUNC "%10.5" "unitless" COEFFS 0 1 0 0 0 1 /end COMPU_METHOD
/begin COMPU_METHOD TCX_FN_DP_EGR_PCT_DES_HI "FN_DP_EGR_PCT_DES_HI X-axis conversion" RAT_FUNC "%10.5" "unitless" COEFFS 0 1 0 0 0 1 /end COMPU_METHOD
/begin COMPU_METHOD TCY_FN_DP_EGR_PCT_DES_HI "FN_DP_EGR_PCT_DES_HI Y-axis conversion" RAT_FUNC "%10.5" "unitless" COEFFS 0 1 0 0 0 1 /end COMPU_METHOD
/begin CHARACTERISTIC FN_DP_EGR_PCT_DES_LO "X Norm=FN_090_DP, Y Norm=FN_091_DP" MAP 0x4F69C TD_FLOAT32_IEEE 0 TCZ_FN_DP_EGR_PCT_DES_LO 0 100
 /begin AXIS_DESCR FIX_AXIS NO_INPUT_QUANTITY TCX_FN_DP_EGR_PCT_DES_LO 14 0 13 FIX_AXIS_PAR 0 0 14 /end AXIS_DESCR
 /begin AXIS_DESCR FIX_AXIS NO_INPUT_QUANTITY TCY_FN_DP_EGR_PCT_DES_LO 14 0 13 FIX_AXIS_PAR 0 0 14 /end AXIS_DESCR
/end CHARACTERISTIC
/begin COMPU_METHOD TCZ_FN_DP_EGR_PCT_DES_LO "FN_DP_EGR_PCT_DES_LO Z-axis conversion" RAT_FUNC "%10.5" "unitless" COEFFS 0 1 0 0 0 1 /end COMPU_METHOD
/begin COMPU_METHOD TCX_FN_DP_EGR_PCT_DES_LO "FN_DP_EGR_PCT_DES_LO X-axis conversion" RAT_FUNC "%10.5" "unitless" COEFFS 0 1 0 0 0 1 /end COMPU_METHOD
/begin COMPU_METHOD TCY_FN_DP_EGR_PCT_DES_LO "FN_DP_EGR_PCT_DES_LO Y-axis conversion" RAT_FUNC "%10.5" "unitless" COEFFS 0 1 0 0 0 1 /end COMPU_METHOD
/begin CHARACTERISTIC FN_DP_EGR_PCT_DES_MED "X Norm=FN_090_DP, Y Norm=FN_091_DP" MAP 0x4F9AC TD_FLOAT32_IEEE 0 TCZ_FN_DP_EGR_PCT_DES_MED 0 100
 /begin AXIS_DESCR FIX_AXIS NO_INPUT_QUANTITY TCX_FN_DP_EGR_PCT_DES_MED 14 0 13 FIX_AXIS_PAR 0 0 14 /end AXIS_DESCR
 /begin AXIS_DESCR FIX_AXIS NO_INPUT_QUANTITY TCY_FN_DP_EGR_PCT_DES_MED 14 0 13 FIX_AXIS_PAR 0 0 14 /end AXIS_DESCR
/end CHARACTERISTIC
/begin COMPU_METHOD TCZ_FN_DP_EGR_PCT_DES_MED "FN_DP_EGR_PCT_DES_MED Z-axis conversion" RAT_FUNC "%10.5" "unitless" COEFFS 0 1 0 0 0 1 /end COMPU_METHOD
/begin COMPU_METHOD TCX_FN_DP_EGR_PCT_DES_MED "FN_DP_EGR_PCT_DES_MED X-axis conversion" RAT_FUNC "%10.5" "unitless" COEFFS 0 1 0 0 0 1 /end COMPU_METHOD
/begin COMPU_METHOD TCY_FN_DP_EGR_PCT_DES_MED "FN_DP_EGR_PCT_DES_MED Y-axis conversion" RAT_FUNC "%10.5" "unitless" COEFFS 0 1 0 0 0 1 /end COMPU_METHOD
/begin CHARACTERISTIC FN_DP_MF_TRNS_MULT "" CURVE 0x4EF9C FD_FLOAT32_IEEE 0 FCY_FN_DP_MF_TRNS_MULT 0 1
 /begin AXIS_DESCR STD_AXIS DP_EGR_MF_TRNS_FILT FCX_FN_DP_MF_TRNS_MULT 14 -150 300 /end AXIS_DESCR
/end CHARACTERISTIC
/begin COMPU_METHOD FCX_FN_DP_MF_TRNS_MULT "FN_DP_MF_TRNS_MULT X-axis conversion" RAT_FUNC "%10.5" "unitless" COEFFS 0 1 0 0 0 1 /end COMPU_METHOD
/begin COMPU_METHOD FCY_FN_DP_MF_TRNS_MULT "FN_DP_MF_TRNS_MULT Y-axis conversion" RAT_FUNC "%10.5" "unitless" COEFFS 0 1 0 0 0 1 /end COMPU_METHOD
/begin CHARACTERISTIC FN_DP_PLUS "" CURVE 0x4F00C FD_FLOAT32_IEEE 0 FCY_FN_DP_PLUS 0 1 /begin AXIS_DESCR STD_AXIS DP_DP FCX_FN_DP_PLUS 14 -150 50 /end AXIS_DESCR /end CHARACTERISTIC
/begin COMPU_METHOD FCX_FN_DP_PLUS "FN_DP_PLUS X-axis conversion" RAT_FUNC "%10.5" "unitless" COEFFS 0 1 0 0 0 1 /end COMPU_METHOD
/begin COMPU_METHOD FCY_FN_DP_PLUS "FN_DP_PLUS Y-axis conversion" RAT_FUNC "%10.5" "unitless" COEFFS 0 1 0 0 0 1 /end COMPU_METHOD
/begin CHARACTERISTIC FN_DP_VOL_EFF "X Norm=FN_090_DP, Y Norm=FN_093_DP" MAP 0x4FFCC TD_FLOAT32_IEEE 0 TCZ_FN_DP_VOL_EFF 0 100
 /begin AXIS_DESCR FIX_AXIS NO_INPUT_QUANTITY TCX_FN_DP_VOL_EFF 14 0 13 FIX_AXIS_PAR 0 0 14 /end AXIS_DESCR
 /begin AXIS_DESCR FIX_AXIS NO_INPUT_QUANTITY TCY_FN_DP_VOL_EFF 14 0 13 FIX_AXIS_PAR 0 0 14 /end AXIS_DESCR
/end CHARACTERISTIC
/begin COMPU_METHOD TCZ_FN_DP_VOL_EFF "FN_DP_VOL_EFF Z-axis conversion" RAT_FUNC "%10.5" "unitless" COEFFS 0 1 0 0 0 1 /end COMPU_METHOD
/begin COMPU_METHOD TCX_FN_DP_VOL_EFF "FN_DP_VOL_EFF X-axis conversion" RAT_FUNC "%10.5" "unitless" COEFFS 0 1 0 0 0 1 /end COMPU_METHOD
/begin COMPU_METHOD TCY_FN_DP_VOL_EFF "FN_DP_VOL_EFF Y-axis conversion" RAT_FUNC "%10.5" "unitless" COEFFS 0 1 0 0 0 1 /end COMPU_METHOD
/begin CHARACTERISTIC FN_ECT_THLD_ECT_COLD "" CURVE 0x4169C FD_FLOAT32_IEEE 0 FCY_FN_ECT_THLD_ECT_COLD 0 65535 /begin AXIS_DESCR STD_AXIS ECT_C FCX_FN_ECT_THLD_ECT_COLD 14 -4096 4095.87 /end AXIS_DESCR /end CHARACTERISTIC
/begin COMPU_METHOD FCX_FN_ECT_THLD_ECT_COLD "FN_ECT_THLD_ECT_COLD X-axis conversion" RAT_FUNC "%10.5" "degC" COEFFS 0 1 0 0 0 1 /end COMPU_METHOD
/begin COMPU_METHOD FCY_FN_ECT_THLD_ECT_COLD "FN_ECT_THLD_ECT_COLD Y-axis conversion" RAT_FUNC "%10.5" "unitless" COEFFS 0 1 0 0 0 1 /end COMPU_METHOD
/begin CHARACTERISTIC FN_ECT_THLD_ECT_HOT "" CURVE 0x415BC FD_FLOAT32_IEEE 0 FCY_FN_ECT_THLD_ECT_HOT 0 65535 /begin AXIS_DESCR STD_AXIS ECT_C FCX_FN_ECT_THLD_ECT_HOT 14 -4096 4095.87 /end AXIS_DESCR /end CHARACTERISTIC
/begin COMPU_METHOD FCX_FN_ECT_THLD_ECT_HOT "FN_ECT_THLD_ECT_HOT X-axis conversion" RAT_FUNC "%10.5" "degC" COEFFS 0 1 0 0 0 1 /end COMPU_METHOD
/begin COMPU_METHOD FCY_FN_ECT_THLD_ECT_HOT "FN_ECT_THLD_ECT_HOT Y-axis conversion" RAT_FUNC "%10.5" "unitless" COEFFS 0 1 0 0 0 1 /end COMPU_METHOD
/begin CHARACTERISTIC FN_ECT_THLD_IAT_COLD "" CURVE 0x4162C FD_FLOAT32_IEEE 0 FCY_FN_ECT_THLD_IAT_COLD 0 65535 /begin AXIS_DESCR STD_AXIS IAT FCX_FN_ECT_THLD_IAT_COLD 14 0 127.5 /end AXIS_DESCR /end CHARACTERISTIC
/begin COMPU_METHOD FCX_FN_ECT_THLD_IAT_COLD "FN_ECT_THLD_IAT_COLD X-axis conversion" RAT_FUNC "%10.5" "A" COEFFS 0 1 0 0 0 1 /end COMPU_METHOD
/begin COMPU_METHOD FCY_FN_ECT_THLD_IAT_COLD "FN_ECT_THLD_IAT_COLD Y-axis conversion" RAT_FUNC "%10.5" "unitless" COEFFS 0 1 0 0 0 1 /end COMPU_METHOD
/begin CHARACTERISTIC FN_ECT_THLD_IAT_HOT "" CURVE 0x4154C FD_FLOAT32_IEEE 0 FCY_FN_ECT_THLD_IAT_HOT 0 65535 /begin AXIS_DESCR STD_AXIS IAT FCX_FN_ECT_THLD_IAT_HOT 14 0 127.5 /end AXIS_DESCR /end CHARACTERISTIC
/begin COMPU_METHOD FCX_FN_ECT_THLD_IAT_HOT "FN_ECT_THLD_IAT_HOT X-axis conversion" RAT_FUNC "%10.5" "A" COEFFS 0 1 0 0 0 1 /end COMPU_METHOD
/begin COMPU_METHOD FCY_FN_ECT_THLD_IAT_HOT "FN_ECT_THLD_IAT_HOT Y-axis conversion" RAT_FUNC "%10.5" "unitless" COEFFS 0 1 0 0 0 1 /end COMPU_METHOD
/begin CHARACTERISTIC FN_EOT_THLD_EOT_COLD "EOT cold error threshold count table based on EOT value" CURVE 0x4146C FD_FLOAT32_IEEE 0 FCY_FN_EOT_THLD_EOT_COLD 0 65535 /begin AXIS_DESCR STD_AXIS EOT_C FCX_FN_EOT_THLD_EOT_COLD 14 -8192 8191 /end AXIS_DESCR /end CHARACTERISTIC
/begin COMPU_METHOD FCX_FN_EOT_THLD_EOT_COLD "FN_EOT_THLD_EOT_COLD X-axis conversion" RAT_FUNC "%10.5" "degC" COEFFS 0 1 0 0 0 1 /end COMPU_METHOD
/begin COMPU_METHOD FCY_FN_EOT_THLD_EOT_COLD "FN_EOT_THLD_EOT_COLD Y-axis conversion" RAT_FUNC "%10.5" "unitless" COEFFS 0 1 0 0 0 1 /end COMPU_METHOD
/begin CHARACTERISTIC FN_EOT_THLD_EOT_HOT "EOT hot error threshold count table based on EOT value" CURVE 0x4138C FD_FLOAT32_IEEE 0 FCY_FN_EOT_THLD_EOT_HOT 0 65535 /begin AXIS_DESCR STD_AXIS EOT_C FCX_FN_EOT_THLD_EOT_HOT 14 -8192 8191 /end AXIS_DESCR /end CHARACTERISTIC
/begin COMPU_METHOD FCX_FN_EOT_THLD_EOT_HOT "FN_EOT_THLD_EOT_HOT X-axis conversion" RAT_FUNC "%10.5" "degC" COEFFS 0 1 0 0 0 1 /end COMPU_METHOD
/begin COMPU_METHOD FCY_FN_EOT_THLD_EOT_HOT "FN_EOT_THLD_EOT_HOT Y-axis conversion" RAT_FUNC "%10.5" "unitless" COEFFS 0 1 0 0 0 1 /end COMPU_METHOD
/begin CHARACTERISTIC FN_EOT_THLD_IAT_COLD "EOT  cold error threshold count table based on IAT value." CURVE 0x413FC FD_FLOAT32_IEEE 0 FCY_FN_EOT_THLD_IAT_COLD 0 65535 /begin AXIS_DESCR STD_AXIS IAT FCX_FN_EOT_THLD_IAT_COLD 14 0 127.5 /end AXIS_DESCR /end CHARACTERISTIC
/begin COMPU_METHOD FCX_FN_EOT_THLD_IAT_COLD "FN_EOT_THLD_IAT_COLD X-axis conversion" RAT_FUNC "%10.5" "A" COEFFS 0 1 0 0 0 1 /end COMPU_METHOD
/begin COMPU_METHOD FCY_FN_EOT_THLD_IAT_COLD "FN_EOT_THLD_IAT_COLD Y-axis conversion" RAT_FUNC "%10.5" "unitless" COEFFS 0 1 0 0 0 1 /end COMPU_METHOD
/begin CHARACTERISTIC FN_EOT_THLD_IAT_HOT "EOT hot error threshold count table based on IAT value." CURVE 0x4131C FD_FLOAT32_IEEE 0 FCY_FN_EOT_THLD_IAT_HOT 0 65535 /begin AXIS_DESCR STD_AXIS IAT FCX_FN_EOT_THLD_IAT_HOT 14 0 127.5 /end AXIS_DESCR /end CHARACTERISTIC
/begin COMPU_METHOD FCX_FN_EOT_THLD_IAT_HOT "FN_EOT_THLD_IAT_HOT X-axis conversion" RAT_FUNC "%10.5" "A" COEFFS 0 1 0 0 0 1 /end COMPU_METHOD
/begin COMPU_METHOD FCY_FN_EOT_THLD_IAT_HOT "FN_EOT_THLD_IAT_HOT Y-axis conversion" RAT_FUNC "%10.5" "unitless" COEFFS 0 1 0 0 0 1 /end COMPU_METHOD
/begin CHARACTERISTIC FN_EOT_THLD_TST_TM "EOT threshold timer counter table." CURVE 0x412AC FD_FLOAT32_IEEE 0 FCY_FN_EOT_THLD_TST_TM 0 64 /begin AXIS_DESCR STD_AXIS EOT_C FCX_FN_EOT_THLD_TST_TM 14 -100 400 /end AXIS_DESCR /end CHARACTERISTIC
/begin COMPU_METHOD FCX_FN_EOT_THLD_TST_TM "FN_EOT_THLD_TST_TM X-axis conversion" RAT_FUNC "%10.5" "degC" COEFFS 0 1 0 0 0 1 /end COMPU_METHOD
/begin COMPU_METHOD FCY_FN_EOT_THLD_TST_TM "FN_EOT_THLD_TST_TM Y-axis conversion" RAT_FUNC "%10.5" "s" COEFFS 0 1 0 0 0 1 /end COMPU_METHOD
/begin CHARACTERISTIC FN_FRICTION "X Norm=FNN_FRICT_NORM, Y Norm=FNEOTC_FRICT_NORM" MAP 0x4C34C TD_FLOAT32_IEEE 0 TCZ_FN_FRICTION 0 500
 /begin AXIS_DESCR FIX_AXIS NO_INPUT_QUANTITY TCX_FN_FRICTION 14 0 13 FIX_AXIS_PAR 0 0 14 /end AXIS_DESCR
 /begin AXIS_DESCR FIX_AXIS NO_INPUT_QUANTITY TCY_FN_FRICTION 14 0 13 FIX_AXIS_PAR 0 0 14 /end AXIS_DESCR
/end CHARACTERISTIC
/begin COMPU_METHOD TCZ_FN_FRICTION "FN_FRICTION Z-axis conversion" RAT_FUNC "%10.5" "unitless" COEFFS 0 1 0 0 0 1 /end COMPU_METHOD
/begin COMPU_METHOD TCX_FN_FRICTION "FN_FRICTION X-axis conversion" RAT_FUNC "%10.5" "unitless" COEFFS 0 1 0 0 0 1 /end COMPU_METHOD
/begin COMPU_METHOD TCY_FN_FRICTION "FN_FRICTION Y-axis conversion" RAT_FUNC "%10.5" "unitless" COEFFS 0 1 0 0 0 1 /end COMPU_METHOD
/begin CHARACTERISTIC FN_HIALT_MN "X Norm=FN090DS_TQ, Y Norm=FN091DS_TQ" MAP 0x4AD6C TD_FLOAT32_IEEE 0 TCZ_FN_HIALT_MN 0 500
 /begin AXIS_DESCR FIX_AXIS NO_INPUT_QUANTITY TCX_FN_HIALT_MN 14 0 13 FIX_AXIS_PAR 0 0 14 /end AXIS_DESCR
 /begin AXIS_DESCR FIX_AXIS NO_INPUT_QUANTITY TCY_FN_HIALT_MN 14 0 13 FIX_AXIS_PAR 0 0 14 /end AXIS_DESCR
/end CHARACTERISTIC
/begin COMPU_METHOD TCZ_FN_HIALT_MN "FN_HIALT_MN Z-axis conversion" RAT_FUNC "%10.5" "unitless" COEFFS 0 1 0 0 0 1 /end COMPU_METHOD
/begin COMPU_METHOD TCX_FN_HIALT_MN "FN_HIALT_MN X-axis conversion" RAT_FUNC "%10.5" "unitless" COEFFS 0 1 0 0 0 1 /end COMPU_METHOD
/begin COMPU_METHOD TCY_FN_HIALT_MN "FN_HIALT_MN Y-axis conversion" RAT_FUNC "%10.5" "unitless" COEFFS 0 1 0 0 0 1 /end COMPU_METHOD
/begin CHARACTERISTIC FN_HIALT_MN_COPY "X Norm=FN_TQ114, Y Norm=FN_TQ106, Copy of fn_hialt_mn from the torque calculator" MAP 0x4CF9C TD_FLOAT32_IEEE 0 TCZ_FN_HIALT_MN_COPY 0 1000
 /begin AXIS_DESCR FIX_AXIS NO_INPUT_QUANTITY TCX_FN_HIALT_MN_COPY 14 0 13 FIX_AXIS_PAR 0 0 14 /end AXIS_DESCR
 /begin AXIS_DESCR FIX_AXIS NO_INPUT_QUANTITY TCY_FN_HIALT_MN_COPY 14 0 13 FIX_AXIS_PAR 0 0 14 /end AXIS_DESCR
/end CHARACTERISTIC
/begin COMPU_METHOD TCZ_FN_HIALT_MN_COPY "FN_HIALT_MN_COPY Z-axis conversion" RAT_FUNC "%10.5" "unitless" COEFFS 0 1 0 0 0 1 /end COMPU_METHOD
/begin COMPU_METHOD TCX_FN_HIALT_MN_COPY "FN_HIALT_MN_COPY X-axis conversion" RAT_FUNC "%10.5" "unitless" COEFFS 0 1 0 0 0 1 /end COMPU_METHOD
/begin COMPU_METHOD TCY_FN_HIALT_MN_COPY "FN_HIALT_MN_COPY Y-axis conversion" RAT_FUNC "%10.5" "unitless" COEFFS 0 1 0 0 0 1 /end COMPU_METHOD
/begin CHARACTERISTIC FN_ID_SEED "Underrun 'SEED' function in Drive Only" CURVE 0x4290C FD_FLOAT32_IEEE 0 FCY_FN_ID_SEED 0 80 /begin AXIS_DESCR STD_AXIS EOT_C FCX_FN_ID_SEED 8 -40 150 /end AXIS_DESCR /end CHARACTERISTIC
/begin COMPU_METHOD FCX_FN_ID_SEED "FN_ID_SEED X-axis conversion" RAT_FUNC "%10.5" "degC" COEFFS 0 1 0 0 0 1 /end COMPU_METHOD
/begin COMPU_METHOD FCY_FN_ID_SEED "FN_ID_SEED Y-axis conversion" RAT_FUNC "%10.5" "unitless" COEFFS 0 1 0 0 0 1 /end COMPU_METHOD
/begin CHARACTERISTIC FN_INFMAT_ADDER "X Norm=FN_N_MAT_NORM, Y Norm=FN_MFDES_MAT_NORM, Inferred MAT offset value" MAP 0x41E9C TD_FLOAT32_IEEE 0 TCZ_FN_INFMAT_ADDER -2048 2047.94
 /begin AXIS_DESCR FIX_AXIS NO_INPUT_QUANTITY TCX_FN_INFMAT_ADDER 8 0 7 FIX_AXIS_PAR 0 0 8 /end AXIS_DESCR
 /begin AXIS_DESCR FIX_AXIS NO_INPUT_QUANTITY TCY_FN_INFMAT_ADDER 12 0 11 FIX_AXIS_PAR 0 0 12 /end AXIS_DESCR
/end CHARACTERISTIC
/begin COMPU_METHOD TCZ_FN_INFMAT_ADDER "FN_INFMAT_ADDER Z-axis conversion" RAT_FUNC "%10.5" "unitless" COEFFS 0 1 0 0 0 1 /end COMPU_METHOD
/begin COMPU_METHOD TCX_FN_INFMAT_ADDER "FN_INFMAT_ADDER X-axis conversion" RAT_FUNC "%10.5" "RPM" COEFFS 0 1 0 0 0 1 /end COMPU_METHOD
/begin COMPU_METHOD TCY_FN_INFMAT_ADDER "FN_INFMAT_ADDER Y-axis conversion" RAT_FUNC "%10.5" "unitless" COEFFS 0 1 0 0 0 1 /end COMPU_METHOD
/begin CHARACTERISTIC FN_IN_SEED "Underrun 'SEED' function in neutral" CURVE 0x428CC FD_FLOAT32_IEEE 0 FCY_FN_IN_SEED 0 80 /begin AXIS_DESCR STD_AXIS EOT_C FCX_FN_IN_SEED 8 -40 150 /end AXIS_DESCR /end CHARACTERISTIC
/begin COMPU_METHOD FCX_FN_IN_SEED "FN_IN_SEED X-axis conversion" RAT_FUNC "%10.5" "degC" COEFFS 0 1 0 0 0 1 /end COMPU_METHOD
/begin COMPU_METHOD FCY_FN_IN_SEED "FN_IN_SEED Y-axis conversion" RAT_FUNC "%10.5" "unitless" COEFFS 0 1 0 0 0 1 /end COMPU_METHOD
/begin CHARACTERISTIC FN_ITH_ANTI_FOUL "" CURVE 0x5041C FD_FLOAT32_IEEE 0 FCY_FN_ITH_ANTI_FOUL 0 1 /begin AXIS_DESCR STD_AXIS EOT_C FCX_FN_ITH_ANTI_FOUL 14 -50 150 /end AXIS_DESCR /end CHARACTERISTIC
/begin COMPU_METHOD FCX_FN_ITH_ANTI_FOUL "FN_ITH_ANTI_FOUL X-axis conversion" RAT_FUNC "%10.5" "unitless" COEFFS 0 1 0 0 0 1 /end COMPU_METHOD
/begin COMPU_METHOD FCY_FN_ITH_ANTI_FOUL "FN_ITH_ANTI_FOUL Y-axis conversion" RAT_FUNC "%10.5" "unitless" COEFFS 0 1 0 0 0 1 /end COMPU_METHOD
/begin CHARACTERISTIC FN_ITH_TRNS_MULT "" CURVE 0x5048C FD_FLOAT32_IEEE 0 FCY_FN_ITH_TRNS_MULT 0 1 /begin AXIS_DESCR STD_AXIS ITH_MF_TRNS_FILT FCX_FN_ITH_TRNS_MULT 14 -350 350 /end AXIS_DESCR /end CHARACTERISTIC
/begin COMPU_METHOD FCX_FN_ITH_TRNS_MULT "FN_ITH_TRNS_MULT X-axis conversion" RAT_FUNC "%10.5" "unitless" COEFFS 0 1 0 0 0 1 /end COMPU_METHOD
/begin COMPU_METHOD FCY_FN_ITH_TRNS_MULT "FN_ITH_TRNS_MULT Y-axis conversion" RAT_FUNC "%10.5" "unitless" COEFFS 0 1 0 0 0 1 /end COMPU_METHOD
/begin CHARACTERISTIC FN_LOALT_MN "X Norm=FN090DS_TQ, Y Norm=FN091DS_TQ" MAP 0x4B3AC TD_FLOAT32_IEEE 0 TCZ_FN_LOALT_MN 0 500
 /begin AXIS_DESCR FIX_AXIS NO_INPUT_QUANTITY TCX_FN_LOALT_MN 14 0 13 FIX_AXIS_PAR 0 0 14 /end AXIS_DESCR
 /begin AXIS_DESCR FIX_AXIS NO_INPUT_QUANTITY TCY_FN_LOALT_MN 14 0 13 FIX_AXIS_PAR 0 0 14 /end AXIS_DESCR
/end CHARACTERISTIC
/begin COMPU_METHOD TCZ_FN_LOALT_MN "FN_LOALT_MN Z-axis conversion" RAT_FUNC "%10.5" "unitless" COEFFS 0 1 0 0 0 1 /end COMPU_METHOD
/begin COMPU_METHOD TCX_FN_LOALT_MN "FN_LOALT_MN X-axis conversion" RAT_FUNC "%10.5" "unitless" COEFFS 0 1 0 0 0 1 /end COMPU_METHOD
/begin COMPU_METHOD TCY_FN_LOALT_MN "FN_LOALT_MN Y-axis conversion" RAT_FUNC "%10.5" "unitless" COEFFS 0 1 0 0 0 1 /end COMPU_METHOD
/begin CHARACTERISTIC FN_LOALT_MN_COPY "X Norm=FN_TQ114, Y Norm=FN_TQ106, Copy of fn_loalt_mn from the torque calculator" MAP 0x4D5DC TD_FLOAT32_IEEE 0 TCZ_FN_LOALT_MN_COPY 0 1000
 /begin AXIS_DESCR FIX_AXIS NO_INPUT_QUANTITY TCX_FN_LOALT_MN_COPY 14 0 13 FIX_AXIS_PAR 0 0 14 /end AXIS_DESCR
 /begin AXIS_DESCR FIX_AXIS NO_INPUT_QUANTITY TCY_FN_LOALT_MN_COPY 14 0 13 FIX_AXIS_PAR 0 0 14 /end AXIS_DESCR
/end CHARACTERISTIC
/begin COMPU_METHOD TCZ_FN_LOALT_MN_COPY "FN_LOALT_MN_COPY Z-axis conversion" RAT_FUNC "%10.5" "unitless" COEFFS 0 1 0 0 0 1 /end COMPU_METHOD
/begin COMPU_METHOD TCX_FN_LOALT_MN_COPY "FN_LOALT_MN_COPY X-axis conversion" RAT_FUNC "%10.5" "unitless" COEFFS 0 1 0 0 0 1 /end COMPU_METHOD
/begin COMPU_METHOD TCY_FN_LOALT_MN_COPY "FN_LOALT_MN_COPY Y-axis conversion" RAT_FUNC "%10.5" "unitless" COEFFS 0 1 0 0 0 1 /end COMPU_METHOD
/begin CHARACTERISTIC FN_MEDALT_MN "X Norm=FN090DS_TQ, Y Norm=FN091DS_TQ" MAP 0x4B08C TD_FLOAT32_IEEE 0 TCZ_FN_MEDALT_MN 0 500
 /begin AXIS_DESCR FIX_AXIS NO_INPUT_QUANTITY TCX_FN_MEDALT_MN 14 0 13 FIX_AXIS_PAR 0 0 14 /end AXIS_DESCR
 /begin AXIS_DESCR FIX_AXIS NO_INPUT_QUANTITY TCY_FN_MEDALT_MN 14 0 13 FIX_AXIS_PAR 0 0 14 /end AXIS_DESCR
/end CHARACTERISTIC
/begin COMPU_METHOD TCZ_FN_MEDALT_MN "FN_MEDALT_MN Z-axis conversion" RAT_FUNC "%10.5" "unitless" COEFFS 0 1 0 0 0 1 /end COMPU_METHOD
/begin COMPU_METHOD TCX_FN_MEDALT_MN "FN_MEDALT_MN X-axis conversion" RAT_FUNC "%10.5" "unitless" COEFFS 0 1 0 0 0 1 /end COMPU_METHOD
/begin COMPU_METHOD TCY_FN_MEDALT_MN "FN_MEDALT_MN Y-axis conversion" RAT_FUNC "%10.5" "unitless" COEFFS 0 1 0 0 0 1 /end COMPU_METHOD
/begin CHARACTERISTIC FN_MEDALT_MN_COPY "X Norm=FN_TQ114, Y Norm=FN_TQ106, Copy of fn_medalt_mn from the torque calculator" MAP 0x4D2BC TD_FLOAT32_IEEE 0 TCZ_FN_MEDALT_MN_COPY 0 1000
 /begin AXIS_DESCR FIX_AXIS NO_INPUT_QUANTITY TCX_FN_MEDALT_MN_COPY 14 0 13 FIX_AXIS_PAR 0 0 14 /end AXIS_DESCR
 /begin AXIS_DESCR FIX_AXIS NO_INPUT_QUANTITY TCY_FN_MEDALT_MN_COPY 14 0 13 FIX_AXIS_PAR 0 0 14 /end AXIS_DESCR
/end CHARACTERISTIC
/begin COMPU_METHOD TCZ_FN_MEDALT_MN_COPY "FN_MEDALT_MN_COPY Z-axis conversion" RAT_FUNC "%10.5" "unitless" COEFFS 0 1 0 0 0 1 /end COMPU_METHOD
/begin COMPU_METHOD TCX_FN_MEDALT_MN_COPY "FN_MEDALT_MN_COPY X-axis conversion" RAT_FUNC "%10.5" "unitless" COEFFS 0 1 0 0 0 1 /end COMPU_METHOD
/begin COMPU_METHOD TCY_FN_MEDALT_MN_COPY "FN_MEDALT_MN_COPY Y-axis conversion" RAT_FUNC "%10.5" "unitless" COEFFS 0 1 0 0 0 1 /end COMPU_METHOD
/begin CHARACTERISTIC FN_MFBCOL "" CURVE 0x4408C FD_FLOAT32_IEEE 0 FCY_FN_MFBCOL 0 11 /begin AXIS_DESCR STD_AXIS EOT_C FCX_FN_MFBCOL 12 -200 1000 /end AXIS_DESCR /end CHARACTERISTIC
/begin COMPU_METHOD FCX_FN_MFBCOL "FN_MFBCOL X-axis conversion" RAT_FUNC "%10.5" "unitless" COEFFS 0 1 0 0 0 1 /end COMPU_METHOD
/begin COMPU_METHOD FCY_FN_MFBCOL "FN_MFBCOL Y-axis conversion" RAT_FUNC "%10.5" "unitless" COEFFS 0 1 0 0 0 1 /end COMPU_METHOD
/begin CHARACTERISTIC FN_MFDES_MAT_NORM "Desired MAF normalising function for fn_infmat_adder" CURVE 0x41E5C FD_FLOAT32_IEEE 0 FCY_FN_MFDES_MAT_NORM 0 8
 /begin AXIS_DESCR STD_AXIS NO_INPUT_QUANTITY FCX_FN_MFDES_MAT_NORM 8 -2048 2047.94 /end AXIS_DESCR
/end CHARACTERISTIC
/begin COMPU_METHOD FCX_FN_MFDES_MAT_NORM "FN_MFDES_MAT_NORM X-axis conversion" RAT_FUNC "%10.5" "unitless" COEFFS 0 1 0 0 0 1 /end COMPU_METHOD
/begin COMPU_METHOD FCY_FN_MFDES_MAT_NORM "FN_MFDES_MAT_NORM Y-axis conversion" RAT_FUNC "%10.5" "unitless" COEFFS 0 1 0 0 0 1 /end COMPU_METHOD
/begin CHARACTERISTIC FN_N_MAT_NORM "Engine speed normalising function for fn_infmat_adder" CURVE 0x41DFC FD_FLOAT32_IEEE 0 FCY_FN_N_MAT_NORM 0 12 /begin AXIS_DESCR STD_AXIS N FCX_FN_N_MAT_NORM 12 0 8000 /end AXIS_DESCR /end CHARACTERISTIC
/begin COMPU_METHOD FCX_FN_N_MAT_NORM "FN_N_MAT_NORM X-axis conversion" RAT_FUNC "%10.5" "RPM" COEFFS 0 1 0 0 0 1 /end COMPU_METHOD
/begin COMPU_METHOD FCY_FN_N_MAT_NORM "FN_N_MAT_NORM Y-axis conversion" RAT_FUNC "%10.5" "unitless" COEFFS 0 1 0 0 0 1 /end COMPU_METHOD
/begin CHARACTERISTIC FN_TQ100 "Normalixed eot_c for fn2_tq_xxx_brk_cf table function" CURVE 0x4CA6C FD_FLOAT32_IEEE 0 FCY_FN_TQ100 0 10 /begin AXIS_DESCR STD_AXIS EOT_C FCX_FN_TQ100 10 -8000 8000 /end AXIS_DESCR /end CHARACTERISTIC
/begin COMPU_METHOD FCX_FN_TQ100 "FN_TQ100 X-axis conversion" RAT_FUNC "%10.5" "degC" COEFFS 0 1 0 0 0 1 /end COMPU_METHOD
/begin COMPU_METHOD FCY_FN_TQ100 "FN_TQ100 Y-axis conversion" RAT_FUNC "%10.5" "unitless" COEFFS 0 1 0 0 0 1 /end COMPU_METHOD
/begin CHARACTERISTIC FN_TQ101 "Normalize bp_kpa for fn2_tq_xxx_brk_cf table function" CURVE 0x4CABC FD_FLOAT32_IEEE 0 FCY_FN_TQ101 0 9 /begin AXIS_DESCR STD_AXIS NO_INPUT_QUANTITY FCX_FN_TQ101 10 0 16000 /end AXIS_DESCR /end CHARACTERISTIC
/begin COMPU_METHOD FCX_FN_TQ101 "FN_TQ101 X-axis conversion" RAT_FUNC "%10.5" "kPa" COEFFS 0 1 0 0 0 1 /end COMPU_METHOD
/begin COMPU_METHOD FCY_FN_TQ101 "FN_TQ101 Y-axis conversion" RAT_FUNC "%10.5" "unitless" COEFFS 0 1 0 0 0 1 /end COMPU_METHOD
/begin CHARACTERISTIC FN_TQ104 "Output normalized tq_max_comb_trq" CURVE 0x4CB7C FD_FLOAT32_IEEE 0 FCY_FN_TQ104 0 13 /begin AXIS_DESCR STD_AXIS TQ_MAX_COMB_TRQ FCX_FN_TQ104 14 -400 1100 /end AXIS_DESCR /end CHARACTERISTIC
/begin COMPU_METHOD FCX_FN_TQ104 "FN_TQ104 X-axis conversion" RAT_FUNC "%10.5" "lbf*ft" COEFFS 0 1 0 0 0 1 /end COMPU_METHOD
/begin COMPU_METHOD FCY_FN_TQ104 "FN_TQ104 Y-axis conversion" RAT_FUNC "%10.5" "unitless" COEFFS 0 1 0 0 0 1 /end COMPU_METHOD
/begin CHARACTERISTIC FN_TQ106 "Output normalized mfgov_pi" CURVE 0x4CB0C FD_FLOAT32_IEEE 0 FCY_FN_TQ106 0 13 /begin AXIS_DESCR STD_AXIS MFGOV_PI FCX_FN_TQ106 14 -2000 2000 /end AXIS_DESCR /end CHARACTERISTIC
/begin COMPU_METHOD FCX_FN_TQ106 "FN_TQ106 X-axis conversion" RAT_FUNC "%10.5" "unitless" COEFFS 0 1 0 0 0 1 /end COMPU_METHOD
/begin COMPU_METHOD FCY_FN_TQ106 "FN_TQ106 Y-axis conversion" RAT_FUNC "%10.5" "unitless" COEFFS 0 1 0 0 0 1 /end COMPU_METHOD
/begin CHARACTERISTIC FN_TQ114 "Engine speed normalizing function" CURVE 0x4CBEC FD_FLOAT32_IEEE 0 FCY_FN_TQ114 0 14 /begin AXIS_DESCR STD_AXIS N FCX_FN_TQ114 14 0 8000 /end AXIS_DESCR /end CHARACTERISTIC
/begin COMPU_METHOD FCX_FN_TQ114 "FN_TQ114 X-axis conversion" RAT_FUNC "%10.5" "unitless" COEFFS 0 1 0 0 0 1 /end COMPU_METHOD
/begin COMPU_METHOD FCY_FN_TQ114 "FN_TQ114 Y-axis conversion" RAT_FUNC "%10.5" "unitless" COEFFS 0 1 0 0 0 1 /end COMPU_METHOD
/begin CHARACTERISTIC FN_TQ_MOTORING_TORQUE "normal motoring torque curve for the engine" CURVE 0x4C9FC FD_FLOAT32_IEEE 0 FCY_FN_TQ_MOTORING_TORQUE -400 1100 /begin AXIS_DESCR STD_AXIS MIN_BRK_REQ FCX_FN_TQ_MOTORING_TORQUE 14 0 8000 /end AXIS_DESCR /end CHARACTERISTIC
/begin COMPU_METHOD FCX_FN_TQ_MOTORING_TORQUE "FN_TQ_MOTORING_TORQUE X-axis conversion" RAT_FUNC "%10.5" "RPM" COEFFS 0 1 0 0 0 1 /end COMPU_METHOD
/begin COMPU_METHOD FCY_FN_TQ_MOTORING_TORQUE "FN_TQ_MOTORING_TORQUE Y-axis conversion" RAT_FUNC "%10.5" "unitless" COEFFS 0 1 0 0 0 1 /end COMPU_METHOD
/begin CHARACTERISTIC FN_TQ_TORQUE_CURVE "mormaltorque curve of the engine speed" CURVE 0x4C98C FD_FLOAT32_IEEE 0 FCY_FN_TQ_TORQUE_CURVE -400 1100 /begin AXIS_DESCR STD_AXIS MAX_BRK_REQ FCX_FN_TQ_TORQUE_CURVE 14 0 8000 /end AXIS_DESCR /end CHARACTERISTIC
/begin COMPU_METHOD FCX_FN_TQ_TORQUE_CURVE "FN_TQ_TORQUE_CURVE X-axis conversion" RAT_FUNC "%10.5" "RPM" COEFFS 0 1 0 0 0 1 /end COMPU_METHOD
/begin COMPU_METHOD FCY_FN_TQ_TORQUE_CURVE "FN_TQ_TORQUE_CURVE Y-axis conversion" RAT_FUNC "%10.5" "unitless" COEFFS 0 1 0 0 0 1 /end COMPU_METHOD
/begin CHARACTERISTIC FN_VGT_ACF "" CURVE 0x512BC FD_FLOAT32_IEEE 0 FCY_FN_VGT_ACF -2000 20000 /begin AXIS_DESCR STD_AXIS BP FCX_FN_VGT_ACF 14 0 255.992 /end AXIS_DESCR /end CHARACTERISTIC
/begin COMPU_METHOD FCX_FN_VGT_ACF "FN_VGT_ACF X-axis conversion" RAT_FUNC "%10.5" "unitless" COEFFS 0 1 0 0 0 1 /end COMPU_METHOD
/begin COMPU_METHOD FCY_FN_VGT_ACF "FN_VGT_ACF Y-axis conversion" RAT_FUNC "%10.5" "unitless" COEFFS 0 1 0 0 0 1 /end COMPU_METHOD
/begin CHARACTERISTIC FN_VGT_OSP "" CURVE 0x5147C FD_FLOAT32_IEEE 0 FCY_FN_VGT_OSP 0 1 /begin AXIS_DESCR STD_AXIS VGT_TSP FCX_FN_VGT_OSP 14 0 200000 /end AXIS_DESCR /end CHARACTERISTIC
/begin COMPU_METHOD FCX_FN_VGT_OSP "FN_VGT_OSP X-axis conversion" RAT_FUNC "%10.5" "unitless" COEFFS 0 1 0 0 0 1 /end COMPU_METHOD
/begin COMPU_METHOD FCY_FN_VGT_OSP "FN_VGT_OSP Y-axis conversion" RAT_FUNC "%10.5" "unitless" COEFFS 0 1 0 0 0 1 /end COMPU_METHOD
/begin CHARACTERISTIC FN_VGT_TSP_HI "" CURVE 0x5132C FD_FLOAT32_IEEE 0 FCY_FN_VGT_TSP_HI 0 200000 /begin AXIS_DESCR STD_AXIS MAP_KPA FCX_FN_VGT_TSP_HI 14 0 255.992 /end AXIS_DESCR /end CHARACTERISTIC
/begin COMPU_METHOD FCX_FN_VGT_TSP_HI "FN_VGT_TSP_HI X-axis conversion" RAT_FUNC "%10.5" "unitless" COEFFS 0 1 0 0 0 1 /end COMPU_METHOD
/begin COMPU_METHOD FCY_FN_VGT_TSP_HI "FN_VGT_TSP_HI Y-axis conversion" RAT_FUNC "%10.5" "unitless" COEFFS 0 1 0 0 0 1 /end COMPU_METHOD
/begin CHARACTERISTIC FN_VGT_TSP_LO "" CURVE 0x5139C FD_FLOAT32_IEEE 0 FCY_FN_VGT_TSP_LO 0 200000 /begin AXIS_DESCR STD_AXIS MAP_KPA FCX_FN_VGT_TSP_LO 14 0 255.992 /end AXIS_DESCR /end CHARACTERISTIC
/begin COMPU_METHOD FCX_FN_VGT_TSP_LO "FN_VGT_TSP_LO X-axis conversion" RAT_FUNC "%10.5" "unitless" COEFFS 0 1 0 0 0 1 /end COMPU_METHOD
/begin COMPU_METHOD FCY_FN_VGT_TSP_LO "FN_VGT_TSP_LO Y-axis conversion" RAT_FUNC "%10.5" "unitless" COEFFS 0 1 0 0 0 1 /end COMPU_METHOD
/begin CHARACTERISTIC FN_VGT_TSP_MID "" CURVE 0x5140C FD_FLOAT32_IEEE 0 FCY_FN_VGT_TSP_MID 0 200000 /begin AXIS_DESCR STD_AXIS MAP_KPA FCX_FN_VGT_TSP_MID 14 0 255.992 /end AXIS_DESCR /end CHARACTERISTIC
/begin COMPU_METHOD FCX_FN_VGT_TSP_MID "FN_VGT_TSP_MID X-axis conversion" RAT_FUNC "%10.5" "unitless" COEFFS 0 1 0 0 0 1 /end COMPU_METHOD
/begin COMPU_METHOD FCY_FN_VGT_TSP_MID "FN_VGT_TSP_MID Y-axis conversion" RAT_FUNC "%10.5" "unitless" COEFFS 0 1 0 0 0 1 /end COMPU_METHOD
/begin CHARACTERISTIC FPMP_ON_TM "Maximum time for fuel pump to be on during engine off and OTM tests." VALUE 0x56844 SD_FLOAT32_IEEE 0 SC_FPMP_ON_TM 0 31.875 /end CHARACTERISTIC
/begin COMPU_METHOD SC_FPMP_ON_TM "FPMP_ON_TM conversion" RAT_FUNC "%10.5" "s" COEFFS 0 1 0 0 0 1 /end COMPU_METHOD
/begin MEASUREMENT FPMP_ON_TMR "Timer to limit the on time during engine off testing and output test mode" FLOAT32_IEEE MC_FPMP_ON_TMR 0 0 0 0 ECU_ADDRESS 0x3FA270 /end MEASUREMENT
/begin COMPU_METHOD MC_FPMP_ON_TMR "FPMP_ON_TMR conversion" RAT_FUNC "%10.5" "Unitless" COEFFS 0 1 0 0 0 1 /end COMPU_METHOD
/begin MEASUREMENT FP_CMD "Fuel pump command (on/off)" UBYTE MC_FP_CMD 0 0 0 0 ECU_ADDRESS 0x3FAF70 /end MEASUREMENT
/begin COMPU_METHOD MC_FP_CMD "FP_CMD conversion" RAT_FUNC "%3.0" "Unitless" COEFFS 0 1 0 0 0 1 /end COMPU_METHOD
/begin CHARACTERISTIC FP_EN_CON "Fuel pump control enable flag" VALUE 0x56848 SD_UBYTE 0 SC_FP_EN_CON 0 1 /end CHARACTERISTIC
/begin COMPU_METHOD SC_FP_EN_CON "FP_EN_CON conversion" RAT_FUNC "%3.0" "unitless" COEFFS 0 1 0 0 0 1 /end COMPU_METHOD
/begin MEASUREMENT FP_STATUS "Status of Fuel Pump high level driver ( 0 = ok )" UBYTE MC_FP_STATUS 0 0 0 0 ECU_ADDRESS 0x3FAAC0 /end MEASUREMENT
/begin COMPU_METHOD MC_FP_STATUS "FP_STATUS conversion" RAT_FUNC "%3.0" "Unitless" COEFFS 0 1 0 0 0 1 /end COMPU_METHOD
/begin MEASUREMENT FUEL_FMEM "FUEL system FMEM flag.  1 -> don't run FUEL monitor due to system FMEM." UBYTE MC_FUEL_FMEM 0 0 0 0 ECU_ADDRESS 0x3F9F01 /end MEASUREMENT
/begin COMPU_METHOD MC_FUEL_FMEM "FUEL_FMEM conversion" RAT_FUNC "%3.0" "Unitless" COEFFS 0 1 0 0 0 1 /end COMPU_METHOD
/begin MEASUREMENT FUEL_GOV_DTIME "Fuel governor timer delta time" ULONG MC_FUEL_GOV_DTIME 0 0 0 0 ECU_ADDRESS 0x3FA40C /end MEASUREMENT
/begin COMPU_METHOD MC_FUEL_GOV_DTIME "FUEL_GOV_DTIME conversion" RAT_FUNC "%10.0" "Unitless" COEFFS 0 1 0 0 0 1 /end COMPU_METHOD
/begin MEASUREMENT FUEL_GOV_MSEC "Fuel governor timer last time" ULONG MC_FUEL_GOV_MSEC 0 0 0 0 ECU_ADDRESS 0x3FA404 /end MEASUREMENT
/begin COMPU_METHOD MC_FUEL_GOV_MSEC "FUEL_GOV_MSEC conversion" RAT_FUNC "%10.0" "Unitless" COEFFS 0 1 0 0 0 1 /end COMPU_METHOD
/begin MEASUREMENT FUEL_MON "OBDII monitor flag for fuel system; 1=>all fuel faults been monitored since power-up" UBYTE MC_FUEL_MON 0 0 0 0 ECU_ADDRESS 0x3FADD9 /end MEASUREMENT
/begin COMPU_METHOD MC_FUEL_MON "FUEL_MON conversion" RAT_FUNC "%3.0" "Unitless" COEFFS 0 1 0 0 0 1 /end COMPU_METHOD
/begin MEASUREMENT FUEL_TST_ENA "OBD-II Fuel Test enable flag. (1 => test enabled)" UBYTE MC_FUEL_TST_ENA 0 0 0 0 ECU_ADDRESS 0x3F9EE3 /end MEASUREMENT
/begin COMPU_METHOD MC_FUEL_TST_ENA "FUEL_TST_ENA conversion" RAT_FUNC "%3.0" "Unitless" COEFFS 0 1 0 0 0 1 /end COMPU_METHOD
/begin CHARACTERISTIC GAP_RATIO "" VALUE 0x572C8 SD_FLOAT32_IEEE 0 SC_GAP_RATIO 0 2 /end CHARACTERISTIC
/begin COMPU_METHOD SC_GAP_RATIO "GAP_RATIO conversion" RAT_FUNC "%10.5" "unitless" COEFFS 0 1 0 0 0 1 /end COMPU_METHOD
/begin MEASUREMENT GOVFLRTMR "Governor Flair Timer" ULONG MC_GOVFLRTMR 0 0 0 0 ECU_ADDRESS 0x3FA3F0 /end MEASUREMENT
/begin COMPU_METHOD MC_GOVFLRTMR "GOVFLRTMR conversion" RAT_FUNC "%10.0" "Unitless" COEFFS 0 1 0 0 0 1 /end COMPU_METHOD
/begin MEASUREMENT GOV_CL "0=Open Loop 1=Closed Loop, Governor Control" UBYTE MC_GOV_CL 0 0 0 0 ECU_ADDRESS 0x3FA2ED /end MEASUREMENT
/begin COMPU_METHOD MC_GOV_CL "GOV_CL conversion" RAT_FUNC "%3.0" "Unitless" COEFFS 0 1 0 0 0 1 /end COMPU_METHOD
/begin CHARACTERISTIC GOV_CLP_MULT "Governor integral clamp multiplier" VALUE 0x5698C SD_FLOAT32_IEEE 0 SC_GOV_CLP_MULT 0 2 /end CHARACTERISTIC
/begin COMPU_METHOD SC_GOV_CLP_MULT "GOV_CLP_MULT conversion" RAT_FUNC "%10.5" "unitless" COEFFS 0 1 0 0 0 1 /end COMPU_METHOD
/begin MEASUREMENT GOV_I_CLAMP "MFGOV_I clamping logic (1=Clamp)" UBYTE MC_GOV_I_CLAMP 0 0 0 0 ECU_ADDRESS 0x3FA2F0 /end MEASUREMENT
/begin COMPU_METHOD MC_GOV_I_CLAMP "GOV_I_CLAMP conversion" RAT_FUNC "%3.0" "Unitless" COEFFS 0 1 0 0 0 1 /end COMPU_METHOD
/begin CHARACTERISTIC GOV_KI_NORM "governor integral gain normal" VALUE 0x569AC SD_FLOAT32_IEEE 0 SC_GOV_KI_NORM 0 3 /end CHARACTERISTIC
/begin COMPU_METHOD SC_GOV_KI_NORM "GOV_KI_NORM conversion" RAT_FUNC "%10.5" "unitless" COEFFS 0 1 0 0 0 1 /end COMPU_METHOD
/begin CHARACTERISTIC GOV_KI_NORM_P "governor integral gain - pilot mode" VALUE 0x569A8 SD_FLOAT32_IEEE 0 SC_GOV_KI_NORM_P 0 3 /end CHARACTERISTIC
/begin COMPU_METHOD SC_GOV_KI_NORM_P "GOV_KI_NORM_P conversion" RAT_FUNC "%10.5" "unitless" COEFFS 0 1 0 0 0 1 /end COMPU_METHOD
/begin MEASUREMENT GOV_KP "Isochronous governor proportional gain" FLOAT32_IEEE MC_GOV_KP 0 0 0 0 ECU_ADDRESS 0x3FA2B8 /end MEASUREMENT
/begin COMPU_METHOD MC_GOV_KP "GOV_KP conversion" RAT_FUNC "%10.5" "Unitless" COEFFS 0 1 0 0 0 1 /end COMPU_METHOD
/begin CHARACTERISTIC GOV_NERR_CLP "Engine speed error for integral clamping" VALUE 0x56998 SD_FLOAT32_IEEE 0 SC_GOV_NERR_CLP -1000 1000 /end CHARACTERISTIC
/begin COMPU_METHOD SC_GOV_NERR_CLP "GOV_NERR_CLP conversion" RAT_FUNC "%10.5" "RPM" COEFFS 0 1 0 0 0 1 /end COMPU_METHOD
/begin CHARACTERISTIC GPCDTY_FULON "" VALUE 0x56E28 SD_FLOAT32_IEEE 0 SC_GPCDTY_FULON 0 1 /end CHARACTERISTIC
/begin COMPU_METHOD SC_GPCDTY_FULON "GPCDTY_FULON conversion" RAT_FUNC "%10.5" "unitless" COEFFS 0 1 0 0 0 1 /end COMPU_METHOD
/begin CHARACTERISTIC GPCEN_FLG "1= Glow Plug option ON" VALUE 0x56E38 SD_UBYTE 0 SC_GPCEN_FLG 0 1 /end CHARACTERISTIC
/begin COMPU_METHOD SC_GPCEN_FLG "GPCEN_FLG conversion" RAT_FUNC "%3.0" "unitless" COEFFS 0 1 0 0 0 1 /end COMPU_METHOD
/begin MEASUREMENT GPC_DTY "Glow Plug coil duty cycle commanded" FLOAT32_IEEE MC_GPC_DTY 0 0 0 0 ECU_ADDRESS 0x3FA618 /end MEASUREMENT
/begin COMPU_METHOD MC_GPC_DTY "GPC_DTY conversion" RAT_FUNC "%10.5" "Unitless" COEFFS 0 1 0 0 0 1 /end COMPU_METHOD
/begin MEASUREMENT GPC_PRD "Glow Plug coil period commanded" UWORD MC_GPC_PRD 0 0 0 0 ECU_ADDRESS 0x3FA624 /end MEASUREMENT
/begin COMPU_METHOD MC_GPC_PRD "GPC_PRD conversion" RAT_FUNC "%5.0" "Unitless" COEFFS 0 1 0 0 0 1 /end COMPU_METHOD
/begin MEASUREMENT GPC_PRD_CNTR "" UBYTE MC_GPC_PRD_CNTR 0 0 0 0 ECU_ADDRESS 0x3FAAC4 /end MEASUREMENT
/begin COMPU_METHOD MC_GPC_PRD_CNTR "GPC_PRD_CNTR conversion" RAT_FUNC "%3.0" "Unitless" COEFFS 0 1 0 0 0 1 /end COMPU_METHOD
/begin MEASUREMENT GPC_TIMER "Glow plug coil timer" FLOAT32_IEEE MC_GPC_TIMER 0 0 0 0 ECU_ADDRESS 0x3FA620 /end MEASUREMENT
/begin COMPU_METHOD MC_GPC_TIMER "GPC_TIMER conversion" RAT_FUNC "%10.5" "Unitless" COEFFS 0 1 0 0 0 1 /end COMPU_METHOD
/begin MEASUREMENT GPC_TM "Glow plugs activation time FINAL (sec)" FLOAT32_IEEE MC_GPC_TM 0 0 0 0 ECU_ADDRESS 0x3FA614 /end MEASUREMENT
/begin COMPU_METHOD MC_GPC_TM "GPC_TM conversion" RAT_FUNC "%10.5" "Unitless" COEFFS 0 1 0 0 0 1 /end COMPU_METHOD
/begin CHARACTERISTIC GPC_TM_MAX "Glow plug control 'ON' time Maximum" VALUE 0x56E30 SD_FLOAT32_IEEE 0 SC_GPC_TM_MAX 0.125 120 /end CHARACTERISTIC
/begin COMPU_METHOD SC_GPC_TM_MAX "GPC_TM_MAX conversion" RAT_FUNC "%10.5" "s" COEFFS 0 1 0 0 0 1 /end COMPU_METHOD
/begin CHARACTERISTIC GPC_WAIT_TM "Glow plug control wait time (sec)" VALUE 0x56E2C SD_FLOAT32_IEEE 0 SC_GPC_WAIT_TM 0.125 10 /end CHARACTERISTIC
/begin COMPU_METHOD SC_GPC_WAIT_TM "GPC_WAIT_TM conversion" RAT_FUNC "%10.5" "s" COEFFS 0 1 0 0 0 1 /end COMPU_METHOD
/begin MEASUREMENT GPL_BP_TM "Glow plug lamp activation time based on BP (sec)" FLOAT32_IEEE MC_GPL_BP_TM 0 0 0 0 ECU_ADDRESS 0x3FA610 /end MEASUREMENT
/begin COMPU_METHOD MC_GPL_BP_TM "GPL_BP_TM conversion" RAT_FUNC "%10.5" "Unitless" COEFFS 0 1 0 0 0 1 /end COMPU_METHOD
/begin MEASUREMENT GPL_FLG "Glow Plug lamp on/off flag" UBYTE MC_GPL_FLG 0 0 0 0 ECU_ADDRESS 0x3FA627 /end MEASUREMENT
/begin COMPU_METHOD MC_GPL_FLG "GPL_FLG conversion" RAT_FUNC "%3.0" "Unitless" COEFFS 0 1 0 0 0 1 /end COMPU_METHOD
/begin MEASUREMENT GPL_TM "Glow plug lamp activation time FINAL (sec)" FLOAT32_IEEE MC_GPL_TM 0 0 0 0 ECU_ADDRESS 0x3FA60C /end MEASUREMENT
/begin COMPU_METHOD MC_GPL_TM "GPL_TM conversion" RAT_FUNC "%10.5" "Unitless" COEFFS 0 1 0 0 0 1 /end COMPU_METHOD
/begin CHARACTERISTIC GPL_TM_MAX "Glow plug lamp 'ON' time Maximum" VALUE 0x56E24 SD_FLOAT32_IEEE 0 SC_GPL_TM_MAX 0.125 30 /end CHARACTERISTIC
/begin COMPU_METHOD SC_GPL_TM_MAX "GPL_TM_MAX conversion" RAT_FUNC "%10.5" "s" COEFFS 0 1 0 0 0 1 /end COMPU_METHOD
/begin MEASUREMENT GP_COMP_FLG "Glow Plug cycle complete flag (1=complete)" UBYTE MC_GP_COMP_FLG 0 0 0 0 ECU_ADDRESS 0x3FA626 /end MEASUREMENT
/begin COMPU_METHOD MC_GP_COMP_FLG "GP_COMP_FLG conversion" RAT_FUNC "%3.0" "Unitless" COEFFS 0 1 0 0 0 1 /end COMPU_METHOD
/begin CHARACTERISTIC GP_CON_SW "Glow plug control switch (0 = Glow Plug Relay [default]; 1 = Glow Plug Control Module [GPCM])" VALUE 0x57B52 SD_UBYTE 0 SC_GP_CON_SW 0 1 /end CHARACTERISTIC
/begin COMPU_METHOD SC_GP_CON_SW "GP_CON_SW conversion" RAT_FUNC "%3.0" "unitless" COEFFS 0 1 0 0 0 1 /end COMPU_METHOD
/begin MEASUREMENT GP_ENG_WAS_STALLED "Glow plug control-Engine was stalled indication flag" UBYTE MC_GP_ENG_WAS_STALLED 0 0 0 0 ECU_ADDRESS 0x3FA609 /end MEASUREMENT
/begin COMPU_METHOD MC_GP_ENG_WAS_STALLED "GP_ENG_WAS_STALLED conversion" RAT_FUNC "%3.0" "Unitless" COEFFS 0 1 0 0 0 1 /end COMPU_METHOD
/begin CHARACTERISTIC GP_PONTM "Time after power up to set FIRST_GP_PRD flag" VALUE 0x56E34 SD_FLOAT32_IEEE 0 SC_GP_PONTM 0.125 120 /end CHARACTERISTIC
/begin COMPU_METHOD SC_GP_PONTM "GP_PONTM conversion" RAT_FUNC "%10.5" "s" COEFFS 0 1 0 0 0 1 /end COMPU_METHOD
/begin CHARACTERISTIC GP_STALL_SW "Allows Glow Plug reactivation on engine stall" VALUE 0x56E39 SD_UBYTE 0 SC_GP_STALL_SW 0 1 /end CHARACTERISTIC
/begin COMPU_METHOD SC_GP_STALL_SW "GP_STALL_SW conversion" RAT_FUNC "%3.0" "unitless" COEFFS 0 1 0 0 0 1 /end COMPU_METHOD
/begin MEASUREMENT HALF_PIP_RAW "unvalidated period between the last two PIP transitions." FLOAT32_IEEE MC_HALF_PIP_RAW 0 0 0 0 ECU_ADDRESS 0x3FA97C /end MEASUREMENT
/begin COMPU_METHOD MC_HALF_PIP_RAW "HALF_PIP_RAW conversion" RAT_FUNC "%10.5" "Unitless" COEFFS 0 1 0 0 0 1 /end COMPU_METHOD
/begin MEASUREMENT HEGO_FAULT "Flag indicating at least one EGO sensor is faulted." UBYTE MC_HEGO_FAULT 0 0 0 0 ECU_ADDRESS 0x3FADE0 /end MEASUREMENT
/begin COMPU_METHOD MC_HEGO_FAULT "HEGO_FAULT conversion" RAT_FUNC "%3.0" "Unitless" COEFFS 0 1 0 0 0 1 /end COMPU_METHOD
/begin MEASUREMENT HEGO_FDBACK "Flag indicating normal closed loop operation." UBYTE MC_HEGO_FDBACK 0 0 0 0 ECU_ADDRESS 0x3FADE1 /end MEASUREMENT
/begin COMPU_METHOD MC_HEGO_FDBACK "HEGO_FDBACK conversion" RAT_FUNC "%3.0" "Unitless" COEFFS 0 1 0 0 0 1 /end COMPU_METHOD
/begin MEASUREMENT HI_ALT_BP_MULT "High altitude barometric multiplier." FLOAT32_IEEE MC_HI_ALT_BP_MULT 0 0 0 0 ECU_ADDRESS 0x3F9F54 /end MEASUREMENT
/begin COMPU_METHOD MC_HI_ALT_BP_MULT "HI_ALT_BP_MULT conversion" RAT_FUNC "%10.5" "Unitless" COEFFS 0 1 0 0 0 1 /end COMPU_METHOD
/begin MEASUREMENT HLD_AC_TMR_D "Timer to control how long to hold the A/C in its current state." FLOAT32_IEEE MC_HLD_AC_TMR_D 0 0 0 0 ECU_ADDRESS 0x3F9E80 /end MEASUREMENT
/begin COMPU_METHOD MC_HLD_AC_TMR_D "HLD_AC_TMR_D conversion" RAT_FUNC "%10.5" "Unitless" COEFFS 0 1 0 0 0 1 /end COMPU_METHOD
/begin CHARACTERISTIC HLD_AC_TM_D "Time to disallow A/C to change state during gear shifts" VALUE 0x5624C SD_FLOAT32_IEEE 0 SC_HLD_AC_TM_D 0 65535 /end CHARACTERISTIC
/begin COMPU_METHOD SC_HLD_AC_TM_D "HLD_AC_TM_D conversion" RAT_FUNC "%10.5" "s" COEFFS 0 1 0 0 0 1 /end COMPU_METHOD
/begin CHARACTERISTIC HPDLCOT "Maximum time to disable A/C after high pedal" VALUE 0x56278 SD_FLOAT32_IEEE 0 SC_HPDLCOT 0 62 /end CHARACTERISTIC
/begin COMPU_METHOD SC_HPDLCOT "HPDLCOT conversion" RAT_FUNC "%10.5" "s" COEFFS 0 1 0 0 0 1 /end COMPU_METHOD
/begin MEASUREMENT HYD_MULT_ACTV "Hydraulic  multiplier active flag from CAN" UBYTE MC_HYD_MULT_ACTV 0 0 0 0 ECU_ADDRESS 0x3FADE3 /end MEASUREMENT
/begin COMPU_METHOD MC_HYD_MULT_ACTV "HYD_MULT_ACTV conversion" RAT_FUNC "%3.0" "Unitless" COEFFS 0 1 0 0 0 1 /end COMPU_METHOD
/begin MEASUREMENT IAT " Alternator generation current" FLOAT32_IEEE MC_IAT 0 0 0 0 ECU_ADDRESS 0x3FA1DC /end MEASUREMENT
/begin COMPU_METHOD MC_IAT "IAT conversion" RAT_FUNC "%10.5" "Unitless" COEFFS 0 1 0 0 0 1 /end COMPU_METHOD
/begin CHARACTERISTIC IAT_AD_TC "IAT filter time constant" VALUE 0x5678C SD_FLOAT32_IEEE 0 SC_IAT_AD_TC 0 64 /end CHARACTERISTIC
/begin COMPU_METHOD SC_IAT_AD_TC "IAT_AD_TC conversion" RAT_FUNC "%10.5" "s" COEFFS 0 1 0 0 0 1 /end COMPU_METHOD
/begin MEASUREMENT IAT_CNTS "Intake air temperature sensor A/D counts" SLONG MC_IAT_CNTS 0 0 0 0 ECU_ADDRESS 0x3FAA7C /end MEASUREMENT
/begin COMPU_METHOD MC_IAT_CNTS "IAT_CNTS conversion" RAT_FUNC "%10.0" "Unitless" COEFFS 0 1 0 0 0 1 /end COMPU_METHOD
/begin CHARACTERISTIC IAT_DEF "Default FMEM value for intake air temperature" VALUE 0x56794 SD_FLOAT32_IEEE 0 SC_IAT_DEF -40 150 /end CHARACTERISTIC
/begin COMPU_METHOD SC_IAT_DEF "IAT_DEF conversion" RAT_FUNC "%10.5" "degC" COEFFS 0 1 0 0 0 1 /end COMPU_METHOD
/begin RECORD_LAYOUT SD_UBYTE FNC_VALUES 1 UBYTE ROW_DIR DIRECT /end RECORD_LAYOUT
/begin RECORD_LAYOUT SD_FLOAT32_IEEE FNC_VALUES 1 FLOAT32_IEEE ROW_DIR DIRECT /end RECORD_LAYOUT
/begin RECORD_LAYOUT FD_FLOAT32_IEEE AXIS_PTS_X 1 FLOAT32_IEEE INDEX_INCR DIRECT FNC_VALUES 2 FLOAT32_IEEE ALTERNATE_WITH_X DIRECT /end RECORD_LAYOUT
/begin RECORD_LAYOUT TD_FLOAT32_IEEE FNC_VALUES 1 FLOAT32_IEEE ROW_DIR DIRECT /end RECORD_LAYOUT
/end MODULE
/end PROJECT
